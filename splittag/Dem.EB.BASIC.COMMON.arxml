AUTOSAR XML (schema 4-0-3)
package /Dem
  module config Dem: implementation-config-variant=VARIANT-PRE-COMPILE
    DemGeneral: DemMaxNumberEventEntryPrimary=1, DemReportBSWEventsViaSetEventStatus=1
      CLIENT_0 (DemClient): DemClientId=0
      DEM_OPCYC_POWER (DemOperationCycle): DemOperationCycleAutomaticEnd=0, DemOperationCycleType=DEM_OPCYC_POWER
