AUTOSAR XML (schema 4-3-0)
package /CANInterface_ARPkg
  13 x sender receiver interface:
    IF_CAN3_SG_BMS1
      data CAN3_SG_BMS1: type=DT_CAN3_SG_BMS1
    IF_CAN3_SG_BMS6
      data CAN3_SG_BMS6: type=DT_CAN3_SG_BMS6
    IF_CAN3_SG_FD3_C100_0
      data CAN3_SG_FD3_C100_0: type=DT_CAN3_SG_FD3_C100_0
    IF_CAN3_SG_FD3_VCU1
      data CAN3_SG_FD3_VCU1: type=DT_CAN3_SG_FD3_VCU1
    IF_CAN3_SG_FD3_VCU2
      data CAN3_SG_FD3_VCU2: type=DT_CAN3_SG_FD3_VCU2
    IF_CAN3_SG_FD3_VCU5
      data CAN3_SG_FD3_VCU5: type=DT_CAN3_SG_FD3_VCU5
    IF_CAN3_SG_GW3_CE100_0
      data CAN3_SG_GW3_CE100_0: type=DT_CAN3_SG_GW3_CE100_0
    IF_CAN3_SG_MCU_B_R1
      data CAN3_SG_MCU_B_R1: type=DT_CAN3_SG_MCU_B_R1
    IF_CAN3_SG_MCU_B_R2
      data CAN3_SG_MCU_B_R2: type=DT_CAN3_SG_MCU_B_R2
    IF_CAN3_SG_MCU_B_R_Debug1
      data CAN3_SG_MCU_B_R_Debug1: type=DT_CAN3_SG_MCU_B_R_Debug1
    IF_CAN3_SG_MCU_FVT_R1
      data CAN3_SG_MCU_FVT_R1: type=DT_CAN3_SG_MCU_FVT_R1
    IF_CAN_MCU_R1_SG_EOP_FVT_R_Local1
      data CAN_MCU_R1_SG_EOP_FVT_R_Local1: type=DT_CAN_MCU_R1_SG_EOP_FVT_R_Local1
    IF_CAN_MCU_R1_SG_MCU_FVT_R_Local1
      data CAN_MCU_R1_SG_MCU_FVT_R_Local1: type=DT_CAN_MCU_R1_SG_MCU_FVT_R_Local1
