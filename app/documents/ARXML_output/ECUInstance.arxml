AUTOSAR XML (schema 4-3-0)
package /ECU
  ecu instance MCU: associated-com-i-pdu-group=[MCU_B_R_CAN3_Tx, MCU_B_R_CAN3_Rx, MCU_B_R_CAN_MCU_R1_Tx, MCU_B_R_CAN_MCU_R1_Rx], com-configuration-gw-time-base=0.005, com-configuration-rx-time-base=0.005, com-configuration-tx-time-base=0.005
    can communication controller CAN3
    can communication controller CAN_MCU_R1
    can communication connector ConnCAN3: comm-controller=CAN3
    can communication connector ConnCAN_MCU_R1: comm-controller=CAN_MCU_R1
