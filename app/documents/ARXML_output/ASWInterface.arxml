AUTOSAR XML (schema 4-3-0)
package /ASWInterface_ARPkg
  sender receiver interface IF_HiRateTxLoRateRx
    data HiRateTxLoRateRx: type=DT_HiRateTxLoRateRx
  sender receiver interface IF_LoRateTxHiRateRx
    data LoRateTxHiRateRx: type=DT_LoRateTxHiRateRx
package /DataTypeDef_ARPkg
  impl type DT_HiRateTxLoRateRx: category=STRUCTURE
    20 x element, all with category=TYPE_REFERENCE:
      f32_DSS_uDCSide: implementation-data-type=float32
      f32_RotS_nRot: implementation-data-type=float32
      f32_RotS_agRot: implementation-data-type=float32
      f32_PCS_iPaCS: implementation-data-type=float32
      f32_PCS_iPbCS: implementation-data-type=float32
      f32_PCS_iPcCS: implementation-data-type=float32
      u8_PCS_bOverCurr: implementation-data-type=uint8
      f32_TorqEst_tqMotEst: implementation-data-type=float32
      f32_CCM_uDVoltTar: implementation-data-type=float32
      f32_CCM_uQVoltTar: implementation-data-type=float32
      f32_CCM_iDCurrAct: implementation-data-type=float32
      f32_CCM_iQCurrAct: implementation-data-type=float32
      u8_Diag_bPhaCurrOverU: implementation-data-type=uint8
      u8_Diag_bPhaCurrOverV: implementation-data-type=uint8
      u8_Diag_bPhaCurrOverW: implementation-data-type=uint8
      u8_Diag1_b1_SumErr_null: implementation-data-type=uint8
      f32_VCCM_BattVolCirRadius_V: implementation-data-type=float32
      f32_VCCM_VcmdBfLim_V: implementation-data-type=float32
      f32_VMCM_TqAct_Nm: implementation-data-type=float32
      u8_VDSM_FltActn12_flg: implementation-data-type=uint8
  impl type DT_LoRateTxHiRateRx: category=STRUCTURE
    6 x element, all with category=TYPE_REFERENCE:
      u8_OpMod_stMotAct: implementation-data-type=uint8
      u8_OpMod_stIvtrTar: implementation-data-type=uint8
      f32_SysLim_frqSwitchMax: implementation-data-type=float32
      f32_VMCM_IdCmd_A: implementation-data-type=float32
      f32_VMCM_IqCmd_A: implementation-data-type=float32
      u8_VDSM_FltActn22_flg: implementation-data-type=uint8
