AUTOSAR XML (schema 4-0-3)
package /CanIf
  module config CanIf: implementation-config-variant=VARIANT-POST-BUILD
    CanIfCtrlDrvCfg_0 (CanIfCtrlDrvCfg): CanIfCtrlDrvTxCancellation=0, CanIfCtrlDrvInitHohConfigRef=CanIfInitHohCfg, CanIfCtrlDrvNameRef=CanGeneral
      3 x CanIfCtrlCfg, all with CanIfCtrlMaxRxNotifyPdus=64, CanIfCtrlMaxTxNotifyPdus=64, CanIfCtrlWakeupSupport=0:
        CAN3: CanIfCtrlCanCtrlRef=CAN3
        CAN_EOP: CanIfCtrlId=2, CanIfCtrlCanCtrlRef=CAN_EOP
        CAN_Xcp: CanIfCtrlId=1, CanIfCtrlCanCtrlRef=CAN_XCP
    CanIfDecoupledMeasurementSupport:
      CanIfNumberOfEnqueuedRxPdusApiName = 
      CanIfNumberOfEnqueuedTxPdusApiName = 
      CanIfNumberOfRxPdusExceedingQueueApiName = 
      CanIfNumberOfTxPdusExceedingQueueApiName = 
      CanIfRxDecoupledMeasurementSupport = 0
      CanIfTxDecoupledMeasurementSupport = 0
    CanIfDefensiveProgramming:
      CanIfDefProgEnabled = 0
      CanIfInvariantAssertEnabled = 0
      CanIfPostcondAssertEnabled = 0
      CanIfPrecondAssertEnabled = 0
      CanIfStaticAssertEnabled = 0
      CanIfUnreachAssertEnabled = 0
    CanIfDispatchCfg:
      CanIfDispatchUserConfirmPnAvailabilityName = (unset)
      CanIfDispatchUserConfirmPnAvailabilityUL = CAN_SM
      CanIfDispatchUserCtrlBusOffName = (unset)
      CanIfDispatchUserCtrlBusOffUL = CAN_SM
      CanIfDispatchUserCtrlModeIndicationName = (unset)
      CanIfDispatchUserCtrlModeIndicationUL = CAN_SM
      CanIfDispatchUserSetWakeupEventName = (unset)
      CanIfDispatchUserSetWakeupEventUL = ECUM
      CanIfDispatchUserTrcvModeIndicationName = (unset)
      CanIfDispatchUserTrcvModeIndicationUL = CAN_SM
      CanIfDispatchUserValidateWakeupEventName = (unset)
      CanIfDispatchUserValidateWakeupEventUL = (unset)
    CanIfHookOnRxSupport: CanIfHookOnReceptionFunctionName=(unset), CanIfHookOnReceptionHeader=(unset)
    CanIf_InitCfg (CanIfInitCfg): CanIfInitCfgSet=
      3 x CanIfBufferCfg, all with CanIfBufferSize=0:
        HOH_TX_0_CAN3: CanIfBufferHthRef=CanIfInitHohCfg/HOH_TX_0_CAN3
        HOH_TX_0_CAN_EOP: CanIfBufferHthRef=CanIfInitHohCfg/HOH_TX_0_CAN_EOP
        HOH_TX_0_CAN_Xcp: CanIfBufferHthRef=CanIfInitHohCfg/HOH_TX_0_CAN_Xcp
      CanIfInitHohCfg: CanIfInitRefCfgSet=CanConfigSet
        9 x CanIfHrhCfg, all with CanIfHrhSoftwareFilter=0:
          HOH_{1..7}_CAN3: CanIfHrhCanCtrlIdRef=CAN3, CanIfHrhIdSymRef=HOH_{1..7}_CAN3
          HOH_1_CAN_MCU_R1: CanIfHrhCanCtrlIdRef=CAN_EOP, CanIfHrhIdSymRef=HOH_1_CAN_MCU_R1
          HOH_1_CAN_Xcp: CanIfHrhCanCtrlIdRef=CAN_Xcp, CanIfHrhIdSymRef=HOH_1_CAN_Xcp
        3 x CanIfHthCfg:
          HOH_TX_0_CAN3: CanIfHthCanCtrlIdRef=CAN3, CanIfHthIdSymRef=HOH_TX_0_CAN3
          HOH_TX_0_CAN_EOP: CanIfHthCanCtrlIdRef=CAN_EOP, CanIfHthIdSymRef=HOH_TX_0_CAN_EOP
          HOH_TX_0_CAN_Xcp: CanIfHthCanCtrlIdRef=CAN_Xcp, CanIfHthIdSymRef=HOH_TX_0_CAN_Xcp
      9 x CanIfRxPduCfg, all with CanIfRxPduCanIdMask=536870911, CanIfRxPduReadData=0, CanIfRxPduReadNotifyStatus=0, CanIfRxPduUserRxIndicationName=, CanIfRxPduBswSchExclAreaIdRef=(unset):
        CAN3_BMS1_369R: CanIfRxPduCanId=369, CanIfRxPduCanIdType=STANDARD_FD_CAN, CanIfRxPduDlc=16, CanIfRxPduId=0, CanIfRxPduTargetPduID=(unset), CanIfRxPduUserRxIndicationUL=PDUR, CanIfRxPduHrhIdRef=HOH_4_CAN3, CanIfRxPduRef=CAN3_BMS1_369R, CanIfRxPduUpperLayerRef=(unset)
          CanIfTTRxFrameTriggering: CanIfTTRxHwObjectTriggerIdRef=(unset)
        CAN3_BMS6_378R: CanIfRxPduCanId=378, CanIfRxPduCanIdType=STANDARD_FD_CAN, CanIfRxPduDlc=12, CanIfRxPduId=1, CanIfRxPduTargetPduID=(unset), CanIfRxPduUserRxIndicationUL=PDUR, CanIfRxPduHrhIdRef=HOH_5_CAN3, CanIfRxPduRef=CAN3_BMS6_378R, CanIfRxPduUpperLayerRef=(unset)
          CanIfTTRxFrameTriggering: CanIfTTRxHwObjectTriggerIdRef=(unset)
        CAN3_FD3_C100_0_386R: CanIfRxPduCanId=386, CanIfRxPduCanIdType=STANDARD_FD_CAN, CanIfRxPduDlc=20, CanIfRxPduId=2, CanIfRxPduTargetPduID=(unset), CanIfRxPduUserRxIndicationUL=PDUR, CanIfRxPduHrhIdRef=HOH_6_CAN3, CanIfRxPduRef=CAN3_FD3_C100_0_386R, CanIfRxPduUpperLayerRef=(unset)
          CanIfTTRxFrameTriggering: CanIfTTRxHwObjectTriggerIdRef=(unset)
        CAN3_FD3_VCU1_277R: CanIfRxPduCanId=277, CanIfRxPduCanIdType=STANDARD_FD_CAN, CanIfRxPduDlc=8, CanIfRxPduId=3, CanIfRxPduTargetPduID=(unset), CanIfRxPduUserRxIndicationUL=PDUR, CanIfRxPduHrhIdRef=HOH_1_CAN3, CanIfRxPduRef=CAN3_FD3_VCU1_277R, CanIfRxPduUpperLayerRef=(unset)
          CanIfTTRxFrameTriggering: CanIfTTRxHwObjectTriggerIdRef=(unset)
        CAN3_FD3_VCU2_339R: CanIfRxPduCanId=339, CanIfRxPduCanIdType=STANDARD_FD_CAN, CanIfRxPduDlc=32, CanIfRxPduId=4, CanIfRxPduTargetPduID=(unset), CanIfRxPduUserRxIndicationUL=PDUR, CanIfRxPduHrhIdRef=HOH_2_CAN3, CanIfRxPduRef=CAN3_FD3_VCU2_339R, CanIfRxPduUpperLayerRef=(unset)
          CanIfTTRxFrameTriggering: CanIfTTRxHwObjectTriggerIdRef=(unset)
        CAN3_FD3_VCU5_341R: CanIfRxPduCanId=341, CanIfRxPduCanIdType=STANDARD_FD_CAN, CanIfRxPduDlc=32, CanIfRxPduId=5, CanIfRxPduTargetPduID=(unset), CanIfRxPduUserRxIndicationUL=PDUR, CanIfRxPduHrhIdRef=HOH_3_CAN3, CanIfRxPduRef=CAN3_FD3_VCU5_341R, CanIfRxPduUpperLayerRef=(unset)
          CanIfTTRxFrameTriggering: CanIfTTRxHwObjectTriggerIdRef=(unset)
        CAN3_GW3_CE100_0_451R: CanIfRxPduCanId=451, CanIfRxPduCanIdType=STANDARD_FD_CAN, CanIfRxPduDlc=32, CanIfRxPduId=6, CanIfRxPduTargetPduID=(unset), CanIfRxPduUserRxIndicationUL=PDUR, CanIfRxPduHrhIdRef=HOH_7_CAN3, CanIfRxPduRef=CAN3_GW3_CE100_0_451R, CanIfRxPduUpperLayerRef=(unset)
          CanIfTTRxFrameTriggering: CanIfTTRxHwObjectTriggerIdRef=(unset)
        CAN_MCU_R1_EOP_FVT_R_Local1_1012R: CanIfRxPduCanId=1012, CanIfRxPduCanIdType=STANDARD_NO_FD_CAN, CanIfRxPduDlc=8, CanIfRxPduId=7, CanIfRxPduTargetPduID=(unset), CanIfRxPduUserRxIndicationUL=PDUR, CanIfRxPduHrhIdRef=HOH_1_CAN_MCU_R1, CanIfRxPduRef=CAN_MCU_R1_EOP_FVT_R_Local1_1012R, CanIfRxPduUpperLayerRef=(unset)
          CanIfTTRxFrameTriggering: CanIfTTRxHwObjectTriggerIdRef=(unset)
        XCP_1639R: CanIfRxPduCanId=1639, CanIfRxPduCanIdType=STANDARD_CAN, CanIfRxPduDlc=0, CanIfRxPduId=8, CanIfRxPduTargetPduID=0, CanIfRxPduUserRxIndicationUL=CDD, CanIfRxPduHrhIdRef=HOH_1_CAN_Xcp, CanIfRxPduRef=XCP_1639R, CanIfRxPduUpperLayerRef=XCP
          CanIfTTRxFrameTriggering: CanIfTTRxHwObjectTriggerIdRef=(unset)
      6 x CanIfTxPduCfg, all with CanIfTxPduCanIdMask=536870911, CanIfTxPduPnFilterPdu=0, CanIfTxPduReadNotifyStatus=0, CanIfTxPduTruncateToFrame=1, CanIfTxPduTruncation=1, CanIfTxPduType=STATIC, CanIfTxPduUserTxConfirmationName=, CanIfTxPduBswSchExclAreaIdRef=(unset):
        CAN3_MCU_B_R1_400T: CanIfTxPduCanId=400, CanIfTxPduCanIdType=STANDARD_FD_CAN, CanIfTxPduDlc=32, CanIfTxPduId=0, CanIfTxPduSourcePduID=(unset), CanIfTxPduUserTxConfirmationUL=PDUR, CanIfTxPduBufferRef=CanIf_InitCfg/HOH_TX_0_CAN3, CanIfTxPduRef=CAN3_MCU_B_R1_400T, CanIfTxPduUpperLayerRef=(unset)
          CanIfTTTxFrameTriggering: CanIfTTTxHwObjectTriggerIdRef=(unset)
        CAN3_MCU_B_R2_403T: CanIfTxPduCanId=403, CanIfTxPduCanIdType=STANDARD_FD_CAN, CanIfTxPduDlc=16, CanIfTxPduId=1, CanIfTxPduSourcePduID=(unset), CanIfTxPduUserTxConfirmationUL=PDUR, CanIfTxPduBufferRef=CanIf_InitCfg/HOH_TX_0_CAN3, CanIfTxPduRef=CAN3_MCU_B_R2_403T, CanIfTxPduUpperLayerRef=(unset)
          CanIfTTTxFrameTriggering: CanIfTTTxHwObjectTriggerIdRef=(unset)
        CAN3_MCU_B_R_Debug1_1269T: CanIfTxPduCanId=1269, CanIfTxPduCanIdType=STANDARD_FD_CAN, CanIfTxPduDlc=32, CanIfTxPduId=2, CanIfTxPduSourcePduID=(unset), CanIfTxPduUserTxConfirmationUL=PDUR, CanIfTxPduBufferRef=CanIf_InitCfg/HOH_TX_0_CAN3, CanIfTxPduRef=CAN3_MCU_B_R_Debug1_1269T, CanIfTxPduUpperLayerRef=(unset)
          CanIfTTTxFrameTriggering: CanIfTTTxHwObjectTriggerIdRef=(unset)
        CAN3_MCU_FVT_R1_409T: CanIfTxPduCanId=409, CanIfTxPduCanIdType=STANDARD_FD_CAN, CanIfTxPduDlc=20, CanIfTxPduId=3, CanIfTxPduSourcePduID=(unset), CanIfTxPduUserTxConfirmationUL=PDUR, CanIfTxPduBufferRef=CanIf_InitCfg/HOH_TX_0_CAN3, CanIfTxPduRef=CAN3_MCU_FVT_R1_409T, CanIfTxPduUpperLayerRef=(unset)
          CanIfTTTxFrameTriggering: CanIfTTTxHwObjectTriggerIdRef=(unset)
        CAN_MCU_R1_MCU_FVT_R_Local1_1008T: CanIfTxPduCanId=1008, CanIfTxPduCanIdType=STANDARD_CAN, CanIfTxPduDlc=8, CanIfTxPduId=4, CanIfTxPduSourcePduID=(unset), CanIfTxPduUserTxConfirmationUL=PDUR, CanIfTxPduBufferRef=CanIf_InitCfg/HOH_TX_0_CAN_EOP, CanIfTxPduRef=CAN_MCU_R1_MCU_FVT_R_Local1_1008T, CanIfTxPduUpperLayerRef=(unset)
          CanIfTTTxFrameTriggering: CanIfTTTxHwObjectTriggerIdRef=(unset)
        XCP_1569T: CanIfTxPduCanId=1569, CanIfTxPduCanIdType=STANDARD_FD_CAN, CanIfTxPduDlc=8, CanIfTxPduId=5, CanIfTxPduSourcePduID=0, CanIfTxPduUserTxConfirmationUL=CDD, CanIfTxPduBufferRef=CanIf_InitCfg/HOH_TX_0_CAN_Xcp, CanIfTxPduRef=XCP_1569T, CanIfTxPduUpperLayerRef=XCP
          CanIfTTTxFrameTriggering: CanIfTTTxHwObjectTriggerIdRef=(unset)
    CanIfMirroringSupport:
      CanIfCanControllerErrorStateSupported = 0
      CanIfCanTxErrorCounterSupported = 0
      CanIfErrorStateValue = CAN_ERRORSTATE_ACTIVE
      CanIfMirrorToCDDReportingEnable = 0
      CanIfMirrorToCDDReportingFunctionName = (unset)
      CanIfMirrorToCDDReportingHeader = (unset)
      CanIfTxErrorCounterValue = 0
      TxMirrorBufferSize = (unset)
    CanIfPrivateCfg: CanIfPrivateDlcCheck=1, CanIfPrivateSoftwareFilterType=BINARY, CanIfSupportTTCAN=0
      CanIfTTGeneral: CanIfTTJoblist=0, CanIfTTMaxIsrDelay=(unset)
    CanIfPublicCfg:
      CanIfBusMirroringSupport = 0
      CanIfCanDriverCompatibility = ASR440
      CanIfDecoupledProcessingSupport = 0
      CanIfDetReportRuntimeError = 1
      CanIfEnableSecurityEventReporting = 0
      CanIfGlobalTimeSupport = 0
      CanIfHookOnReceptionSupport = 0
      CanIfMetaDataSupport = 0
      CanIfMultiCoreSupport = 0
      CanIfMulticoreWakeupExtension = 0
      CanIfPublicCanIdTypeEnum = UINT32
      CanIfPublicCancelTransmitSupport = 0
      CanIfPublicCddHeaderFile = Xcp_Cbk.h
      CanIfPublicChangeBaudrateSupport = 0
      CanIfPublicDevErrorDetect = 1
      CanIfPublicHandleTypeEnum = UINT16
      CanIfPublicHohTranslationOpt = 0
      CanIfPublicMaxCtrl = 3
      CanIfPublicMaxDynTxPdus = 8
      CanIfPublicMaxHths = 16
      CanIfPublicMaxRxBuffer = 72
      CanIfPublicMaxRxNotifyPdus = 64
      CanIfPublicMaxTxBufferSize = 512
      CanIfPublicMaxTxBuffers = 64
      CanIfPublicMaxTxNotifyPdus = 64
      CanIfPublicMultipleDrvSupport = 1
      CanIfPublicNumberOfCanHwUnits = 1
      CanIfPublicPnSupport = 0
      CanIfPublicRangeReceptionSupport = 1
      CanIfPublicReadRxPduDataApi = 0
      CanIfPublicReadRxPduNotifyStatusApi = 0
      CanIfPublicReadTxPduNotifyStatusApi = 0
      CanIfPublicSetDynamicTxIdApi = 0
      CanIfPublicSingleCtrlOpt = 0
      CanIfPublicTrcvWakeupSupport = 1
      CanIfPublicTxBuffering = 1
      CanIfPublicTxConfirmPollingSupport = 0
      CanIfPublicVersionInfoApi = 0
      CanIfPublicWakeupCheckValidByNM = 0
      CanIfPublicWakeupCheckValidSupport = 0
      CanIfRelocatablePbcfgEnable = 1
      CanIfSetBaudrateApi = 0
      CanIfSingleCanTrcvAPIInfixEnable = 1
      CanIfSoftwareFilteringSupport = 1
      CanIfTxOfflineActiveSupport = 0
      CanIfValidateWakeupOnStartedCtrlOnly = 0
      CanIfSecurityEventRefs
    PDUR (CanIfUpperLayerConfig):
      CanIfPublicTxConfResultSupport = 0
      CanIfRxPduUserRxIndicationName = PduR_CanIfRxIndication
      CanIfTxPduUserTxConfirmationName = PduR_CanIfTxConfirmation
      CanIfUpperLayerUseCanId = 0
      CanIfUseCddHandleIds = 0
    XCP (CanIfUpperLayerConfig):
      CanIfPublicTxConfResultSupport = 0
      CanIfRxPduUserRxIndicationName = Xcp_CanIfRxIndication
      CanIfTxPduUserTxConfirmationName = Xcp_CanIfTxConfirmation
      CanIfUpperLayerUseCanId = 0
      CanIfUseCddHandleIds = 0
