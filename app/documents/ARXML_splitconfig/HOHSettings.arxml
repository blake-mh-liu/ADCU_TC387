AUTOSAR XML (schema 4-0-3)
package /Can
  module config Can: implementation-config-variant=VARIANT-POST-BUILD
    CanConfigSet
      3 x CanController, all with CanBusoffProcessing=INTERRUPT, CanControllerActivation=1, CanControllerLoopbackEnable=0, CanRxProcessing=INTERRUPT, CanTxProcessing=INTERRUPT, CanWakeupFunctionalityAPI=0, CanWakeupProcessing=INTERRUPT, CanWakeupSupport=0, CanCpuClockRef=(unset), CanPeripheralBusClockRef=McuClockReferencePointConfig:
        CAN3: CanControllerBaseAddress=4028663040, CanRxInputSelection=CANxx_RXDC, CanControllerDefaultBaudrate=CAN3/CanControllerBaudrateConfig_0
          CanControllerBaudrateConfig_0 (CanControllerBaudrateConfig): CanControllerBaudRate=500.0, CanControllerPropSeg=47, CanControllerSeg1=16, CanControllerSeg2=16, CanControllerSyncJumpWidth=4
            CanControllerFdBaudrateConfig_0 (CanControllerFdBaudrateConfig):
              CanControllerFdBaudRate = 2000.0
              CanControllerPropSeg = 1
              CanControllerSeg1 = 2
              CanControllerSeg2 = 1
              CanControllerSyncJumpWidth = 1
              CanControllerTxBitRateSwitch = 1
        CAN_EOP: CanControllerBaseAddress=4028665088, CanRxInputSelection=CANxx_RXDB, CanControllerDefaultBaudrate=CAN_EOP/CanControllerBaudrateConfig_0
          CanControllerBaudrateConfig_0 (CanControllerBaudrateConfig): CanControllerBaudRate=500.0, CanControllerPropSeg=47, CanControllerSeg1=16, CanControllerSeg2=16, CanControllerSyncJumpWidth=4
        CAN_XCP: CanControllerBaseAddress=4028664064, CanRxInputSelection=CANxx_RXDE, CanControllerDefaultBaudrate=CAN_XCP/CanControllerBaudrateConfig_0
          CanControllerBaudrateConfig_0 (CanControllerBaudrateConfig): CanControllerBaudRate=500.0, CanControllerPropSeg=47, CanControllerSeg1=16, CanControllerSeg2=16, CanControllerSyncJumpWidth=4
            CanControllerFdBaudrateConfig_0 (CanControllerFdBaudrateConfig):
              CanControllerFdBaudRate = 2000.0
              CanControllerPropSeg = 1
              CanControllerSeg1 = 2
              CanControllerSeg2 = 1
              CanControllerSyncJumpWidth = 1
              CanControllerTxBitRateSwitch = 1
      12 x CanHardwareObject, all with CanHwFIFOThreshold=1, CanIdType=STANDARD:
        HOH_1_CAN3: CanHandleType=FULL, CanHwObjectCount=1, CanObjectId=0, CanObjectType=RECEIVE, CanControllerRef=CAN3
          CanHwFilter: CanHwFilterCode=277, CanHwFilterMask=2047
        HOH_2_CAN3: CanHandleType=FULL, CanHwObjectCount=1, CanObjectId=1, CanObjectType=RECEIVE, CanControllerRef=CAN3
          CanHwFilter: CanHwFilterCode=339, CanHwFilterMask=2047
        HOH_3_CAN3: CanHandleType=FULL, CanHwObjectCount=1, CanObjectId=2, CanObjectType=RECEIVE, CanControllerRef=CAN3
          CanHwFilter: CanHwFilterCode=341, CanHwFilterMask=2047
        HOH_4_CAN3: CanHandleType=FULL, CanHwObjectCount=1, CanObjectId=3, CanObjectType=RECEIVE, CanControllerRef=CAN3
          CanHwFilter: CanHwFilterCode=369, CanHwFilterMask=2047
        HOH_5_CAN3: CanHandleType=FULL, CanHwObjectCount=1, CanObjectId=4, CanObjectType=RECEIVE, CanControllerRef=CAN3
          CanHwFilter: CanHwFilterCode=378, CanHwFilterMask=2047
        HOH_6_CAN3: CanHandleType=FULL, CanHwObjectCount=1, CanObjectId=5, CanObjectType=RECEIVE, CanControllerRef=CAN3
          CanHwFilter: CanHwFilterCode=386, CanHwFilterMask=2047
        HOH_7_CAN3: CanHandleType=FULL, CanHwObjectCount=1, CanObjectId=6, CanObjectType=RECEIVE, CanControllerRef=CAN3
          CanHwFilter: CanHwFilterCode=451, CanHwFilterMask=2047
        HOH_1_CAN_MCU_R1: CanHandleType=FULL, CanHwObjectCount=1, CanObjectId=7, CanObjectType=RECEIVE, CanControllerRef=CAN_EOP
          CanHwFilter: CanHwFilterCode=1012, CanHwFilterMask=2047
        HOH_1_CAN_Xcp: CanHandleType=BASIC, CanHwObjectCount=12, CanObjectId=8, CanObjectType=RECEIVE, CanControllerRef=CAN_XCP
          CanHwFilter_0 (CanHwFilter): CanHwFilterCode=1639, CanHwFilterMask=2047
        HOH_TX_0_CAN3: CanHandleType=BASIC, CanHwObjectCount=1, CanObjectId=9, CanObjectType=TRANSMIT, CanControllerRef=CAN3
        HOH_TX_0_CAN_EOP: CanHandleType=BASIC, CanHwObjectCount=1, CanObjectId=10, CanObjectType=TRANSMIT, CanControllerRef=CAN_EOP
        HOH_TX_0_CAN_Xcp: CanHandleType=BASIC, CanHwObjectCount=1, CanObjectId=11, CanObjectType=TRANSMIT, CanControllerRef=CAN_XCP
    CanGeneral:
      CanDeInitApi = 1
      CanDevErrorDetect = 0
      CanIndex = 0
      CanInitDeInitApiMode = CAN_17_MCMCAN_MCAL_SUPERVISOR
      CanMainFunctionModePeriod = 0.005
      CanMultiCoreErrorDetect = 0
      CanMultiplexedTransmission = 0
      CanPublicIcomSupport = 0
      CanRunTimeErrorDetect = 1
      CanSetBaudrateApi = 0
      CanTimeoutDuration = 0.001
      CanVersionInfoApi = 0
      CanSupportTTCANRef = (unset)
