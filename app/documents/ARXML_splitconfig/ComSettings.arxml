AUTOSAR XML (schema 4-0-3)
package /Com
  module config Com: implementation-config-variant=VARIANT-POST-BUILD
    ComConfig: ComConfigurationId=0
      13 x ComIPdu, all with ComIPduSignalProcessing=IMMEDIATE, ComIPduType=NORMAL, ComMainFunctionRef=(unset):
        PDCAN3_BMS1_369R: ComIPduDirection=RECEIVE, ComIPduHandleId=0, ComIPduGroupRef=MCU_CAN3_Rx, ComIPduSignalGroupRef=GRCAN3_SG_BMS1_369R, ComPduIdRef=CAN3_BMS1_369R
          ComIPduCounter: ComIPduCounterSize=(unset), ComIPduCounterStartPosition=(unset)
          ComIPduReplication: ComIPduReplicationQuorum=(unset), ComIPduReplicaRef=(unset)
          ComTxIPdu: ComTxIPduClearUpdateBit=Transmit, ComTxIPduUnusedAreasDefault=0
        PDCAN3_BMS6_378R: ComIPduDirection=RECEIVE, ComIPduHandleId=1, ComIPduGroupRef=MCU_CAN3_Rx, ComIPduSignalGroupRef=GRCAN3_SG_BMS6_378R, ComPduIdRef=CAN3_BMS6_378R
          ComIPduCounter: ComIPduCounterSize=(unset), ComIPduCounterStartPosition=(unset)
          ComIPduReplication: ComIPduReplicationQuorum=(unset), ComIPduReplicaRef=(unset)
          ComTxIPdu: ComTxIPduClearUpdateBit=Transmit, ComTxIPduUnusedAreasDefault=0
        PDCAN3_FD3_C100_0_386R: ComIPduDirection=RECEIVE, ComIPduHandleId=2, ComIPduGroupRef=MCU_CAN3_Rx, ComIPduSignalGroupRef=GRCAN3_SG_FD3_C100_0_386R, ComPduIdRef=CAN3_FD3_C100_0_386R
          ComIPduCounter: ComIPduCounterSize=(unset), ComIPduCounterStartPosition=(unset)
          ComIPduReplication: ComIPduReplicationQuorum=(unset), ComIPduReplicaRef=(unset)
          ComTxIPdu: ComTxIPduClearUpdateBit=Transmit, ComTxIPduUnusedAreasDefault=0
        PDCAN3_FD3_VCU1_277R: ComIPduDirection=RECEIVE, ComIPduHandleId=3, ComIPduGroupRef=MCU_CAN3_Rx, ComIPduSignalGroupRef=GRCAN3_SG_FD3_VCU1_277R, ComPduIdRef=CAN3_FD3_VCU1_277R
          ComIPduCounter: ComIPduCounterSize=(unset), ComIPduCounterStartPosition=(unset)
          ComIPduReplication: ComIPduReplicationQuorum=(unset), ComIPduReplicaRef=(unset)
          ComTxIPdu: ComTxIPduClearUpdateBit=Transmit, ComTxIPduUnusedAreasDefault=0
        PDCAN3_FD3_VCU2_339R: ComIPduDirection=RECEIVE, ComIPduHandleId=4, ComIPduGroupRef=MCU_CAN3_Rx, ComIPduSignalGroupRef=GRCAN3_SG_FD3_VCU2_339R, ComPduIdRef=CAN3_FD3_VCU2_339R
          ComIPduCounter: ComIPduCounterSize=(unset), ComIPduCounterStartPosition=(unset)
          ComIPduReplication: ComIPduReplicationQuorum=(unset), ComIPduReplicaRef=(unset)
          ComTxIPdu: ComTxIPduClearUpdateBit=Transmit, ComTxIPduUnusedAreasDefault=0
        PDCAN3_FD3_VCU5_341R: ComIPduDirection=RECEIVE, ComIPduHandleId=5, ComIPduGroupRef=MCU_CAN3_Rx, ComIPduSignalGroupRef=GRCAN3_SG_FD3_VCU5_341R, ComPduIdRef=CAN3_FD3_VCU5_341R
          ComIPduCounter: ComIPduCounterSize=(unset), ComIPduCounterStartPosition=(unset)
          ComIPduReplication: ComIPduReplicationQuorum=(unset), ComIPduReplicaRef=(unset)
          ComTxIPdu: ComTxIPduClearUpdateBit=Transmit, ComTxIPduUnusedAreasDefault=0
        PDCAN3_GW3_CE100_0_451R: ComIPduDirection=RECEIVE, ComIPduHandleId=6, ComIPduGroupRef=MCU_CAN3_Rx, ComIPduSignalGroupRef=GRCAN3_SG_GW3_CE100_0_451R, ComPduIdRef=CAN3_GW3_CE100_0_451R
          ComIPduCounter: ComIPduCounterSize=(unset), ComIPduCounterStartPosition=(unset)
          ComIPduReplication: ComIPduReplicationQuorum=(unset), ComIPduReplicaRef=(unset)
          ComTxIPdu: ComTxIPduClearUpdateBit=Transmit, ComTxIPduUnusedAreasDefault=0
        PDCAN_MCU_R1_EOP_FVT_R_Local1_1012R: ComIPduDirection=RECEIVE, ComIPduHandleId=7, ComIPduGroupRef=MCU_CAN_MCU_R1_Rx, ComIPduSignalGroupRef=GRCAN_MCU_R1_SG_EOP_FVT_R_Local1_1012R, ComPduIdRef=CAN_MCU_R1_EOP_FVT_R_Local1_1012R
          ComIPduCounter: ComIPduCounterSize=(unset), ComIPduCounterStartPosition=(unset)
          ComIPduReplication: ComIPduReplicationQuorum=(unset), ComIPduReplicaRef=(unset)
          ComTxIPdu: ComTxIPduClearUpdateBit=Transmit, ComTxIPduUnusedAreasDefault=0
        PDCAN3_MCU_B_R1_400T: ComIPduDirection=SEND, ComIPduHandleId=0, ComIPduGroupRef=MCU_CAN3_Tx, ComIPduSignalGroupRef=GRCAN3_SG_MCU_B_R1_400T, ComPduIdRef=CAN3_MCU_B_R1_400T
          ComIPduCounter: ComIPduCounterSize=(unset), ComIPduCounterStartPosition=(unset)
          ComIPduReplication: ComIPduReplicationQuorum=(unset), ComIPduReplicaRef=(unset)
          ComTxIPdu: ComMinimumDelayTime=0.0, ComTxIPduClearUpdateBit=Transmit, ComTxIPduUnusedAreasDefault=0
            ComTxModeTrue
              ComTxMode: ComTxModeMode=PERIODIC, ComTxModeNumberOfRepetitions=1, ComTxModeRepetitionPeriod=1.0, ComTxModeTimeOffset=0.0, ComTxModeTimePeriod=0.01
        PDCAN3_MCU_B_R2_403T: ComIPduDirection=SEND, ComIPduHandleId=1, ComIPduGroupRef=MCU_CAN3_Tx, ComIPduSignalGroupRef=GRCAN3_SG_MCU_B_R2_403T, ComPduIdRef=CAN3_MCU_B_R2_403T
          ComIPduCounter: ComIPduCounterSize=(unset), ComIPduCounterStartPosition=(unset)
          ComIPduReplication: ComIPduReplicationQuorum=(unset), ComIPduReplicaRef=(unset)
          ComTxIPdu: ComMinimumDelayTime=0.0, ComTxIPduClearUpdateBit=Transmit, ComTxIPduUnusedAreasDefault=0
            ComTxModeTrue
              ComTxMode: ComTxModeMode=PERIODIC, ComTxModeNumberOfRepetitions=1, ComTxModeRepetitionPeriod=1.0, ComTxModeTimeOffset=0.0, ComTxModeTimePeriod=0.01
        PDCAN3_MCU_B_R_Debug1_1269T: ComIPduDirection=SEND, ComIPduHandleId=2, ComIPduGroupRef=MCU_CAN3_Tx, ComIPduSignalGroupRef=GRCAN3_SG_MCU_B_R_Debug1_1269T, ComPduIdRef=CAN3_MCU_B_R_Debug1_1269T
          ComIPduCounter: ComIPduCounterSize=(unset), ComIPduCounterStartPosition=(unset)
          ComIPduReplication: ComIPduReplicationQuorum=(unset), ComIPduReplicaRef=(unset)
          ComTxIPdu: ComMinimumDelayTime=0.0, ComTxIPduClearUpdateBit=Transmit, ComTxIPduUnusedAreasDefault=0
            ComTxModeTrue
              ComTxMode: ComTxModeMode=PERIODIC, ComTxModeNumberOfRepetitions=1, ComTxModeRepetitionPeriod=1.0, ComTxModeTimeOffset=0.0, ComTxModeTimePeriod=0.01
        PDCAN3_MCU_FVT_R1_409T: ComIPduDirection=SEND, ComIPduHandleId=3, ComIPduGroupRef=MCU_CAN3_Tx, ComIPduSignalGroupRef=GRCAN3_SG_MCU_FVT_R1_409T, ComPduIdRef=CAN3_MCU_FVT_R1_409T
          ComIPduCounter: ComIPduCounterSize=(unset), ComIPduCounterStartPosition=(unset)
          ComIPduReplication: ComIPduReplicationQuorum=(unset), ComIPduReplicaRef=(unset)
          ComTxIPdu: ComMinimumDelayTime=0.0, ComTxIPduClearUpdateBit=Transmit, ComTxIPduUnusedAreasDefault=0
            ComTxModeTrue
              ComTxMode: ComTxModeMode=PERIODIC, ComTxModeNumberOfRepetitions=1, ComTxModeRepetitionPeriod=1.0, ComTxModeTimeOffset=0.0, ComTxModeTimePeriod=0.01
        PDCAN_MCU_R1_MCU_FVT_R_Local1_1008T: ComIPduDirection=SEND, ComIPduHandleId=4, ComIPduGroupRef=MCU_CAN_MCU_R1_Tx, ComIPduSignalGroupRef=GRCAN_MCU_R1_SG_MCU_FVT_R_Local1_1008T, ComPduIdRef=CAN_MCU_R1_MCU_FVT_R_Local1_1008T
          ComIPduCounter: ComIPduCounterSize=(unset), ComIPduCounterStartPosition=(unset)
          ComIPduReplication: ComIPduReplicationQuorum=(unset), ComIPduReplicaRef=(unset)
          ComTxIPdu: ComMinimumDelayTime=0.0, ComTxIPduClearUpdateBit=Transmit, ComTxIPduUnusedAreasDefault=0
            ComTxModeTrue
              ComTxMode: ComTxModeMode=PERIODIC, ComTxModeNumberOfRepetitions=1, ComTxModeRepetitionPeriod=1.0, ComTxModeTimeOffset=0.0, ComTxModeTimePeriod=0.01
      MCU_CAN3_Rx (ComIPduGroup): ComIPduGroupHandleId=0
      MCU_CAN_MCU_R1_Rx (ComIPduGroup): ComIPduGroupHandleId=1
      ComRxMainFunctions
        Com_MainFunctionRx_0 (Com_MainFunctionRx): ComRxTimeBase=0.005, ComPartitionRef=(unset)
      13 x ComSignalGroup, all with ComInvalidNotification=(unset), ComSignalGroupArrayAccess=0:
        GRCAN3_SG_BMS1_369R: ComFirstTimeout=0.005, ComSignalGroupDirection=RECEIVE, ComTimeout=0.025, ComTransferProperty=PENDING, ComHandleId=0, ComSystemTemplateSignalGroupRef=CAN3_SG_BMS1
          CAN3_HVBattVolt_369R (ComGroupSignal):
            ComBitPosition = 28
            ComBitSize = 13
            ComSignalEndianness = BIG_ENDIAN
            ComSignalInitValue = 0
            ComSignalLength = (unset)
            ComSignalType = UINT16
            ComTimeoutSubstitutionValue = 
            ComTransferProperty = TRIGGERED_ON_CHANGE
            ComHandleId = 0
            ComSystemTemplateSystemSignalRef = CAN3_HVBattVolt
        GRCAN3_SG_BMS6_378R: ComFirstTimeout=0.005, ComSignalGroupDirection=RECEIVE, ComTimeout=0.25, ComTransferProperty=TRIGGERED_ON_CHANGE, ComHandleId=1, ComSystemTemplateSignalGroupRef=CAN3_SG_BMS6
          CAN3_HVBContactorSta_378R (ComGroupSignal):
            ComBitPosition = 66
            ComBitSize = 1
            ComSignalEndianness = BIG_ENDIAN
            ComSignalInitValue = 0
            ComSignalLength = (unset)
            ComSignalType = UINT8
            ComTimeoutSubstitutionValue = 
            ComTransferProperty = TRIGGERED_ON_CHANGE
            ComHandleId = 1
            ComSystemTemplateSystemSignalRef = CAN3_HVBContactorSta
        GRCAN3_SG_FD3_C100_0_386R: ComFirstTimeout=0.005, ComSignalGroupDirection=RECEIVE, ComTimeout=0.25, ComTransferProperty=PENDING, ComHandleId=2, ComSystemTemplateSignalGroupRef=CAN3_SG_FD3_C100_0
          3 x ComGroupSignal, all with ComSignalEndianness=BIG_ENDIAN, ComSignalLength=(unset), ComTimeoutSubstitutionValue=, ComTransferProperty=TRIGGERED_ON_CHANGE:
            CAN3_BatteryMode_386R: ComBitPosition=118, ComBitSize=3, ComSignalInitValue=0, ComSignalType=UINT8, ComHandleId=2, ComSystemTemplateSystemSignalRef=CAN3_BatteryMode
            CAN3_Rr_Coolantflow_386R: ComBitPosition=150, ComBitSize=6, ComSignalInitValue=0, ComSignalType=UINT8, ComHandleId=3, ComSystemTemplateSystemSignalRef=CAN3_Rr_Coolantflow
            CAN3_Rr_Coolanttemp_386R: ComBitPosition=144, ComBitSize=9, ComSignalInitValue=40, ComSignalType=UINT16, ComHandleId=4, ComSystemTemplateSystemSignalRef=CAN3_Rr_Coolanttemp
        GRCAN3_SG_FD3_VCU1_277R: ComFirstTimeout=0.005, ComSignalGroupDirection=RECEIVE, ComTimeout=0.25, ComTransferProperty=TRIGGERED_ON_CHANGE, ComHandleId=3, ComSystemTemplateSignalGroupRef=CAN3_SG_FD3_VCU1
          5 x ComGroupSignal, all with ComSignalEndianness=BIG_ENDIAN, ComSignalLength=(unset), ComSignalType=UINT8, ComTimeoutSubstitutionValue=:
            CAN3_ActiveDischReq_277R: ComBitPosition=44, ComBitSize=1, ComSignalInitValue=0, ComTransferProperty=TRIGGERED_ON_CHANGE, ComHandleId=5, ComSystemTemplateSystemSignalRef=CAN3_ActiveDischReq
            CAN3_CS_VCU1_277R: ComBitPosition=7, ComBitSize=8, ComSignalInitValue=0, ComTransferProperty=PENDING, ComHandleId=6, ComSystemTemplateSystemSignalRef=CAN3_CS_VCU1
            CAN3_PwrSta_277R: ComBitPosition=63, ComBitSize=3, ComSignalInitValue=7, ComTransferProperty=TRIGGERED_ON_CHANGE, ComHandleId=7, ComSystemTemplateSystemSignalRef=CAN3_PwrSta
            CAN3_RC_VCU1_277R: ComBitPosition=11, ComBitSize=4, ComSignalInitValue=0, ComTransferProperty=PENDING, ComHandleId=8, ComSystemTemplateSystemSignalRef=CAN3_RC_VCU1
            CAN3_ShiftGearPosn_277R: ComBitPosition=38, ComBitSize=3, ComSignalInitValue=1, ComTransferProperty=TRIGGERED_ON_CHANGE, ComHandleId=9, ComSystemTemplateSystemSignalRef=CAN3_ShiftGearPosn
        GRCAN3_SG_FD3_VCU2_339R: ComFirstTimeout=0.005, ComSignalGroupDirection=RECEIVE, ComTimeout=0.025, ComTransferProperty=PENDING, ComHandleId=4, ComSystemTemplateSignalGroupRef=CAN3_SG_FD3_VCU2
          11 x ComGroupSignal, all with ComSignalEndianness=BIG_ENDIAN, ComSignalLength=(unset), ComTimeoutSubstitutionValue=, ComTransferProperty=TRIGGERED_ON_CHANGE:
            CAN3_CS_VCU2_CAN1_339R: ComBitPosition=7, ComBitSize=8, ComSignalInitValue=0, ComSignalType=UINT8, ComHandleId=10, ComSystemTemplateSystemSignalRef=CAN3_CS_VCU2_CAN1
            CAN3_RC_VCU2_CAN1_339R: ComBitPosition=11, ComBitSize=4, ComSignalInitValue=0, ComSignalType=UINT8, ComHandleId=11, ComSystemTemplateSystemSignalRef=CAN3_RC_VCU2_CAN1
            CAN3_Rr_ActvDmpDisabReq_339R: ComBitPosition=196, ComBitSize=1, ComSignalInitValue=0, ComSignalType=UINT8, ComHandleId=12, ComSystemTemplateSystemSignalRef=CAN3_Rr_ActvDmpDisabReq
            CAN3_Rr_IdcMax_339R: ComBitPosition=23, ComBitSize=12, ComSignalInitValue=0, ComSignalType=UINT16, ComHandleId=13, ComSystemTemplateSystemSignalRef=CAN3_Rr_IdcMax
            CAN3_Rr_IdcMin_339R: ComBitPosition=27, ComBitSize=12, ComSignalInitValue=0, ComSignalType=UINT16, ComHandleId=14, ComSystemTemplateSystemSignalRef=CAN3_Rr_IdcMin
            CAN3_Rr_MCUEnaReq_339R: ComBitPosition=197, ComBitSize=1, ComSignalInitValue=0, ComSignalType=UINT8, ComHandleId=15, ComSystemTemplateSystemSignalRef=CAN3_Rr_MCUEnaReq
            CAN3_Rr_TMTqReq_339R: ComBitPosition=119, ComBitSize=16, ComSignalInitValue=5300, ComSignalType=UINT16, ComHandleId=16, ComSystemTemplateSystemSignalRef=CAN3_Rr_TMTqReq
            CAN3_Rr_TorqMax_339R: ComBitPosition=47, ComBitSize=12, ComSignalInitValue=0, ComSignalType=UINT16, ComHandleId=17, ComSystemTemplateSystemSignalRef=CAN3_Rr_TorqMax
            CAN3_Rr_TorqMin_339R: ComBitPosition=51, ComBitSize=12, ComSignalInitValue=0, ComSignalType=UINT16, ComHandleId=18, ComSystemTemplateSystemSignalRef=CAN3_Rr_TorqMin
            CAN3_Rr_UdcMax_339R: ComBitPosition=71, ComBitSize=12, ComSignalInitValue=0, ComSignalType=UINT16, ComHandleId=19, ComSystemTemplateSystemSignalRef=CAN3_Rr_UdcMax
            CAN3_Rr_UdcMin_339R: ComBitPosition=75, ComBitSize=12, ComSignalInitValue=0, ComSignalType=UINT16, ComHandleId=20, ComSystemTemplateSystemSignalRef=CAN3_Rr_UdcMin
        GRCAN3_SG_FD3_VCU5_341R: ComFirstTimeout=0.005, ComSignalGroupDirection=RECEIVE, ComTimeout=0.025, ComTransferProperty=PENDING, ComHandleId=5, ComSystemTemplateSignalGroupRef=CAN3_SG_FD3_VCU5
          7 x ComGroupSignal, all with ComSignalEndianness=BIG_ENDIAN, ComSignalLength=(unset), ComTimeoutSubstitutionValue=, ComTransferProperty=TRIGGERED_ON_CHANGE:
            CAN3_FDC_VCU_RrSpdMax_Req_341R: ComBitPosition=103, ComBitSize=16, ComSignalInitValue=0, ComSignalType=UINT16, ComHandleId=21, ComSystemTemplateSystemSignalRef=CAN3_FDC_VCU_RrSpdMax_Req
            CAN3_FDC_VCU_RrSpdMin_Req_341R: ComBitPosition=135, ComBitSize=16, ComSignalInitValue=22000, ComSignalType=UINT16, ComHandleId=22, ComSystemTemplateSystemSignalRef=CAN3_FDC_VCU_RrSpdMin_Req
            CAN3_FDC_VCU_RrTMCtrlMode_Req_341R: ComBitPosition=47, ComBitSize=3, ComSignalInitValue=0, ComSignalType=UINT8, ComHandleId=23, ComSystemTemplateSystemSignalRef=CAN3_FDC_VCU_RrTMCtrlMode_Req
            CAN3_FDC_VCU_RrTMSpd_Req_341R: ComBitPosition=167, ComBitSize=16, ComSignalInitValue=22000, ComSignalType=UINT16, ComHandleId=24, ComSystemTemplateSystemSignalRef=CAN3_FDC_VCU_RrTMSpd_Req
            CAN3_FDC_VCU_RrTMTq_Req_341R: ComBitPosition=199, ComBitSize=16, ComSignalInitValue=10000, ComSignalType=UINT16, ComHandleId=25, ComSystemTemplateSystemSignalRef=CAN3_FDC_VCU_RrTMTq_Req
            CAN3_FDC_VCU_RrTqMax_Req_341R: ComBitPosition=219, ComBitSize=12, ComSignalInitValue=0, ComSignalType=UINT16, ComHandleId=26, ComSystemTemplateSystemSignalRef=CAN3_FDC_VCU_RrTqMax_Req
            CAN3_FDC_VCU_RrTqMin_Req_341R: ComBitPosition=243, ComBitSize=12, ComSignalInitValue=1022, ComSignalType=UINT16, ComHandleId=27, ComSystemTemplateSystemSignalRef=CAN3_FDC_VCU_RrTqMin_Req
        GRCAN3_SG_GW3_CE100_0_451R: ComFirstTimeout=0.005, ComSignalGroupDirection=RECEIVE, ComTimeout=0.25, ComTransferProperty=TRIGGERED_ON_CHANGE, ComHandleId=6, ComSystemTemplateSignalGroupRef=CAN3_SG_GW3_CE100_0
          6 x ComGroupSignal, all with ComSignalEndianness=BIG_ENDIAN, ComSignalInitValue=0, ComSignalLength=(unset), ComTimeoutSubstitutionValue=, ComTransferProperty=PENDING:
            CAN3_IVI_Time_Day_451R: ComBitPosition=228, ComBitSize=5, ComSignalType=UINT8, ComHandleId=28, ComSystemTemplateSystemSignalRef=CAN3_IVI_Time_Day
            CAN3_IVI_Time_Hour_451R: ComBitPosition=236, ComBitSize=5, ComSignalType=UINT8, ComHandleId=29, ComSystemTemplateSystemSignalRef=CAN3_IVI_Time_Hour
            CAN3_IVI_Time_Minute_451R: ComBitPosition=245, ComBitSize=6, ComSignalType=UINT8, ComHandleId=30, ComSystemTemplateSystemSignalRef=CAN3_IVI_Time_Minute
            CAN3_IVI_Time_Month_451R: ComBitPosition=219, ComBitSize=4, ComSignalType=UINT8, ComHandleId=31, ComSystemTemplateSystemSignalRef=CAN3_IVI_Time_Month
            CAN3_IVI_Time_Second_451R: ComBitPosition=253, ComBitSize=6, ComSignalType=UINT8, ComHandleId=32, ComSystemTemplateSystemSignalRef=CAN3_IVI_Time_Second
            CAN3_VehSpeed_451R: ComBitPosition=19, ComBitSize=12, ComSignalType=UINT16, ComHandleId=33, ComSystemTemplateSystemSignalRef=CAN3_VehSpeed
        GRCAN_MCU_R1_SG_EOP_FVT_R_Local1_1012R: ComFirstTimeout=0.005, ComSignalGroupDirection=RECEIVE, ComTimeout=0.025, ComTransferProperty=PENDING, ComHandleId=7, ComSystemTemplateSignalGroupRef=CAN_MCU_R1_SG_EOP_FVT_R_Local1
          15 x ComGroupSignal, all with ComSignalEndianness=BIG_ENDIAN, ComSignalInitValue=0, ComSignalLength=(unset), ComTimeoutSubstitutionValue=, ComTransferProperty=TRIGGERED_ON_CHANGE:
            CAN_MCU_R1_EOP_FVT_R_ActualSpd_Sta_1012R: ComBitPosition=52, ComBitSize=13, ComSignalType=UINT16, ComHandleId=34, ComSystemTemplateSystemSignalRef=CAN_MCU_R1_EOP_FVT_R_ActualSpd_Sta
            CAN_MCU_R1_EOP_FVT_R_CSInvalid_Sta_1012R: ComBitPosition=31, ComBitSize=1, ComSignalType=UINT8, ComHandleId=35, ComSystemTemplateSystemSignalRef=CAN_MCU_R1_EOP_FVT_R_CSInvalid_Sta
            CAN_MCU_R1_EOP_FVT_R_CanLoss_Sta_1012R: ComBitPosition=29, ComBitSize=1, ComSignalType=UINT8, ComHandleId=36, ComSystemTemplateSystemSignalRef=CAN_MCU_R1_EOP_FVT_R_CanLoss_Sta
            CAN_MCU_R1_EOP_FVT_R_EnableOff_Sta_1012R: ComBitPosition=24, ComBitSize=1, ComSignalType=UINT8, ComHandleId=37, ComSystemTemplateSystemSignalRef=CAN_MCU_R1_EOP_FVT_R_EnableOff_Sta
            CAN_MCU_R1_EOP_FVT_R_HallSigErr_Sta_1012R: ComBitPosition=27, ComBitSize=1, ComSignalType=UINT8, ComHandleId=38, ComSystemTemplateSystemSignalRef=CAN_MCU_R1_EOP_FVT_R_HallSigErr_Sta
            CAN_MCU_R1_EOP_FVT_R_Local1_CS_Sta_1012R: ComBitPosition=7, ComBitSize=8, ComSignalType=UINT8, ComHandleId=39, ComSystemTemplateSystemSignalRef=CAN_MCU_R1_EOP_FVT_R_Local1_CS_Sta
            CAN_MCU_R1_EOP_FVT_R_Local1_RC_Sta_1012R: ComBitPosition=11, ComBitSize=4, ComSignalType=UINT8, ComHandleId=40, ComSystemTemplateSystemSignalRef=CAN_MCU_R1_EOP_FVT_R_Local1_RC_Sta
            CAN_MCU_R1_EOP_FVT_R_OverTempBCK_Sta_1012R: ComBitPosition=23, ComBitSize=2, ComSignalType=UINT8, ComHandleId=41, ComSystemTemplateSystemSignalRef=CAN_MCU_R1_EOP_FVT_R_OverTempBCK_Sta
            CAN_MCU_R1_EOP_FVT_R_OverTemp_Sta_1012R: ComBitPosition=28, ComBitSize=1, ComSignalType=UINT8, ComHandleId=42, ComSystemTemplateSystemSignalRef=CAN_MCU_R1_EOP_FVT_R_OverTemp_Sta
            CAN_MCU_R1_EOP_FVT_R_OverVol_Sta_1012R: ComBitPosition=21, ComBitSize=2, ComSignalType=UINT8, ComHandleId=43, ComSystemTemplateSystemSignalRef=CAN_MCU_R1_EOP_FVT_R_OverVol_Sta
            CAN_MCU_R1_EOP_FVT_R_PumpReady_Sta_1012R: ComBitPosition=25, ComBitSize=1, ComSignalType=UINT8, ComHandleId=44, ComSystemTemplateSystemSignalRef=CAN_MCU_R1_EOP_FVT_R_PumpReady_Sta
            CAN_MCU_R1_EOP_FVT_R_RCInvalid_Sta_1012R: ComBitPosition=30, ComBitSize=1, ComSignalType=UINT8, ComHandleId=45, ComSystemTemplateSystemSignalRef=CAN_MCU_R1_EOP_FVT_R_RCInvalid_Sta
            CAN_MCU_R1_EOP_FVT_R_RunStatus_Sta_1012R: ComBitPosition=17, ComBitSize=2, ComSignalType=UINT8, ComHandleId=46, ComSystemTemplateSystemSignalRef=CAN_MCU_R1_EOP_FVT_R_RunStatus_Sta
            CAN_MCU_R1_EOP_FVT_R_StartFailure_Sta_1012R: ComBitPosition=26, ComBitSize=1, ComSignalType=UINT8, ComHandleId=47, ComSystemTemplateSystemSignalRef=CAN_MCU_R1_EOP_FVT_R_StartFailure_Sta
            CAN_MCU_R1_EOP_FVT_R_UnderVol_Sta_1012R: ComBitPosition=19, ComBitSize=2, ComSignalType=UINT8, ComHandleId=48, ComSystemTemplateSystemSignalRef=CAN_MCU_R1_EOP_FVT_R_UnderVol_Sta
        GRCAN3_SG_MCU_B_R1_400T: ComSignalGroupDirection=SEND, ComTransferProperty=PENDING, ComHandleId=0, ComSystemTemplateSignalGroupRef=CAN3_SG_MCU_B_R1
          29 x ComGroupSignal, all with ComSignalEndianness=BIG_ENDIAN, ComSignalLength=(unset), ComTimeoutSubstitutionValue=(unset), ComTransferProperty=TRIGGERED_ON_CHANGE:
            CAN3_MCUWarn_R_400T: ComBitPosition=62, ComBitSize=3, ComSignalInitValue=7, ComSignalType=UINT8, ComHandleId=0, ComSystemTemplateSystemSignalRef=CAN3_MCUWarn_R
            CAN3_MCU_B_R_IGBTDdeTemp_Sta_400T: ComBitPosition=24, ComBitSize=9, ComSignalInitValue=40, ComSignalType=UINT16, ComHandleId=1, ComSystemTemplateSystemSignalRef=CAN3_MCU_B_R_IGBTDdeTemp_Sta
            CAN3_MCU_B_R_RealPwrKw_Sta_400T: ComBitPosition=47, ComBitSize=16, ComSignalInitValue=5300, ComSignalType=UINT16, ComHandleId=2, ComSystemTemplateSystemSignalRef=CAN3_MCU_B_R_RealPwrKw_Sta
            CAN3_Rr_ActvDmpDisabSta_400T: ComBitPosition=201, ComBitSize=1, ComSignalInitValue=0, ComSignalType=UINT8, ComHandleId=3, ComSystemTemplateSystemSignalRef=CAN3_Rr_ActvDmpDisabSta
            CAN3_Rr_EDUDrtSta_400T: ComBitPosition=202, ComBitSize=1, ComSignalInitValue=0, ComSignalType=UINT8, ComHandleId=4, ComSystemTemplateSystemSignalRef=CAN3_Rr_EDUDrtSta
            CAN3_Rr_EDUOpratingSta_400T: ComBitPosition=245, ComBitSize=1, ComSignalInitValue=0, ComSignalType=UINT8, ComHandleId=5, ComSystemTemplateSystemSignalRef=CAN3_Rr_EDUOpratingSta
            CAN3_Rr_EDURealTMTq_400T: ComBitPosition=231, ComBitSize=16, ComSignalInitValue=10220, ComSignalType=UINT16, ComHandleId=6, ComSystemTemplateSystemSignalRef=CAN3_Rr_EDURealTMTq
            CAN3_Rr_EDURotateDirction_400T: ComBitPosition=247, ComBitSize=2, ComSignalInitValue=0, ComSignalType=UINT8, ComHandleId=7, ComSystemTemplateSystemSignalRef=CAN3_Rr_EDURotateDirction
            CAN3_Rr_EDUTqReqFbk_400T: ComBitPosition=243, ComBitSize=12, ComSignalInitValue=1022, ComSignalType=UINT16, ComHandleId=8, ComSystemTemplateSystemSignalRef=CAN3_Rr_EDUTqReqFbk
            CAN3_Rr_MCU1Chksum_400T: ComBitPosition=7, ComBitSize=8, ComSignalInitValue=0, ComSignalType=UINT8, ComHandleId=9, ComSystemTemplateSystemSignalRef=CAN3_Rr_MCU1Chksum
            CAN3_Rr_MCU1RolCnt_400T: ComBitPosition=11, ComBitSize=4, ComSignalInitValue=0, ComSignalType=UINT8, ComHandleId=10, ComSystemTemplateSystemSignalRef=CAN3_Rr_MCU1RolCnt
            CAN3_Rr_MCUBAT_400T: ComBitPosition=71, ComBitSize=8, ComSignalInitValue=0, ComSignalType=UINT8, ComHandleId=11, ComSystemTemplateSystemSignalRef=CAN3_Rr_MCUBAT
            CAN3_Rr_MCUDCBusCurr_400T: ComBitPosition=174, ComBitSize=15, ComSignalInitValue=15000, ComSignalType=UINT16, ComHandleId=12, ComSystemTemplateSystemSignalRef=CAN3_Rr_MCUDCBusCurr
            CAN3_Rr_MCUDCBusVolt_400T: ComBitPosition=191, ComBitSize=16, ComSignalInitValue=0, ComSignalType=UINT16, ComHandleId=13, ComSystemTemplateSystemSignalRef=CAN3_Rr_MCUDCBusVolt
            CAN3_Rr_MCUDischrgSta_400T: ComBitPosition=203, ComBitSize=1, ComSignalInitValue=0, ComSignalType=UINT8, ComHandleId=14, ComSystemTemplateSystemSignalRef=CAN3_Rr_MCUDischrgSta
            CAN3_Rr_MCUEnaSta_400T: ComBitPosition=244, ComBitSize=1, ComSignalInitValue=0, ComSignalType=UINT8, ComHandleId=15, ComSystemTemplateSystemSignalRef=CAN3_Rr_MCUEnaSta
            CAN3_Rr_MCUErr_400T: ComBitPosition=143, ComBitSize=8, ComSignalInitValue=0, ComSignalType=UINT8, ComHandleId=16, ComSystemTemplateSystemSignalRef=CAN3_Rr_MCUErr
            CAN3_Rr_MCUIGN_sta_400T: ComBitPosition=72, ComBitSize=1, ComSignalInitValue=0, ComSignalType=UINT8, ComHandleId=17, ComSystemTemplateSystemSignalRef=CAN3_Rr_MCUIGN_sta
            CAN3_Rr_MCUReady_400T: ComBitPosition=63, ComBitSize=1, ComSignalInitValue=0, ComSignalType=UINT8, ComHandleId=18, ComSystemTemplateSystemSignalRef=CAN3_Rr_MCUReady
            CAN3_Rr_MCUReady4Pre_400T: ComBitPosition=200, ComBitSize=1, ComSignalInitValue=0, ComSignalType=UINT8, ComHandleId=19, ComSystemTemplateSystemSignalRef=CAN3_Rr_MCUReady4Pre
            CAN3_Rr_MCUSysSta_400T: ComBitPosition=59, ComBitSize=4, ComSignalInitValue=0, ComSignalType=UINT8, ComHandleId=20, ComSystemTemplateSystemSignalRef=CAN3_Rr_MCUSysSta
            CAN3_Rr_MCUTemp_400T: ComBitPosition=167, ComBitSize=9, ComSignalInitValue=0, ComSignalType=UINT16, ComHandleId=21, ComSystemTemplateSystemSignalRef=CAN3_Rr_MCUTemp
            CAN3_Rr_MotorAvailTq_400T: ComBitPosition=91, ComBitSize=12, ComSignalInitValue=0, ComSignalType=UINT16, ComHandleId=22, ComSystemTemplateSystemSignalRef=CAN3_Rr_MotorAvailTq
            CAN3_Rr_RegenAvailTq_400T: ComBitPosition=87, ComBitSize=12, ComSignalInitValue=0, ComSignalType=UINT16, ComHandleId=23, ComSystemTemplateSystemSignalRef=CAN3_Rr_RegenAvailTq
            CAN3_Rr_Reserved_bits_400T: ComBitPosition=79, ComBitSize=7, ComSignalInitValue=0, ComSignalType=UINT8, ComHandleId=24, ComSystemTemplateSystemSignalRef=CAN3_Rr_Reserved_bits
            CAN3_Rr_TMSpd_400T: ComBitPosition=215, ComBitSize=16, ComSignalInitValue=18000, ComSignalType=UINT16, ComHandleId=25, ComSystemTemplateSystemSignalRef=CAN3_Rr_TMSpd
            CAN3_Rr_TMTemp_400T: ComBitPosition=144, ComBitSize=9, ComSignalInitValue=0, ComSignalType=UINT16, ComHandleId=26, ComSystemTemplateSystemSignalRef=CAN3_Rr_TMTemp
            CAN3_Rr_TMid_400T: ComBitPosition=126, ComBitSize=15, ComSignalInitValue=15000, ComSignalType=UINT16, ComHandleId=27, ComSystemTemplateSystemSignalRef=CAN3_Rr_TMid
            CAN3_Rr_TMiq_400T: ComBitPosition=110, ComBitSize=15, ComSignalInitValue=15000, ComSignalType=UINT16, ComHandleId=28, ComSystemTemplateSystemSignalRef=CAN3_Rr_TMiq
        GRCAN3_SG_MCU_B_R2_403T: ComSignalGroupDirection=SEND, ComTransferProperty=PENDING, ComHandleId=1, ComSystemTemplateSignalGroupRef=CAN3_SG_MCU_B_R2
          16 x ComGroupSignal, all with ComSignalEndianness=BIG_ENDIAN, ComSignalLength=(unset), ComTimeoutSubstitutionValue=(unset), ComTransferProperty=TRIGGERED_ON_CHANGE:
            CAN3_MCU_B_R_FailLv_Sta_403T: ComBitPosition=27, ComBitSize=3, ComSignalInitValue=0, ComSignalType=UINT8, ComHandleId=29, ComSystemTemplateSystemSignalRef=CAN3_MCU_B_R_FailLv_Sta
            CAN3_MCU_B_R_KL302TqCnt_Sta_403T: ComBitPosition=71, ComBitSize=8, ComSignalInitValue=0, ComSignalType=UINT8, ComHandleId=30, ComSystemTemplateSystemSignalRef=CAN3_MCU_B_R_KL302TqCnt_Sta
            CAN3_MCU_B_R_LLCTempWarn_Sta_403T: ComBitPosition=23, ComBitSize=2, ComSignalInitValue=0, ComSignalType=UINT8, ComHandleId=31, ComSystemTemplateSystemSignalRef=CAN3_MCU_B_R_LLCTempWarn_Sta
            CAN3_Rr_CoolanttempReq_403T: ComBitPosition=24, ComBitSize=9, ComSignalInitValue=40, ComSignalType=UINT16, ComHandleId=32, ComSystemTemplateSystemSignalRef=CAN3_Rr_CoolanttempReq
            CAN3_Rr_Failcode1_403T: ComBitPosition=63, ComBitSize=8, ComSignalInitValue=0, ComSignalType=UINT8, ComHandleId=33, ComSystemTemplateSystemSignalRef=CAN3_Rr_Failcode1
            CAN3_Rr_Failcode2_403T: ComBitPosition=55, ComBitSize=8, ComSignalInitValue=0, ComSignalType=UINT8, ComHandleId=34, ComSystemTemplateSystemSignalRef=CAN3_Rr_Failcode2
            CAN3_Rr_Failcodehistory1_403T: ComBitPosition=41, ComBitSize=2, ComSignalInitValue=0, ComSignalType=UINT8, ComHandleId=35, ComSystemTemplateSystemSignalRef=CAN3_Rr_Failcodehistory1
            CAN3_Rr_Failcodehistory2_403T: ComBitPosition=43, ComBitSize=2, ComSignalInitValue=0, ComSignalType=UINT8, ComHandleId=36, ComSystemTemplateSystemSignalRef=CAN3_Rr_Failcodehistory2
            CAN3_Rr_LLCTemp_403T: ComBitPosition=80, ComBitSize=9, ComSignalInitValue=40, ComSignalType=UINT16, ComHandleId=37, ComSystemTemplateSystemSignalRef=CAN3_Rr_LLCTemp
            CAN3_Rr_LLCflowReq_403T: ComBitPosition=21, ComBitSize=6, ComSignalInitValue=0, ComSignalType=UINT8, ComHandleId=38, ComSystemTemplateSystemSignalRef=CAN3_Rr_LLCflowReq
            CAN3_Rr_MCU2Chksum_403T: ComBitPosition=7, ComBitSize=8, ComSignalInitValue=0, ComSignalType=UINT8, ComHandleId=39, ComSystemTemplateSystemSignalRef=CAN3_Rr_MCU2Chksum
            CAN3_Rr_MCU2RolCnt_403T: ComBitPosition=11, ComBitSize=4, ComSignalInitValue=0, ComSignalType=UINT8, ComHandleId=40, ComSystemTemplateSystemSignalRef=CAN3_Rr_MCU2RolCnt
            CAN3_Rr_MCU3_HW_Ver_403T: ComBitPosition=103, ComBitSize=16, ComSignalInitValue=0, ComSignalType=UINT16, ComHandleId=41, ComSystemTemplateSystemSignalRef=CAN3_Rr_MCU3_HW_Ver
            CAN3_Rr_MCU3_SW_Ver_403T: ComBitPosition=119, ComBitSize=16, ComSignalInitValue=0, ComSignalType=UINT16, ComHandleId=42, ComSystemTemplateSystemSignalRef=CAN3_Rr_MCU3_SW_Ver
            CAN3_Rr_MCUTempWarn_403T: ComBitPosition=47, ComBitSize=2, ComSignalInitValue=3, ComSignalType=UINT8, ComHandleId=43, ComSystemTemplateSystemSignalRef=CAN3_Rr_MCUTempWarn
            CAN3_Rr_TMTempWarn_403T: ComBitPosition=45, ComBitSize=2, ComSignalInitValue=3, ComSignalType=UINT8, ComHandleId=44, ComSystemTemplateSystemSignalRef=CAN3_Rr_TMTempWarn
        GRCAN3_SG_MCU_B_R_Debug1_1269T: ComSignalGroupDirection=SEND, ComTransferProperty=PENDING, ComHandleId=2, ComSystemTemplateSignalGroupRef=CAN3_SG_MCU_B_R_Debug1
          14 x ComGroupSignal, all with ComSignalEndianness=BIG_ENDIAN, ComSignalInitValue=0, ComSignalLength=(unset), ComTimeoutSubstitutionValue=(unset), ComTransferProperty=TRIGGERED_ON_CHANGE:
            CAN3_MCU_R_ID_REF_1269T: ComBitPosition=39, ComBitSize=32, ComSignalType=UINT32, ComHandleId=45, ComSystemTemplateSystemSignalRef=CAN3_MCU_R_ID_REF
            CAN3_MCU_R_IQ_REF_1269T: ComBitPosition=7, ComBitSize=32, ComSignalType=UINT32, ComHandleId=46, ComSystemTemplateSystemSignalRef=CAN3_MCU_R_IQ_REF
            CAN3_MCU_R_Reserve0_1269T: ComBitPosition=119, ComBitSize=16, ComSignalType=UINT16, ComHandleId=47, ComSystemTemplateSystemSignalRef=CAN3_MCU_R_Reserve0
            CAN3_MCU_R_Reserve1_1269T: ComBitPosition=103, ComBitSize=16, ComSignalType=UINT16, ComHandleId=48, ComSystemTemplateSystemSignalRef=CAN3_MCU_R_Reserve1
            CAN3_MCU_R_Reserve2_1269T: ComBitPosition=87, ComBitSize=16, ComSignalType=UINT16, ComHandleId=49, ComSystemTemplateSystemSignalRef=CAN3_MCU_R_Reserve2
            CAN3_R_FD_FACTCODE_N_1269T: ComBitPosition=191, ComBitSize=8, ComSignalType=UINT8, ComHandleId=50, ComSystemTemplateSystemSignalRef=CAN3_R_FD_FACTCODE_N
            CAN3_R_FD_FACTCODE_P_1269T: ComBitPosition=183, ComBitSize=8, ComSignalType=UINT8, ComHandleId=51, ComSystemTemplateSystemSignalRef=CAN3_R_FD_FACTCODE_P
            CAN3_R_ID_TQ_LIM_N_1269T: ComBitPosition=175, ComBitSize=8, ComSignalType=UINT8, ComHandleId=52, ComSystemTemplateSystemSignalRef=CAN3_R_ID_TQ_LIM_N
            CAN3_R_ID_TQ_LIM_P_1269T: ComBitPosition=167, ComBitSize=8, ComSignalType=UINT8, ComHandleId=53, ComSystemTemplateSystemSignalRef=CAN3_R_ID_TQ_LIM_P
            CAN3_R_K_TQ_LIM_N_1269T: ComBitPosition=159, ComBitSize=8, ComSignalType=UINT8, ComHandleId=54, ComSystemTemplateSystemSignalRef=CAN3_R_K_TQ_LIM_N
            CAN3_R_K_TQ_LIM_P_1269T: ComBitPosition=151, ComBitSize=8, ComSignalType=UINT8, ComHandleId=55, ComSystemTemplateSystemSignalRef=CAN3_R_K_TQ_LIM_P
            CAN3_R_OffsetAngle_1269T: ComBitPosition=71, ComBitSize=16, ComSignalType=UINT16, ComHandleId=56, ComSystemTemplateSystemSignalRef=CAN3_R_OffsetAngle
            CAN3_R_TQ_LIM_N_1269T: ComBitPosition=143, ComBitSize=8, ComSignalType=UINT8, ComHandleId=57, ComSystemTemplateSystemSignalRef=CAN3_R_TQ_LIM_N
            CAN3_R_TQ_LIM_P_1269T: ComBitPosition=135, ComBitSize=8, ComSignalType=UINT8, ComHandleId=58, ComSystemTemplateSystemSignalRef=CAN3_R_TQ_LIM_P
        GRCAN3_SG_MCU_FVT_R1_409T: ComSignalGroupDirection=SEND, ComTransferProperty=PENDING, ComHandleId=3, ComSystemTemplateSignalGroupRef=CAN3_SG_MCU_FVT_R1
          9 x ComGroupSignal, all with ComSignalEndianness=BIG_ENDIAN, ComSignalLength=(unset), ComTimeoutSubstitutionValue=(unset), ComTransferProperty=TRIGGERED_ON_CHANGE:
            CAN3_MCU_FVT_R_BoostOP_Sta_409T: ComBitPosition=17, ComBitSize=1, ComSignalInitValue=0, ComSignalType=UINT8, ComHandleId=59, ComSystemTemplateSystemSignalRef=CAN3_MCU_FVT_R_BoostOP_Sta
            CAN3_MCU_FVT_R_EDUTqReq_Fbk_409T: ComBitPosition=71, ComBitSize=16, ComSignalInitValue=10220, ComSignalType=UINT16, ComHandleId=60, ComSystemTemplateSystemSignalRef=CAN3_MCU_FVT_R_EDUTqReq_Fbk
            CAN3_MCU_FVT_R_Failcode3_Sta_409T: ComBitPosition=95, ComBitSize=8, ComSignalInitValue=0, ComSignalType=UINT8, ComHandleId=61, ComSystemTemplateSystemSignalRef=CAN3_MCU_FVT_R_Failcode3_Sta
            CAN3_MCU_FVT_R_HeatingOP_Sta_409T: ComBitPosition=33, ComBitSize=1, ComSignalInitValue=0, ComSignalType=UINT8, ComHandleId=62, ComSystemTemplateSystemSignalRef=CAN3_MCU_FVT_R_HeatingOP_Sta
            CAN3_MCU_FVT_R_MCUBAT_Sta_409T: ComBitPosition=16, ComBitSize=9, ComSignalInitValue=0, ComSignalType=UINT16, ComHandleId=63, ComSystemTemplateSystemSignalRef=CAN3_MCU_FVT_R_MCUBAT_Sta
            CAN3_MCU_FVT_R_MCUErr_Sta_409T: ComBitPosition=87, ComBitSize=8, ComSignalInitValue=0, ComSignalType=UINT8, ComHandleId=64, ComSystemTemplateSystemSignalRef=CAN3_MCU_FVT_R_MCUErr_Sta
            CAN3_MCU_FVT_R_MCUSys_Sta_409T: ComBitPosition=23, ComBitSize=4, ComSignalInitValue=6, ComSignalType=UINT8, ComHandleId=65, ComSystemTemplateSystemSignalRef=CAN3_MCU_FVT_R_MCUSys_Sta
            CAN3_MCU_FVT_R_OilTemp_Sta_409T: ComBitPosition=32, ComBitSize=9, ComSignalInitValue=40, ComSignalType=UINT16, ComHandleId=66, ComSystemTemplateSystemSignalRef=CAN3_MCU_FVT_R_OilTemp_Sta
            CAN3_MCU_FVT_R_TMSpd_Sta_409T: ComBitPosition=55, ComBitSize=16, ComSignalInitValue=22000, ComSignalType=UINT16, ComHandleId=67, ComSystemTemplateSystemSignalRef=CAN3_MCU_FVT_R_TMSpd_Sta
        GRCAN_MCU_R1_SG_MCU_FVT_R_Local1_1008T: ComSignalGroupDirection=SEND, ComTransferProperty=PENDING, ComHandleId=4, ComSystemTemplateSignalGroupRef=CAN_MCU_R1_SG_MCU_FVT_R_Local1
          4 x ComGroupSignal, all with ComSignalEndianness=BIG_ENDIAN, ComSignalInitValue=0, ComSignalLength=(unset), ComTimeoutSubstitutionValue=(unset), ComTransferProperty=TRIGGERED_ON_CHANGE:
            CAN_MCU_R1_MCU_FVT_R_Local1_CS_Sta_1008T: ComBitPosition=7, ComBitSize=8, ComSignalType=UINT8, ComHandleId=68, ComSystemTemplateSystemSignalRef=CAN_MCU_R1_MCU_FVT_R_Local1_CS_Sta
            CAN_MCU_R1_MCU_FVT_R_Local1_RC_Sta_1008T: ComBitPosition=11, ComBitSize=4, ComSignalType=UINT8, ComHandleId=69, ComSystemTemplateSystemSignalRef=CAN_MCU_R1_MCU_FVT_R_Local1_RC_Sta
            CAN_MCU_R1_MCU_FVT_R_OPCStartOn_Req_1008T: ComBitPosition=16, ComBitSize=1, ComSignalType=UINT8, ComHandleId=70, ComSystemTemplateSystemSignalRef=CAN_MCU_R1_MCU_FVT_R_OPCStartOn_Req
            CAN_MCU_R1_MCU_FVT_R_OilPmpTarSpd_Req_1008T: ComBitPosition=52, ComBitSize=13, ComSignalType=UINT16, ComHandleId=71, ComSystemTemplateSystemSignalRef=CAN_MCU_R1_MCU_FVT_R_OilPmpTarSpd_Req
      ComTimeBase: ComGwTimeBase=0.005, ComRxTimeBase=0.005, ComTxTimeBase=0.005
      ComTxMainFunctions
        Com_MainFunctionTx_0 (Com_MainFunctionTx): ComTxTimeBase=0.005, ComPartitionRef=(unset)
    ComDefensiveProgramming:
      ComDefProgEnabled = 0
      ComInvariantAssertEnabled = 0
      ComPostcondAssertEnabled = 0
      ComPrecondAssertEnabled = 0
      ComStaticAssertEnabled = 0
      ComUnreachAssertEnabled = 0
    ComGeneral: ComConfigurationUseDet=1, ComEnableSignalGroupArrayApi=1, ComSupportedIPduGroups=32, ComVersionInfoApi=1
      VendorSpecific:
        ComBasedTransformerSupportRx = 1
        ComBasedTransformerSupportTx = 1
        ComCallOutFuncPtrArraySizeMax = INDEX_UINT16
        ComCbkRxAckPtrArraySizeMax = INDEX_UINT16
        ComCbkRxTOutArraySizeMax = INDEX_UINT16
        ComCbkTxAckPtrArraySizeMax = INDEX_UINT16
        ComCbkTxTOutArraySizeMax = INDEX_UINT16
        ComCheckValueSizeEnable = 0
        ComClearUpdateBitTxTransmitEnable = 1
        ComClearUpdateBitTxTriggerTransmitEnable = 1
        ComClearUpdateBitTxTxConfirmationEnable = 1
        ComConfigurationArraySizeMax = INDEX_UINT32
        ComConstCfgAddress = 0
        ComConstCfgAddressEnable = 0
        ComDeferTx2MainFunc = 0
        ComFilterOneEveryNOccuranceMax = SIZE_16_BIT
        ComFilterOneEveryNPeriodOffSMax = SIZE_16_BIT
        ComFilterReceiverEnable = 1
        ComHandleSmallerRxPdus = TRUNCATE_DATA_NOTIFY_ALL
        ComIpduGroupStartStopAPIEnable = 0
        ComRamSizeMax = INDEX_UINT16
        ComRelocatableCfgEnable = 1
        ComReportToDetEnable = 1
        ComRxBigEndianEnable = 1
        ComRxDataTimeoutAction = RX_DATA_TIMEOUT_ACTION_CONFIG
        ComRxDynLengthIPduEnable = 1
        ComRxFirstTimeoutFactorSize = SIZE_16_BIT
        ComRxLittleEndianEnable = 1
        ComRxSigConfDeferredEnable = 1
        ComRxSigConfImmediateEnable = 1
        ComRxTimeoutFactorSize = SIZE_16_BIT
        ComRxTpAPIEnable = 0
        ComSigGwRxFilterEnable = 0
        ComSignalGroupArrayLengthParamEnable = 1
        ComSignalGwEnable = 1
        ComTmsEnable = 1
        ComTransfPropTriggeredEnable = 1
        ComTransfPropTriggeredOCEnable = 1
        ComTransfPropWithoutRepEnable = 1
        ComTriggerTxCallOutEnable = 1
        ComTxBigEndianEnable = 1
        ComTxDynLengthIPduEnable = 1
        ComTxGroupSignalNoLock = 0
        ComTxIpduMDTFactorSize = SIZE_16_BIT
        ComTxLittleEndianEnable = 1
        ComTxModeBehaviour = AUTOSAR
        ComTxModeDirectEnable = 1
        ComTxModeMixedDirectEnable = 1
        ComTxModeMixedNTimesEnable = 1
        ComTxModeNTimesEnable = 1
        ComTxModePeriodicEnable = 1
        ComTxModeRepetitionPeriodFactorS = SIZE_16_BIT
        ComTxModeTimeOffsetFactorSize = SIZE_16_BIT
        ComTxModeTimePeriodFactorSize = SIZE_16_BIT
        ComTxSigConfDeferredEnable = 1
        ComTxSigConfImmediateEnable = 1
        ComTxTimeoutFactorSize = SIZE_16_BIT
        ComTxTpAPIEnable = 0
        ComTxZeroSignalEnable = 0
        ComUpdateBitRxConfig = UPDATE_BIT_INDIVIDUAL
        ComUpdateBitTxConfig = UPDATE_BIT_INDIVIDUAL
        Com_TxF_MaskNewDiffersMaskOld_En = 1
