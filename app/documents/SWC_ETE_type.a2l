/******************************************************************************
* ASAP2 file: hcu_main.a2l
* Code generation for model "hcu_main".
* Model version : 3.10
* Simulink Coder version : 9.6 (R2021b) 14-May-2021
* C source code generated on : Wed Sep 28 09:25:40 2022
* Target selection: ert.tlc
* Embedded hardware selection: ARM Compatible->ARM 10
* Code generation objectives: Unspecified
* Validation result: Not run
* (add additional file header information here)
******************************************************************************/ ASAP2_VERSION 1 60
/* Version 1.60 */
/begin PROJECT ProjectName "Project Comment Goes Here"
/begin HEADER "Header Comments go here" /end HEADER
/begin MODULE ModuleName "Module Comment Goes Here"
/begin MOD_COMMON "Mod Common Comment Here" BYTE_ORDER MSB_LAST ALIGNMENT_BYTE 1 ALIGNMENT_WORD 2 ALIGNMENT_LONG 2 ALIGNMENT_FLOAT32_IEEE 2 ALIGNMENT_FLOAT64_IEEE 4 /end MOD_COMMON
/begin IF_DATA XCPplus
 /begin PROTOCOL_LAYER 0x0104 /* XCP protocol layer version 1.04 */ 2000 /* T1 [ms] */ 2000 /* T2 [ms] */ 2000 /* T3 [ms] */ 2000 /* T4 [ms] */ 2000 /* T5 [ms] */ 0005 /* T6 [ms] */ 0005 /* T7 [ms] */ 0x8 /* MAX_CTO */ 0x40 /* MAX_DTO */ BYTE_ORDER_MSB_LAST ADDRESS_GRANULARITY_BYTE /* SEED_AND_KEY_EXTERNAL_FUNCTION "stm32f1_seed_key.dll" */ OPTIONAL_CMD GET_COMM_MODE_INFO OPTIONAL_CMD GET_ID OPTIONAL_CMD SET_REQUEST OPTIONAL_CMD GET_SEED OPTIONAL_CMD UNLOCK OPTIONAL_CMD SET_MTA OPTIONAL_CMD UPLOAD OPTIONAL_CMD SHORT_UPLOAD OPTIONAL_CMD BUILD_CHECKSUM OPTIONAL_CMD TRANSPORT_LAYER_CMD OPTIONAL_CMD USER_CMD OPTIONAL_CMD DOWNLOAD OPTIONAL_CMD DOWNLOAD_NEXT OPTIONAL_CMD SET_CAL_PAGE OPTIONAL_CMD GET_CAL_PAGE OPTIONAL_CMD GET_PAG_PROCESSOR_INFO OPTIONAL_CMD SET_DAQ_PTR OPTIONAL_CMD WRITE_DAQ OPTIONAL_CMD SET_DAQ_LIST_MODE OPTIONAL_CMD GET_DAQ_LIST_MODE OPTIONAL_CMD START_STOP_DAQ_LIST OPTIONAL_CMD START_STOP_SYNCH OPTIONAL_CMD GET_DAQ_CLOCK OPTIONAL_CMD READ_DAQ OPTIONAL_CMD GET_DAQ_PROCESSOR_INFO OPTIONAL_CMD GET_DAQ_RESOLUTION_INFO OPTIONAL_CMD GET_DAQ_LIST_INFO OPTIONAL_CMD GET_DAQ_EVENT_INFO OPTIONAL_CMD FREE_DAQ OPTIONAL_CMD ALLOC_DAQ OPTIONAL_CMD ALLOC_ODT OPTIONAL_CMD ALLOC_ODT_ENTRY OPTIONAL_CMD PROGRAM_START OPTIONAL_CMD PROGRAM OPTIONAL_CMD PROGRAM_CLEAR OPTIONAL_CMD PROGRAM_RESET OPTIONAL_CMD PROGRAM_NEXT OPTIONAL_CMD COPY_CAL_PAGE OPTIONAL_CMD MODIFY_BITS
  /begin COMMUNICATION_MODE_SUPPORTED /begin BLOCK SLAVE MASTER 0xff 100 /end BLOCK /end COMMUNICATION_MODE_SUPPORTED
 /end PROTOCOL_LAYER
 /begin DAQ STATIC /* DAQ_CONFIG_TYPE */ 0x03 /* MAX_DAQ */ 0x03 /* MAX_EVENT_CHANNEL */ 0x00 /* MIN_DAQ */ OPTIMISATION_TYPE_DEFAULT /* OPTIMISATION_TYPE */ ADDRESS_EXTENSION_FREE /* ADDRESS_EXTENSION */ IDENTIFICATION_FIELD_TYPE_ABSOLUTE /* IDENTIFICATION_FIELD */ GRANULARITY_ODT_ENTRY_SIZE_DAQ_BYTE /* GRANULARITY_ODT_ENTRY_SIZE_DAQ */ 0x08 /* MAX_ODT_ENTRY_SIZE_DAQ */ NO_OVERLOAD_INDICATION PRESCALER_SUPPORTED
  /begin TIMESTAMP_SUPPORTED 1 /* TIMESTAMP_TICKS */ SIZE_WORD /* TIMESTAMP_SIZE */ UNIT_1MS /* TIMESTAMP_UNIT */ /end TIMESTAMP_SUPPORTED
  /begin DAQ_LIST 0 DAQ_LIST_TYPE DAQ MAX_ODT 2 MAX_ODT_ENTRIES 63 FIRST_PID 0 EVENT_FIXED 0 /end DAQ_LIST
  /begin DAQ_LIST 1 DAQ_LIST_TYPE DAQ MAX_ODT 2 MAX_ODT_ENTRIES 63 FIRST_PID 16 EVENT_FIXED 1 /end DAQ_LIST
  /begin DAQ_LIST 2 DAQ_LIST_TYPE DAQ MAX_ODT 2 MAX_ODT_ENTRIES 63 FIRST_PID 32 EVENT_FIXED 2 /end DAQ_LIST
  /begin EVENT "10ms" "10ms" 0 DAQ_STIM 0xff 10 6 0 /end EVENT
  /begin EVENT "20ms" "20ms" 1 DAQ_STIM 0xff 20 6 0 /end EVENT
  /begin EVENT "100ms" "100ms" 2 DAQ_STIM 0xff 10 7 0 /end EVENT
 /end DAQ
 /begin PAG 0x02 /* MAX_SEGMENTS */ FREEZE_SUPPORTED /end PAG
 /begin PGM PGM_MODE_ABSOLUTE 3 /* MAX_SECTORS */ 0x08 /* MAX_CTO_PGM */ /begin SECTOR "sector 0" 0 0x0 0x1000 2 2 0 /end SECTOR /begin SECTOR "sector 1" 1 0x1000 0x2000 1 1 0 /end SECTOR /begin SECTOR "sector 2" 2 0x3000 0x3000 0 0 0 /end SECTOR COMMUNICATION_MODE_SUPPORTED BLOCK SLAVE MASTER 0xff /* MAX_BS_PGM */ 100 /* MIN_ST_PGM */ /end PGM
 /begin XCP_ON_CAN 0x0104 /* XCP on CAN version */ CAN_ID_MASTER 0x0667 /* CMD/STIM */ CAN_ID_SLAVE 0x0621 /* RES/ERR/EV/SERV */ BAUDRATE 500000 /* BAUDRATE */ SAMPLE_POINT 80 /* SAMPLE POINT */ SAMPLE_RATE SINGLE /* SAMPLE RATE */ BTL_CYCLES 0 /* BTL CYCLES */ SJW 2 /* SJW */ SYNC_EDGE SINGLE /* SYNC EDGE */
  /begin CAN_FD MAX_DLC 64 /* 8, 12, 16, 20, 24, 32, 48 or 64 */ CAN_FD_DATA_TRANSFER_BAUDRATE 2000000 SAMPLE_POINT 80 BTL_CYCLES 0x14 SJW 0x04 /* MAX_DLC_REQUIRED */ SECONDARY_SAMPLE_POINT 0x00 TRANSCEIVER_DELAY_COMPENSATION OFF /end CAN_FD
  /begin DAQ_LIST_CAN_ID 0 FIXED 0x0621 /end DAQ_LIST_CAN_ID
  /begin DAQ_LIST_CAN_ID 1 FIXED 0x0621 /end DAQ_LIST_CAN_ID
  /begin DAQ_LIST_CAN_ID 2 FIXED 0x0621 /end DAQ_LIST_CAN_ID
 /end XCP_ON_CAN
/end IF_DATA
/begin MOD_PAR "MOD PAR Comment Goes Here" VERSION "V0.1" ADDR_EPK 0x0 EPK "" SUPPLIER "FVT" CUSTOMER "FVT internal + Demosample" CUSTOMER_NO "NONE Demo" USER "ETAS-PGA/EAP - Dm" PHONE_NO "0" ECU "S32G274A / CAN " CPU_TYPE "S32G274A" NO_OF_INTERFACES 1 /* CODE (ROM) */
 /begin MEMORY_SEGMENT APP_CODE "" CODE FLASH INTERN 0x80005000 /* int_sram start Address (rom start)*/ 0x10000 /* int_sram Size (rom size)*/ -1 -1 -1 -1 -1 /* no mirrored segments */
  /begin IF_DATA XCP
   /begin SEGMENT 0x00 /* segment logical number */ 0x01 /* number of pages */ 0x00 /* address extension */ 0x00 /* Compression method */ 0x00 /* Encryption method */
    /begin CHECKSUM XCP_CRC_16_CITT /* checksum through external function */ MAX_BLOCK_SIZE 0x00000800 /* maximum block size */ /end CHECKSUM
    /begin PAGE 0x00 /* page number */ ECU_ACCESS_WITH_XCP_ONLY XCP_READ_ACCESS_WITH_ECU_ONLY XCP_WRITE_ACCESS_NOT_ALLOWED /end PAGE
   /end SEGMENT
  /end IF_DATA
 /end MEMORY_SEGMENT
 /* REFERENCE PAGE (ROM) */
 /begin MEMORY_SEGMENT APP_CALIBDATA_Core1 "" DATA FLASH INTERN 0x803ec000 /* CAL START ADDRESS (CAL1 start)*/ 0x14000 /* CAL PAGE SIZE (All CALx size combine)*/ -1 -1 -1 -1 -1
  /begin IF_DATA XCP
   /begin SEGMENT 0x01 /* segment logical number */ 0x01 /* number of pages */ 0x00 /* address extension */ 0x00 /* Compression method */ 0x00 /* Encryption method */
    /begin CHECKSUM XCP_CRC_16_CITT /* checksum through external function */ MAX_BLOCK_SIZE 0x00000800 /* maximum block size */ /end CHECKSUM
    /begin PAGE 0x00 /* page number */ ECU_ACCESS_WITH_XCP_ONLY XCP_READ_ACCESS_WITH_ECU_ONLY XCP_WRITE_ACCESS_WITH_ECU_ONLY INIT_SEGMENT 0x00 /end PAGE
    /begin ADDRESS_MAPPING 0x803ec000 /* CAL from (CAL1 start)*/ 0xb0000000 /* CAL to (CAL1 start)*/ 0x14000 /* CAL length (All CALx size combine)*/ /end ADDRESS_MAPPING
   /end SEGMENT
  /end IF_DATA
 /end MEMORY_SEGMENT
 ECU_CALIBRATION_OFFSET 0xd03ec000 /* VARIABLE PAGE (RAM) */
 /begin MEMORY_SEGMENT DATA_BSS_CORE0 "" RESERVED RAM INTERN 0x70037800 /* data_bss_sram START ADDRESS (VAR1 start)*/ 0x800 /* data_bss_sram SIZE (All VARx size combine)*/ -1 -1 -1 -1 -1 /end MEMORY_SEGMENT
 /begin MEMORY_SEGMENT RAM_CORE0_CALIBDATA "" VARIABLES /* CALIBRATION_VARIABLES */ RAM INTERN 0xb0000000 /* VARIABLE PAGE START ADDRESS (VAR1 start)*/ 0x800 /* VARIABLE PAGE SIZE (All VARx size combine)*/ -1 -1 -1 -1 -1 /end MEMORY_SEGMENT
 /begin MEMORY_SEGMENT DATA_BSS_CORE1 "" RESERVED RAM INTERN 0x60037000 /* data_bss_sram START ADDRESS (VAR1 start)*/ 0x1000 /* data_bss_sram SIZE (All VARx size combine)*/ -1 -1 -1 -1 -1 /end MEMORY_SEGMENT
 /begin MEMORY_SEGMENT RAM_CORE1_CALIBDATA "" VARIABLES /* CALIBRATION_VARIABLES */ RAM INTERN 0xb0010000 /* VARIABLE PAGE START ADDRESS (VAR1 start)*/ 0x4000 /* VARIABLE PAGE SIZE (All VARx size combine)*/ -1 -1 -1 -1 -1 /end MEMORY_SEGMENT
/end MOD_PAR
/begin RECORD_LAYOUT Scalar_BOOLEAN FNC_VALUES 1 UBYTE COLUMN_DIR DIRECT /end RECORD_LAYOUT
/begin RECORD_LAYOUT Scalar_UBYTE FNC_VALUES 1 UBYTE COLUMN_DIR DIRECT /end RECORD_LAYOUT
/begin RECORD_LAYOUT Scalar_BYTE FNC_VALUES 1 SBYTE COLUMN_DIR DIRECT /end RECORD_LAYOUT
/begin RECORD_LAYOUT Scalar_UWORD FNC_VALUES 1 UWORD COLUMN_DIR DIRECT /end RECORD_LAYOUT
/begin RECORD_LAYOUT Scalar_SWORD FNC_VALUES 1 SWORD COLUMN_DIR DIRECT /end RECORD_LAYOUT
/begin RECORD_LAYOUT Scalar_ULONG FNC_VALUES 1 ULONG COLUMN_DIR DIRECT /end RECORD_LAYOUT
/begin RECORD_LAYOUT Scalar_LONG FNC_VALUES 1 SLONG COLUMN_DIR DIRECT /end RECORD_LAYOUT
/begin RECORD_LAYOUT Scalar_FLOAT32_IEEE FNC_VALUES 1 FLOAT32_IEEE COLUMN_DIR DIRECT /end RECORD_LAYOUT
/begin RECORD_LAYOUT Scalar_FLOAT64_IEEE FNC_VALUES 1 FLOAT64_IEEE COLUMN_DIR DIRECT /end RECORD_LAYOUT
/begin RECORD_LAYOUT Lookup1D_BOOLEAN FNC_VALUES 1 UBYTE COLUMN_DIR DIRECT /end RECORD_LAYOUT
/begin RECORD_LAYOUT Lookup1D_X_BOOLEAN AXIS_PTS_X 1 UBYTE INDEX_INCR DIRECT /end RECORD_LAYOUT
/begin RECORD_LAYOUT Lookup1D_BYTE FNC_VALUES 1 SBYTE COLUMN_DIR DIRECT /end RECORD_LAYOUT
/begin RECORD_LAYOUT Lookup1D_X_BYTE AXIS_PTS_X 1 SBYTE INDEX_INCR DIRECT /end RECORD_LAYOUT
/begin RECORD_LAYOUT Lookup1D_UBYTE FNC_VALUES 1 UBYTE COLUMN_DIR DIRECT /end RECORD_LAYOUT
/begin RECORD_LAYOUT Lookup1D_X_UBYTE AXIS_PTS_X 1 UBYTE INDEX_INCR DIRECT /end RECORD_LAYOUT
/begin RECORD_LAYOUT Lookup1D_UWORD FNC_VALUES 1 UWORD COLUMN_DIR DIRECT /end RECORD_LAYOUT
/begin RECORD_LAYOUT Lookup1D_X_UWORD AXIS_PTS_X 1 UWORD INDEX_INCR DIRECT /end RECORD_LAYOUT
/begin RECORD_LAYOUT Lookup1D_WORD FNC_VALUES 1 SWORD COLUMN_DIR DIRECT /end RECORD_LAYOUT
/begin RECORD_LAYOUT Lookup1D_X_WORD AXIS_PTS_X 1 SWORD INDEX_INCR DIRECT /end RECORD_LAYOUT
/begin RECORD_LAYOUT Lookup1D_ULONG FNC_VALUES 1 ULONG COLUMN_DIR DIRECT /end RECORD_LAYOUT
/begin RECORD_LAYOUT Lookup1D_X_ULONG AXIS_PTS_X 1 ULONG INDEX_INCR DIRECT /end RECORD_LAYOUT
/begin RECORD_LAYOUT Lookup1D_SLONG FNC_VALUES 1 SLONG COLUMN_DIR DIRECT /end RECORD_LAYOUT
/begin RECORD_LAYOUT Lookup1D_X_LONG AXIS_PTS_X 1 SLONG INDEX_INCR DIRECT /end RECORD_LAYOUT
/begin RECORD_LAYOUT Lookup1D_FLOAT32_IEEE FNC_VALUES 1 FLOAT32_IEEE COLUMN_DIR DIRECT /end RECORD_LAYOUT
/begin RECORD_LAYOUT Lookup1D_X_FLOAT32_IEEE AXIS_PTS_X 1 FLOAT32_IEEE INDEX_INCR DIRECT /end RECORD_LAYOUT
/begin RECORD_LAYOUT Lookup1D_FLOAT64_IEEE FNC_VALUES 1 FLOAT64_IEEE COLUMN_DIR DIRECT /end RECORD_LAYOUT
/begin RECORD_LAYOUT Lookup1D_X_FLOAT64_IEEE AXIS_PTS_X 1 FLOAT64_IEEE INDEX_INCR DIRECT /end RECORD_LAYOUT
/begin RECORD_LAYOUT Lookup2D_BOOLEAN FNC_VALUES 1 UBYTE COLUMN_DIR DIRECT /end RECORD_LAYOUT
/begin RECORD_LAYOUT Lookup2D_X_BOOLEAN AXIS_PTS_X 1 UBYTE INDEX_INCR DIRECT /end RECORD_LAYOUT
/begin RECORD_LAYOUT Lookup2D_UBYTE FNC_VALUES 1 UBYTE COLUMN_DIR DIRECT /end RECORD_LAYOUT
/begin RECORD_LAYOUT Lookup2D_X_UBYTE AXIS_PTS_X 1 UBYTE INDEX_INCR DIRECT /end RECORD_LAYOUT
/begin RECORD_LAYOUT Lookup2D_BYTE FNC_VALUES 1 SBYTE COLUMN_DIR DIRECT /end RECORD_LAYOUT
/begin RECORD_LAYOUT Lookup2D_X_BYTE AXIS_PTS_X 1 SBYTE INDEX_INCR DIRECT /end RECORD_LAYOUT
/begin RECORD_LAYOUT Lookup2D_UWORD FNC_VALUES 1 UWORD COLUMN_DIR DIRECT /end RECORD_LAYOUT
/begin RECORD_LAYOUT Lookup2D_X_UWORD AXIS_PTS_X 1 UWORD INDEX_INCR DIRECT /end RECORD_LAYOUT
/begin RECORD_LAYOUT Lookup2D_WORD FNC_VALUES 1 SWORD COLUMN_DIR DIRECT /end RECORD_LAYOUT
/begin RECORD_LAYOUT Lookup2D_X_WORD AXIS_PTS_X 1 SWORD INDEX_INCR DIRECT /end RECORD_LAYOUT
/begin RECORD_LAYOUT Lookup2D_ULONG FNC_VALUES 1 ULONG COLUMN_DIR DIRECT /end RECORD_LAYOUT
/begin RECORD_LAYOUT Lookup2D_X_ULONG AXIS_PTS_X 1 ULONG INDEX_INCR DIRECT /end RECORD_LAYOUT
/begin RECORD_LAYOUT Lookup2D_LONG FNC_VALUES 1 SLONG COLUMN_DIR DIRECT /end RECORD_LAYOUT
/begin RECORD_LAYOUT Lookup2D_X_LONG AXIS_PTS_X 1 SLONG INDEX_INCR DIRECT /end RECORD_LAYOUT
/begin RECORD_LAYOUT Lookup2D_FLOAT32_IEEE FNC_VALUES 1 FLOAT32_IEEE COLUMN_DIR DIRECT /end RECORD_LAYOUT
/begin RECORD_LAYOUT Lookup2D_X_FLOAT32_IEEE AXIS_PTS_X 1 FLOAT32_IEEE INDEX_INCR DIRECT /end RECORD_LAYOUT
/begin RECORD_LAYOUT Lookup2D_FLOAT64_IEEE FNC_VALUES 1 FLOAT64_IEEE COLUMN_DIR DIRECT /end RECORD_LAYOUT
/begin RECORD_LAYOUT Lookup2D_X_FLOAT64_IEEE AXIS_PTS_X 1 FLOAT64_IEEE INDEX_INCR DIRECT /end RECORD_LAYOUT
/begin CHARACTERISTIC MEOP_nReqMotSpdMax_Y_T "" CURVE 0x0000 /* @ECU_Address@MEOP_nReqMotSpdMax_Y_T@ */ Lookup1D_FLOAT32_IEEE 0 SWC_ETE_type_CM_single_rpm -10000.0 10000.0
 /begin AXIS_DESCR COM_AXIS NO_INPUT_QUANTITY SWC_ETE_type_CM_single_degC 5 -500.0 500.0 AXIS_PTS_REF AEOP_nReqMotSpdMax_X_A /end AXIS_DESCR
/end CHARACTERISTIC
/begin AXIS_PTS AEOP_nReqMotSpdMax_X_A "" 0x0000 /* @ECU_Address@AEOP_nReqMotSpdMax_X_A@ */ NO_INPUT_QUANTITY Lookup1D_X_FLOAT32_IEEE 0 SWC_ETE_type_CM_single_degC 5 -500.0 500.0 /end AXIS_PTS
/begin CHARACTERISTIC MLLC_volCoolFlowOil_Y_T "" CURVE 0x0000 /* @ECU_Address@MLLC_volCoolFlowOil_Y_T@ */ Lookup1D_FLOAT32_IEEE 0 SWC_ETE_type_CM_single_flow -1000.0 1000.0
 /begin AXIS_DESCR COM_AXIS VFOC_ADCOilTemp_degC SWC_ETE_type_CM_single_degC 4 -500.0 500.0 AXIS_PTS_REF ALLC_volCoolFlowOil_X_degC /end AXIS_DESCR
/end CHARACTERISTIC
/begin AXIS_PTS ALLC_volCoolFlowOil_X_degC "" 0x0000 /* @ECU_Address@ALLC_volCoolFlowOil_X_degC@ */ VFOC_ADCOilTemp_degC Lookup1D_X_FLOAT32_IEEE 0 SWC_ETE_type_CM_single_degC 4 -500.0 500.0 /end AXIS_PTS
/begin CHARACTERISTIC MLLC_volCoolFlowWater_Z_M "" MAP 0x0000 /* @ECU_Address@MLLC_volCoolFlowWater_Z_M@ */ Lookup2D_FLOAT32_IEEE 0 SWC_ETE_type_CM_single_M -100.0 100.0
 /begin AXIS_DESCR COM_AXIS VCRM_PwrEleAct_W SWC_ETE_type_CM_single_kW 4 -100.0 100.0 AXIS_PTS_REF ALLC_volCoolFlowWater_X_kW /end AXIS_DESCR
 /begin AXIS_DESCR COM_AXIS NO_INPUT_QUANTITY SWC_ETE_type_CM_single_degC 4 -500.0 500.0 AXIS_PTS_REF ALLC_volCoolFlowWater_Y_degC /end AXIS_DESCR
/end CHARACTERISTIC
/begin AXIS_PTS ALLC_volCoolFlowWater_Y_degC "" 0x0000 /* @ECU_Address@ALLC_volCoolFlowWater_Y_degC@ */ NO_INPUT_QUANTITY Lookup2D_X_FLOAT32_IEEE 0 SWC_ETE_type_CM_single_degC 4 -500.0 500.0 /end AXIS_PTS
/begin AXIS_PTS ALLC_volCoolFlowWater_X_kW "" 0x0000 /* @ECU_Address@ALLC_volCoolFlowWater_X_kW@ */ VCRM_PwrEleAct_W Lookup2D_X_FLOAT32_IEEE 0 SWC_ETE_type_CM_single_kW 4 -100.0 100.0 /end AXIS_PTS
/begin CHARACTERISTIC MLLC_volfCooltFlow_Y_T "" CURVE 0x0000 /* @ECU_Address@MLLC_volfCooltFlow_Y_T@ */ Lookup1D_FLOAT32_IEEE 0 SWC_ETE_type_CM_single_flow -1000.0 1000.0
 /begin AXIS_DESCR COM_AXIS NO_INPUT_QUANTITY SWC_ETE_type_CM_single_degC 4 -500.0 500.0 AXIS_PTS_REF ALLC_volfCooltFlow_X_degC /end AXIS_DESCR
/end CHARACTERISTIC
/begin AXIS_PTS ALLC_volfCooltFlow_X_degC "" 0x0000 /* @ECU_Address@ALLC_volfCooltFlow_X_degC@ */ NO_INPUT_QUANTITY Lookup1D_X_FLOAT32_IEEE 0 SWC_ETE_type_CM_single_degC 4 -500.0 500.0 /end AXIS_PTS
/begin CHARACTERISTIC MSYL_TrqMax_Z_Nm "" MAP 0x0000 /* @ECU_Address@MSYL_TrqMax_Z_Nm@ */ Lookup2D_FLOAT32_IEEE 0 SWC_ETE_type_CM_single_Nm 0.0 500.0
 /begin AXIS_DESCR COM_AXIS NO_INPUT_QUANTITY SWC_ETE_type_CM_single_V 5 0.0 700.0 AXIS_PTS_REF ASYL_TrqMax_X_V /end AXIS_DESCR
 /begin AXIS_DESCR COM_AXIS NO_INPUT_QUANTITY SWC_ETE_type_CM_single_rpm 21 0.0 20000.0 AXIS_PTS_REF ASYL_TrqMax_Y_rpm /end AXIS_DESCR
/end CHARACTERISTIC
/begin AXIS_PTS ASYL_TrqMax_Y_rpm "" 0x0000 /* @ECU_Address@ASYL_TrqMax_Y_rpm@ */ NO_INPUT_QUANTITY Lookup2D_X_FLOAT32_IEEE 0 SWC_ETE_type_CM_single_rpm 21 0.0 20000.0 /end AXIS_PTS
/begin AXIS_PTS ASYL_TrqMax_X_V "" 0x0000 /* @ECU_Address@ASYL_TrqMax_X_V@ */ NO_INPUT_QUANTITY Lookup2D_X_FLOAT32_IEEE 0 SWC_ETE_type_CM_single_V 5 0.0 700.0 /end AXIS_PTS
/begin CHARACTERISTIC MSYL_TrqMin_Z_Nm "" MAP 0x0000 /* @ECU_Address@MSYL_TrqMin_Z_Nm@ */ Lookup2D_FLOAT32_IEEE 0 SWC_ETE_type_CM_single_Nm -500.0 0.0
 /begin AXIS_DESCR COM_AXIS NO_INPUT_QUANTITY SWC_ETE_type_CM_single_V 5 0.0 700.0 AXIS_PTS_REF ASYL_TrqMin_X_V /end AXIS_DESCR
 /begin AXIS_DESCR COM_AXIS NO_INPUT_QUANTITY SWC_ETE_type_CM_single_rpm 21 0.0 20000.0 AXIS_PTS_REF ASYL_TrqMin_Y_rpm /end AXIS_DESCR
/end CHARACTERISTIC
/begin AXIS_PTS ASYL_TrqMin_Y_rpm "" 0x0000 /* @ECU_Address@ASYL_TrqMin_Y_rpm@ */ NO_INPUT_QUANTITY Lookup2D_X_FLOAT32_IEEE 0 SWC_ETE_type_CM_single_rpm 21 0.0 20000.0 /end AXIS_PTS
/begin AXIS_PTS ASYL_TrqMin_X_V "" 0x0000 /* @ECU_Address@ASYL_TrqMin_X_V@ */ NO_INPUT_QUANTITY Lookup2D_X_FLOAT32_IEEE 0 SWC_ETE_type_CM_single_V 5 0.0 700.0 /end AXIS_PTS
/begin CHARACTERISTIC MCRM_Eta_Y_null "" CURVE 0x0000 /* @ECU_Address@MCRM_Eta_Y_null@ */ Lookup1D_FLOAT32_IEEE 0 SWC_ETE_type_CM_single_constant 0.0 10.0
 /begin AXIS_DESCR COM_AXIS NO_INPUT_QUANTITY SWC_ETE_type_CM_single_RPM 4 0.0 20000.0 AXIS_PTS_REF ACRM_Eta_X_rpm /end AXIS_DESCR
/end CHARACTERISTIC
/begin AXIS_PTS ACRM_Eta_X_rpm "" 0x0000 /* @ECU_Address@ACRM_Eta_X_rpm@ */ NO_INPUT_QUANTITY Lookup1D_X_FLOAT32_IEEE 0 SWC_ETE_type_CM_single_RPM 4 0.0 20000.0 /end AXIS_PTS
/begin CHARACTERISTIC MEOP_nRrOilTempDetOptMod_Z_M "" MAP 0x0000 /* @ECU_Address@MEOP_nRrOilTempDetOptMod_Z_M@ */ Lookup2D_FLOAT32_IEEE 0 SWC_ETE_type_CM_single_M -10000.0 10000.0
 /begin AXIS_DESCR COM_AXIS NO_INPUT_QUANTITY SWC_ETE_type_CM_single_degC 9 -500.0 500.0 AXIS_PTS_REF AEOP_nRrOilTempSpdMod_X_degC /end AXIS_DESCR
 /begin AXIS_DESCR COM_AXIS NO_INPUT_QUANTITY SWC_ETE_type_CM_single_kW 10 -100.0 100.0 AXIS_PTS_REF AEOP_nRrOilTempSpdMod_Y_KW /end AXIS_DESCR
/end CHARACTERISTIC
/begin AXIS_PTS AEOP_nRrOilTempSpdMod_Y_KW "" 0x0000 /* @ECU_Address@AEOP_nRrOilTempSpdMod_Y_KW@ */ NO_INPUT_QUANTITY Lookup2D_X_FLOAT32_IEEE 0 SWC_ETE_type_CM_single_kW 10 -100.0 100.0 /end AXIS_PTS
/begin AXIS_PTS AEOP_nRrOilTempSpdMod_X_degC "" 0x0000 /* @ECU_Address@AEOP_nRrOilTempSpdMod_X_degC@ */ NO_INPUT_QUANTITY Lookup2D_X_FLOAT32_IEEE 0 SWC_ETE_type_CM_single_degC 9 -500.0 500.0 /end AXIS_PTS
/begin CHARACTERISTIC MEOP_nRrOilTempDetOptMod_Y_T "" CURVE 0x0000 /* @ECU_Address@MEOP_nRrOilTempDetOptMod_Y_T@ */ Lookup1D_FLOAT32_IEEE 0 SWC_ETE_type_CM_single_T -10000.0 10000.0
 /begin AXIS_DESCR COM_AXIS NO_INPUT_QUANTITY SWC_ETE_type_CM_single_degC 10 -500.0 500.0 AXIS_PTS_REF AEOP_nRrTMTempSpdMod_X_degC /end AXIS_DESCR
/end CHARACTERISTIC
/begin AXIS_PTS AEOP_nRrTMTempSpdMod_X_degC "" 0x0000 /* @ECU_Address@AEOP_nRrTMTempSpdMod_X_degC@ */ NO_INPUT_QUANTITY Lookup1D_X_FLOAT32_IEEE 0 SWC_ETE_type_CM_single_degC 10 -500.0 500.0 /end AXIS_PTS
/begin CHARACTERISTIC MEOP_nRrOilTempMotOptMod_Z_M "" MAP 0x0000 /* @ECU_Address@MEOP_nRrOilTempMotOptMod_Z_M@ */ Lookup2D_FLOAT32_IEEE 0 SWC_ETE_type_CM_single_M -10000.0 10000.0
 /begin AXIS_DESCR COM_AXIS NO_INPUT_QUANTITY SWC_ETE_type_CM_single_degC 9 -500.0 500.0 AXIS_PTS_REF AEOP_nRrOilTempSpdMod_X_degC /end AXIS_DESCR
 /begin AXIS_DESCR COM_AXIS NO_INPUT_QUANTITY SWC_ETE_type_CM_single_kW 10 -100.0 100.0 AXIS_PTS_REF AEOP_nRrOilTempSpdMod_Y_KW /end AXIS_DESCR
/end CHARACTERISTIC
/begin CHARACTERISTIC MEOP_nRrTMTempMotOptMod_Y_T "" CURVE 0x0000 /* @ECU_Address@MEOP_nRrTMTempMotOptMod_Y_T@ */ Lookup1D_FLOAT32_IEEE 0 SWC_ETE_type_CM_single_T -10000.0 10000.0
 /begin AXIS_DESCR COM_AXIS NO_INPUT_QUANTITY SWC_ETE_type_CM_single_degC 10 -500.0 500.0 AXIS_PTS_REF AEOP_nRrTMTempSpdMod_X_degC /end AXIS_DESCR
/end CHARACTERISTIC
/begin CHARACTERISTIC MEOP_nRrOilTempSpdMod_Z_M "" MAP 0x0000 /* @ECU_Address@MEOP_nRrOilTempSpdMod_Z_M@ */ Lookup2D_FLOAT32_IEEE 0 SWC_ETE_type_CM_single_M -10000.0 10000.0
 /begin AXIS_DESCR COM_AXIS NO_INPUT_QUANTITY SWC_ETE_type_CM_single_degC 9 -500.0 500.0 AXIS_PTS_REF AEOP_nRrOilTempSpdMod_X_degC /end AXIS_DESCR
 /begin AXIS_DESCR COM_AXIS NO_INPUT_QUANTITY SWC_ETE_type_CM_single_kW 10 -100.0 100.0 AXIS_PTS_REF AEOP_nRrOilTempSpdMod_Y_KW /end AXIS_DESCR
/end CHARACTERISTIC
/begin CHARACTERISTIC MEOP_nRrTMTempSpdMod_Y_T "" CURVE 0x0000 /* @ECU_Address@MEOP_nRrTMTempSpdMod_Y_T@ */ Lookup1D_FLOAT32_IEEE 0 SWC_ETE_type_CM_single_T -10000.0 10000.0
 /begin AXIS_DESCR COM_AXIS NO_INPUT_QUANTITY SWC_ETE_type_CM_single_degC 10 -500.0 500.0 AXIS_PTS_REF AEOP_nRrTMTempSpdMod_X_degC /end AXIS_DESCR
/end CHARACTERISTIC
/begin CHARACTERISTIC MCRM_MTPVIdLimt_Y_A "" CURVE 0x0000 /* @ECU_Address@MCRM_MTPVIdLimt_Y_A@ */ Lookup1D_FLOAT32_IEEE 0 SWC_ETE_type_CM_single_A -600.0 0.0
 /begin AXIS_DESCR COM_AXIS NO_INPUT_QUANTITY SWC_ETE_type_CM_single_RPM 18 0.0 20000.0 AXIS_PTS_REF ACRM_MTPVIdLimt_X_rpm /end AXIS_DESCR
/end CHARACTERISTIC
/begin AXIS_PTS ACRM_MTPVIdLimt_X_rpm "" 0x0000 /* @ECU_Address@ACRM_MTPVIdLimt_X_rpm@ */ NO_INPUT_QUANTITY Lookup1D_X_FLOAT32_IEEE 0 SWC_ETE_type_CM_single_RPM 18 0.0 20000.0 /end AXIS_PTS
/begin CHARACTERISTIC MCRM_MTPAIdGen_Z_A "" MAP 0x0000 /* @ECU_Address@MCRM_MTPAIdGen_Z_A@ */ Lookup2D_FLOAT32_IEEE 0 SWC_ETE_type_CM_single_A -500.0 20.0
 /begin AXIS_DESCR COM_AXIS NO_INPUT_QUANTITY SWC_ETE_type_CM_single_RPM 20 0.0 20000.0 AXIS_PTS_REF ACRM_MTPAIdMot_X_rpm /end AXIS_DESCR
 /begin AXIS_DESCR COM_AXIS NO_INPUT_QUANTITY SWC_ETE_type_CM_single_Nm 51 0.0 500.0 AXIS_PTS_REF ACRM_MTPAIdMot_Y_Nm /end AXIS_DESCR
/end CHARACTERISTIC
/begin AXIS_PTS ACRM_MTPAIdMot_Y_Nm "" 0x0000 /* @ECU_Address@ACRM_MTPAIdMot_Y_Nm@ */ NO_INPUT_QUANTITY Lookup2D_X_FLOAT32_IEEE 0 SWC_ETE_type_CM_single_Nm 51 0.0 500.0 /end AXIS_PTS
/begin AXIS_PTS ACRM_MTPAIdMot_X_rpm "" 0x0000 /* @ECU_Address@ACRM_MTPAIdMot_X_rpm@ */ NO_INPUT_QUANTITY Lookup2D_X_FLOAT32_IEEE 0 SWC_ETE_type_CM_single_RPM 20 0.0 20000.0 /end AXIS_PTS
/begin CHARACTERISTIC MCRM_MTPAIdMot_Z_A "" MAP 0x0000 /* @ECU_Address@MCRM_MTPAIdMot_Z_A@ */ Lookup2D_FLOAT32_IEEE 0 SWC_ETE_type_CM_single_A -500.0 20.0
 /begin AXIS_DESCR COM_AXIS NO_INPUT_QUANTITY SWC_ETE_type_CM_single_RPM 20 0.0 20000.0 AXIS_PTS_REF ACRM_MTPAIdMot_X_rpm /end AXIS_DESCR
 /begin AXIS_DESCR COM_AXIS NO_INPUT_QUANTITY SWC_ETE_type_CM_single_Nm 51 0.0 500.0 AXIS_PTS_REF ACRM_MTPAIdMot_Y_Nm /end AXIS_DESCR
/end CHARACTERISTIC
/begin CHARACTERISTIC MCRM_MTPAIdGenMin_Z_A "" MAP 0x0000 /* @ECU_Address@MCRM_MTPAIdGenMin_Z_A@ */ Lookup2D_FLOAT32_IEEE 0 SWC_ETE_type_CM_single_A -700.0 20.0
 /begin AXIS_DESCR COM_AXIS NO_INPUT_QUANTITY SWC_ETE_type_CM_single_RPM 20 0.0 20000.0 AXIS_PTS_REF ACRM_MTPAIdMotMin_X_rpm /end AXIS_DESCR
 /begin AXIS_DESCR COM_AXIS NO_INPUT_QUANTITY SWC_ETE_type_CM_single_Nm 51 0.0 500.0 AXIS_PTS_REF ACRM_MTPAIdMotMin_Y_Nm /end AXIS_DESCR
/end CHARACTERISTIC
/begin AXIS_PTS ACRM_MTPAIdMotMin_Y_Nm "" 0x0000 /* @ECU_Address@ACRM_MTPAIdMotMin_Y_Nm@ */ NO_INPUT_QUANTITY Lookup2D_X_FLOAT32_IEEE 0 SWC_ETE_type_CM_single_Nm 51 0.0 500.0 /end AXIS_PTS
/begin AXIS_PTS ACRM_MTPAIdMotMin_X_rpm "" 0x0000 /* @ECU_Address@ACRM_MTPAIdMotMin_X_rpm@ */ NO_INPUT_QUANTITY Lookup2D_X_FLOAT32_IEEE 0 SWC_ETE_type_CM_single_RPM 20 0.0 20000.0 /end AXIS_PTS
/begin CHARACTERISTIC MCRM_MTPAIdMotMin_Z_A "" MAP 0x0000 /* @ECU_Address@MCRM_MTPAIdMotMin_Z_A@ */ Lookup2D_FLOAT32_IEEE 0 SWC_ETE_type_CM_single_A -700.0 20.0
 /begin AXIS_DESCR COM_AXIS NO_INPUT_QUANTITY SWC_ETE_type_CM_single_RPM 20 0.0 20000.0 AXIS_PTS_REF ACRM_MTPAIdMotMin_X_rpm /end AXIS_DESCR
 /begin AXIS_DESCR COM_AXIS NO_INPUT_QUANTITY SWC_ETE_type_CM_single_Nm 51 0.0 500.0 AXIS_PTS_REF ACRM_MTPAIdMotMin_Y_Nm /end AXIS_DESCR
/end CHARACTERISTIC
/begin CHARACTERISTIC ACRM_MTPAIdGenMin_X_rpm "" VAL_BLK 0x0000 /* @ECU_Address@ACRM_MTPAIdGenMin_X_rpm@ */ Scalar_FLOAT32_IEEE 0 SWC_ETE_type_CM_single_RPM 0.0 20000.0 NUMBER 20 /end CHARACTERISTIC
/begin CHARACTERISTIC ACRM_MTPAIdGenMin_Y_Nm "" VAL_BLK 0x0000 /* @ECU_Address@ACRM_MTPAIdGenMin_Y_Nm@ */ Scalar_FLOAT32_IEEE 0 SWC_ETE_type_CM_single_Nm 0.0 500.0 NUMBER 51 /end CHARACTERISTIC
/begin CHARACTERISTIC ACRM_MTPAIdGen_X_rpm "" VAL_BLK 0x0000 /* @ECU_Address@ACRM_MTPAIdGen_X_rpm@ */ Scalar_FLOAT32_IEEE 0 SWC_ETE_type_CM_single_RPM 0.0 20000.0 NUMBER 20 /end CHARACTERISTIC
/begin CHARACTERISTIC ACRM_MTPAIdGen_Y_Nm "" VAL_BLK 0x0000 /* @ECU_Address@ACRM_MTPAIdGen_Y_Nm@ */ Scalar_FLOAT32_IEEE 0 SWC_ETE_type_CM_single_Nm 0.0 500.0 NUMBER 51 /end CHARACTERISTIC
/begin CHARACTERISTIC Diag2_f32_UdcLowCoefAddStep_C "" VALUE 0x0000 /* @ECU_Address@Diag2_f32_UdcLowCoefAddStep_C@ */ Scalar_FLOAT32_IEEE 0 SWC_ETE_type_CM_single_cnt 0.0 1.0 /end CHARACTERISTIC
/begin CHARACTERISTIC Diag2_f32_UdcLowCoefDepStep_C "" VALUE 0x0000 /* @ECU_Address@Diag2_f32_UdcLowCoefDepStep_C@ */ Scalar_FLOAT32_IEEE 0 SWC_ETE_type_CM_single_cnt 0.0 1.0 /end CHARACTERISTIC
/begin CHARACTERISTIC Diag2_f32_UdcLowHysBand_C "" VALUE 0x0000 /* @ECU_Address@Diag2_f32_UdcLowHysBand_C@ */ Scalar_FLOAT32_IEEE 0 SWC_ETE_type_CM_single_V -2000.0 2000.0 /end CHARACTERISTIC
/begin CHARACTERISTIC Diag2_f32_UdcLowStartDerat_C "" VALUE 0x0000 /* @ECU_Address@Diag2_f32_UdcLowStartDerat_C@ */ Scalar_FLOAT32_IEEE 0 SWC_ETE_type_CM_single_V -2000.0 2000.0 /end CHARACTERISTIC
/begin CHARACTERISTIC Diag2_f32_UdcLowStopDerat_C "" VALUE 0x0000 /* @ECU_Address@Diag2_f32_UdcLowStopDerat_C@ */ Scalar_FLOAT32_IEEE 0 SWC_ETE_type_CM_single_V -2000.0 2000.0 /end CHARACTERISTIC
/begin CHARACTERISTIC Diag2_f32_UdcOverCoefAddStep_C "" VALUE 0x0000 /* @ECU_Address@Diag2_f32_UdcOverCoefAddStep_C@ */ Scalar_FLOAT32_IEEE 0 SWC_ETE_type_CM_single_cnt 0.0 1.0 /end CHARACTERISTIC
/begin CHARACTERISTIC Diag2_f32_UdcOverCoefDepStep_C "" VALUE 0x0000 /* @ECU_Address@Diag2_f32_UdcOverCoefDepStep_C@ */ Scalar_FLOAT32_IEEE 0 SWC_ETE_type_CM_single_cnt 0.0 1.0 /end CHARACTERISTIC
/begin CHARACTERISTIC Diag2_f32_UdcOverHysBand_C "" VALUE 0x0000 /* @ECU_Address@Diag2_f32_UdcOverHysBand_C@ */ Scalar_FLOAT32_IEEE 0 SWC_ETE_type_CM_single_V -2000.0 2000.0 /end CHARACTERISTIC
/begin CHARACTERISTIC Diag2_f32_UdcOverStartDerat_C "" VALUE 0x0000 /* @ECU_Address@Diag2_f32_UdcOverStartDerat_C@ */ Scalar_FLOAT32_IEEE 0 SWC_ETE_type_CM_single_V -2000.0 2000.0 /end CHARACTERISTIC
/begin CHARACTERISTIC Diag2_f32_UdcOverStopDerat_C "" VALUE 0x0000 /* @ECU_Address@Diag2_f32_UdcOverStopDerat_C@ */ Scalar_FLOAT32_IEEE 0 SWC_ETE_type_CM_single_V -2000.0 2000.0 /end CHARACTERISTIC
/begin CHARACTERISTIC EopC_nReqMotSpdMan_C "" VALUE 0x0000 /* @ECU_Address@EopC_nReqMotSpdMan_C@ */ Scalar_FLOAT32_IEEE 0 SWC_ETE_type_CM_single_rpm -10000.0 10000.0 /end CHARACTERISTIC
/begin CHARACTERISTIC EopC_nReqMotSpdMin_C "" VALUE 0x0000 /* @ECU_Address@EopC_nReqMotSpdMin_C@ */ Scalar_FLOAT32_IEEE 0 SWC_ETE_type_CM_single_rpm -10000.0 10000.0 /end CHARACTERISTIC
/begin CHARACTERISTIC EopC_rSpdRampDown_C "" VALUE 0x0000 /* @ECU_Address@EopC_rSpdRampDown_C@ */ Scalar_FLOAT32_IEEE 0 SWC_ETE_type_CM_single_rpm -50000.0 0.0 /end CHARACTERISTIC
/begin CHARACTERISTIC EopC_rSpdRampUp_C "" VALUE 0x0000 /* @ECU_Address@EopC_rSpdRampUp_C@ */ Scalar_FLOAT32_IEEE 0 SWC_ETE_type_CM_single_rpm 0.0 50000.0 /end CHARACTERISTIC
/begin CHARACTERISTIC KCRM_AtSweep_deg_ovrdval "" VALUE 0x0000 /* @ECU_Address@KCRM_AtSweep_deg_ovrdval@ */ Scalar_FLOAT32_IEEE 0 SWC_ETE_type_CM_single_deg 0.0 180.0 /end CHARACTERISTIC
/begin CHARACTERISTIC KCRM_BusCurFil_null "" VALUE 0x0000 /* @ECU_Address@KCRM_BusCurFil_null@ */ Scalar_FLOAT32_IEEE 0 SWC_ETE_type_CM_single_constant 0.0 1000.0 /end CHARACTERISTIC
/begin CHARACTERISTIC KCRM_CurTqCmdHi_Nm "" VALUE 0x0000 /* @ECU_Address@KCRM_CurTqCmdHi_Nm@ */ Scalar_FLOAT32_IEEE 0 SWC_ETE_type_CM_single_Nm 0.0 1000.0 /end CHARACTERISTIC
/begin CHARACTERISTIC KCRM_CurTqCmdLo_Nm "" VALUE 0x0000 /* @ECU_Address@KCRM_CurTqCmdLo_Nm@ */ Scalar_FLOAT32_IEEE 0 SWC_ETE_type_CM_single_Nm 0.0 1000.0 /end CHARACTERISTIC
/begin CHARACTERISTIC KCRM_DynoDeratingFiltFac_null "" VALUE 0x0000 /* @ECU_Address@KCRM_DynoDeratingFiltFac_null@ */ Scalar_FLOAT32_IEEE 0 SWC_ETE_type_CM_single_constant 0.0 100.0 /end CHARACTERISTIC
/begin CHARACTERISTIC KCRM_FWCEnable_null "" VALUE 0x0000 /* @ECU_Address@KCRM_FWCEnable_null@ */ Scalar_FLOAT32_IEEE 0 SWC_ETE_type_CM_single_constant 0.0 1.0 /end CHARACTERISTIC
/begin CHARACTERISTIC KCRM_FWCKi_null "" VALUE 0x0000 /* @ECU_Address@KCRM_FWCKi_null@ */ Scalar_FLOAT32_IEEE 0 SWC_ETE_type_CM_single_constant 0.0 1000.0 /end CHARACTERISTIC
/begin CHARACTERISTIC KCRM_FWCKp_null "" VALUE 0x0000 /* @ECU_Address@KCRM_FWCKp_null@ */ Scalar_FLOAT32_IEEE 0 SWC_ETE_type_CM_single_constant 0.0 1000.0 /end CHARACTERISTIC
/begin CHARACTERISTIC KCRM_IdCmdFilCoeff_null "" VALUE 0x0000 /* @ECU_Address@KCRM_IdCmdFilCoeff_null@ */ Scalar_FLOAT32_IEEE 0 SWC_ETE_type_CM_single_constant 0.0 100.0 /end CHARACTERISTIC
/begin CHARACTERISTIC KCRM_IdCmdMaxLimt_A "" VALUE 0x0000 /* @ECU_Address@KCRM_IdCmdMaxLimt_A@ */ Scalar_FLOAT32_IEEE 0 SWC_ETE_type_CM_single_A -1000.0 0.0 /end CHARACTERISTIC
/begin CHARACTERISTIC KCRM_IdSpForActvDisc_null "" VALUE 0x0000 /* @ECU_Address@KCRM_IdSpForActvDisc_null@ */ Scalar_FLOAT32_IEEE 0 SWC_ETE_type_CM_single_A -1000.0 1000.0 /end CHARACTERISTIC
/begin CHARACTERISTIC KCRM_IdSp_A_ovrdval "" VALUE 0x0000 /* @ECU_Address@KCRM_IdSp_A_ovrdval@ */ Scalar_FLOAT32_IEEE 0 SWC_ETE_type_CM_single_A -700.0 700.0 /end CHARACTERISTIC
/begin CHARACTERISTIC KCRM_IdqMapVolHi_V "" VALUE 0x0000 /* @ECU_Address@KCRM_IdqMapVolHi_V@ */ Scalar_FLOAT32_IEEE 0 SWC_ETE_type_CM_single_V 0.0 1000.0 /end CHARACTERISTIC
/begin CHARACTERISTIC KCRM_IdqMapVolLo_V "" VALUE 0x0000 /* @ECU_Address@KCRM_IdqMapVolLo_V@ */ Scalar_FLOAT32_IEEE 0 SWC_ETE_type_CM_single_V 0.0 1000.0 /end CHARACTERISTIC
/begin CHARACTERISTIC KCRM_IqCmdFilCoeff_null "" VALUE 0x0000 /* @ECU_Address@KCRM_IqCmdFilCoeff_null@ */ Scalar_FLOAT32_IEEE 0 SWC_ETE_type_CM_single_constant 0.0 100.0 /end CHARACTERISTIC
/begin CHARACTERISTIC KCRM_IqDeratingFac_null "" VALUE 0x0000 /* @ECU_Address@KCRM_IqDeratingFac_null@ */ Scalar_FLOAT32_IEEE 0 SWC_ETE_type_CM_single_constant 0.0 1.0 /end CHARACTERISTIC
/begin CHARACTERISTIC KCRM_IqDeratingRecoverTi_ms "" VALUE 0x0000 /* @ECU_Address@KCRM_IqDeratingRecoverTi_ms@ */ Scalar_FLOAT32_IEEE 0 SWC_ETE_type_CM_single_ms 0.0 100000.0 /end CHARACTERISTIC
/begin CHARACTERISTIC KCRM_IqDeratingTi_ms "" VALUE 0x0000 /* @ECU_Address@KCRM_IqDeratingTi_ms@ */ Scalar_FLOAT32_IEEE 0 SWC_ETE_type_CM_single_ms 0.0 100000.0 /end CHARACTERISTIC
/begin CHARACTERISTIC KCRM_IqSp_A_ovrdval "" VALUE 0x0000 /* @ECU_Address@KCRM_IqSp_A_ovrdval@ */ Scalar_FLOAT32_IEEE 0 SWC_ETE_type_CM_single_A -700.0 700.0 /end CHARACTERISTIC
/begin CHARACTERISTIC KCRM_IsSp_A "" VALUE 0x0000 /* @ECU_Address@KCRM_IsSp_A@ */ Scalar_FLOAT32_IEEE 0 SWC_ETE_type_CM_single_A -700.0 700.0 /end CHARACTERISTIC
/begin CHARACTERISTIC KCRM_MTPVSpdThd_rpm "" VALUE 0x0000 /* @ECU_Address@KCRM_MTPVSpdThd_rpm@ */ Scalar_FLOAT32_IEEE 0 SWC_ETE_type_CM_single_RPM -20000.0 20000.0 /end CHARACTERISTIC
/begin CHARACTERISTIC KCRM_MinVolOfst4FW_V "" VALUE 0x0000 /* @ECU_Address@KCRM_MinVolOfst4FW_V@ */ Scalar_FLOAT32_IEEE 0 SWC_ETE_type_CM_single_V 0.0 1000.0 /end CHARACTERISTIC
/begin CHARACTERISTIC KCRM_PILowerLimit_null "" VALUE 0x0000 /* @ECU_Address@KCRM_PILowerLimit_null@ */ Scalar_FLOAT32_IEEE 0 SWC_ETE_type_CM_single_constant -1000.0 0.0 /end CHARACTERISTIC
/begin CHARACTERISTIC KCRM_SpdCtlPrd_s "" VALUE 0x0000 /* @ECU_Address@KCRM_SpdCtlPrd_s@ */ Scalar_FLOAT32_IEEE 0 SWC_ETE_type_CM_single_s 0.0 1000.0 /end CHARACTERISTIC
/begin CHARACTERISTIC KCRM_VolModINV_perc "" VALUE 0x0000 /* @ECU_Address@KCRM_VolModINV_perc@ */ Scalar_FLOAT32_IEEE 0 SWC_ETE_type_CM_single_constant 0.0 20.0 /end CHARACTERISTIC
/begin CHARACTERISTIC KCRM_VolOfstVsBattVol4FW_V "" VALUE 0x0000 /* @ECU_Address@KCRM_VolOfstVsBattVol4FW_V@ */ Scalar_FLOAT32_IEEE 0 SWC_ETE_type_CM_single_V 0.0 1000.0 /end CHARACTERISTIC
/begin CHARACTERISTIC KCRM_grdIsThetaRampDown_C "" VALUE 0x0000 /* @ECU_Address@KCRM_grdIsThetaRampDown_C@ */ Scalar_FLOAT32_IEEE 0 SWC_ETE_type_CM_single_constant -100.0 0.0 /end CHARACTERISTIC
/begin CHARACTERISTIC KCRM_grdIsThetaRampUp_C "" VALUE 0x0000 /* @ECU_Address@KCRM_grdIsThetaRampUp_C@ */ Scalar_FLOAT32_IEEE 0 SWC_ETE_type_CM_single_constant 0.0 100.0 /end CHARACTERISTIC
/begin CHARACTERISTIC KCRM_nDebugOverSpd_rpm "" VALUE 0x0000 /* @ECU_Address@KCRM_nDebugOverSpd_rpm@ */ Scalar_FLOAT32_IEEE 0 SWC_ETE_type_CM_single_RPM 0.0 20000.0 /end CHARACTERISTIC
/begin CHARACTERISTIC KCRM_tiDebugOverSpdDlyon_ms "" VALUE 0x0000 /* @ECU_Address@KCRM_tiDebugOverSpdDlyon_ms@ */ Scalar_FLOAT32_IEEE 0 SWC_ETE_type_CM_single_ms 0.0 100000.0 /end CHARACTERISTIC
/begin CHARACTERISTIC KDGL_IGBTCoefAddStep_C "" VALUE 0x0000 /* @ECU_Address@KDGL_IGBTCoefAddStep_C@ */ Scalar_FLOAT32_IEEE 0 SWC_ETE_type_CM_single_cnt 0.0 1.0 /end CHARACTERISTIC
/begin CHARACTERISTIC KDGL_IGBTCoefDepStep_C "" VALUE 0x0000 /* @ECU_Address@KDGL_IGBTCoefDepStep_C@ */ Scalar_FLOAT32_IEEE 0 SWC_ETE_type_CM_single_cnt 0.0 1.0 /end CHARACTERISTIC
/begin CHARACTERISTIC KDGL_IGBTHysBand_C "" VALUE 0x0000 /* @ECU_Address@KDGL_IGBTHysBand_C@ */ Scalar_FLOAT32_IEEE 0 SWC_ETE_type_CM_single_degC -200.0 200.0 /end CHARACTERISTIC
/begin CHARACTERISTIC KDGL_IGBTStartDerat_C "" VALUE 0x0000 /* @ECU_Address@KDGL_IGBTStartDerat_C@ */ Scalar_FLOAT32_IEEE 0 SWC_ETE_type_CM_single_degC -200.0 200.0 /end CHARACTERISTIC
/begin CHARACTERISTIC KDGL_IGBTStopDerat_C "" VALUE 0x0000 /* @ECU_Address@KDGL_IGBTStopDerat_C@ */ Scalar_FLOAT32_IEEE 0 SWC_ETE_type_CM_single_degC -200.0 200.0 /end CHARACTERISTIC
/begin CHARACTERISTIC KDGL_MotCoefAddStep_C "" VALUE 0x0000 /* @ECU_Address@KDGL_MotCoefAddStep_C@ */ Scalar_FLOAT32_IEEE 0 SWC_ETE_type_CM_single_cnt 0.0 1.0 /end CHARACTERISTIC
/begin CHARACTERISTIC KDGL_MotCoefDepStep_C "" VALUE 0x0000 /* @ECU_Address@KDGL_MotCoefDepStep_C@ */ Scalar_FLOAT32_IEEE 0 SWC_ETE_type_CM_single_cnt 0.0 1.0 /end CHARACTERISTIC
/begin CHARACTERISTIC KDGL_MotHysBand_C "" VALUE 0x0000 /* @ECU_Address@KDGL_MotHysBand_C@ */ Scalar_FLOAT32_IEEE 0 SWC_ETE_type_CM_single_degC -300.0 300.0 /end CHARACTERISTIC
/begin CHARACTERISTIC KDGL_MotStartDerat_C "" VALUE 0x0000 /* @ECU_Address@KDGL_MotStartDerat_C@ */ Scalar_FLOAT32_IEEE 0 SWC_ETE_type_CM_single_degC -300.0 300.0 /end CHARACTERISTIC
/begin CHARACTERISTIC KDGL_MotStopDerat_C "" VALUE 0x0000 /* @ECU_Address@KDGL_MotStopDerat_C@ */ Scalar_FLOAT32_IEEE 0 SWC_ETE_type_CM_single_degC -300.0 300.0 /end CHARACTERISTIC
/begin CHARACTERISTIC KDGL_OilCoefAddStep_C "" VALUE 0x0000 /* @ECU_Address@KDGL_OilCoefAddStep_C@ */ Scalar_FLOAT32_IEEE 0 SWC_ETE_type_CM_single_cnt 0.0 1.0 /end CHARACTERISTIC
/begin CHARACTERISTIC KDGL_OilCoefDepStep_C "" VALUE 0x0000 /* @ECU_Address@KDGL_OilCoefDepStep_C@ */ Scalar_FLOAT32_IEEE 0 SWC_ETE_type_CM_single_cnt 0.0 1.0 /end CHARACTERISTIC
/begin CHARACTERISTIC KDGL_OilHysBand_C "" VALUE 0x0000 /* @ECU_Address@KDGL_OilHysBand_C@ */ Scalar_FLOAT32_IEEE 0 SWC_ETE_type_CM_single_degC -200.0 200.0 /end CHARACTERISTIC
/begin CHARACTERISTIC KDGL_OilStartDerat_C "" VALUE 0x0000 /* @ECU_Address@KDGL_OilStartDerat_C@ */ Scalar_FLOAT32_IEEE 0 SWC_ETE_type_CM_single_degC -200.0 200.0 /end CHARACTERISTIC
/begin CHARACTERISTIC KDGL_OilStopDerat_C "" VALUE 0x0000 /* @ECU_Address@KDGL_OilStopDerat_C@ */ Scalar_FLOAT32_IEEE 0 SWC_ETE_type_CM_single_degC -200.0 200.0 /end CHARACTERISTIC
/begin CHARACTERISTIC KDGL_OverSpdHysBand_rpm "" VALUE 0x0000 /* @ECU_Address@KDGL_OverSpdHysBand_rpm@ */ Scalar_FLOAT32_IEEE 0 SWC_ETE_type_CM_single_rpm 0.0 22000.0 /end CHARACTERISTIC
/begin CHARACTERISTIC KDGL_OverSpdNotEna_rpm "" VALUE 0x0000 /* @ECU_Address@KDGL_OverSpdNotEna_rpm@ */ Scalar_FLOAT32_IEEE 0 SWC_ETE_type_CM_single_rpm 0.0 22000.0 /end CHARACTERISTIC
/begin CHARACTERISTIC KDGL_OverSpd_rpm "" VALUE 0x0000 /* @ECU_Address@KDGL_OverSpd_rpm@ */ Scalar_FLOAT32_IEEE 0 SWC_ETE_type_CM_single_rpm 0.0 22000.0 /end CHARACTERISTIC
/begin CHARACTERISTIC KDGL_PCBCoefAddStep_C "" VALUE 0x0000 /* @ECU_Address@KDGL_PCBCoefAddStep_C@ */ Scalar_FLOAT32_IEEE 0 SWC_ETE_type_CM_single_cnt 0.0 1.0 /end CHARACTERISTIC
/begin CHARACTERISTIC KDGL_PCBCoefDepStep_C "" VALUE 0x0000 /* @ECU_Address@KDGL_PCBCoefDepStep_C@ */ Scalar_FLOAT32_IEEE 0 SWC_ETE_type_CM_single_cnt 0.0 1.0 /end CHARACTERISTIC
/begin CHARACTERISTIC KDGL_PCBHysBand_C "" VALUE 0x0000 /* @ECU_Address@KDGL_PCBHysBand_C@ */ Scalar_FLOAT32_IEEE 0 SWC_ETE_type_CM_single_degC -200.0 200.0 /end CHARACTERISTIC
/begin CHARACTERISTIC KDGL_PCBStartDerat_C "" VALUE 0x0000 /* @ECU_Address@KDGL_PCBStartDerat_C@ */ Scalar_FLOAT32_IEEE 0 SWC_ETE_type_CM_single_degC -200.0 200.0 /end CHARACTERISTIC
/begin CHARACTERISTIC KDGL_PCBStopDerat_C "" VALUE 0x0000 /* @ECU_Address@KDGL_PCBStopDerat_C@ */ Scalar_FLOAT32_IEEE 0 SWC_ETE_type_CM_single_degC -200.0 200.0 /end CHARACTERISTIC
/begin CHARACTERISTIC KDGL_SpdOverCoefAddStep_C "" VALUE 0x0000 /* @ECU_Address@KDGL_SpdOverCoefAddStep_C@ */ Scalar_FLOAT32_IEEE 0 SWC_ETE_type_CM_single_cnt 0.0 1.0 /end CHARACTERISTIC
/begin CHARACTERISTIC KDGL_SpdOverCoefSubStep_C "" VALUE 0x0000 /* @ECU_Address@KDGL_SpdOverCoefSubStep_C@ */ Scalar_FLOAT32_IEEE 0 SWC_ETE_type_CM_single_cnt 0.0 1.0 /end CHARACTERISTIC
/begin CHARACTERISTIC KDGL_iMotStallProtEna_A "" VALUE 0x0000 /* @ECU_Address@KDGL_iMotStallProtEna_A@ */ Scalar_FLOAT32_IEEE 0 SWC_ETE_type_CM_single_A 0.0 10000.0 /end CHARACTERISTIC
/begin CHARACTERISTIC KDGL_nEOPSpdDiff_rpm "" VALUE 0x0000 /* @ECU_Address@KDGL_nEOPSpdDiff_rpm@ */ Scalar_FLOAT32_IEEE 0 SWC_ETE_type_CM_single_rpm 0.0 10000.0 /end CHARACTERISTIC
/begin CHARACTERISTIC KDGL_nRotStallProtEna_rpm "" VALUE 0x0000 /* @ECU_Address@KDGL_nRotStallProtEna_rpm@ */ Scalar_FLOAT32_IEEE 0 SWC_ETE_type_CM_single_rpm 0.0 10000.0 /end CHARACTERISTIC
/begin CHARACTERISTIC KDGL_tiDlyOffEOP_C "" VALUE 0x0000 /* @ECU_Address@KDGL_tiDlyOffEOP_C@ */ Scalar_FLOAT32_IEEE 0 SWC_ETE_type_CM_single_C 0.0 5000.0 /end CHARACTERISTIC
/begin CHARACTERISTIC KDGL_tiDlyOffOverTqProt_C "" VALUE 0x0000 /* @ECU_Address@KDGL_tiDlyOffOverTqProt_C@ */ Scalar_FLOAT32_IEEE 0 SWC_ETE_type_CM_single_cnt 0.0 5000.0 /end CHARACTERISTIC
/begin CHARACTERISTIC KDGL_tiDlyOnEOP_C "" VALUE 0x0000 /* @ECU_Address@KDGL_tiDlyOnEOP_C@ */ Scalar_FLOAT32_IEEE 0 SWC_ETE_type_CM_single_cnt 0.0 5000.0 /end CHARACTERISTIC
/begin CHARACTERISTIC KDGL_tiDlyOnOverTqProt_C "" VALUE 0x0000 /* @ECU_Address@KDGL_tiDlyOnOverTqProt_C@ */ Scalar_FLOAT32_IEEE 0 SWC_ETE_type_CM_single_cnt 0.0 5000.0 /end CHARACTERISTIC
/begin CHARACTERISTIC KDGL_tiDlyOnStallProt_C "" VALUE 0x0000 /* @ECU_Address@KDGL_tiDlyOnStallProt_C@ */ Scalar_FLOAT32_IEEE 0 SWC_ETE_type_CM_single_cnt 0.0 5000.0 /end CHARACTERISTIC
/begin CHARACTERISTIC KDGL_tqMotStallProtEna_Nm "" VALUE 0x0000 /* @ECU_Address@KDGL_tqMotStallProtEna_Nm@ */ Scalar_FLOAT32_IEEE 0 SWC_ETE_type_CM_single_Nm 0.0 10000.0 /end CHARACTERISTIC
/begin CHARACTERISTIC KINP_EOPFVTRActualSpdSta_rpm_defval "" VALUE 0x0000 /* @ECU_Address@KINP_EOPFVTRActualSpdSta_rpm_defval@ */ Scalar_FLOAT32_IEEE 0 SWC_ETE_type_CM_single_rpm 0.0 8191.0 /end CHARACTERISTIC
/begin CHARACTERISTIC KINP_EOPFVTRActualSpdSta_rpm_ovrdval "" VALUE 0x0000 /* @ECU_Address@KINP_EOPFVTRActualSpdSta_rpm_ovrdval@ */ Scalar_FLOAT32_IEEE 0 SWC_ETE_type_CM_single_rpm 0.0 8191.0 /end CHARACTERISTIC
/begin CHARACTERISTIC KINP_FDCVCURrSpdMaxReq_rpm_defval "" VALUE 0x0000 /* @ECU_Address@KINP_FDCVCURrSpdMaxReq_rpm_defval@ */ Scalar_FLOAT32_IEEE 0 SWC_ETE_type_CM_single_rpm 0.0 65535.0 /end CHARACTERISTIC
/begin CHARACTERISTIC KINP_FDCVCURrSpdMaxReq_rpm_ovrdval "" VALUE 0x0000 /* @ECU_Address@KINP_FDCVCURrSpdMaxReq_rpm_ovrdval@ */ Scalar_FLOAT32_IEEE 0 SWC_ETE_type_CM_single_rpm 0.0 65535.0 /end CHARACTERISTIC
/begin CHARACTERISTIC KINP_FDCVCURrSpdMinReq_rpm_defval "" VALUE 0x0000 /* @ECU_Address@KINP_FDCVCURrSpdMinReq_rpm_defval@ */ Scalar_FLOAT32_IEEE 0 SWC_ETE_type_CM_single_rpm -22000.0 43535.0 /end CHARACTERISTIC
/begin CHARACTERISTIC KINP_FDCVCURrSpdMinReq_rpm_ovrdval "" VALUE 0x0000 /* @ECU_Address@KINP_FDCVCURrSpdMinReq_rpm_ovrdval@ */ Scalar_FLOAT32_IEEE 0 SWC_ETE_type_CM_single_rpm -22000.0 43535.0 /end CHARACTERISTIC
/begin CHARACTERISTIC KINP_FDCVCURrTMSpdReq_rpm_defval "" VALUE 0x0000 /* @ECU_Address@KINP_FDCVCURrTMSpdReq_rpm_defval@ */ Scalar_FLOAT32_IEEE 0 SWC_ETE_type_CM_single_rpm -22000.0 43535.0 /end CHARACTERISTIC
/begin CHARACTERISTIC KINP_FDCVCURrTMSpdReq_rpm_ovrdval "" VALUE 0x0000 /* @ECU_Address@KINP_FDCVCURrTMSpdReq_rpm_ovrdval@ */ Scalar_FLOAT32_IEEE 0 SWC_ETE_type_CM_single_rpm -22000.0 43535.0 /end CHARACTERISTIC
/begin CHARACTERISTIC KINP_FDCVCURrTMTqReq_Nm_defval "" VALUE 0x0000 /* @ECU_Address@KINP_FDCVCURrTMTqReq_Nm_defval@ */ Scalar_FLOAT32_IEEE 0 SWC_ETE_type_CM_single_Nm -1000.0 5553.5 /end CHARACTERISTIC
/begin CHARACTERISTIC KINP_FDCVCURrTMTqReq_Nm_ovrdval "" VALUE 0x0000 /* @ECU_Address@KINP_FDCVCURrTMTqReq_Nm_ovrdval@ */ Scalar_FLOAT32_IEEE 0 SWC_ETE_type_CM_single_Nm -1000.0 5553.5 /end CHARACTERISTIC
/begin CHARACTERISTIC KINP_FDCVCURrTqMaxReq_Nm_defval "" VALUE 0x0000 /* @ECU_Address@KINP_FDCVCURrTqMaxReq_Nm_defval@ */ Scalar_FLOAT32_IEEE 0 SWC_ETE_type_CM_single_Nm 0.0 4095.0 /end CHARACTERISTIC
/begin CHARACTERISTIC KINP_FDCVCURrTqMaxReq_Nm_ovrdval "" VALUE 0x0000 /* @ECU_Address@KINP_FDCVCURrTqMaxReq_Nm_ovrdval@ */ Scalar_FLOAT32_IEEE 0 SWC_ETE_type_CM_single_Nm 0.0 4095.0 /end CHARACTERISTIC
/begin CHARACTERISTIC KINP_FDCVCURrTqMinReq_Nm_defval "" VALUE 0x0000 /* @ECU_Address@KINP_FDCVCURrTqMinReq_Nm_defval@ */ Scalar_FLOAT32_IEEE 0 SWC_ETE_type_CM_single_Nm -1022.0 3073.0 /end CHARACTERISTIC
/begin CHARACTERISTIC KINP_FDCVCURrTqMinReq_Nm_ovrdval "" VALUE 0x0000 /* @ECU_Address@KINP_FDCVCURrTqMinReq_Nm_ovrdval@ */ Scalar_FLOAT32_IEEE 0 SWC_ETE_type_CM_single_Nm -1022.0 3073.0 /end CHARACTERISTIC
/begin CHARACTERISTIC KINP_HVBattVolt_V_defval "" VALUE 0x0000 /* @ECU_Address@KINP_HVBattVolt_V_defval@ */ Scalar_FLOAT32_IEEE 0 SWC_ETE_type_CM_single_V 0.0 819.0 /end CHARACTERISTIC
/begin CHARACTERISTIC KINP_HVBattVolt_V_ovrdval "" VALUE 0x0000 /* @ECU_Address@KINP_HVBattVolt_V_ovrdval@ */ Scalar_FLOAT32_IEEE 0 SWC_ETE_type_CM_single_V 0.0 819.0 /end CHARACTERISTIC
/begin CHARACTERISTIC KINP_IVITimeDay_DAY_defval "" VALUE 0x0000 /* @ECU_Address@KINP_IVITimeDay_DAY_defval@ */ Scalar_FLOAT32_IEEE 0 SWC_ETE_type_CM_single_DAY 0.0 31.0 /end CHARACTERISTIC
/begin CHARACTERISTIC KINP_IVITimeDay_DAY_ovrdval "" VALUE 0x0000 /* @ECU_Address@KINP_IVITimeDay_DAY_ovrdval@ */ Scalar_FLOAT32_IEEE 0 SWC_ETE_type_CM_single_DAY 0.0 31.0 /end CHARACTERISTIC
/begin CHARACTERISTIC KINP_IVITimeHour_hr_defval "" VALUE 0x0000 /* @ECU_Address@KINP_IVITimeHour_hr_defval@ */ Scalar_FLOAT32_IEEE 0 SWC_ETE_type_CM_single_hr 0.0 31.0 /end CHARACTERISTIC
/begin CHARACTERISTIC KINP_IVITimeHour_hr_ovrdval "" VALUE 0x0000 /* @ECU_Address@KINP_IVITimeHour_hr_ovrdval@ */ Scalar_FLOAT32_IEEE 0 SWC_ETE_type_CM_single_hr 0.0 31.0 /end CHARACTERISTIC
/begin CHARACTERISTIC KINP_IVITimeMinute_min_defval "" VALUE 0x0000 /* @ECU_Address@KINP_IVITimeMinute_min_defval@ */ Scalar_FLOAT32_IEEE 0 SWC_ETE_type_CM_single_min 0.0 63.0 /end CHARACTERISTIC
/begin CHARACTERISTIC KINP_IVITimeMinute_min_ovrdval "" VALUE 0x0000 /* @ECU_Address@KINP_IVITimeMinute_min_ovrdval@ */ Scalar_FLOAT32_IEEE 0 SWC_ETE_type_CM_single_min 0.0 63.0 /end CHARACTERISTIC
/begin CHARACTERISTIC KINP_IVITimeMonth_MONTH_defval "" VALUE 0x0000 /* @ECU_Address@KINP_IVITimeMonth_MONTH_defval@ */ Scalar_FLOAT32_IEEE 0 SWC_ETE_type_CM_single_MONTH 0.0 12.0 /end CHARACTERISTIC
/begin CHARACTERISTIC KINP_IVITimeMonth_MONTH_ovrdval "" VALUE 0x0000 /* @ECU_Address@KINP_IVITimeMonth_MONTH_ovrdval@ */ Scalar_FLOAT32_IEEE 0 SWC_ETE_type_CM_single_MONTH 0.0 12.0 /end CHARACTERISTIC
/begin CHARACTERISTIC KINP_IVITimeSecond_s_defval "" VALUE 0x0000 /* @ECU_Address@KINP_IVITimeSecond_s_defval@ */ Scalar_FLOAT32_IEEE 0 SWC_ETE_type_CM_single_s 0.0 63.0 /end CHARACTERISTIC
/begin CHARACTERISTIC KINP_IVITimeSecond_s_ovrdval "" VALUE 0x0000 /* @ECU_Address@KINP_IVITimeSecond_s_ovrdval@ */ Scalar_FLOAT32_IEEE 0 SWC_ETE_type_CM_single_s 0.0 63.0 /end CHARACTERISTIC
/begin CHARACTERISTIC KINP_RrCoolantflow_Lpmin_defval "" VALUE 0x0000 /* @ECU_Address@KINP_RrCoolantflow_Lpmin_defval@ */ Scalar_FLOAT32_IEEE 0 SWC_ETE_type_CM_single_Lpmin 0.0 15.75 /end CHARACTERISTIC
/begin CHARACTERISTIC KINP_RrCoolantflow_Lpmin_ovrdval "" VALUE 0x0000 /* @ECU_Address@KINP_RrCoolantflow_Lpmin_ovrdval@ */ Scalar_FLOAT32_IEEE 0 SWC_ETE_type_CM_single_Lpmin 0.0 15.75 /end CHARACTERISTIC
/begin CHARACTERISTIC KINP_RrCoolanttemp_C_defval "" VALUE 0x0000 /* @ECU_Address@KINP_RrCoolanttemp_C_defval@ */ Scalar_FLOAT32_IEEE 0 SWC_ETE_type_CM_single_C -40.0 214.0 /end CHARACTERISTIC
/begin CHARACTERISTIC KINP_RrCoolanttemp_C_ovrdval "" VALUE 0x0000 /* @ECU_Address@KINP_RrCoolanttemp_C_ovrdval@ */ Scalar_FLOAT32_IEEE 0 SWC_ETE_type_CM_single_C -40.0 214.0 /end CHARACTERISTIC
/begin CHARACTERISTIC KINP_VehSpeed_kph_defval "" VALUE 0x0000 /* @ECU_Address@KINP_VehSpeed_kph_defval@ */ Scalar_FLOAT32_IEEE 0 SWC_ETE_type_CM_single_kph 0.0 255.875 /end CHARACTERISTIC
/begin CHARACTERISTIC KINP_VehSpeed_kph_ovrdval "" VALUE 0x0000 /* @ECU_Address@KINP_VehSpeed_kph_ovrdval@ */ Scalar_FLOAT32_IEEE 0 SWC_ETE_type_CM_single_kph 0.0 255.875 /end CHARACTERISTIC
/begin CHARACTERISTIC KOUTP_ADCKL15_V_maxval "" VALUE 0x0000 /* @ECU_Address@KOUTP_ADCKL15_V_maxval@ */ Scalar_FLOAT32_IEEE 0 SWC_ETE_type_CM_single_V -100000.0 100000.0 /end CHARACTERISTIC
/begin CHARACTERISTIC KOUTP_ADCKL15_V_minval "" VALUE 0x0000 /* @ECU_Address@KOUTP_ADCKL15_V_minval@ */ Scalar_FLOAT32_IEEE 0 SWC_ETE_type_CM_single_V -100000.0 100000.0 /end CHARACTERISTIC
/begin CHARACTERISTIC KOUTP_ADCKL15_V_ovrdval "" VALUE 0x0000 /* @ECU_Address@KOUTP_ADCKL15_V_ovrdval@ */ Scalar_FLOAT32_IEEE 0 SWC_ETE_type_CM_single_V -100000.0 100000.0 /end CHARACTERISTIC
/begin CHARACTERISTIC KOUTP_ADCKL30_V_maxval "" VALUE 0x0000 /* @ECU_Address@KOUTP_ADCKL30_V_maxval@ */ Scalar_FLOAT32_IEEE 0 SWC_ETE_type_CM_single_V -100000.0 100000.0 /end CHARACTERISTIC
/begin CHARACTERISTIC KOUTP_ADCKL30_V_minval "" VALUE 0x0000 /* @ECU_Address@KOUTP_ADCKL30_V_minval@ */ Scalar_FLOAT32_IEEE 0 SWC_ETE_type_CM_single_V -100000.0 100000.0 /end CHARACTERISTIC
/begin CHARACTERISTIC KOUTP_ADCKL30_V_ovrdval "" VALUE 0x0000 /* @ECU_Address@KOUTP_ADCKL30_V_ovrdval@ */ Scalar_FLOAT32_IEEE 0 SWC_ETE_type_CM_single_V -100000.0 100000.0 /end CHARACTERISTIC
/begin CHARACTERISTIC KOUTP_BusCurr_A_maxval "" VALUE 0x0000 /* @ECU_Address@KOUTP_BusCurr_A_maxval@ */ Scalar_FLOAT32_IEEE 0 SWC_ETE_type_CM_single_A -100000.0 100000.0 /end CHARACTERISTIC
/begin CHARACTERISTIC KOUTP_BusCurr_A_minval "" VALUE 0x0000 /* @ECU_Address@KOUTP_BusCurr_A_minval@ */ Scalar_FLOAT32_IEEE 0 SWC_ETE_type_CM_single_A -100000.0 100000.0 /end CHARACTERISTIC
/begin CHARACTERISTIC KOUTP_BusCurr_A_ovrdval "" VALUE 0x0000 /* @ECU_Address@KOUTP_BusCurr_A_ovrdval@ */ Scalar_FLOAT32_IEEE 0 SWC_ETE_type_CM_single_A -100000.0 100000.0 /end CHARACTERISTIC
/begin CHARACTERISTIC KOUTP_OilTemp_degC_maxval "" VALUE 0x0000 /* @ECU_Address@KOUTP_OilTemp_degC_maxval@ */ Scalar_FLOAT32_IEEE 0 SWC_ETE_type_CM_single_degC -100000.0 100000.0 /end CHARACTERISTIC
/begin CHARACTERISTIC KOUTP_OilTemp_degC_minval "" VALUE 0x0000 /* @ECU_Address@KOUTP_OilTemp_degC_minval@ */ Scalar_FLOAT32_IEEE 0 SWC_ETE_type_CM_single_degC -100000.0 100000.0 /end CHARACTERISTIC
/begin CHARACTERISTIC KOUTP_OilTemp_degC_ovrdval "" VALUE 0x0000 /* @ECU_Address@KOUTP_OilTemp_degC_ovrdval@ */ Scalar_FLOAT32_IEEE 0 SWC_ETE_type_CM_single_degC -100000.0 100000.0 /end CHARACTERISTIC
/begin CHARACTERISTIC KOUTP_PwrEleAct_W_maxval "" VALUE 0x0000 /* @ECU_Address@KOUTP_PwrEleAct_W_maxval@ */ Scalar_FLOAT32_IEEE 0 SWC_ETE_type_CM_single_W -100000.0 100000.0 /end CHARACTERISTIC
/begin CHARACTERISTIC KOUTP_PwrEleAct_W_minval "" VALUE 0x0000 /* @ECU_Address@KOUTP_PwrEleAct_W_minval@ */ Scalar_FLOAT32_IEEE 0 SWC_ETE_type_CM_single_W -100000.0 100000.0 /end CHARACTERISTIC
/begin CHARACTERISTIC KOUTP_PwrEleAct_W_ovrdval "" VALUE 0x0000 /* @ECU_Address@KOUTP_PwrEleAct_W_ovrdval@ */ Scalar_FLOAT32_IEEE 0 SWC_ETE_type_CM_single_W -100000.0 100000.0 /end CHARACTERISTIC
/begin CHARACTERISTIC KOUTP_RotSpd_rpm_maxval "" VALUE 0x0000 /* @ECU_Address@KOUTP_RotSpd_rpm_maxval@ */ Scalar_FLOAT32_IEEE 0 SWC_ETE_type_CM_single_rpm -100000.0 100000.0 /end CHARACTERISTIC
/begin CHARACTERISTIC KOUTP_RotSpd_rpm_minval "" VALUE 0x0000 /* @ECU_Address@KOUTP_RotSpd_rpm_minval@ */ Scalar_FLOAT32_IEEE 0 SWC_ETE_type_CM_single_rpm -100000.0 100000.0 /end CHARACTERISTIC
/begin CHARACTERISTIC KOUTP_RotSpd_rpm_ovrdval "" VALUE 0x0000 /* @ECU_Address@KOUTP_RotSpd_rpm_ovrdval@ */ Scalar_FLOAT32_IEEE 0 SWC_ETE_type_CM_single_rpm -100000.0 100000.0 /end CHARACTERISTIC
/begin CHARACTERISTIC KOUTP_iDCurrAct_A_maxval "" VALUE 0x0000 /* @ECU_Address@KOUTP_iDCurrAct_A_maxval@ */ Scalar_FLOAT32_IEEE 0 SWC_ETE_type_CM_single_A -100000.0 100000.0 /end CHARACTERISTIC
/begin CHARACTERISTIC KOUTP_iDCurrAct_A_minval "" VALUE 0x0000 /* @ECU_Address@KOUTP_iDCurrAct_A_minval@ */ Scalar_FLOAT32_IEEE 0 SWC_ETE_type_CM_single_A -100000.0 100000.0 /end CHARACTERISTIC
/begin CHARACTERISTIC KOUTP_iDCurrAct_A_ovrdval "" VALUE 0x0000 /* @ECU_Address@KOUTP_iDCurrAct_A_ovrdval@ */ Scalar_FLOAT32_IEEE 0 SWC_ETE_type_CM_single_A -100000.0 100000.0 /end CHARACTERISTIC
/begin CHARACTERISTIC KOUTP_iQCurrAct_A_maxval "" VALUE 0x0000 /* @ECU_Address@KOUTP_iQCurrAct_A_maxval@ */ Scalar_FLOAT32_IEEE 0 SWC_ETE_type_CM_single_A -100000.0 100000.0 /end CHARACTERISTIC
/begin CHARACTERISTIC KOUTP_iQCurrAct_A_minval "" VALUE 0x0000 /* @ECU_Address@KOUTP_iQCurrAct_A_minval@ */ Scalar_FLOAT32_IEEE 0 SWC_ETE_type_CM_single_A -100000.0 100000.0 /end CHARACTERISTIC
/begin CHARACTERISTIC KOUTP_iQCurrAct_A_ovrdval "" VALUE 0x0000 /* @ECU_Address@KOUTP_iQCurrAct_A_ovrdval@ */ Scalar_FLOAT32_IEEE 0 SWC_ETE_type_CM_single_A -100000.0 100000.0 /end CHARACTERISTIC
/begin CHARACTERISTIC KOUTP_nEOPSpdReq_rpm_maxval "" VALUE 0x0000 /* @ECU_Address@KOUTP_nEOPSpdReq_rpm_maxval@ */ Scalar_FLOAT32_IEEE 0 SWC_ETE_type_CM_single_rpm -100000.0 100000.0 /end CHARACTERISTIC
/begin CHARACTERISTIC KOUTP_nEOPSpdReq_rpm_minval "" VALUE 0x0000 /* @ECU_Address@KOUTP_nEOPSpdReq_rpm_minval@ */ Scalar_FLOAT32_IEEE 0 SWC_ETE_type_CM_single_rpm -100000.0 100000.0 /end CHARACTERISTIC
/begin CHARACTERISTIC KOUTP_nEOPSpdReq_rpm_ovrdval "" VALUE 0x0000 /* @ECU_Address@KOUTP_nEOPSpdReq_rpm_ovrdval@ */ Scalar_FLOAT32_IEEE 0 SWC_ETE_type_CM_single_rpm -100000.0 100000.0 /end CHARACTERISTIC
/begin CHARACTERISTIC KOUTP_tqTMTqMax_Nm_maxval "" VALUE 0x0000 /* @ECU_Address@KOUTP_tqTMTqMax_Nm_maxval@ */ Scalar_FLOAT32_IEEE 0 SWC_ETE_type_CM_single_Nm -100000.0 100000.0 /end CHARACTERISTIC
/begin CHARACTERISTIC KOUTP_tqTMTqMax_Nm_minval "" VALUE 0x0000 /* @ECU_Address@KOUTP_tqTMTqMax_Nm_minval@ */ Scalar_FLOAT32_IEEE 0 SWC_ETE_type_CM_single_Nm -100000.0 100000.0 /end CHARACTERISTIC
/begin CHARACTERISTIC KOUTP_tqTMTqMax_Nm_ovrdval "" VALUE 0x0000 /* @ECU_Address@KOUTP_tqTMTqMax_Nm_ovrdval@ */ Scalar_FLOAT32_IEEE 0 SWC_ETE_type_CM_single_Nm -100000.0 100000.0 /end CHARACTERISTIC
/begin CHARACTERISTIC KOUTP_tqTMTqMin_Nm_maxval "" VALUE 0x0000 /* @ECU_Address@KOUTP_tqTMTqMin_Nm_maxval@ */ Scalar_FLOAT32_IEEE 0 SWC_ETE_type_CM_single_Nm -100000.0 100000.0 /end CHARACTERISTIC
/begin CHARACTERISTIC KOUTP_tqTMTqMin_Nm_minval "" VALUE 0x0000 /* @ECU_Address@KOUTP_tqTMTqMin_Nm_minval@ */ Scalar_FLOAT32_IEEE 0 SWC_ETE_type_CM_single_Nm -100000.0 100000.0 /end CHARACTERISTIC
/begin CHARACTERISTIC KOUTP_tqTMTqMin_Nm_ovrdval "" VALUE 0x0000 /* @ECU_Address@KOUTP_tqTMTqMin_Nm_ovrdval@ */ Scalar_FLOAT32_IEEE 0 SWC_ETE_type_CM_single_Nm -100000.0 100000.0 /end CHARACTERISTIC
/begin CHARACTERISTIC KOUTP_uDC_V_maxval "" VALUE 0x0000 /* @ECU_Address@KOUTP_uDC_V_maxval@ */ Scalar_FLOAT32_IEEE 0 SWC_ETE_type_CM_single_flag -100000.0 100000.0 /end CHARACTERISTIC
/begin CHARACTERISTIC KOUTP_uDC_V_minval "" VALUE 0x0000 /* @ECU_Address@KOUTP_uDC_V_minval@ */ Scalar_FLOAT32_IEEE 0 SWC_ETE_type_CM_single_flag -100000.0 100000.0 /end CHARACTERISTIC
/begin CHARACTERISTIC KOUTP_uDC_V_ovrdval "" VALUE 0x0000 /* @ECU_Address@KOUTP_uDC_V_ovrdval@ */ Scalar_FLOAT32_IEEE 0 SWC_ETE_type_CM_single_V -100000.0 100000.0 /end CHARACTERISTIC
/begin CHARACTERISTIC KOUTP_volfCooltFlowTar_C_maxval "" VALUE 0x0000 /* @ECU_Address@KOUTP_volfCooltFlowTar_C_maxval@ */ Scalar_FLOAT32_IEEE 0 SWC_ETE_type_CM_single_flow -65535.0 65535.0 /end CHARACTERISTIC
/begin CHARACTERISTIC KOUTP_volfCooltFlowTar_C_minval "" VALUE 0x0000 /* @ECU_Address@KOUTP_volfCooltFlowTar_C_minval@ */ Scalar_FLOAT32_IEEE 0 SWC_ETE_type_CM_single_flow -65535.0 65535.0 /end CHARACTERISTIC
/begin CHARACTERISTIC KOUTP_volfCooltFlowTar_C_ovrdval "" VALUE 0x0000 /* @ECU_Address@KOUTP_volfCooltFlowTar_C_ovrdval@ */ Scalar_FLOAT32_IEEE 0 SWC_ETE_type_CM_single_C -65535.0 65535.0 /end CHARACTERISTIC
/begin CHARACTERISTIC KSYL_frqSwitchMax_Hz "" VALUE 0x0000 /* @ECU_Address@KSYL_frqSwitchMax_Hz@ */ Scalar_FLOAT32_IEEE 0 SWC_ETE_type_CM_single_Hz 0.0 10000.0 /end CHARACTERISTIC
/begin CHARACTERISTIC KSYL_nTMSpdMax_RPM "" VALUE 0x0000 /* @ECU_Address@KSYL_nTMSpdMax_RPM@ */ Scalar_FLOAT32_IEEE 0 SWC_ETE_type_CM_single_rpm 0.0 20000.0 /end CHARACTERISTIC
/begin CHARACTERISTIC KSYL_nTMSpdMin_RPM "" VALUE 0x0000 /* @ECU_Address@KSYL_nTMSpdMin_RPM@ */ Scalar_FLOAT32_IEEE 0 SWC_ETE_type_CM_single_rpm -20000.0 0.0 /end CHARACTERISTIC
/begin CHARACTERISTIC LLCM_tlvtrATemp_C "" VALUE 0x0000 /* @ECU_Address@LLCM_tlvtrATemp_C@ */ Scalar_FLOAT32_IEEE 0 SWC_ETE_type_CM_single_degC -500.0 500.0 /end CHARACTERISTIC
/begin CHARACTERISTIC LLCM_tlvtrBTemp_C "" VALUE 0x0000 /* @ECU_Address@LLCM_tlvtrBTemp_C@ */ Scalar_FLOAT32_IEEE 0 SWC_ETE_type_CM_single_degC -500.0 500.0 /end CHARACTERISTIC
/begin CHARACTERISTIC LLCM_tlvtrCTemp_C "" VALUE 0x0000 /* @ECU_Address@LLCM_tlvtrCTemp_C@ */ Scalar_FLOAT32_IEEE 0 SWC_ETE_type_CM_single_degC -500.0 500.0 /end CHARACTERISTIC
/begin CHARACTERISTIC LLCM_volfcooltFlowMax_C "" VALUE 0x0000 /* @ECU_Address@LLCM_volfcooltFlowMax_C@ */ Scalar_FLOAT32_IEEE 0 SWC_ETE_type_CM_single_flow -1000.0 1000.0 /end CHARACTERISTIC
/begin CHARACTERISTIC LLCM_volfcooltFlowMin_C "" VALUE 0x0000 /* @ECU_Address@LLCM_volfcooltFlowMin_C@ */ Scalar_FLOAT32_IEEE 0 SWC_ETE_type_CM_single_flow -1000.0 1000.0 /end CHARACTERISTIC
/begin CHARACTERISTIC LLCM_volfcooltFlowMor_C "" VALUE 0x0000 /* @ECU_Address@LLCM_volfcooltFlowMor_C@ */ Scalar_FLOAT32_IEEE 0 SWC_ETE_type_CM_single_flow -1000.0 1000.0 /end CHARACTERISTIC
/begin CHARACTERISTIC LLCM_volfcooltFlowRampDown_C "" VALUE 0x0000 /* @ECU_Address@LLCM_volfcooltFlowRampDown_C@ */ Scalar_FLOAT32_IEEE 0 SWC_ETE_type_CM_single_flow -1000.0 1000.0 /end CHARACTERISTIC
/begin CHARACTERISTIC LLCM_volfcooltFlowRampUp_C "" VALUE 0x0000 /* @ECU_Address@LLCM_volfcooltFlowRampUp_C@ */ Scalar_FLOAT32_IEEE 0 SWC_ETE_type_CM_single_flow -1000.0 1000.0 /end CHARACTERISTIC
/begin CHARACTERISTIC OpMod_nRot2AfterRun_C "" VALUE 0x0000 /* @ECU_Address@OpMod_nRot2AfterRun_C@ */ Scalar_FLOAT32_IEEE 0 SWC_ETE_type_CM_single_cnt 0.0 100000.0 /end CHARACTERISTIC
/begin CHARACTERISTIC OpMod_nRotASCDi_C "" VALUE 0x0000 /* @ECU_Address@OpMod_nRotASCDi_C@ */ Scalar_FLOAT32_IEEE 0 SWC_ETE_type_CM_single_cnt 0.0 100000.0 /end CHARACTERISTIC
/begin CHARACTERISTIC OpMod_nRotASCEna_C "" VALUE 0x0000 /* @ECU_Address@OpMod_nRotASCEna_C@ */ Scalar_FLOAT32_IEEE 0 SWC_ETE_type_CM_single_cnt 0.0 100000.0 /end CHARACTERISTIC
/begin CHARACTERISTIC OpMod_tiDcha2AfterRun_C "" VALUE 0x0000 /* @ECU_Address@OpMod_tiDcha2AfterRun_C@ */ Scalar_FLOAT32_IEEE 0 SWC_ETE_type_CM_single_cnt 0.0 100000.0 /end CHARACTERISTIC
/begin CHARACTERISTIC OpMod_uDCSide2AfterRun_C "" VALUE 0x0000 /* @ECU_Address@OpMod_uDCSide2AfterRun_C@ */ Scalar_FLOAT32_IEEE 0 SWC_ETE_type_CM_single_cnt 0.0 100000.0 /end CHARACTERISTIC
/begin CHARACTERISTIC Diag2_int16_HvLowErrErr_C "" VALUE 0x0000 /* @ECU_Address@Diag2_int16_HvLowErrErr_C@ */ Scalar_SWORD 0 SWC_ETE_type_CM_int16_cnt -250.0 250.0 /end CHARACTERISTIC
/begin CHARACTERISTIC Diag2_int16_HvLowErrHeal_C "" VALUE 0x0000 /* @ECU_Address@Diag2_int16_HvLowErrHeal_C@ */ Scalar_SWORD 0 SWC_ETE_type_CM_int16_cnt -250.0 250.0 /end CHARACTERISTIC
/begin CHARACTERISTIC Diag2_int16_HvLowWarnErr_C "" VALUE 0x0000 /* @ECU_Address@Diag2_int16_HvLowWarnErr_C@ */ Scalar_SWORD 0 SWC_ETE_type_CM_int16_cnt -250.0 250.0 /end CHARACTERISTIC
/begin CHARACTERISTIC Diag2_int16_HvLowWarnHeal_C "" VALUE 0x0000 /* @ECU_Address@Diag2_int16_HvLowWarnHeal_C@ */ Scalar_SWORD 0 SWC_ETE_type_CM_int16_cnt -250.0 250.0 /end CHARACTERISTIC
/begin CHARACTERISTIC Diag2_int16_HvOverErrErr_C "" VALUE 0x0000 /* @ECU_Address@Diag2_int16_HvOverErrErr_C@ */ Scalar_SWORD 0 SWC_ETE_type_CM_int16_cnt -250.0 250.0 /end CHARACTERISTIC
/begin CHARACTERISTIC Diag2_int16_HvOverErrHeal_C "" VALUE 0x0000 /* @ECU_Address@Diag2_int16_HvOverErrHeal_C@ */ Scalar_SWORD 0 SWC_ETE_type_CM_int16_cnt -250.0 250.0 /end CHARACTERISTIC
/begin CHARACTERISTIC Diag2_int16_HvOverWarnErr_C "" VALUE 0x0000 /* @ECU_Address@Diag2_int16_HvOverWarnErr_C@ */ Scalar_SWORD 0 SWC_ETE_type_CM_int16_cnt -250.0 250.0 /end CHARACTERISTIC
/begin CHARACTERISTIC Diag2_int16_HvOverWarnHeal_C "" VALUE 0x0000 /* @ECU_Address@Diag2_int16_HvOverWarnHeal_C@ */ Scalar_SWORD 0 SWC_ETE_type_CM_int16_cnt -250.0 250.0 /end CHARACTERISTIC
/begin CHARACTERISTIC KDGL_OverSpdErr_cnt "" VALUE 0x0000 /* @ECU_Address@KDGL_OverSpdErr_cnt@ */ Scalar_SWORD 0 SWC_ETE_type_CM_int16_cnt -250.0 250.0 /end CHARACTERISTIC
/begin CHARACTERISTIC KDGL_OverSpdHeal_cnt "" VALUE 0x0000 /* @ECU_Address@KDGL_OverSpdHeal_cnt@ */ Scalar_SWORD 0 SWC_ETE_type_CM_int16_cnt -250.0 250.0 /end CHARACTERISTIC
/begin CHARACTERISTIC KDGL_TempIGBTFaultErr_C "" VALUE 0x0000 /* @ECU_Address@KDGL_TempIGBTFaultErr_C@ */ Scalar_SWORD 0 SWC_ETE_type_CM_int16_cnt -250.0 250.0 /end CHARACTERISTIC
/begin CHARACTERISTIC KDGL_TempIGBTFaultHeal_C "" VALUE 0x0000 /* @ECU_Address@KDGL_TempIGBTFaultHeal_C@ */ Scalar_SWORD 0 SWC_ETE_type_CM_int16_cnt -250.0 250.0 /end CHARACTERISTIC
/begin CHARACTERISTIC KDGL_TempIGBTWarningErr_C "" VALUE 0x0000 /* @ECU_Address@KDGL_TempIGBTWarningErr_C@ */ Scalar_SWORD 0 SWC_ETE_type_CM_int16_cnt -250.0 250.0 /end CHARACTERISTIC
/begin CHARACTERISTIC KDGL_TempIGBTWarningHeal_C "" VALUE 0x0000 /* @ECU_Address@KDGL_TempIGBTWarningHeal_C@ */ Scalar_SWORD 0 SWC_ETE_type_CM_int16_cnt -250.0 250.0 /end CHARACTERISTIC
/begin CHARACTERISTIC KDGL_TempMotFaultErr_C "" VALUE 0x0000 /* @ECU_Address@KDGL_TempMotFaultErr_C@ */ Scalar_SWORD 0 SWC_ETE_type_CM_int16_cnt -250.0 250.0 /end CHARACTERISTIC
/begin CHARACTERISTIC KDGL_TempMotFaultHeal_C "" VALUE 0x0000 /* @ECU_Address@KDGL_TempMotFaultHeal_C@ */ Scalar_SWORD 0 SWC_ETE_type_CM_int16_cnt -250.0 250.0 /end CHARACTERISTIC
/begin CHARACTERISTIC KDGL_TempMotWarningErr_C "" VALUE 0x0000 /* @ECU_Address@KDGL_TempMotWarningErr_C@ */ Scalar_SWORD 0 SWC_ETE_type_CM_int16_cnt -250.0 250.0 /end CHARACTERISTIC
/begin CHARACTERISTIC KDGL_TempMotWarningHeal_C "" VALUE 0x0000 /* @ECU_Address@KDGL_TempMotWarningHeal_C@ */ Scalar_SWORD 0 SWC_ETE_type_CM_int16_cnt -250.0 250.0 /end CHARACTERISTIC
/begin CHARACTERISTIC KDGL_TempOilFaultErr_C "" VALUE 0x0000 /* @ECU_Address@KDGL_TempOilFaultErr_C@ */ Scalar_SWORD 0 SWC_ETE_type_CM_int16_cnt -250.0 250.0 /end CHARACTERISTIC
/begin CHARACTERISTIC KDGL_TempOilFaultHeal_C "" VALUE 0x0000 /* @ECU_Address@KDGL_TempOilFaultHeal_C@ */ Scalar_SWORD 0 SWC_ETE_type_CM_int16_cnt -250.0 250.0 /end CHARACTERISTIC
/begin CHARACTERISTIC KDGL_TempOilWarningErr_C "" VALUE 0x0000 /* @ECU_Address@KDGL_TempOilWarningErr_C@ */ Scalar_SWORD 0 SWC_ETE_type_CM_int16_cnt -250.0 250.0 /end CHARACTERISTIC
/begin CHARACTERISTIC KDGL_TempOilWarningHeal_C "" VALUE 0x0000 /* @ECU_Address@KDGL_TempOilWarningHeal_C@ */ Scalar_SWORD 0 SWC_ETE_type_CM_int16_cnt -250.0 250.0 /end CHARACTERISTIC
/begin CHARACTERISTIC KDGL_TempPCBFaultErr_C "" VALUE 0x0000 /* @ECU_Address@KDGL_TempPCBFaultErr_C@ */ Scalar_SWORD 0 SWC_ETE_type_CM_int16_cnt -250.0 250.0 /end CHARACTERISTIC
/begin CHARACTERISTIC KDGL_TempPCBFaultHeal_C "" VALUE 0x0000 /* @ECU_Address@KDGL_TempPCBFaultHeal_C@ */ Scalar_SWORD 0 SWC_ETE_type_CM_int16_cnt -250.0 250.0 /end CHARACTERISTIC
/begin CHARACTERISTIC KDGL_TempPCBWarningErr_C "" VALUE 0x0000 /* @ECU_Address@KDGL_TempPCBWarningErr_C@ */ Scalar_SWORD 0 SWC_ETE_type_CM_int16_cnt -250.0 250.0 /end CHARACTERISTIC
/begin CHARACTERISTIC KDGL_TempPCBWarningHeal_C "" VALUE 0x0000 /* @ECU_Address@KDGL_TempPCBWarningHeal_C@ */ Scalar_SWORD 0 SWC_ETE_type_CM_int16_cnt -250.0 250.0 /end CHARACTERISTIC
/begin CHARACTERISTIC Diag2_bRstFault_C "" VALUE 0x0000 /* @ECU_Address@Diag2_bRstFault_C@ */ Scalar_BOOLEAN 0 SWC_ETE_type_CM_boolean_flg 0.0 1.0 /end CHARACTERISTIC
/begin CHARACTERISTIC DiagM_Fault2LevelMor_C "" VALUE 0x0000 /* @ECU_Address@DiagM_Fault2LevelMor_C@ */ Scalar_BOOLEAN 0 SWC_ETE_type_CM_boolean_flg 0.0 1.0 /end CHARACTERISTIC
/begin CHARACTERISTIC DiagM_Fault2LevelTrig_C "" VALUE 0x0000 /* @ECU_Address@DiagM_Fault2LevelTrig_C@ */ Scalar_BOOLEAN 0 SWC_ETE_type_CM_boolean_flg 0.0 1.0 /end CHARACTERISTIC
/begin CHARACTERISTIC DiagM_bZeroCurrMor_C "" VALUE 0x0000 /* @ECU_Address@DiagM_bZeroCurrMor_C@ */ Scalar_BOOLEAN 0 SWC_ETE_type_CM_boolean_flg 0.0 1.0 /end CHARACTERISTIC
/begin CHARACTERISTIC DiagM_bZeroCurrTrig_C "" VALUE 0x0000 /* @ECU_Address@DiagM_bZeroCurrTrig_C@ */ Scalar_BOOLEAN 0 SWC_ETE_type_CM_boolean_flg 0.0 1.0 /end CHARACTERISTIC
/begin CHARACTERISTIC EopC_bMotEnaManTrig_C "" VALUE 0x0000 /* @ECU_Address@EopC_bMotEnaManTrig_C@ */ Scalar_BOOLEAN 0 SWC_ETE_type_CM_boolean_flg 0.0 1.0 /end CHARACTERISTIC
/begin CHARACTERISTIC EopC_bMotEnaMan_C "" VALUE 0x0000 /* @ECU_Address@EopC_bMotEnaMan_C@ */ Scalar_BOOLEAN 0 SWC_ETE_type_CM_boolean_flg 0.0 1.0 /end CHARACTERISTIC
/begin CHARACTERISTIC EopC_nReqMotSpdTrig_C "" VALUE 0x0000 /* @ECU_Address@EopC_nReqMotSpdTrig_C@ */ Scalar_BOOLEAN 0 SWC_ETE_type_CM_boolean_flg 0.0 1.0 /end CHARACTERISTIC
/begin CHARACTERISTIC KCRM_AtSweep_deg_ovrdflg "" VALUE 0x0000 /* @ECU_Address@KCRM_AtSweep_deg_ovrdflg@ */ Scalar_BOOLEAN 0 SWC_ETE_type_CM_boolean_flag 0.0 1.0 /end CHARACTERISTIC
/begin CHARACTERISTIC KCRM_CurDebugSwt_null "" VALUE 0x0000 /* @ECU_Address@KCRM_CurDebugSwt_null@ */ Scalar_BOOLEAN 0 SWC_ETE_type_CM_boolean_constant 0.0 1.0 /end CHARACTERISTIC
/begin CHARACTERISTIC KCRM_MTPAGenSwitch_flg "" VALUE 0x0000 /* @ECU_Address@KCRM_MTPAGenSwitch_flg@ */ Scalar_BOOLEAN 0 SWC_ETE_type_CM_boolean_flag 0.0 1.0 /end CHARACTERISTIC
/begin CHARACTERISTIC KCRM_MTPAMotSwitch_flg "" VALUE 0x0000 /* @ECU_Address@KCRM_MTPAMotSwitch_flg@ */ Scalar_BOOLEAN 0 SWC_ETE_type_CM_boolean_flag 0.0 1.0 /end CHARACTERISTIC
/begin CHARACTERISTIC KCRM_UsingIsSp_A_ovrdflg "" VALUE 0x0000 /* @ECU_Address@KCRM_UsingIsSp_A_ovrdflg@ */ Scalar_BOOLEAN 0 SWC_ETE_type_CM_boolean_flag 0.0 1.0 /end CHARACTERISTIC
/begin CHARACTERISTIC KCRM_bRstDebugOverSpd_null "" VALUE 0x0000 /* @ECU_Address@KCRM_bRstDebugOverSpd_null@ */ Scalar_BOOLEAN 0 SWC_ETE_type_CM_boolean_flag 0.0 1.0 /end CHARACTERISTIC
/begin CHARACTERISTIC KDGL_OverTorque_flg_ovrdflg "" VALUE 0x0000 /* @ECU_Address@KDGL_OverTorque_flg_ovrdflg@ */ Scalar_BOOLEAN 0 SWC_ETE_type_CM_boolean_flg 0.0 1.0 /end CHARACTERISTIC
/begin CHARACTERISTIC KDGL_OverTorque_flg_ovrdval "" VALUE 0x0000 /* @ECU_Address@KDGL_OverTorque_flg_ovrdval@ */ Scalar_BOOLEAN 0 SWC_ETE_type_CM_boolean_flg 0.0 1.0 /end CHARACTERISTIC
/begin CHARACTERISTIC KDGL_bBusOffEna_C "" VALUE 0x0000 /* @ECU_Address@KDGL_bBusOffEna_C@ */ Scalar_BOOLEAN 0 SWC_ETE_type_CM_boolean_flg 0.0 1.0 /end CHARACTERISTIC
/begin CHARACTERISTIC KDGL_bComInvaildVcuEna_C "" VALUE 0x0000 /* @ECU_Address@KDGL_bComInvaildVcuEna_C@ */ Scalar_BOOLEAN 0 SWC_ETE_type_CM_boolean_flg 0.0 1.0 /end CHARACTERISTIC
/begin CHARACTERISTIC KDGL_bComLostVcuEna_C "" VALUE 0x0000 /* @ECU_Address@KDGL_bComLostVcuEna_C@ */ Scalar_BOOLEAN 0 SWC_ETE_type_CM_boolean_flg 0.0 1.0 /end CHARACTERISTIC
/begin CHARACTERISTIC KDGL_bCurrFaultEna_C "" VALUE 0x0000 /* @ECU_Address@KDGL_bCurrFaultEna_C@ */ Scalar_BOOLEAN 0 SWC_ETE_type_CM_boolean_flg 0.0 1.0 /end CHARACTERISTIC
/begin CHARACTERISTIC KDGL_bEOPFaultEna_C "" VALUE 0x0000 /* @ECU_Address@KDGL_bEOPFaultEna_C@ */ Scalar_BOOLEAN 0 SWC_ETE_type_CM_boolean_flg 0.0 1.0 /end CHARACTERISTIC
/begin CHARACTERISTIC KDGL_bEnaBenchShutDwn_C "" VALUE 0x0000 /* @ECU_Address@KDGL_bEnaBenchShutDwn_C@ */ Scalar_BOOLEAN 0 SWC_ETE_type_CM_boolean_flg 0.0 1.0 /end CHARACTERISTIC
/begin CHARACTERISTIC KDGL_bHvDcVoltFaultEna_C "" VALUE 0x0000 /* @ECU_Address@KDGL_bHvDcVoltFaultEna_C@ */ Scalar_BOOLEAN 0 SWC_ETE_type_CM_boolean_flg 0.0 1.0 /end CHARACTERISTIC
/begin CHARACTERISTIC KDGL_bIGNVoltFaultEna_C "" VALUE 0x0000 /* @ECU_Address@KDGL_bIGNVoltFaultEna_C@ */ Scalar_BOOLEAN 0 SWC_ETE_type_CM_boolean_flg 0.0 1.0 /end CHARACTERISTIC
/begin CHARACTERISTIC KDGL_bOilTempFaultEna_C "" VALUE 0x0000 /* @ECU_Address@KDGL_bOilTempFaultEna_C@ */ Scalar_BOOLEAN 0 SWC_ETE_type_CM_boolean_flg 0.0 1.0 /end CHARACTERISTIC
/begin CHARACTERISTIC KDGL_bPCBTempFaultEna_C "" VALUE 0x0000 /* @ECU_Address@KDGL_bPCBTempFaultEna_C@ */ Scalar_BOOLEAN 0 SWC_ETE_type_CM_boolean_flg 0.0 1.0 /end CHARACTERISTIC
/begin CHARACTERISTIC KDGL_bPREREGFaultEna_C "" VALUE 0x0000 /* @ECU_Address@KDGL_bPREREGFaultEna_C@ */ Scalar_BOOLEAN 0 SWC_ETE_type_CM_boolean_flg 0.0 1.0 /end CHARACTERISTIC
/begin CHARACTERISTIC KDGL_bPosSenrFaultEna_C "" VALUE 0x0000 /* @ECU_Address@KDGL_bPosSenrFaultEna_C@ */ Scalar_BOOLEAN 0 SWC_ETE_type_CM_boolean_flg 0.0 1.0 /end CHARACTERISTIC
/begin CHARACTERISTIC KDGL_bRstStallPort_flg "" VALUE 0x0000 /* @ECU_Address@KDGL_bRstStallPort_flg@ */ Scalar_BOOLEAN 0 SWC_ETE_type_CM_boolean_flg 0.0 1.0 /end CHARACTERISTIC
/begin CHARACTERISTIC KDGL_bSicFltFaultEna_C "" VALUE 0x0000 /* @ECU_Address@KDGL_bSicFltFaultEna_C@ */ Scalar_BOOLEAN 0 SWC_ETE_type_CM_boolean_flg 0.0 1.0 /end CHARACTERISTIC
/begin CHARACTERISTIC KDGL_bSicTempFaultEna_C "" VALUE 0x0000 /* @ECU_Address@KDGL_bSicTempFaultEna_C@ */ Scalar_BOOLEAN 0 SWC_ETE_type_CM_boolean_flg 0.0 1.0 /end CHARACTERISTIC
/begin CHARACTERISTIC KDGL_bTempSensrFaultEna_C "" VALUE 0x0000 /* @ECU_Address@KDGL_bTempSensrFaultEna_C@ */ Scalar_BOOLEAN 0 SWC_ETE_type_CM_boolean_flg 0.0 1.0 /end CHARACTERISTIC
/begin CHARACTERISTIC KDGL_bVCC5VFaultEna_C "" VALUE 0x0000 /* @ECU_Address@KDGL_bVCC5VFaultEna_C@ */ Scalar_BOOLEAN 0 SWC_ETE_type_CM_boolean_flg 0.0 1.0 /end CHARACTERISTIC
/begin CHARACTERISTIC KDGL_bVREF5VFaultEna_C "" VALUE 0x0000 /* @ECU_Address@KDGL_bVREF5VFaultEna_C@ */ Scalar_BOOLEAN 0 SWC_ETE_type_CM_boolean_flg 0.0 1.0 /end CHARACTERISTIC
/begin CHARACTERISTIC KDGL_bWaterTempFaultEna_C "" VALUE 0x0000 /* @ECU_Address@KDGL_bWaterTempFaultEna_C@ */ Scalar_BOOLEAN 0 SWC_ETE_type_CM_boolean_flg 0.0 1.0 /end CHARACTERISTIC
/begin CHARACTERISTIC KHAL_CAN3BMS1E2E_flg "" VALUE 0x0000 /* @ECU_Address@KHAL_CAN3BMS1E2E_flg@ */ Scalar_BOOLEAN 0 SWC_ETE_type_CM_boolean_flg 0.0 1.0 /end CHARACTERISTIC
/begin CHARACTERISTIC KHAL_CAN3BMS6E2E_flg "" VALUE 0x0000 /* @ECU_Address@KHAL_CAN3BMS6E2E_flg@ */ Scalar_BOOLEAN 0 SWC_ETE_type_CM_boolean_flg 0.0 1.0 /end CHARACTERISTIC
/begin CHARACTERISTIC KHAL_CAN3TxReq_flg "" VALUE 0x0000 /* @ECU_Address@KHAL_CAN3TxReq_flg@ */ Scalar_BOOLEAN 0 SWC_ETE_type_CM_boolean_flg 0.0 1.0 /end CHARACTERISTIC
/begin CHARACTERISTIC KHAL_CAN_MCU_R1TxReq_flg "" VALUE 0x0000 /* @ECU_Address@KHAL_CAN_MCU_R1TxReq_flg@ */ Scalar_BOOLEAN 0 SWC_ETE_type_CM_boolean_flg 0.0 1.0 /end CHARACTERISTIC
/begin CHARACTERISTIC KINP_ActiveDischReq_flg_defval "" VALUE 0x0000 /* @ECU_Address@KINP_ActiveDischReq_flg_defval@ */ Scalar_BOOLEAN 0 SWC_ETE_type_CM_boolean_flg 0.0 1.0 /end CHARACTERISTIC
/begin CHARACTERISTIC KINP_ActiveDischReq_flg_ovrdflg "" VALUE 0x0000 /* @ECU_Address@KINP_ActiveDischReq_flg_ovrdflg@ */ Scalar_BOOLEAN 0 SWC_ETE_type_CM_boolean_flg 0.0 1.0 /end CHARACTERISTIC
/begin CHARACTERISTIC KINP_ActiveDischReq_flg_ovrdval "" VALUE 0x0000 /* @ECU_Address@KINP_ActiveDischReq_flg_ovrdval@ */ Scalar_BOOLEAN 0 SWC_ETE_type_CM_boolean_flg 0.0 1.0 /end CHARACTERISTIC
/begin CHARACTERISTIC KINP_BMS1CSErr_flg_defval "" VALUE 0x0000 /* @ECU_Address@KINP_BMS1CSErr_flg_defval@ */ Scalar_BOOLEAN 0 SWC_ETE_type_CM_boolean_flg 0.0 1.0 /end CHARACTERISTIC
/begin CHARACTERISTIC KINP_BMS1CSErr_flg_ovrdflg "" VALUE 0x0000 /* @ECU_Address@KINP_BMS1CSErr_flg_ovrdflg@ */ Scalar_BOOLEAN 0 SWC_ETE_type_CM_boolean_flg 0.0 1.0 /end CHARACTERISTIC
/begin CHARACTERISTIC KINP_BMS1CSErr_flg_ovrdval "" VALUE 0x0000 /* @ECU_Address@KINP_BMS1CSErr_flg_ovrdval@ */ Scalar_BOOLEAN 0 SWC_ETE_type_CM_boolean_flg 0.0 1.0 /end CHARACTERISTIC
/begin CHARACTERISTIC KINP_BMS1RCErr_flg_defval "" VALUE 0x0000 /* @ECU_Address@KINP_BMS1RCErr_flg_defval@ */ Scalar_BOOLEAN 0 SWC_ETE_type_CM_boolean_flg 0.0 1.0 /end CHARACTERISTIC
/begin CHARACTERISTIC KINP_BMS1RCErr_flg_ovrdflg "" VALUE 0x0000 /* @ECU_Address@KINP_BMS1RCErr_flg_ovrdflg@ */ Scalar_BOOLEAN 0 SWC_ETE_type_CM_boolean_flg 0.0 1.0 /end CHARACTERISTIC
/begin CHARACTERISTIC KINP_BMS1RCErr_flg_ovrdval "" VALUE 0x0000 /* @ECU_Address@KINP_BMS1RCErr_flg_ovrdval@ */ Scalar_BOOLEAN 0 SWC_ETE_type_CM_boolean_flg 0.0 1.0 /end CHARACTERISTIC
/begin CHARACTERISTIC KINP_BMS6CSErr_flg_defval "" VALUE 0x0000 /* @ECU_Address@KINP_BMS6CSErr_flg_defval@ */ Scalar_BOOLEAN 0 SWC_ETE_type_CM_boolean_flg 0.0 1.0 /end CHARACTERISTIC
/begin CHARACTERISTIC KINP_BMS6CSErr_flg_ovrdflg "" VALUE 0x0000 /* @ECU_Address@KINP_BMS6CSErr_flg_ovrdflg@ */ Scalar_BOOLEAN 0 SWC_ETE_type_CM_boolean_flg 0.0 1.0 /end CHARACTERISTIC
/begin CHARACTERISTIC KINP_BMS6CSErr_flg_ovrdval "" VALUE 0x0000 /* @ECU_Address@KINP_BMS6CSErr_flg_ovrdval@ */ Scalar_BOOLEAN 0 SWC_ETE_type_CM_boolean_flg 0.0 1.0 /end CHARACTERISTIC
/begin CHARACTERISTIC KINP_BMS6RCErr_flg_defval "" VALUE 0x0000 /* @ECU_Address@KINP_BMS6RCErr_flg_defval@ */ Scalar_BOOLEAN 0 SWC_ETE_type_CM_boolean_flg 0.0 1.0 /end CHARACTERISTIC
/begin CHARACTERISTIC KINP_BMS6RCErr_flg_ovrdflg "" VALUE 0x0000 /* @ECU_Address@KINP_BMS6RCErr_flg_ovrdflg@ */ Scalar_BOOLEAN 0 SWC_ETE_type_CM_boolean_flg 0.0 1.0 /end CHARACTERISTIC
/begin CHARACTERISTIC KINP_BMS6RCErr_flg_ovrdval "" VALUE 0x0000 /* @ECU_Address@KINP_BMS6RCErr_flg_ovrdval@ */ Scalar_BOOLEAN 0 SWC_ETE_type_CM_boolean_flg 0.0 1.0 /end CHARACTERISTIC
/begin CHARACTERISTIC KINP_BatteryMode_enum_ovrdflg "" VALUE 0x0000 /* @ECU_Address@KINP_BatteryMode_enum_ovrdflg@ */ Scalar_BOOLEAN 0 SWC_ETE_type_CM_boolean_flg 0.0 1.0 /end CHARACTERISTIC
/begin CHARACTERISTIC KINP_CANMsgInvalidBMS1_flg_ovrdflg "" VALUE 0x0000 /* @ECU_Address@KINP_CANMsgInvalidBMS1_flg_ovrdflg@ */ Scalar_BOOLEAN 0 SWC_ETE_type_CM_boolean_flg 0.0 1.0 /end CHARACTERISTIC
/begin CHARACTERISTIC KINP_CANMsgInvalidBMS1_flg_ovrdval "" VALUE 0x0000 /* @ECU_Address@KINP_CANMsgInvalidBMS1_flg_ovrdval@ */ Scalar_BOOLEAN 0 SWC_ETE_type_CM_boolean_flg 0.0 1.0 /end CHARACTERISTIC
/begin CHARACTERISTIC KINP_CANMsgInvalidBMS6_flg_ovrdflg "" VALUE 0x0000 /* @ECU_Address@KINP_CANMsgInvalidBMS6_flg_ovrdflg@ */ Scalar_BOOLEAN 0 SWC_ETE_type_CM_boolean_flg 0.0 1.0 /end CHARACTERISTIC
/begin CHARACTERISTIC KINP_CANMsgInvalidBMS6_flg_ovrdval "" VALUE 0x0000 /* @ECU_Address@KINP_CANMsgInvalidBMS6_flg_ovrdval@ */ Scalar_BOOLEAN 0 SWC_ETE_type_CM_boolean_flg 0.0 1.0 /end CHARACTERISTIC
/begin CHARACTERISTIC KINP_CANMsgInvalidEOPFVTRLocal1_flg_ovrdflg "" VALUE 0x0000 /* @ECU_Address@KINP_CANMsgInvalidEOPFVTRLocal1_flg_ovrdflg@ */ Scalar_BOOLEAN 0 SWC_ETE_type_CM_boolean_flg 0.0 1.0 /end CHARACTERISTIC
/begin CHARACTERISTIC KINP_CANMsgInvalidEOPFVTRLocal1_flg_ovrdval "" VALUE 0x0000 /* @ECU_Address@KINP_CANMsgInvalidEOPFVTRLocal1_flg_ovrdval@ */ Scalar_BOOLEAN 0 SWC_ETE_type_CM_boolean_flg 0.0 1.0 /end CHARACTERISTIC
/begin CHARACTERISTIC KINP_CANMsgInvalidFD3C1000_flg_ovrdflg "" VALUE 0x0000 /* @ECU_Address@KINP_CANMsgInvalidFD3C1000_flg_ovrdflg@ */ Scalar_BOOLEAN 0 SWC_ETE_type_CM_boolean_flg 0.0 1.0 /end CHARACTERISTIC
/begin CHARACTERISTIC KINP_CANMsgInvalidFD3C1000_flg_ovrdval "" VALUE 0x0000 /* @ECU_Address@KINP_CANMsgInvalidFD3C1000_flg_ovrdval@ */ Scalar_BOOLEAN 0 SWC_ETE_type_CM_boolean_flg 0.0 1.0 /end CHARACTERISTIC
/begin CHARACTERISTIC KINP_CANMsgInvalidFD3VCU1_flg_ovrdflg "" VALUE 0x0000 /* @ECU_Address@KINP_CANMsgInvalidFD3VCU1_flg_ovrdflg@ */ Scalar_BOOLEAN 0 SWC_ETE_type_CM_boolean_flg 0.0 1.0 /end CHARACTERISTIC
/begin CHARACTERISTIC KINP_CANMsgInvalidFD3VCU1_flg_ovrdval "" VALUE 0x0000 /* @ECU_Address@KINP_CANMsgInvalidFD3VCU1_flg_ovrdval@ */ Scalar_BOOLEAN 0 SWC_ETE_type_CM_boolean_flg 0.0 1.0 /end CHARACTERISTIC
/begin CHARACTERISTIC KINP_CANMsgInvalidFD3VCU2_flg_ovrdflg "" VALUE 0x0000 /* @ECU_Address@KINP_CANMsgInvalidFD3VCU2_flg_ovrdflg@ */ Scalar_BOOLEAN 0 SWC_ETE_type_CM_boolean_flg 0.0 1.0 /end CHARACTERISTIC
/begin CHARACTERISTIC KINP_CANMsgInvalidFD3VCU2_flg_ovrdval "" VALUE 0x0000 /* @ECU_Address@KINP_CANMsgInvalidFD3VCU2_flg_ovrdval@ */ Scalar_BOOLEAN 0 SWC_ETE_type_CM_boolean_flg 0.0 1.0 /end CHARACTERISTIC
/begin CHARACTERISTIC KINP_CANMsgInvalidFD3VCU5_flg_ovrdflg "" VALUE 0x0000 /* @ECU_Address@KINP_CANMsgInvalidFD3VCU5_flg_ovrdflg@ */ Scalar_BOOLEAN 0 SWC_ETE_type_CM_boolean_flg 0.0 1.0 /end CHARACTERISTIC
/begin CHARACTERISTIC KINP_CANMsgInvalidFD3VCU5_flg_ovrdval "" VALUE 0x0000 /* @ECU_Address@KINP_CANMsgInvalidFD3VCU5_flg_ovrdval@ */ Scalar_BOOLEAN 0 SWC_ETE_type_CM_boolean_flg 0.0 1.0 /end CHARACTERISTIC
/begin CHARACTERISTIC KINP_CANMsgInvalidGW3CE1000_flg_ovrdflg "" VALUE 0x0000 /* @ECU_Address@KINP_CANMsgInvalidGW3CE1000_flg_ovrdflg@ */ Scalar_BOOLEAN 0 SWC_ETE_type_CM_boolean_flg 0.0 1.0 /end CHARACTERISTIC
/begin CHARACTERISTIC KINP_CANMsgInvalidGW3CE1000_flg_ovrdval "" VALUE 0x0000 /* @ECU_Address@KINP_CANMsgInvalidGW3CE1000_flg_ovrdval@ */ Scalar_BOOLEAN 0 SWC_ETE_type_CM_boolean_flg 0.0 1.0 /end CHARACTERISTIC
/begin CHARACTERISTIC KINP_CSVCU1_enum_ovrdflg "" VALUE 0x0000 /* @ECU_Address@KINP_CSVCU1_enum_ovrdflg@ */ Scalar_BOOLEAN 0 SWC_ETE_type_CM_boolean_flg 0.0 1.0 /end CHARACTERISTIC
/begin CHARACTERISTIC KINP_CSVCU2CAN1_enum_ovrdflg "" VALUE 0x0000 /* @ECU_Address@KINP_CSVCU2CAN1_enum_ovrdflg@ */ Scalar_BOOLEAN 0 SWC_ETE_type_CM_boolean_flg 0.0 1.0 /end CHARACTERISTIC
/begin CHARACTERISTIC KINP_EOPFVTRActualSpdSta_rpm_ovrdflg "" VALUE 0x0000 /* @ECU_Address@KINP_EOPFVTRActualSpdSta_rpm_ovrdflg@ */ Scalar_BOOLEAN 0 SWC_ETE_type_CM_boolean_flg 0.0 1.0 /end CHARACTERISTIC
/begin CHARACTERISTIC KINP_EOPFVTRCSInvalidSta_flg_defval "" VALUE 0x0000 /* @ECU_Address@KINP_EOPFVTRCSInvalidSta_flg_defval@ */ Scalar_BOOLEAN 0 SWC_ETE_type_CM_boolean_flg 0.0 1.0 /end CHARACTERISTIC
/begin CHARACTERISTIC KINP_EOPFVTRCSInvalidSta_flg_ovrdflg "" VALUE 0x0000 /* @ECU_Address@KINP_EOPFVTRCSInvalidSta_flg_ovrdflg@ */ Scalar_BOOLEAN 0 SWC_ETE_type_CM_boolean_flg 0.0 1.0 /end CHARACTERISTIC
/begin CHARACTERISTIC KINP_EOPFVTRCSInvalidSta_flg_ovrdval "" VALUE 0x0000 /* @ECU_Address@KINP_EOPFVTRCSInvalidSta_flg_ovrdval@ */ Scalar_BOOLEAN 0 SWC_ETE_type_CM_boolean_flg 0.0 1.0 /end CHARACTERISTIC
/begin CHARACTERISTIC KINP_EOPFVTRCanLossSta_flg_defval "" VALUE 0x0000 /* @ECU_Address@KINP_EOPFVTRCanLossSta_flg_defval@ */ Scalar_BOOLEAN 0 SWC_ETE_type_CM_boolean_flg 0.0 1.0 /end CHARACTERISTIC
/begin CHARACTERISTIC KINP_EOPFVTRCanLossSta_flg_ovrdflg "" VALUE 0x0000 /* @ECU_Address@KINP_EOPFVTRCanLossSta_flg_ovrdflg@ */ Scalar_BOOLEAN 0 SWC_ETE_type_CM_boolean_flg 0.0 1.0 /end CHARACTERISTIC
/begin CHARACTERISTIC KINP_EOPFVTRCanLossSta_flg_ovrdval "" VALUE 0x0000 /* @ECU_Address@KINP_EOPFVTRCanLossSta_flg_ovrdval@ */ Scalar_BOOLEAN 0 SWC_ETE_type_CM_boolean_flg 0.0 1.0 /end CHARACTERISTIC
/begin CHARACTERISTIC KINP_EOPFVTREnableOffSta_flg_defval "" VALUE 0x0000 /* @ECU_Address@KINP_EOPFVTREnableOffSta_flg_defval@ */ Scalar_BOOLEAN 0 SWC_ETE_type_CM_boolean_flg 0.0 1.0 /end CHARACTERISTIC
/begin CHARACTERISTIC KINP_EOPFVTREnableOffSta_flg_ovrdflg "" VALUE 0x0000 /* @ECU_Address@KINP_EOPFVTREnableOffSta_flg_ovrdflg@ */ Scalar_BOOLEAN 0 SWC_ETE_type_CM_boolean_flg 0.0 1.0 /end CHARACTERISTIC
/begin CHARACTERISTIC KINP_EOPFVTREnableOffSta_flg_ovrdval "" VALUE 0x0000 /* @ECU_Address@KINP_EOPFVTREnableOffSta_flg_ovrdval@ */ Scalar_BOOLEAN 0 SWC_ETE_type_CM_boolean_flg 0.0 1.0 /end CHARACTERISTIC
/begin CHARACTERISTIC KINP_EOPFVTRHallSigErrSta_flg_defval "" VALUE 0x0000 /* @ECU_Address@KINP_EOPFVTRHallSigErrSta_flg_defval@ */ Scalar_BOOLEAN 0 SWC_ETE_type_CM_boolean_flg 0.0 1.0 /end CHARACTERISTIC
/begin CHARACTERISTIC KINP_EOPFVTRHallSigErrSta_flg_ovrdflg "" VALUE 0x0000 /* @ECU_Address@KINP_EOPFVTRHallSigErrSta_flg_ovrdflg@ */ Scalar_BOOLEAN 0 SWC_ETE_type_CM_boolean_flg 0.0 1.0 /end CHARACTERISTIC
/begin CHARACTERISTIC KINP_EOPFVTRHallSigErrSta_flg_ovrdval "" VALUE 0x0000 /* @ECU_Address@KINP_EOPFVTRHallSigErrSta_flg_ovrdval@ */ Scalar_BOOLEAN 0 SWC_ETE_type_CM_boolean_flg 0.0 1.0 /end CHARACTERISTIC
/begin CHARACTERISTIC KINP_EOPFVTRLocal1CSSta_enum_ovrdflg "" VALUE 0x0000 /* @ECU_Address@KINP_EOPFVTRLocal1CSSta_enum_ovrdflg@ */ Scalar_BOOLEAN 0 SWC_ETE_type_CM_boolean_flg 0.0 1.0 /end CHARACTERISTIC
/begin CHARACTERISTIC KINP_EOPFVTRLocal1RCSta_enum_ovrdflg "" VALUE 0x0000 /* @ECU_Address@KINP_EOPFVTRLocal1RCSta_enum_ovrdflg@ */ Scalar_BOOLEAN 0 SWC_ETE_type_CM_boolean_flg 0.0 1.0 /end CHARACTERISTIC
/begin CHARACTERISTIC KINP_EOPFVTROverTempBCKSta_enum_ovrdflg "" VALUE 0x0000 /* @ECU_Address@KINP_EOPFVTROverTempBCKSta_enum_ovrdflg@ */ Scalar_BOOLEAN 0 SWC_ETE_type_CM_boolean_flg 0.0 1.0 /end CHARACTERISTIC
/begin CHARACTERISTIC KINP_EOPFVTROverTempSta_flg_defval "" VALUE 0x0000 /* @ECU_Address@KINP_EOPFVTROverTempSta_flg_defval@ */ Scalar_BOOLEAN 0 SWC_ETE_type_CM_boolean_flg 0.0 1.0 /end CHARACTERISTIC
/begin CHARACTERISTIC KINP_EOPFVTROverTempSta_flg_ovrdflg "" VALUE 0x0000 /* @ECU_Address@KINP_EOPFVTROverTempSta_flg_ovrdflg@ */ Scalar_BOOLEAN 0 SWC_ETE_type_CM_boolean_flg 0.0 1.0 /end CHARACTERISTIC
/begin CHARACTERISTIC KINP_EOPFVTROverTempSta_flg_ovrdval "" VALUE 0x0000 /* @ECU_Address@KINP_EOPFVTROverTempSta_flg_ovrdval@ */ Scalar_BOOLEAN 0 SWC_ETE_type_CM_boolean_flg 0.0 1.0 /end CHARACTERISTIC
/begin CHARACTERISTIC KINP_EOPFVTROverVolSta_enum_ovrdflg "" VALUE 0x0000 /* @ECU_Address@KINP_EOPFVTROverVolSta_enum_ovrdflg@ */ Scalar_BOOLEAN 0 SWC_ETE_type_CM_boolean_flg 0.0 1.0 /end CHARACTERISTIC
/begin CHARACTERISTIC KINP_EOPFVTRPumpReadySta_flg_defval "" VALUE 0x0000 /* @ECU_Address@KINP_EOPFVTRPumpReadySta_flg_defval@ */ Scalar_BOOLEAN 0 SWC_ETE_type_CM_boolean_flg 0.0 1.0 /end CHARACTERISTIC
/begin CHARACTERISTIC KINP_EOPFVTRPumpReadySta_flg_ovrdflg "" VALUE 0x0000 /* @ECU_Address@KINP_EOPFVTRPumpReadySta_flg_ovrdflg@ */ Scalar_BOOLEAN 0 SWC_ETE_type_CM_boolean_flg 0.0 1.0 /end CHARACTERISTIC
/begin CHARACTERISTIC KINP_EOPFVTRPumpReadySta_flg_ovrdval "" VALUE 0x0000 /* @ECU_Address@KINP_EOPFVTRPumpReadySta_flg_ovrdval@ */ Scalar_BOOLEAN 0 SWC_ETE_type_CM_boolean_flg 0.0 1.0 /end CHARACTERISTIC
/begin CHARACTERISTIC KINP_EOPFVTRRCInvalidSta_flg_defval "" VALUE 0x0000 /* @ECU_Address@KINP_EOPFVTRRCInvalidSta_flg_defval@ */ Scalar_BOOLEAN 0 SWC_ETE_type_CM_boolean_flg 0.0 1.0 /end CHARACTERISTIC
/begin CHARACTERISTIC KINP_EOPFVTRRCInvalidSta_flg_ovrdflg "" VALUE 0x0000 /* @ECU_Address@KINP_EOPFVTRRCInvalidSta_flg_ovrdflg@ */ Scalar_BOOLEAN 0 SWC_ETE_type_CM_boolean_flg 0.0 1.0 /end CHARACTERISTIC
/begin CHARACTERISTIC KINP_EOPFVTRRCInvalidSta_flg_ovrdval "" VALUE 0x0000 /* @ECU_Address@KINP_EOPFVTRRCInvalidSta_flg_ovrdval@ */ Scalar_BOOLEAN 0 SWC_ETE_type_CM_boolean_flg 0.0 1.0 /end CHARACTERISTIC
/begin CHARACTERISTIC KINP_EOPFVTRRunStatusSta_enum_ovrdflg "" VALUE 0x0000 /* @ECU_Address@KINP_EOPFVTRRunStatusSta_enum_ovrdflg@ */ Scalar_BOOLEAN 0 SWC_ETE_type_CM_boolean_flg 0.0 1.0 /end CHARACTERISTIC
/begin CHARACTERISTIC KINP_EOPFVTRStartFailureSta_flg_defval "" VALUE 0x0000 /* @ECU_Address@KINP_EOPFVTRStartFailureSta_flg_defval@ */ Scalar_BOOLEAN 0 SWC_ETE_type_CM_boolean_flg 0.0 1.0 /end CHARACTERISTIC
/begin CHARACTERISTIC KINP_EOPFVTRStartFailureSta_flg_ovrdflg "" VALUE 0x0000 /* @ECU_Address@KINP_EOPFVTRStartFailureSta_flg_ovrdflg@ */ Scalar_BOOLEAN 0 SWC_ETE_type_CM_boolean_flg 0.0 1.0 /end CHARACTERISTIC
/begin CHARACTERISTIC KINP_EOPFVTRStartFailureSta_flg_ovrdval "" VALUE 0x0000 /* @ECU_Address@KINP_EOPFVTRStartFailureSta_flg_ovrdval@ */ Scalar_BOOLEAN 0 SWC_ETE_type_CM_boolean_flg 0.0 1.0 /end CHARACTERISTIC
/begin CHARACTERISTIC KINP_EOPFVTRUnderVolSta_enum_ovrdflg "" VALUE 0x0000 /* @ECU_Address@KINP_EOPFVTRUnderVolSta_enum_ovrdflg@ */ Scalar_BOOLEAN 0 SWC_ETE_type_CM_boolean_flg 0.0 1.0 /end CHARACTERISTIC
/begin CHARACTERISTIC KINP_FDCVCURrSpdMaxReq_rpm_ovrdflg "" VALUE 0x0000 /* @ECU_Address@KINP_FDCVCURrSpdMaxReq_rpm_ovrdflg@ */ Scalar_BOOLEAN 0 SWC_ETE_type_CM_boolean_flg 0.0 1.0 /end CHARACTERISTIC
/begin CHARACTERISTIC KINP_FDCVCURrSpdMinReq_rpm_ovrdflg "" VALUE 0x0000 /* @ECU_Address@KINP_FDCVCURrSpdMinReq_rpm_ovrdflg@ */ Scalar_BOOLEAN 0 SWC_ETE_type_CM_boolean_flg 0.0 1.0 /end CHARACTERISTIC
/begin CHARACTERISTIC KINP_FDCVCURrTMCtrlModeReq_enum_ovrdflg "" VALUE 0x0000 /* @ECU_Address@KINP_FDCVCURrTMCtrlModeReq_enum_ovrdflg@ */ Scalar_BOOLEAN 0 SWC_ETE_type_CM_boolean_flg 0.0 1.0 /end CHARACTERISTIC
/begin CHARACTERISTIC KINP_FDCVCURrTMSpdReq_rpm_ovrdflg "" VALUE 0x0000 /* @ECU_Address@KINP_FDCVCURrTMSpdReq_rpm_ovrdflg@ */ Scalar_BOOLEAN 0 SWC_ETE_type_CM_boolean_flg 0.0 1.0 /end CHARACTERISTIC
/begin CHARACTERISTIC KINP_FDCVCURrTMTqReq_Nm_ovrdflg "" VALUE 0x0000 /* @ECU_Address@KINP_FDCVCURrTMTqReq_Nm_ovrdflg@ */ Scalar_BOOLEAN 0 SWC_ETE_type_CM_boolean_flg 0.0 1.0 /end CHARACTERISTIC
/begin CHARACTERISTIC KINP_FDCVCURrTqMaxReq_Nm_ovrdflg "" VALUE 0x0000 /* @ECU_Address@KINP_FDCVCURrTqMaxReq_Nm_ovrdflg@ */ Scalar_BOOLEAN 0 SWC_ETE_type_CM_boolean_flg 0.0 1.0 /end CHARACTERISTIC
/begin CHARACTERISTIC KINP_FDCVCURrTqMinReq_Nm_ovrdflg "" VALUE 0x0000 /* @ECU_Address@KINP_FDCVCURrTqMinReq_Nm_ovrdflg@ */ Scalar_BOOLEAN 0 SWC_ETE_type_CM_boolean_flg 0.0 1.0 /end CHARACTERISTIC
/begin CHARACTERISTIC KINP_HVBContactorSta_flg_defval "" VALUE 0x0000 /* @ECU_Address@KINP_HVBContactorSta_flg_defval@ */ Scalar_BOOLEAN 0 SWC_ETE_type_CM_boolean_flg 0.0 1.0 /end CHARACTERISTIC
/begin CHARACTERISTIC KINP_HVBContactorSta_flg_ovrdflg "" VALUE 0x0000 /* @ECU_Address@KINP_HVBContactorSta_flg_ovrdflg@ */ Scalar_BOOLEAN 0 SWC_ETE_type_CM_boolean_flg 0.0 1.0 /end CHARACTERISTIC
/begin CHARACTERISTIC KINP_HVBContactorSta_flg_ovrdval "" VALUE 0x0000 /* @ECU_Address@KINP_HVBContactorSta_flg_ovrdval@ */ Scalar_BOOLEAN 0 SWC_ETE_type_CM_boolean_flg 0.0 1.0 /end CHARACTERISTIC
/begin CHARACTERISTIC KINP_HVBattVolt_V_ovrdflg "" VALUE 0x0000 /* @ECU_Address@KINP_HVBattVolt_V_ovrdflg@ */ Scalar_BOOLEAN 0 SWC_ETE_type_CM_boolean_flg 0.0 1.0 /end CHARACTERISTIC
/begin CHARACTERISTIC KINP_IVITimeDay_DAY_ovrdflg "" VALUE 0x0000 /* @ECU_Address@KINP_IVITimeDay_DAY_ovrdflg@ */ Scalar_BOOLEAN 0 SWC_ETE_type_CM_boolean_flg 0.0 1.0 /end CHARACTERISTIC
/begin CHARACTERISTIC KINP_IVITimeHour_hr_ovrdflg "" VALUE 0x0000 /* @ECU_Address@KINP_IVITimeHour_hr_ovrdflg@ */ Scalar_BOOLEAN 0 SWC_ETE_type_CM_boolean_flg 0.0 1.0 /end CHARACTERISTIC
/begin CHARACTERISTIC KINP_IVITimeMinute_min_ovrdflg "" VALUE 0x0000 /* @ECU_Address@KINP_IVITimeMinute_min_ovrdflg@ */ Scalar_BOOLEAN 0 SWC_ETE_type_CM_boolean_flg 0.0 1.0 /end CHARACTERISTIC
/begin CHARACTERISTIC KINP_IVITimeMonth_MONTH_ovrdflg "" VALUE 0x0000 /* @ECU_Address@KINP_IVITimeMonth_MONTH_ovrdflg@ */ Scalar_BOOLEAN 0 SWC_ETE_type_CM_boolean_flg 0.0 1.0 /end CHARACTERISTIC
/begin CHARACTERISTIC KINP_IVITimeSecond_s_ovrdflg "" VALUE 0x0000 /* @ECU_Address@KINP_IVITimeSecond_s_ovrdflg@ */ Scalar_BOOLEAN 0 SWC_ETE_type_CM_boolean_flg 0.0 1.0 /end CHARACTERISTIC
/begin CHARACTERISTIC KINP_PwrSta_enum_ovrdflg "" VALUE 0x0000 /* @ECU_Address@KINP_PwrSta_enum_ovrdflg@ */ Scalar_BOOLEAN 0 SWC_ETE_type_CM_boolean_flg 0.0 1.0 /end CHARACTERISTIC
/begin CHARACTERISTIC KINP_RCVCU1_enum_ovrdflg "" VALUE 0x0000 /* @ECU_Address@KINP_RCVCU1_enum_ovrdflg@ */ Scalar_BOOLEAN 0 SWC_ETE_type_CM_boolean_flg 0.0 1.0 /end CHARACTERISTIC
/begin CHARACTERISTIC KINP_RCVCU2CAN1_enum_ovrdflg "" VALUE 0x0000 /* @ECU_Address@KINP_RCVCU2CAN1_enum_ovrdflg@ */ Scalar_BOOLEAN 0 SWC_ETE_type_CM_boolean_flg 0.0 1.0 /end CHARACTERISTIC
/begin CHARACTERISTIC KINP_RrActvDmpDisabReq_flg_defval "" VALUE 0x0000 /* @ECU_Address@KINP_RrActvDmpDisabReq_flg_defval@ */ Scalar_BOOLEAN 0 SWC_ETE_type_CM_boolean_flg 0.0 1.0 /end CHARACTERISTIC
/begin CHARACTERISTIC KINP_RrActvDmpDisabReq_flg_ovrdflg "" VALUE 0x0000 /* @ECU_Address@KINP_RrActvDmpDisabReq_flg_ovrdflg@ */ Scalar_BOOLEAN 0 SWC_ETE_type_CM_boolean_flg 0.0 1.0 /end CHARACTERISTIC
/begin CHARACTERISTIC KINP_RrActvDmpDisabReq_flg_ovrdval "" VALUE 0x0000 /* @ECU_Address@KINP_RrActvDmpDisabReq_flg_ovrdval@ */ Scalar_BOOLEAN 0 SWC_ETE_type_CM_boolean_flg 0.0 1.0 /end CHARACTERISTIC
/begin CHARACTERISTIC KINP_RrCoolantflow_Lpmin_ovrdflg "" VALUE 0x0000 /* @ECU_Address@KINP_RrCoolantflow_Lpmin_ovrdflg@ */ Scalar_BOOLEAN 0 SWC_ETE_type_CM_boolean_flg 0.0 1.0 /end CHARACTERISTIC
/begin CHARACTERISTIC KINP_RrCoolanttemp_C_ovrdflg "" VALUE 0x0000 /* @ECU_Address@KINP_RrCoolanttemp_C_ovrdflg@ */ Scalar_BOOLEAN 0 SWC_ETE_type_CM_boolean_flg 0.0 1.0 /end CHARACTERISTIC
/begin CHARACTERISTIC KINP_RrMCUEnaReq_flg_defval "" VALUE 0x0000 /* @ECU_Address@KINP_RrMCUEnaReq_flg_defval@ */ Scalar_BOOLEAN 0 SWC_ETE_type_CM_boolean_flg 0.0 1.0 /end CHARACTERISTIC
/begin CHARACTERISTIC KINP_RrMCUEnaReq_flg_ovrdflg "" VALUE 0x0000 /* @ECU_Address@KINP_RrMCUEnaReq_flg_ovrdflg@ */ Scalar_BOOLEAN 0 SWC_ETE_type_CM_boolean_flg 0.0 1.0 /end CHARACTERISTIC
/begin CHARACTERISTIC KINP_RrMCUEnaReq_flg_ovrdval "" VALUE 0x0000 /* @ECU_Address@KINP_RrMCUEnaReq_flg_ovrdval@ */ Scalar_BOOLEAN 0 SWC_ETE_type_CM_boolean_flg 0.0 1.0 /end CHARACTERISTIC
/begin CHARACTERISTIC KINP_ShiftGearPosn_enum_ovrdflg "" VALUE 0x0000 /* @ECU_Address@KINP_ShiftGearPosn_enum_ovrdflg@ */ Scalar_BOOLEAN 0 SWC_ETE_type_CM_boolean_flg 0.0 1.0 /end CHARACTERISTIC
/begin CHARACTERISTIC KINP_VehSpeed_kph_ovrdflg "" VALUE 0x0000 /* @ECU_Address@KINP_VehSpeed_kph_ovrdflg@ */ Scalar_BOOLEAN 0 SWC_ETE_type_CM_boolean_flg 0.0 1.0 /end CHARACTERISTIC
/begin CHARACTERISTIC KOPM_FakeKL15_flg "" VALUE 0x0000 /* @ECU_Address@KOPM_FakeKL15_flg@ */ Scalar_BOOLEAN 0 SWC_ETE_type_CM_boolean_flag 0.0 1.0 /end CHARACTERISTIC
/begin CHARACTERISTIC KOPM_IVTROpMode_enum_ovrdflg "" VALUE 0x0000 /* @ECU_Address@KOPM_IVTROpMode_enum_ovrdflg@ */ Scalar_BOOLEAN 0 SWC_ETE_type_CM_boolean_flag 0.0 1.0 /end CHARACTERISTIC
/begin CHARACTERISTIC KOPM_MotMod_enum_ovrdflg "" VALUE 0x0000 /* @ECU_Address@KOPM_MotMod_enum_ovrdflg@ */ Scalar_BOOLEAN 0 SWC_ETE_type_CM_boolean_flag 0.0 1.0 /end CHARACTERISTIC
/begin CHARACTERISTIC KOPM_PsvDischrgEna_flg_ovrdflg "" VALUE 0x0000 /* @ECU_Address@KOPM_PsvDischrgEna_flg_ovrdflg@ */ Scalar_BOOLEAN 0 SWC_ETE_type_CM_boolean_flag 0.0 1.0 /end CHARACTERISTIC
/begin CHARACTERISTIC KOPM_PsvDischrgEna_flg_ovrdval "" VALUE 0x0000 /* @ECU_Address@KOPM_PsvDischrgEna_flg_ovrdval@ */ Scalar_BOOLEAN 0 SWC_ETE_type_CM_boolean_flag 0.0 1.0 /end CHARACTERISTIC
/begin CHARACTERISTIC KOUTP_ADCKL15_V_ovrdflg "" VALUE 0x0000 /* @ECU_Address@KOUTP_ADCKL15_V_ovrdflg@ */ Scalar_BOOLEAN 0 SWC_ETE_type_CM_boolean_flg 0.0 1.0 /end CHARACTERISTIC
/begin CHARACTERISTIC KOUTP_ADCKL30_V_ovrdflg "" VALUE 0x0000 /* @ECU_Address@KOUTP_ADCKL30_V_ovrdflg@ */ Scalar_BOOLEAN 0 SWC_ETE_type_CM_boolean_flg 0.0 1.0 /end CHARACTERISTIC
/begin CHARACTERISTIC KOUTP_BoostOPSta_flg_maxval "" VALUE 0x0000 /* @ECU_Address@KOUTP_BoostOPSta_flg_maxval@ */ Scalar_BOOLEAN 0 SWC_ETE_type_CM_boolean_flag 0.0 1.0 /end CHARACTERISTIC
/begin CHARACTERISTIC KOUTP_BoostOPSta_flg_minval "" VALUE 0x0000 /* @ECU_Address@KOUTP_BoostOPSta_flg_minval@ */ Scalar_BOOLEAN 0 SWC_ETE_type_CM_boolean_flag 0.0 1.0 /end CHARACTERISTIC
/begin CHARACTERISTIC KOUTP_BoostOPSta_flg_ovrdflg "" VALUE 0x0000 /* @ECU_Address@KOUTP_BoostOPSta_flg_ovrdflg@ */ Scalar_BOOLEAN 0 SWC_ETE_type_CM_boolean_flg 0.0 1.0 /end CHARACTERISTIC
/begin CHARACTERISTIC KOUTP_BoostOPSta_flg_ovrdval "" VALUE 0x0000 /* @ECU_Address@KOUTP_BoostOPSta_flg_ovrdval@ */ Scalar_BOOLEAN 0 SWC_ETE_type_CM_boolean_flg 0.0 1.0 /end CHARACTERISTIC
/begin CHARACTERISTIC KOUTP_BusCurr_A_ovrdflg "" VALUE 0x0000 /* @ECU_Address@KOUTP_BusCurr_A_ovrdflg@ */ Scalar_BOOLEAN 0 SWC_ETE_type_CM_boolean_flg 0.0 1.0 /end CHARACTERISTIC
/begin CHARACTERISTIC KOUTP_IVTROpMode_enum_ovrdflg "" VALUE 0x0000 /* @ECU_Address@KOUTP_IVTROpMode_enum_ovrdflg@ */ Scalar_BOOLEAN 0 SWC_ETE_type_CM_boolean_flg 0.0 1.0 /end CHARACTERISTIC
/begin CHARACTERISTIC KOUTP_MCUEna_flg_maxval "" VALUE 0x0000 /* @ECU_Address@KOUTP_MCUEna_flg_maxval@ */ Scalar_BOOLEAN 0 SWC_ETE_type_CM_boolean_flag 0.0 1.0 /end CHARACTERISTIC
/begin CHARACTERISTIC KOUTP_MCUEna_flg_minval "" VALUE 0x0000 /* @ECU_Address@KOUTP_MCUEna_flg_minval@ */ Scalar_BOOLEAN 0 SWC_ETE_type_CM_boolean_flag 0.0 1.0 /end CHARACTERISTIC
/begin CHARACTERISTIC KOUTP_MCUEna_flg_ovrdflg "" VALUE 0x0000 /* @ECU_Address@KOUTP_MCUEna_flg_ovrdflg@ */ Scalar_BOOLEAN 0 SWC_ETE_type_CM_boolean_flg 0.0 1.0 /end CHARACTERISTIC
/begin CHARACTERISTIC KOUTP_MCUEna_flg_ovrdval "" VALUE 0x0000 /* @ECU_Address@KOUTP_MCUEna_flg_ovrdval@ */ Scalar_BOOLEAN 0 SWC_ETE_type_CM_boolean_flg 0.0 1.0 /end CHARACTERISTIC
/begin CHARACTERISTIC KOUTP_MotMod_enum_ovrdflg "" VALUE 0x0000 /* @ECU_Address@KOUTP_MotMod_enum_ovrdflg@ */ Scalar_BOOLEAN 0 SWC_ETE_type_CM_boolean_flg 0.0 1.0 /end CHARACTERISTIC
/begin CHARACTERISTIC KOUTP_OilTemp_degC_ovrdflg "" VALUE 0x0000 /* @ECU_Address@KOUTP_OilTemp_degC_ovrdflg@ */ Scalar_BOOLEAN 0 SWC_ETE_type_CM_boolean_flg 0.0 1.0 /end CHARACTERISTIC
/begin CHARACTERISTIC KOUTP_PwrEleAct_W_ovrdflg "" VALUE 0x0000 /* @ECU_Address@KOUTP_PwrEleAct_W_ovrdflg@ */ Scalar_BOOLEAN 0 SWC_ETE_type_CM_boolean_flg 0.0 1.0 /end CHARACTERISTIC
/begin CHARACTERISTIC KOUTP_RotSpd_rpm_ovrdflg "" VALUE 0x0000 /* @ECU_Address@KOUTP_RotSpd_rpm_ovrdflg@ */ Scalar_BOOLEAN 0 SWC_ETE_type_CM_boolean_flg 0.0 1.0 /end CHARACTERISTIC
/begin CHARACTERISTIC KOUTP_TMReady_flg_maxval "" VALUE 0x0000 /* @ECU_Address@KOUTP_TMReady_flg_maxval@ */ Scalar_BOOLEAN 0 SWC_ETE_type_CM_boolean_flag 0.0 1.0 /end CHARACTERISTIC
/begin CHARACTERISTIC KOUTP_TMReady_flg_minval "" VALUE 0x0000 /* @ECU_Address@KOUTP_TMReady_flg_minval@ */ Scalar_BOOLEAN 0 SWC_ETE_type_CM_boolean_flag 0.0 1.0 /end CHARACTERISTIC
/begin CHARACTERISTIC KOUTP_TMReady_flg_ovrdflg "" VALUE 0x0000 /* @ECU_Address@KOUTP_TMReady_flg_ovrdflg@ */ Scalar_BOOLEAN 0 SWC_ETE_type_CM_boolean_flg 0.0 1.0 /end CHARACTERISTIC
/begin CHARACTERISTIC KOUTP_TMReady_flg_ovrdval "" VALUE 0x0000 /* @ECU_Address@KOUTP_TMReady_flg_ovrdval@ */ Scalar_BOOLEAN 0 SWC_ETE_type_CM_boolean_flg 0.0 1.0 /end CHARACTERISTIC
/begin CHARACTERISTIC KOUTP_bMotEnaReq_flg_maxval "" VALUE 0x0000 /* @ECU_Address@KOUTP_bMotEnaReq_flg_maxval@ */ Scalar_BOOLEAN 0 SWC_ETE_type_CM_boolean_flag 0.0 1.0 /end CHARACTERISTIC
/begin CHARACTERISTIC KOUTP_bMotEnaReq_flg_minval "" VALUE 0x0000 /* @ECU_Address@KOUTP_bMotEnaReq_flg_minval@ */ Scalar_BOOLEAN 0 SWC_ETE_type_CM_boolean_flag 0.0 1.0 /end CHARACTERISTIC
/begin CHARACTERISTIC KOUTP_bMotEnaReq_flg_ovrdflg "" VALUE 0x0000 /* @ECU_Address@KOUTP_bMotEnaReq_flg_ovrdflg@ */ Scalar_BOOLEAN 0 SWC_ETE_type_CM_boolean_flg 0.0 1.0 /end CHARACTERISTIC
/begin CHARACTERISTIC KOUTP_bMotEnaReq_flg_ovrdval "" VALUE 0x0000 /* @ECU_Address@KOUTP_bMotEnaReq_flg_ovrdval@ */ Scalar_BOOLEAN 0 SWC_ETE_type_CM_boolean_flg 0.0 1.0 /end CHARACTERISTIC
/begin CHARACTERISTIC KOUTP_iDCurrAct_A_ovrdflg "" VALUE 0x0000 /* @ECU_Address@KOUTP_iDCurrAct_A_ovrdflg@ */ Scalar_BOOLEAN 0 SWC_ETE_type_CM_boolean_flg 0.0 1.0 /end CHARACTERISTIC
/begin CHARACTERISTIC KOUTP_iQCurrAct_A_ovrdflg "" VALUE 0x0000 /* @ECU_Address@KOUTP_iQCurrAct_A_ovrdflg@ */ Scalar_BOOLEAN 0 SWC_ETE_type_CM_boolean_flg 0.0 1.0 /end CHARACTERISTIC
/begin CHARACTERISTIC KOUTP_nEOPSpdReq_rpm_ovrdflg "" VALUE 0x0000 /* @ECU_Address@KOUTP_nEOPSpdReq_rpm_ovrdflg@ */ Scalar_BOOLEAN 0 SWC_ETE_type_CM_boolean_flg 0.0 1.0 /end CHARACTERISTIC
/begin CHARACTERISTIC KOUTP_tqTMTqMax_Nm_ovrdflg "" VALUE 0x0000 /* @ECU_Address@KOUTP_tqTMTqMax_Nm_ovrdflg@ */ Scalar_BOOLEAN 0 SWC_ETE_type_CM_boolean_flg 0.0 1.0 /end CHARACTERISTIC
/begin CHARACTERISTIC KOUTP_tqTMTqMin_Nm_ovrdflg "" VALUE 0x0000 /* @ECU_Address@KOUTP_tqTMTqMin_Nm_ovrdflg@ */ Scalar_BOOLEAN 0 SWC_ETE_type_CM_boolean_flg 0.0 1.0 /end CHARACTERISTIC
/begin CHARACTERISTIC KOUTP_uDC_V_ovrdflg "" VALUE 0x0000 /* @ECU_Address@KOUTP_uDC_V_ovrdflg@ */ Scalar_BOOLEAN 0 SWC_ETE_type_CM_boolean_flg 0.0 1.0 /end CHARACTERISTIC
/begin CHARACTERISTIC KOUTP_volfCooltFlowTar_C_ovrdflg "" VALUE 0x0000 /* @ECU_Address@KOUTP_volfCooltFlowTar_C_ovrdflg@ */ Scalar_BOOLEAN 0 SWC_ETE_type_CM_boolean_flg 0.0 1.0 /end CHARACTERISTIC
/begin CHARACTERISTIC LLCM_bTcooltFlowTrig_C "" VALUE 0x0000 /* @ECU_Address@LLCM_bTcooltFlowTrig_C@ */ Scalar_BOOLEAN 0 SWC_ETE_type_CM_boolean_flg 0.0 1.0 /end CHARACTERISTIC
/begin CHARACTERISTIC OpMod_ResolverEnt_C "" VALUE 0x0000 /* @ECU_Address@OpMod_ResolverEnt_C@ */ Scalar_BOOLEAN 0 SWC_ETE_type_CM_boolean_flag 0.0 1.0 /end CHARACTERISTIC
/begin CHARACTERISTIC OpMod_bDcha2AfterRunMor_C "" VALUE 0x0000 /* @ECU_Address@OpMod_bDcha2AfterRunMor_C@ */ Scalar_BOOLEAN 0 SWC_ETE_type_CM_boolean_flag 0.0 1.0 /end CHARACTERISTIC
/begin CHARACTERISTIC OpMod_bService_C "" VALUE 0x0000 /* @ECU_Address@OpMod_bService_C@ */ Scalar_BOOLEAN 0 SWC_ETE_type_CM_boolean_flag 0.0 1.0 /end CHARACTERISTIC
/begin CHARACTERISTIC KAPP_ADCKL15_enum "" VALUE 0x0000 /* @ECU_Address@KAPP_ADCKL15_enum@ */ Scalar_UBYTE 0 SWC_ETE_type_CM_uint8_enum 0.0 32.0 /end CHARACTERISTIC
/begin CHARACTERISTIC KAPP_ADCKL30_enum "" VALUE 0x0000 /* @ECU_Address@KAPP_ADCKL30_enum@ */ Scalar_UBYTE 0 SWC_ETE_type_CM_uint8_enum 0.0 32.0 /end CHARACTERISTIC
/begin CHARACTERISTIC KFOC_ADCFlyBackTemp_enum "" VALUE 0x0000 /* @ECU_Address@KFOC_ADCFlyBackTemp_enum@ */ Scalar_UBYTE 0 SWC_ETE_type_CM_uint8_enum 0.0 32.0 /end CHARACTERISTIC
/begin CHARACTERISTIC KFOC_ADCMCUTemp_enum "" VALUE 0x0000 /* @ECU_Address@KFOC_ADCMCUTemp_enum@ */ Scalar_UBYTE 0 SWC_ETE_type_CM_uint8_enum 0.0 32.0 /end CHARACTERISTIC
/begin CHARACTERISTIC KFOC_ADCMotorUTemp_enum "" VALUE 0x0000 /* @ECU_Address@KFOC_ADCMotorUTemp_enum@ */ Scalar_UBYTE 0 SWC_ETE_type_CM_uint8_enum 0.0 32.0 /end CHARACTERISTIC
/begin CHARACTERISTIC KFOC_ADCMotorVTemp_enum "" VALUE 0x0000 /* @ECU_Address@KFOC_ADCMotorVTemp_enum@ */ Scalar_UBYTE 0 SWC_ETE_type_CM_uint8_enum 0.0 32.0 /end CHARACTERISTIC
/begin CHARACTERISTIC KFOC_ADCMotorWTemp_enum "" VALUE 0x0000 /* @ECU_Address@KFOC_ADCMotorWTemp_enum@ */ Scalar_UBYTE 0 SWC_ETE_type_CM_uint8_enum 0.0 32.0 /end CHARACTERISTIC
/begin CHARACTERISTIC KFOC_ADCOilTemp_enum "" VALUE 0x0000 /* @ECU_Address@KFOC_ADCOilTemp_enum@ */ Scalar_UBYTE 0 SWC_ETE_type_CM_uint8_enum 0.0 32.0 /end CHARACTERISTIC
/begin CHARACTERISTIC KFOC_ADCSicUTemp_enum "" VALUE 0x0000 /* @ECU_Address@KFOC_ADCSicUTemp_enum@ */ Scalar_UBYTE 0 SWC_ETE_type_CM_uint8_enum 0.0 32.0 /end CHARACTERISTIC
/begin CHARACTERISTIC KFOC_ADCSicVTemp_enum "" VALUE 0x0000 /* @ECU_Address@KFOC_ADCSicVTemp_enum@ */ Scalar_UBYTE 0 SWC_ETE_type_CM_uint8_enum 0.0 32.0 /end CHARACTERISTIC
/begin CHARACTERISTIC KFOC_ADCSicWTemp_enum "" VALUE 0x0000 /* @ECU_Address@KFOC_ADCSicWTemp_enum@ */ Scalar_UBYTE 0 SWC_ETE_type_CM_uint8_enum 0.0 32.0 /end CHARACTERISTIC
/begin CHARACTERISTIC KINP_BatteryMode_enum_defval "" VALUE 0x0000 /* @ECU_Address@KINP_BatteryMode_enum_defval@ */ Scalar_UBYTE 0 SWC_ETE_type_CM_uint8_enum 0.0 5.0 /end CHARACTERISTIC
/begin CHARACTERISTIC KINP_BatteryMode_enum_ovrdval "" VALUE 0x0000 /* @ECU_Address@KINP_BatteryMode_enum_ovrdval@ */ Scalar_UBYTE 0 SWC_ETE_type_CM_uint8_enum 0.0 5.0 /end CHARACTERISTIC
/begin CHARACTERISTIC KINP_CSVCU1_enum_defval "" VALUE 0x0000 /* @ECU_Address@KINP_CSVCU1_enum_defval@ */ Scalar_UBYTE 0 SWC_ETE_type_CM_uint8_enum 0.0 255.0 /end CHARACTERISTIC
/begin CHARACTERISTIC KINP_CSVCU1_enum_ovrdval "" VALUE 0x0000 /* @ECU_Address@KINP_CSVCU1_enum_ovrdval@ */ Scalar_UBYTE 0 SWC_ETE_type_CM_uint8_enum 0.0 255.0 /end CHARACTERISTIC
/begin CHARACTERISTIC KINP_CSVCU2CAN1_enum_defval "" VALUE 0x0000 /* @ECU_Address@KINP_CSVCU2CAN1_enum_defval@ */ Scalar_UBYTE 0 SWC_ETE_type_CM_uint8_enum 0.0 255.0 /end CHARACTERISTIC
/begin CHARACTERISTIC KINP_CSVCU2CAN1_enum_ovrdval "" VALUE 0x0000 /* @ECU_Address@KINP_CSVCU2CAN1_enum_ovrdval@ */ Scalar_UBYTE 0 SWC_ETE_type_CM_uint8_enum 0.0 255.0 /end CHARACTERISTIC
/begin CHARACTERISTIC KINP_EOPFVTRLocal1CSSta_enum_defval "" VALUE 0x0000 /* @ECU_Address@KINP_EOPFVTRLocal1CSSta_enum_defval@ */ Scalar_UBYTE 0 SWC_ETE_type_CM_uint8_enum 0.0 255.0 /end CHARACTERISTIC
/begin CHARACTERISTIC KINP_EOPFVTRLocal1CSSta_enum_ovrdval "" VALUE 0x0000 /* @ECU_Address@KINP_EOPFVTRLocal1CSSta_enum_ovrdval@ */ Scalar_UBYTE 0 SWC_ETE_type_CM_uint8_enum 0.0 255.0 /end CHARACTERISTIC
/begin CHARACTERISTIC KINP_EOPFVTRLocal1RCSta_enum_defval "" VALUE 0x0000 /* @ECU_Address@KINP_EOPFVTRLocal1RCSta_enum_defval@ */ Scalar_UBYTE 0 SWC_ETE_type_CM_uint8_enum 0.0 14.0 /end CHARACTERISTIC
/begin CHARACTERISTIC KINP_EOPFVTRLocal1RCSta_enum_ovrdval "" VALUE 0x0000 /* @ECU_Address@KINP_EOPFVTRLocal1RCSta_enum_ovrdval@ */ Scalar_UBYTE 0 SWC_ETE_type_CM_uint8_enum 0.0 14.0 /end CHARACTERISTIC
/begin CHARACTERISTIC KINP_EOPFVTROverTempBCKSta_enum_defval "" VALUE 0x0000 /* @ECU_Address@KINP_EOPFVTROverTempBCKSta_enum_defval@ */ Scalar_UBYTE 0 SWC_ETE_type_CM_uint8_enum 0.0 3.0 /end CHARACTERISTIC
/begin CHARACTERISTIC KINP_EOPFVTROverTempBCKSta_enum_ovrdval "" VALUE 0x0000 /* @ECU_Address@KINP_EOPFVTROverTempBCKSta_enum_ovrdval@ */ Scalar_UBYTE 0 SWC_ETE_type_CM_uint8_enum 0.0 3.0 /end CHARACTERISTIC
/begin CHARACTERISTIC KINP_EOPFVTROverVolSta_enum_defval "" VALUE 0x0000 /* @ECU_Address@KINP_EOPFVTROverVolSta_enum_defval@ */ Scalar_UBYTE 0 SWC_ETE_type_CM_uint8_enum 0.0 3.0 /end CHARACTERISTIC
/begin CHARACTERISTIC KINP_EOPFVTROverVolSta_enum_ovrdval "" VALUE 0x0000 /* @ECU_Address@KINP_EOPFVTROverVolSta_enum_ovrdval@ */ Scalar_UBYTE 0 SWC_ETE_type_CM_uint8_enum 0.0 3.0 /end CHARACTERISTIC
/begin CHARACTERISTIC KINP_EOPFVTRRunStatusSta_enum_defval "" VALUE 0x0000 /* @ECU_Address@KINP_EOPFVTRRunStatusSta_enum_defval@ */ Scalar_UBYTE 0 SWC_ETE_type_CM_uint8_enum 0.0 3.0 /end CHARACTERISTIC
/begin CHARACTERISTIC KINP_EOPFVTRRunStatusSta_enum_ovrdval "" VALUE 0x0000 /* @ECU_Address@KINP_EOPFVTRRunStatusSta_enum_ovrdval@ */ Scalar_UBYTE 0 SWC_ETE_type_CM_uint8_enum 0.0 3.0 /end CHARACTERISTIC
/begin CHARACTERISTIC KINP_EOPFVTRUnderVolSta_enum_defval "" VALUE 0x0000 /* @ECU_Address@KINP_EOPFVTRUnderVolSta_enum_defval@ */ Scalar_UBYTE 0 SWC_ETE_type_CM_uint8_enum 0.0 3.0 /end CHARACTERISTIC
/begin CHARACTERISTIC KINP_EOPFVTRUnderVolSta_enum_ovrdval "" VALUE 0x0000 /* @ECU_Address@KINP_EOPFVTRUnderVolSta_enum_ovrdval@ */ Scalar_UBYTE 0 SWC_ETE_type_CM_uint8_enum 0.0 3.0 /end CHARACTERISTIC
/begin CHARACTERISTIC KINP_FDCVCURrTMCtrlModeReq_enum_defval "" VALUE 0x0000 /* @ECU_Address@KINP_FDCVCURrTMCtrlModeReq_enum_defval@ */ Scalar_UBYTE 0 SWC_ETE_type_CM_uint8_enum 0.0 7.0 /end CHARACTERISTIC
/begin CHARACTERISTIC KINP_FDCVCURrTMCtrlModeReq_enum_ovrdval "" VALUE 0x0000 /* @ECU_Address@KINP_FDCVCURrTMCtrlModeReq_enum_ovrdval@ */ Scalar_UBYTE 0 SWC_ETE_type_CM_uint8_enum 0.0 7.0 /end CHARACTERISTIC
/begin CHARACTERISTIC KINP_PwrSta_enum_defval "" VALUE 0x0000 /* @ECU_Address@KINP_PwrSta_enum_defval@ */ Scalar_UBYTE 0 SWC_ETE_type_CM_uint8_enum 0.0 7.0 /end CHARACTERISTIC
/begin CHARACTERISTIC KINP_PwrSta_enum_ovrdval "" VALUE 0x0000 /* @ECU_Address@KINP_PwrSta_enum_ovrdval@ */ Scalar_UBYTE 0 SWC_ETE_type_CM_uint8_enum 0.0 7.0 /end CHARACTERISTIC
/begin CHARACTERISTIC KINP_RCVCU1_enum_defval "" VALUE 0x0000 /* @ECU_Address@KINP_RCVCU1_enum_defval@ */ Scalar_UBYTE 0 SWC_ETE_type_CM_uint8_enum 0.0 14.0 /end CHARACTERISTIC
/begin CHARACTERISTIC KINP_RCVCU1_enum_ovrdval "" VALUE 0x0000 /* @ECU_Address@KINP_RCVCU1_enum_ovrdval@ */ Scalar_UBYTE 0 SWC_ETE_type_CM_uint8_enum 0.0 14.0 /end CHARACTERISTIC
/begin CHARACTERISTIC KINP_RCVCU2CAN1_enum_defval "" VALUE 0x0000 /* @ECU_Address@KINP_RCVCU2CAN1_enum_defval@ */ Scalar_UBYTE 0 SWC_ETE_type_CM_uint8_enum 0.0 14.0 /end CHARACTERISTIC
/begin CHARACTERISTIC KINP_RCVCU2CAN1_enum_ovrdval "" VALUE 0x0000 /* @ECU_Address@KINP_RCVCU2CAN1_enum_ovrdval@ */ Scalar_UBYTE 0 SWC_ETE_type_CM_uint8_enum 0.0 14.0 /end CHARACTERISTIC
/begin CHARACTERISTIC KINP_ShiftGearPosn_enum_defval "" VALUE 0x0000 /* @ECU_Address@KINP_ShiftGearPosn_enum_defval@ */ Scalar_UBYTE 0 SWC_ETE_type_CM_uint8_enum 0.0 7.0 /end CHARACTERISTIC
/begin CHARACTERISTIC KINP_ShiftGearPosn_enum_ovrdval "" VALUE 0x0000 /* @ECU_Address@KINP_ShiftGearPosn_enum_ovrdval@ */ Scalar_UBYTE 0 SWC_ETE_type_CM_uint8_enum 0.0 7.0 /end CHARACTERISTIC
/begin CHARACTERISTIC KOPM_IVTROpMode_enum_ovrdval "" VALUE 0x0000 /* @ECU_Address@KOPM_IVTROpMode_enum_ovrdval@ */ Scalar_UBYTE 0 SWC_ETE_type_CM_uint8_enum 0.0 6.0 /end CHARACTERISTIC
/begin CHARACTERISTIC KOPM_MotMod_enum_ovrdval "" VALUE 0x0000 /* @ECU_Address@KOPM_MotMod_enum_ovrdval@ */ Scalar_UBYTE 0 SWC_ETE_type_CM_uint8_enum 0.0 15.0 /end CHARACTERISTIC
/begin CHARACTERISTIC KOUTP_IVTROpMode_enum_maxval "" VALUE 0x0000 /* @ECU_Address@KOUTP_IVTROpMode_enum_maxval@ */ Scalar_UBYTE 0 SWC_ETE_type_CM_uint8_enum 0.0 255.0 /end CHARACTERISTIC
/begin CHARACTERISTIC KOUTP_IVTROpMode_enum_minval "" VALUE 0x0000 /* @ECU_Address@KOUTP_IVTROpMode_enum_minval@ */ Scalar_UBYTE 0 SWC_ETE_type_CM_uint8_enum 0.0 255.0 /end CHARACTERISTIC
/begin CHARACTERISTIC KOUTP_IVTROpMode_enum_ovrdval "" VALUE 0x0000 /* @ECU_Address@KOUTP_IVTROpMode_enum_ovrdval@ */ Scalar_UBYTE 0 SWC_ETE_type_CM_uint8_enum 0.0 255.0 /end CHARACTERISTIC
/begin CHARACTERISTIC KOUTP_MotMod_enum_maxval "" VALUE 0x0000 /* @ECU_Address@KOUTP_MotMod_enum_maxval@ */ Scalar_UBYTE 0 SWC_ETE_type_CM_uint8_enum 0.0 255.0 /end CHARACTERISTIC
/begin CHARACTERISTIC KOUTP_MotMod_enum_minval "" VALUE 0x0000 /* @ECU_Address@KOUTP_MotMod_enum_minval@ */ Scalar_UBYTE 0 SWC_ETE_type_CM_uint8_enum 0.0 255.0 /end CHARACTERISTIC
/begin CHARACTERISTIC KOUTP_MotMod_enum_ovrdval "" VALUE 0x0000 /* @ECU_Address@KOUTP_MotMod_enum_ovrdval@ */ Scalar_UBYTE 0 SWC_ETE_type_CM_uint8_enum 0.0 255.0 /end CHARACTERISTIC
/begin CHARACTERISTIC MROT_ParkCompAngle_Y_rad "" CURVE 0x0000 /* @ECU_Address@MROT_ParkCompAngle_Y_rad@ */ Lookup1D_FLOAT32_IEEE 0 SWC_ETE_type_CM_single_rad -7.0 7.0
 /begin AXIS_DESCR COM_AXIS VROT_RotSpdM_rpm SWC_ETE_type_CM_single_rpm 20 0.0 100000.0 AXIS_PTS_REF AROT_ParkCompAngle_X_rpm /end AXIS_DESCR
/end CHARACTERISTIC
/begin AXIS_PTS AROT_ParkCompAngle_X_rpm "" 0x0000 /* @ECU_Address@AROT_ParkCompAngle_X_rpm@ */ VROT_RotSpdM_rpm Lookup1D_X_FLOAT32_IEEE 0 SWC_ETE_type_CM_single_rpm 20 0.0 100000.0 /end AXIS_PTS
/begin CHARACTERISTIC MROT_VolPosnOffsWiSpd_Y_deg "" CURVE 0x0000 /* @ECU_Address@MROT_VolPosnOffsWiSpd_Y_deg@ */ Lookup1D_FLOAT32_IEEE 0 SWC_ETE_type_CM_single_deg 0.0 1000.0
 /begin AXIS_DESCR COM_AXIS VROT_RotSpdM_rpm SWC_ETE_type_CM_single_rpm 20 0.0 100000.0 AXIS_PTS_REF AROT_ParkCompAngle_X_rpm /end AXIS_DESCR
/end CHARACTERISTIC
/begin CHARACTERISTIC MCCM_facLPFiDAct_Y_T "" CURVE 0x0000 /* @ECU_Address@MCCM_facLPFiDAct_Y_T@ */ Lookup1D_FLOAT32_IEEE 0 SWC_ETE_type_CM_single_raw 0.0001 1000.0
 /begin AXIS_DESCR COM_AXIS NO_INPUT_QUANTITY SWC_ETE_type_CM_single_rpm 11 0.0 100000.0 AXIS_PTS_REF ACCM_facLPFiDAct_X_rpm /end AXIS_DESCR
/end CHARACTERISTIC
/begin AXIS_PTS ACCM_facLPFiDAct_X_rpm "" 0x0000 /* @ECU_Address@ACCM_facLPFiDAct_X_rpm@ */ NO_INPUT_QUANTITY Lookup1D_X_FLOAT32_IEEE 0 SWC_ETE_type_CM_single_rpm 11 0.0 100000.0 /end AXIS_PTS
/begin CHARACTERISTIC MCCM_facLPFiQAct_Y_T "" CURVE 0x0000 /* @ECU_Address@MCCM_facLPFiQAct_Y_T@ */ Lookup1D_FLOAT32_IEEE 0 SWC_ETE_type_CM_single_raw 0.0001 1000.0
 /begin AXIS_DESCR COM_AXIS NO_INPUT_QUANTITY SWC_ETE_type_CM_single_rpm 11 0.0 100000.0 AXIS_PTS_REF ACCM_facLPFiDAct_X_rpm /end AXIS_DESCR
/end CHARACTERISTIC
/begin CHARACTERISTIC MCCM_facCCMLd_Z_T "" MAP 0x0000 /* @ECU_Address@MCCM_facCCMLd_Z_T@ */ Lookup2D_FLOAT32_IEEE 0 SWC_ETE_type_CM_single_H 0.0 1.0
 /begin AXIS_DESCR COM_AXIS NO_INPUT_QUANTITY SWC_ETE_type_CM_single_A 36 -700.0 700.0 AXIS_PTS_REF ACCM_facCCMLq_X_A /end AXIS_DESCR
 /begin AXIS_DESCR COM_AXIS NO_INPUT_QUANTITY SWC_ETE_type_CM_single_A 36 -700.0 700.0 AXIS_PTS_REF ACCM_facCCMLq_Y_A /end AXIS_DESCR
/end CHARACTERISTIC
/begin AXIS_PTS ACCM_facCCMLq_Y_A "" 0x0000 /* @ECU_Address@ACCM_facCCMLq_Y_A@ */ NO_INPUT_QUANTITY Lookup2D_X_FLOAT32_IEEE 0 SWC_ETE_type_CM_single_A 36 -700.0 700.0 /end AXIS_PTS
/begin AXIS_PTS ACCM_facCCMLq_X_A "" 0x0000 /* @ECU_Address@ACCM_facCCMLq_X_A@ */ NO_INPUT_QUANTITY Lookup2D_X_FLOAT32_IEEE 0 SWC_ETE_type_CM_single_A 36 -700.0 700.0 /end AXIS_PTS
/begin CHARACTERISTIC MCCM_facCCMLq_Z_T "" MAP 0x0000 /* @ECU_Address@MCCM_facCCMLq_Z_T@ */ Lookup2D_FLOAT32_IEEE 0 SWC_ETE_type_CM_single_H 0.0 1.0
 /begin AXIS_DESCR COM_AXIS NO_INPUT_QUANTITY SWC_ETE_type_CM_single_A 36 -700.0 700.0 AXIS_PTS_REF ACCM_facCCMLq_X_A /end AXIS_DESCR
 /begin AXIS_DESCR COM_AXIS NO_INPUT_QUANTITY SWC_ETE_type_CM_single_A 36 -700.0 700.0 AXIS_PTS_REF ACCM_facCCMLq_Y_A /end AXIS_DESCR
/end CHARACTERISTIC
/begin CHARACTERISTIC MCCM_IdKp_Y_value "" CURVE 0x0000 /* @ECU_Address@MCCM_IdKp_Y_value@ */ Lookup1D_FLOAT32_IEEE 0 SWC_ETE_type_CM_single_constant 0.0 100.0
 /begin AXIS_DESCR COM_AXIS VROT_RotSpdM_rpm SWC_ETE_type_CM_single_rpm 20 -20000.0 20000.0 AXIS_PTS_REF ACCM_IdKp_X_rpm /end AXIS_DESCR
/end CHARACTERISTIC
/begin AXIS_PTS ACCM_IdKp_X_rpm "" 0x0000 /* @ECU_Address@ACCM_IdKp_X_rpm@ */ VROT_RotSpdM_rpm Lookup1D_X_FLOAT32_IEEE 0 SWC_ETE_type_CM_single_rpm 20 -20000.0 20000.0 /end AXIS_PTS
/begin CHARACTERISTIC MCCM_IqKp_Y_value "" CURVE 0x0000 /* @ECU_Address@MCCM_IqKp_Y_value@ */ Lookup1D_FLOAT32_IEEE 0 SWC_ETE_type_CM_single_constant 0.0 100.0
 /begin AXIS_DESCR COM_AXIS VROT_RotSpdM_rpm SWC_ETE_type_CM_single_rpm 20 -20000.0 20000.0 AXIS_PTS_REF ACCM_IdKp_X_rpm /end AXIS_DESCR
/end CHARACTERISTIC
/begin CHARACTERISTIC KCCM_BattVolFilTi_fac "" VALUE 0x0000 /* @ECU_Address@KCCM_BattVolFilTi_fac@ */ Scalar_FLOAT32_IEEE 0 SWC_ETE_type_CM_single_factor 0.0 1.0 /end CHARACTERISTIC
/begin CHARACTERISTIC KCCM_CurLoopPrd_t "" VALUE 0x0000 /* @ECU_Address@KCCM_CurLoopPrd_t@ */ Scalar_FLOAT32_IEEE 0 SWC_ETE_type_CM_single_constant 0.0 1000.0 /end CHARACTERISTIC
/begin CHARACTERISTIC KCCM_FwdMask_c "" VALUE 0x0000 /* @ECU_Address@KCCM_FwdMask_c@ */ Scalar_FLOAT32_IEEE 0 SWC_ETE_type_CM_single_constant 0.0 10.0 /end CHARACTERISTIC
/begin CHARACTERISTIC KCCM_IdKi_null "" VALUE 0x0000 /* @ECU_Address@KCCM_IdKi_null@ */ Scalar_FLOAT32_IEEE 0 SWC_ETE_type_CM_single_constant 0.0 1000.0 /end CHARACTERISTIC
/begin CHARACTERISTIC KCCM_IdKt_null "" VALUE 0x0000 /* @ECU_Address@KCCM_IdKt_null@ */ Scalar_FLOAT32_IEEE 0 SWC_ETE_type_CM_single_constant 0.0 1000.0 /end CHARACTERISTIC
/begin CHARACTERISTIC KCCM_IqKi_null "" VALUE 0x0000 /* @ECU_Address@KCCM_IqKi_null@ */ Scalar_FLOAT32_IEEE 0 SWC_ETE_type_CM_single_constant 0.0 1000.0 /end CHARACTERISTIC
/begin CHARACTERISTIC KCCM_IqKt_null "" VALUE 0x0000 /* @ECU_Address@KCCM_IqKt_null@ */ Scalar_FLOAT32_IEEE 0 SWC_ETE_type_CM_single_constant 0.0 1000.0 /end CHARACTERISTIC
/begin CHARACTERISTIC KCCM_UdqASCTagValue_C "" VALUE 0x0000 /* @ECU_Address@KCCM_UdqASCTagValue_C@ */ Scalar_FLOAT32_IEEE 0 SWC_ETE_type_CM_single_constant 0.0 100.0 /end CHARACTERISTIC
/begin CHARACTERISTIC KCCM_UdqASCTimesValue_C "" VALUE 0x0000 /* @ECU_Address@KCCM_UdqASCTimesValue_C@ */ Scalar_FLOAT32_IEEE 0 SWC_ETE_type_CM_single_constant 0.0 100.0 /end CHARACTERISTIC
/begin CHARACTERISTIC KCCM_VdSp_V "" VALUE 0x0000 /* @ECU_Address@KCCM_VdSp_V@ */ Scalar_FLOAT32_IEEE 0 SWC_ETE_type_CM_single_V 0.0 100.0 /end CHARACTERISTIC
/begin CHARACTERISTIC KCCM_VolMod_perc "" VALUE 0x0000 /* @ECU_Address@KCCM_VolMod_perc@ */ Scalar_FLOAT32_IEEE 0 SWC_ETE_type_CM_single_perc 0.0 1.0 /end CHARACTERISTIC
/begin CHARACTERISTIC KCCM_VqSp_V "" VALUE 0x0000 /* @ECU_Address@KCCM_VqSp_V@ */ Scalar_FLOAT32_IEEE 0 SWC_ETE_type_CM_single_V 0.0 100.0 /end CHARACTERISTIC
/begin CHARACTERISTIC KCCM_tiCurErrOvr_C "" VALUE 0x0000 /* @ECU_Address@KCCM_tiCurErrOvr_C@ */ Scalar_FLOAT32_IEEE 0 SWC_ETE_type_CM_single_constant 0.0 100.0 /end CHARACTERISTIC
/begin CHARACTERISTIC KDGH_OverCurrent_A "" VALUE 0x0000 /* @ECU_Address@KDGH_OverCurrent_A@ */ Scalar_FLOAT32_IEEE 0 SWC_ETE_type_CM_single_A 0.0 1000.0 /end CHARACTERISTIC
/begin CHARACTERISTIC KDGH_PhaCurrOverU_A "" VALUE 0x0000 /* @ECU_Address@KDGH_PhaCurrOverU_A@ */ Scalar_FLOAT32_IEEE 0 SWC_ETE_type_CM_single_A 0.0 5000.0 /end CHARACTERISTIC
/begin CHARACTERISTIC KDGH_PhaCurrOverV_A "" VALUE 0x0000 /* @ECU_Address@KDGH_PhaCurrOverV_A@ */ Scalar_FLOAT32_IEEE 0 SWC_ETE_type_CM_single_A 0.0 5000.0 /end CHARACTERISTIC
/begin CHARACTERISTIC KDGH_PhaCurrOverW_A "" VALUE 0x0000 /* @ECU_Address@KDGH_PhaCurrOverW_A@ */ Scalar_FLOAT32_IEEE 0 SWC_ETE_type_CM_single_A 0.0 5000.0 /end CHARACTERISTIC
/begin CHARACTERISTIC KDGH_SumErr_A "" VALUE 0x0000 /* @ECU_Address@KDGH_SumErr_A@ */ Scalar_FLOAT32_IEEE 0 SWC_ETE_type_CM_single_A 0.0 1000.0 /end CHARACTERISTIC
/begin CHARACTERISTIC KDSM_CurErrorThd2_value "" VALUE 0x0000 /* @ECU_Address@KDSM_CurErrorThd2_value@ */ Scalar_FLOAT32_IEEE 0 SWC_ETE_type_CM_single_A 0.0 100.0 /end CHARACTERISTIC
/begin CHARACTERISTIC KDSM_CurErrorThd_value "" VALUE 0x0000 /* @ECU_Address@KDSM_CurErrorThd_value@ */ Scalar_FLOAT32_IEEE 0 SWC_ETE_type_CM_single_A 0.0 100.0 /end CHARACTERISTIC
/begin CHARACTERISTIC KDSM_DiagSpdH_rpm "" VALUE 0x0000 /* @ECU_Address@KDSM_DiagSpdH_rpm@ */ Scalar_FLOAT32_IEEE 0 SWC_ETE_type_CM_single_rpm 0.0 30000.0 /end CHARACTERISTIC
/begin CHARACTERISTIC KDSM_DiagSpdL_rpm "" VALUE 0x0000 /* @ECU_Address@KDSM_DiagSpdL_rpm@ */ Scalar_FLOAT32_IEEE 0 SWC_ETE_type_CM_single_rpm 0.0 30000.0 /end CHARACTERISTIC
/begin CHARACTERISTIC KFOC_DCBusLPF_c "" VALUE 0x0000 /* @ECU_Address@KFOC_DCBusLPF_c@ */ Scalar_FLOAT32_IEEE 0 SWC_ETE_type_CM_single_constant 0.0 1.0 /end CHARACTERISTIC
/begin CHARACTERISTIC KFOC_DCBusVoltage_V_ovrdval "" VALUE 0x0000 /* @ECU_Address@KFOC_DCBusVoltage_V_ovrdval@ */ Scalar_FLOAT32_IEEE 0 SWC_ETE_type_CM_single_V 0.0 2000.0 /end CHARACTERISTIC
/begin CHARACTERISTIC KFOC_IdCmd_A_ovrdfval "" VALUE 0x0000 /* @ECU_Address@KFOC_IdCmd_A_ovrdfval@ */ Scalar_FLOAT32_IEEE 0 SWC_ETE_type_CM_single_A -300.0 300.0 /end CHARACTERISTIC
/begin CHARACTERISTIC KFOC_IqCmd_A_ovrdfval "" VALUE 0x0000 /* @ECU_Address@KFOC_IqCmd_A_ovrdfval@ */ Scalar_FLOAT32_IEEE 0 SWC_ETE_type_CM_single_A -300.0 300.0 /end CHARACTERISTIC
/begin CHARACTERISTIC KFOC_MagFluxLinkage_C "" VALUE 0x0000 /* @ECU_Address@KFOC_MagFluxLinkage_C@ */ Scalar_FLOAT32_IEEE 0 SWC_ETE_type_CM_single_phi 0.0 1000.0 /end CHARACTERISTIC
/begin CHARACTERISTIC KFOC_PolePairs_p "" VALUE 0x0000 /* @ECU_Address@KFOC_PolePairs_p@ */ Scalar_FLOAT32_IEEE 0 SWC_ETE_type_CM_single_p 0.0 100.0 /end CHARACTERISTIC
/begin CHARACTERISTIC KFOC_RotPosnOffset_rad_ovrdval "" VALUE 0x0000 /* @ECU_Address@KFOC_RotPosnOffset_rad_ovrdval@ */ Scalar_FLOAT32_IEEE 0 SWC_ETE_type_CM_single_rad -6.2832 6.2832 /end CHARACTERISTIC
/begin CHARACTERISTIC KFOC_SpdCmd_RPM "" VALUE 0x0000 /* @ECU_Address@KFOC_SpdCmd_RPM@ */ Scalar_FLOAT32_IEEE 0 SWC_ETE_type_CM_single_RPM 0.0 3000.0 /end CHARACTERISTIC
/begin CHARACTERISTIC KFOC_VdCmd_V "" VALUE 0x0000 /* @ECU_Address@KFOC_VdCmd_V@ */ Scalar_FLOAT32_IEEE 0 SWC_ETE_type_CM_single_V -577.0 577.0 /end CHARACTERISTIC
/begin CHARACTERISTIC KFOC_VqCmd_V "" VALUE 0x0000 /* @ECU_Address@KFOC_VqCmd_V@ */ Scalar_FLOAT32_IEEE 0 SWC_ETE_type_CM_single_V -577.0 577.0 /end CHARACTERISTIC
/begin CHARACTERISTIC KMCM_DFwdCoef_null "" VALUE 0x0000 /* @ECU_Address@KMCM_DFwdCoef_null@ */ Scalar_FLOAT32_IEEE 0 SWC_ETE_type_CM_single_flg 0.0 1.0 /end CHARACTERISTIC
/begin CHARACTERISTIC KMCM_QFwdCoef_null "" VALUE 0x0000 /* @ECU_Address@KMCM_QFwdCoef_null@ */ Scalar_FLOAT32_IEEE 0 SWC_ETE_type_CM_single_flg 0.0 1.0 /end CHARACTERISTIC
/begin CHARACTERISTIC KPCS_OffsFilCoeff_fac "" VALUE 0x0000 /* @ECU_Address@KPCS_OffsFilCoeff_fac@ */ Scalar_FLOAT32_IEEE 0 SWC_ETE_type_CM_single_factor 0.0 1.0 /end CHARACTERISTIC
/begin CHARACTERISTIC KPCS_PhaseCurSnsrVolDft_V "" VALUE 0x0000 /* @ECU_Address@KPCS_PhaseCurSnsrVolDft_V@ */ Scalar_FLOAT32_IEEE 0 SWC_ETE_type_CM_single_V -100.0 100.0 /end CHARACTERISTIC
/begin CHARACTERISTIC KPCS_PhaseCurSnsrVolVldMax_V "" VALUE 0x0000 /* @ECU_Address@KPCS_PhaseCurSnsrVolVldMax_V@ */ Scalar_FLOAT32_IEEE 0 SWC_ETE_type_CM_single_V 0.0 100.0 /end CHARACTERISTIC
/begin CHARACTERISTIC KPCS_PhaseCurSnsrVolVldMin_V "" VALUE 0x0000 /* @ECU_Address@KPCS_PhaseCurSnsrVolVldMin_V@ */ Scalar_FLOAT32_IEEE 0 SWC_ETE_type_CM_single_V -100.0 0.0 /end CHARACTERISTIC
/begin CHARACTERISTIC KPCS_UCurSnsr_Gain "" VALUE 0x0000 /* @ECU_Address@KPCS_UCurSnsr_Gain@ */ Scalar_FLOAT32_IEEE 0 SWC_ETE_type_CM_single_gain 0.0 10.0 /end CHARACTERISTIC
/begin CHARACTERISTIC KPCS_VCurSnsr_Gain "" VALUE 0x0000 /* @ECU_Address@KPCS_VCurSnsr_Gain@ */ Scalar_FLOAT32_IEEE 0 SWC_ETE_type_CM_single_gain 0.0 10.0 /end CHARACTERISTIC
/begin CHARACTERISTIC KPCS_WCurSnsr_Gain "" VALUE 0x0000 /* @ECU_Address@KPCS_WCurSnsr_Gain@ */ Scalar_FLOAT32_IEEE 0 SWC_ETE_type_CM_single_gain 0.0 10.0 /end CHARACTERISTIC
/begin CHARACTERISTIC KPDC_facScalePWM_C "" VALUE 0x0000 /* @ECU_Address@KPDC_facScalePWM_C@ */ Scalar_FLOAT32_IEEE 0 SWC_ETE_type_CM_single_factor 0.0 100.0 /end CHARACTERISTIC
/begin CHARACTERISTIC KPDC_nPosnErrMaxSpd_C "" VALUE 0x0000 /* @ECU_Address@KPDC_nPosnErrMaxSpd_C@ */ Scalar_FLOAT32_IEEE 0 SWC_ETE_type_CM_single_rpm 0.0 30000.0 /end CHARACTERISTIC
/begin CHARACTERISTIC KRCM_IdCmd_A "" VALUE 0x0000 /* @ECU_Address@KRCM_IdCmd_A@ */ Scalar_FLOAT32_IEEE 0 SWC_ETE_type_CM_single_A -100.0 100.0 /end CHARACTERISTIC
/begin CHARACTERISTIC KRCM_IqCmd_A "" VALUE 0x0000 /* @ECU_Address@KRCM_IqCmd_A@ */ Scalar_FLOAT32_IEEE 0 SWC_ETE_type_CM_single_A -100.0 100.0 /end CHARACTERISTIC
/begin CHARACTERISTIC KROT_CurLoopPrd_t "" VALUE 0x0000 /* @ECU_Address@KROT_CurLoopPrd_t@ */ Scalar_FLOAT32_IEEE 0 SWC_ETE_type_CM_single_s 0.0 1.0 /end CHARACTERISTIC
/begin CHARACTERISTIC KROT_RotAngleE_rad_ovrdval "" VALUE 0x0000 /* @ECU_Address@KROT_RotAngleE_rad_ovrdval@ */ Scalar_FLOAT32_IEEE 0 SWC_ETE_type_CM_single_rad -20.0 20.0 /end CHARACTERISTIC
/begin CHARACTERISTIC KROT_RotSpdMRaw_rpm_ovrdval "" VALUE 0x0000 /* @ECU_Address@KROT_RotSpdMRaw_rpm_ovrdval@ */ Scalar_FLOAT32_IEEE 0 SWC_ETE_type_CM_single_rpm 0.0 100000.0 /end CHARACTERISTIC
/begin CHARACTERISTIC KROT_SpdCutoffFreq_Hz "" VALUE 0x0000 /* @ECU_Address@KROT_SpdCutoffFreq_Hz@ */ Scalar_FLOAT32_IEEE 0 SWC_ETE_type_CM_single_Hz 0.0 100000.0 /end CHARACTERISTIC
/begin CHARACTERISTIC KeSVMR_FullDTCCurr_A "" VALUE 0x0000 /* @ECU_Address@KeSVMR_FullDTCCurr_A@ */ Scalar_FLOAT32_IEEE 0 SWC_ETE_type_CM_single_A 0.0 10000.0 /end CHARACTERISTIC
/begin CHARACTERISTIC KeSVMR_StrClampMaxDuty_pct "" VALUE 0x0000 /* @ECU_Address@KeSVMR_StrClampMaxDuty_pct@ */ Scalar_FLOAT32_IEEE 0 SWC_ETE_type_CM_single_factor 0.0 1.0 /end CHARACTERISTIC
/begin CHARACTERISTIC KeSVMR_StrClampMinDuty_pct "" VALUE 0x0000 /* @ECU_Address@KeSVMR_StrClampMinDuty_pct@ */ Scalar_FLOAT32_IEEE 0 SWC_ETE_type_CM_single_factor 0.0 1.0 /end CHARACTERISTIC
/begin CHARACTERISTIC KeSVMR_b_UseStrictClamp "" VALUE 0x0000 /* @ECU_Address@KeSVMR_b_UseStrictClamp@ */ Scalar_FLOAT32_IEEE 0 SWC_ETE_type_CM_single_tbd 0.0 100.0 /end CHARACTERISTIC
/begin CHARACTERISTIC KeSVMR_t_DeadTime "" VALUE 0x0000 /* @ECU_Address@KeSVMR_t_DeadTime@ */ Scalar_FLOAT32_IEEE 0 SWC_ETE_type_CM_single_s 0.0 1.0 /end CHARACTERISTIC
/begin CHARACTERISTIC KeSVMR_t_MinPulseWidth "" VALUE 0x0000 /* @ECU_Address@KeSVMR_t_MinPulseWidth@ */ Scalar_FLOAT32_IEEE 0 SWC_ETE_type_CM_single_s 0.0 1.0 /end CHARACTERISTIC
/begin CHARACTERISTIC SampleTimeFOC "" VALUE 0x0000 /* @ECU_Address@SampleTimeFOC@ */ Scalar_FLOAT32_IEEE 0 SWC_ETE_type_CM_single_constant 0.0 100.0 /end CHARACTERISTIC
/begin CHARACTERISTIC KDGH_OverCurrentErr_C "" VALUE 0x0000 /* @ECU_Address@KDGH_OverCurrentErr_C@ */ Scalar_SWORD 0 SWC_ETE_type_CM_int16_cnt 0.0 1000.0 /end CHARACTERISTIC
/begin CHARACTERISTIC KDGH_OverCurrentHeal_C "" VALUE 0x0000 /* @ECU_Address@KDGH_OverCurrentHeal_C@ */ Scalar_SWORD 0 SWC_ETE_type_CM_int16_cnt -1000.0 0.0 /end CHARACTERISTIC
/begin CHARACTERISTIC KDGH_SumErrErr_C "" VALUE 0x0000 /* @ECU_Address@KDGH_SumErrErr_C@ */ Scalar_SWORD 0 SWC_ETE_type_CM_int16_cnt 0.0 1000.0 /end CHARACTERISTIC
/begin CHARACTERISTIC KDGH_SumErrHeal_C "" VALUE 0x0000 /* @ECU_Address@KDGH_SumErrHeal_C@ */ Scalar_SWORD 0 SWC_ETE_type_CM_int16_cnt -1000.0 0.0 /end CHARACTERISTIC
/begin CHARACTERISTIC KPCS_OffsFilTi_cnt "" VALUE 0x0000 /* @ECU_Address@KPCS_OffsFilTi_cnt@ */ Scalar_UWORD 0 SWC_ETE_type_CM_uint16_cnt 0.0 60000.0 /end CHARACTERISTIC
/begin CHARACTERISTIC KeSVMR_PWMPrd_cnt "" VALUE 0x0000 /* @ECU_Address@KeSVMR_PWMPrd_cnt@ */ Scalar_UWORD 0 SWC_ETE_type_CM_uint16_cnt 0.0 60000.0 /end CHARACTERISTIC
/begin CHARACTERISTIC KCCM_UdqASCEna_C "" VALUE 0x0000 /* @ECU_Address@KCCM_UdqASCEna_C@ */ Scalar_BOOLEAN 0 SWC_ETE_type_CM_boolean_flag 0.0 1.0 /end CHARACTERISTIC
/begin CHARACTERISTIC KCCM_VdSpSwEna_flg "" VALUE 0x0000 /* @ECU_Address@KCCM_VdSpSwEna_flg@ */ Scalar_BOOLEAN 0 SWC_ETE_type_CM_boolean_flag 0.0 1.0 /end CHARACTERISTIC
/begin CHARACTERISTIC KCCM_bRstCurErrorOverThd_C "" VALUE 0x0000 /* @ECU_Address@KCCM_bRstCurErrorOverThd_C@ */ Scalar_BOOLEAN 0 SWC_ETE_type_CM_boolean_flag 0.0 1.0 /end CHARACTERISTIC
/begin CHARACTERISTIC KDGH_FaultLevel2_flg_ovrdflg "" VALUE 0x0000 /* @ECU_Address@KDGH_FaultLevel2_flg_ovrdflg@ */ Scalar_BOOLEAN 0 SWC_ETE_type_CM_boolean_flg 0.0 1.0 /end CHARACTERISTIC
/begin CHARACTERISTIC KDGH_FaultLevel2_flg_ovrdval "" VALUE 0x0000 /* @ECU_Address@KDGH_FaultLevel2_flg_ovrdval@ */ Scalar_BOOLEAN 0 SWC_ETE_type_CM_boolean_flg 0.0 1.0 /end CHARACTERISTIC
/begin CHARACTERISTIC KDGH_OverCurrent_flg_ovrdflg "" VALUE 0x0000 /* @ECU_Address@KDGH_OverCurrent_flg_ovrdflg@ */ Scalar_BOOLEAN 0 SWC_ETE_type_CM_boolean_flg 0.0 1.0 /end CHARACTERISTIC
/begin CHARACTERISTIC KDGH_OverCurrent_flg_ovrdval "" VALUE 0x0000 /* @ECU_Address@KDGH_OverCurrent_flg_ovrdval@ */ Scalar_BOOLEAN 0 SWC_ETE_type_CM_boolean_flg 0.0 1.0 /end CHARACTERISTIC
/begin CHARACTERISTIC KDGH_RstPhaCurrOver_flg "" VALUE 0x0000 /* @ECU_Address@KDGH_RstPhaCurrOver_flg@ */ Scalar_BOOLEAN 0 SWC_ETE_type_CM_boolean_flg 0.0 1.0 /end CHARACTERISTIC
/begin CHARACTERISTIC KDGH_RstSumErr_flg "" VALUE 0x0000 /* @ECU_Address@KDGH_RstSumErr_flg@ */ Scalar_BOOLEAN 0 SWC_ETE_type_CM_boolean_flg 0.0 1.0 /end CHARACTERISTIC
/begin CHARACTERISTIC KDGH_SumErr_flg_ovrdflg "" VALUE 0x0000 /* @ECU_Address@KDGH_SumErr_flg_ovrdflg@ */ Scalar_BOOLEAN 0 SWC_ETE_type_CM_boolean_flg 0.0 1.0 /end CHARACTERISTIC
/begin CHARACTERISTIC KDGH_SumErr_flg_ovrdval "" VALUE 0x0000 /* @ECU_Address@KDGH_SumErr_flg_ovrdval@ */ Scalar_BOOLEAN 0 SWC_ETE_type_CM_boolean_flg 0.0 1.0 /end CHARACTERISTIC
/begin CHARACTERISTIC KDGH_bRstRteFault_flg "" VALUE 0x0000 /* @ECU_Address@KDGH_bRstRteFault_flg@ */ Scalar_BOOLEAN 0 SWC_ETE_type_CM_boolean_flg 0.0 1.0 /end CHARACTERISTIC
/begin CHARACTERISTIC KDSM_bIvtrTarHiDebug_flg "" VALUE 0x0000 /* @ECU_Address@KDSM_bIvtrTarHiDebug_flg@ */ Scalar_BOOLEAN 0 SWC_ETE_type_CM_boolean_flag 0.0 1.0 /end CHARACTERISTIC
/begin CHARACTERISTIC KFOC_DCBusUseRaw_flg "" VALUE 0x0000 /* @ECU_Address@KFOC_DCBusUseRaw_flg@ */ Scalar_BOOLEAN 0 SWC_ETE_type_CM_boolean_flg 0.0 1.0 /end CHARACTERISTIC
/begin CHARACTERISTIC KFOC_DCBusVoltage_V_ovrdflg "" VALUE 0x0000 /* @ECU_Address@KFOC_DCBusVoltage_V_ovrdflg@ */ Scalar_BOOLEAN 0 SWC_ETE_type_CM_boolean_flg 0.0 1.0 /end CHARACTERISTIC
/begin CHARACTERISTIC KFOC_FltActn_flg_ovrdflg "" VALUE 0x0000 /* @ECU_Address@KFOC_FltActn_flg_ovrdflg@ */ Scalar_BOOLEAN 0 SWC_ETE_type_CM_boolean_flg 0.0 1.0 /end CHARACTERISTIC
/begin CHARACTERISTIC KFOC_FltActn_flg_ovrdfval "" VALUE 0x0000 /* @ECU_Address@KFOC_FltActn_flg_ovrdfval@ */ Scalar_BOOLEAN 0 SWC_ETE_type_CM_boolean_flg 0.0 1.0 /end CHARACTERISTIC
/begin CHARACTERISTIC KFOC_GateICDisable_flg "" VALUE 0x0000 /* @ECU_Address@KFOC_GateICDisable_flg@ */ Scalar_BOOLEAN 0 SWC_ETE_type_CM_boolean_flg 0.0 1.0 /end CHARACTERISTIC
/begin CHARACTERISTIC KFOC_GateICEnable_flg "" VALUE 0x0000 /* @ECU_Address@KFOC_GateICEnable_flg@ */ Scalar_BOOLEAN 0 SWC_ETE_type_CM_boolean_flg 0.0 1.0 /end CHARACTERISTIC
/begin CHARACTERISTIC KFOC_IdCmd_A_ovrdflg "" VALUE 0x0000 /* @ECU_Address@KFOC_IdCmd_A_ovrdflg@ */ Scalar_BOOLEAN 0 SWC_ETE_type_CM_boolean_flg 0.0 1.0 /end CHARACTERISTIC
/begin CHARACTERISTIC KFOC_IqCmd_A_ovrdflg "" VALUE 0x0000 /* @ECU_Address@KFOC_IqCmd_A_ovrdflg@ */ Scalar_BOOLEAN 0 SWC_ETE_type_CM_boolean_flg 0.0 1.0 /end CHARACTERISTIC
/begin CHARACTERISTIC KFOC_OpMod_enum_ovrdflg "" VALUE 0x0000 /* @ECU_Address@KFOC_OpMod_enum_ovrdflg@ */ Scalar_BOOLEAN 0 SWC_ETE_type_CM_boolean_flg 0.0 1.0 /end CHARACTERISTIC
/begin CHARACTERISTIC KFOC_PWMidle_flg "" VALUE 0x0000 /* @ECU_Address@KFOC_PWMidle_flg@ */ Scalar_BOOLEAN 0 SWC_ETE_type_CM_boolean_flg 0.0 1.0 /end CHARACTERISTIC
/begin CHARACTERISTIC KFOC_RotPosnOffset_rad_ovrdflg "" VALUE 0x0000 /* @ECU_Address@KFOC_RotPosnOffset_rad_ovrdflg@ */ Scalar_BOOLEAN 0 SWC_ETE_type_CM_boolean_flg 0.0 1.0 /end CHARACTERISTIC
/begin CHARACTERISTIC KOSP_IvtrTarMor_enum_ovrdflg "" VALUE 0x0000 /* @ECU_Address@KOSP_IvtrTarMor_enum_ovrdflg@ */ Scalar_BOOLEAN 0 SWC_ETE_type_CM_boolean_flag 0.0 1.0 /end CHARACTERISTIC
/begin CHARACTERISTIC KPCS_EnaSnsrSelfLrn_flg_ovrdflg "" VALUE 0x0000 /* @ECU_Address@KPCS_EnaSnsrSelfLrn_flg_ovrdflg@ */ Scalar_BOOLEAN 0 SWC_ETE_type_CM_boolean_flag 0.0 1.0 /end CHARACTERISTIC
/begin CHARACTERISTIC KPCS_EnaSnsrSelfLrn_flg_ovrdval "" VALUE 0x0000 /* @ECU_Address@KPCS_EnaSnsrSelfLrn_flg_ovrdval@ */ Scalar_BOOLEAN 0 SWC_ETE_type_CM_boolean_flag 0.0 1.0 /end CHARACTERISTIC
/begin CHARACTERISTIC KPCS_MaxCurrReset_flg "" VALUE 0x0000 /* @ECU_Address@KPCS_MaxCurrReset_flg@ */ Scalar_BOOLEAN 0 SWC_ETE_type_CM_boolean_flag 0.0 1.0 /end CHARACTERISTIC
/begin CHARACTERISTIC KPCS_bCurOffsVolVld_flg_ovrdflg "" VALUE 0x0000 /* @ECU_Address@KPCS_bCurOffsVolVld_flg_ovrdflg@ */ Scalar_BOOLEAN 0 SWC_ETE_type_CM_boolean_flag 0.0 1.0 /end CHARACTERISTIC
/begin CHARACTERISTIC KPCS_bCurOffsVolVld_flg_ovrdval "" VALUE 0x0000 /* @ECU_Address@KPCS_bCurOffsVolVld_flg_ovrdval@ */ Scalar_BOOLEAN 0 SWC_ETE_type_CM_boolean_flag 0.0 1.0 /end CHARACTERISTIC
/begin CHARACTERISTIC KROT_RotAngleE_rad_ovrdflg "" VALUE 0x0000 /* @ECU_Address@KROT_RotAngleE_rad_ovrdflg@ */ Scalar_BOOLEAN 0 SWC_ETE_type_CM_boolean_flag 0.0 1.0 /end CHARACTERISTIC
/begin CHARACTERISTIC KROT_RotSpdMRaw_rpm_ovrdflg "" VALUE 0x0000 /* @ECU_Address@KROT_RotSpdMRaw_rpm_ovrdflg@ */ Scalar_BOOLEAN 0 SWC_ETE_type_CM_boolean_flag 0.0 1.0 /end CHARACTERISTIC
/begin CHARACTERISTIC KROT_bUseVariableFc_flg "" VALUE 0x0000 /* @ECU_Address@KROT_bUseVariableFc_flg@ */ Scalar_BOOLEAN 0 SWC_ETE_type_CM_boolean_flag 0.0 1.0 /end CHARACTERISTIC
/begin CHARACTERISTIC KFOC_ADCReadEnum_enum "" VALUE 0x0000 /* @ECU_Address@KFOC_ADCReadEnum_enum@ */ Scalar_UBYTE 0 SWC_ETE_type_CM_uint8_enum 0.0 32.0 /end CHARACTERISTIC
/begin CHARACTERISTIC KFOC_OpMod_enum_ovrdval "" VALUE 0x0000 /* @ECU_Address@KFOC_OpMod_enum_ovrdval@ */ Scalar_UBYTE 0 SWC_ETE_type_CM_uint8_enum 0.0 6.0 /end CHARACTERISTIC
/begin CHARACTERISTIC KFOC_SensorMode_enum "" VALUE 0x0000 /* @ECU_Address@KFOC_SensorMode_enum@ */ Scalar_UBYTE 0 SWC_ETE_type_CM_uint8_enum 0.0 255.0 /end CHARACTERISTIC
/begin CHARACTERISTIC KOSP_IvtrTarMor_enum_ovrdval "" VALUE 0x0000 /* @ECU_Address@KOSP_IvtrTarMor_enum_ovrdval@ */ Scalar_UBYTE 0 SWC_ETE_type_CM_uint8_enum 0.0 10.0 /end CHARACTERISTIC
/begin CHARACTERISTIC KPDC_FWCnt_C "" VALUE 0x0000 /* @ECU_Address@KPDC_FWCnt_C@ */ Scalar_UBYTE 0 SWC_ETE_type_CM_uint8_cnt 0.0 255.0 /end CHARACTERISTIC
/begin CHARACTERISTIC KeMCCR_b_UseMeasCrntDTC "" VALUE 0x0000 /* @ECU_Address@KeMCCR_b_UseMeasCrntDTC@ */ Scalar_UBYTE 0 SWC_ETE_type_CM_uint8_cnt 0.0 255.0 /end CHARACTERISTIC
/begin MEASUREMENT VHAL_EOPFVTRActualSpdSta_rpm "" FLOAT32_IEEE SWC_ETE_type_CM_single_rpm 0 0 0.0 8191.0 ECU_ADDRESS 0x0000 /* @ECU_Address@VHAL_EOPFVTRActualSpdSta_rpm@ */ /end MEASUREMENT
/begin MEASUREMENT VHAL_HVBattVolt_V "" FLOAT32_IEEE SWC_ETE_type_CM_single_V 0 0 0.0 819.0 ECU_ADDRESS 0x0000 /* @ECU_Address@VHAL_HVBattVolt_V@ */ /end MEASUREMENT
/begin MEASUREMENT VHAL_RrCoolantflow_Lpmin "" FLOAT32_IEEE SWC_ETE_type_CM_single_Lpmin 0 0 0.0 15.75 ECU_ADDRESS 0x0000 /* @ECU_Address@VHAL_RrCoolantflow_Lpmin@ */ /end MEASUREMENT
/begin MEASUREMENT VHAL_RrCoolanttemp_C "" FLOAT32_IEEE SWC_ETE_type_CM_single_C 0 0 -40.0 214.0 ECU_ADDRESS 0x0000 /* @ECU_Address@VHAL_RrCoolanttemp_C@ */ /end MEASUREMENT
/begin MEASUREMENT VHAL_FDCVCURrSpdMaxReq_rpm "" FLOAT32_IEEE SWC_ETE_type_CM_single_rpm 0 0 0.0 65535.0 ECU_ADDRESS 0x0000 /* @ECU_Address@VHAL_FDCVCURrSpdMaxReq_rpm@ */ /end MEASUREMENT
/begin MEASUREMENT VHAL_FDCVCURrSpdMinReq_rpm "" FLOAT32_IEEE SWC_ETE_type_CM_single_rpm 0 0 -22000.0 43535.0 ECU_ADDRESS 0x0000 /* @ECU_Address@VHAL_FDCVCURrSpdMinReq_rpm@ */ /end MEASUREMENT
/begin MEASUREMENT VHAL_FDCVCURrTMSpdReq_rpm "" FLOAT32_IEEE SWC_ETE_type_CM_single_rpm 0 0 -22000.0 43535.0 ECU_ADDRESS 0x0000 /* @ECU_Address@VHAL_FDCVCURrTMSpdReq_rpm@ */ /end MEASUREMENT
/begin MEASUREMENT VHAL_FDCVCURrTMTqReq_Nm "" FLOAT32_IEEE SWC_ETE_type_CM_single_Nm 0 0 -1000.0 5553.5 ECU_ADDRESS 0x0000 /* @ECU_Address@VHAL_FDCVCURrTMTqReq_Nm@ */ /end MEASUREMENT
/begin MEASUREMENT VHAL_FDCVCURrTqMaxReq_Nm "" FLOAT32_IEEE SWC_ETE_type_CM_single_Nm 0 0 0.0 4095.0 ECU_ADDRESS 0x0000 /* @ECU_Address@VHAL_FDCVCURrTqMaxReq_Nm@ */ /end MEASUREMENT
/begin MEASUREMENT VHAL_FDCVCURrTqMinReq_Nm "" FLOAT32_IEEE SWC_ETE_type_CM_single_Nm 0 0 -1022.0 3073.0 ECU_ADDRESS 0x0000 /* @ECU_Address@VHAL_FDCVCURrTqMinReq_Nm@ */ /end MEASUREMENT
/begin MEASUREMENT VHAL_IVITimeDay_DAY "" FLOAT32_IEEE SWC_ETE_type_CM_single_DAY 0 0 0.0 31.0 ECU_ADDRESS 0x0000 /* @ECU_Address@VHAL_IVITimeDay_DAY@ */ /end MEASUREMENT
/begin MEASUREMENT VHAL_IVITimeHour_hr "" FLOAT32_IEEE SWC_ETE_type_CM_single_hr 0 0 0.0 31.0 ECU_ADDRESS 0x0000 /* @ECU_Address@VHAL_IVITimeHour_hr@ */ /end MEASUREMENT
/begin MEASUREMENT VHAL_IVITimeMinute_min "" FLOAT32_IEEE SWC_ETE_type_CM_single_min 0 0 0.0 63.0 ECU_ADDRESS 0x0000 /* @ECU_Address@VHAL_IVITimeMinute_min@ */ /end MEASUREMENT
/begin MEASUREMENT VHAL_IVITimeMonth_MONTH "" FLOAT32_IEEE SWC_ETE_type_CM_single_MONTH 0 0 0.0 12.0 ECU_ADDRESS 0x0000 /* @ECU_Address@VHAL_IVITimeMonth_MONTH@ */ /end MEASUREMENT
/begin MEASUREMENT VHAL_IVITimeSecond_s "" FLOAT32_IEEE SWC_ETE_type_CM_single_s 0 0 0.0 63.0 ECU_ADDRESS 0x0000 /* @ECU_Address@VHAL_IVITimeSecond_s@ */ /end MEASUREMENT
/begin MEASUREMENT VHAL_VehSpeed_kph "" FLOAT32_IEEE SWC_ETE_type_CM_single_kph 0 0 0.0 255.875 ECU_ADDRESS 0x0000 /* @ECU_Address@VHAL_VehSpeed_kph@ */ /end MEASUREMENT
/begin MEASUREMENT VCRM_IdSp_A "" FLOAT32_IEEE SWC_ETE_type_CM_single_A 0 0 -100000.0 100000.0 ECU_ADDRESS 0x0000 /* @ECU_Address@VCRM_IdSp_A@ */ /end MEASUREMENT
/begin MEASUREMENT VCRM_IqSp_A "" FLOAT32_IEEE SWC_ETE_type_CM_single_A 0 0 -100000.0 100000.0 ECU_ADDRESS 0x0000 /* @ECU_Address@VCRM_IqSp_A@ */ /end MEASUREMENT
/begin MEASUREMENT VCRM_PIOut_value "" FLOAT32_IEEE SWC_ETE_type_CM_single_value 0 0 -100000.0 100000.0 ECU_ADDRESS 0x0000 /* @ECU_Address@VCRM_PIOut_value@ */ /end MEASUREMENT
/begin MEASUREMENT VCRM_IdCmdFWC_A "" FLOAT32_IEEE SWC_ETE_type_CM_single_A 0 0 -100000.0 100000.0 ECU_ADDRESS 0x0000 /* @ECU_Address@VCRM_IdCmdFWC_A@ */ /end MEASUREMENT
/begin MEASUREMENT VCRM_IdCmd_A "" FLOAT32_IEEE SWC_ETE_type_CM_single_A 0 0 -100000.0 100000.0 ECU_ADDRESS 0x0000 /* @ECU_Address@VCRM_IdCmd_A@ */ /end MEASUREMENT
/begin MEASUREMENT VCRM_IqCmdFWC_A "" FLOAT32_IEEE SWC_ETE_type_CM_single_A 0 0 -100000.0 100000.0 ECU_ADDRESS 0x0000 /* @ECU_Address@VCRM_IqCmdFWC_A@ */ /end MEASUREMENT
/begin MEASUREMENT VDGL_OverSpdDerateCoef_gain "" FLOAT32_IEEE SWC_ETE_type_CM_single_gain 0 0 0.0 1.0 ECU_ADDRESS 0x0000 /* @ECU_Address@VDGL_OverSpdDerateCoef_gain@ */ /end MEASUREMENT
/begin MEASUREMENT VDGL_IGBTDerateCoef_gain "" FLOAT32_IEEE SWC_ETE_type_CM_single_gain 0 0 0.0 1.0 ECU_ADDRESS 0x0000 /* @ECU_Address@VDGL_IGBTDerateCoef_gain@ */ /end MEASUREMENT
/begin MEASUREMENT VDGL_MotDerateCoef_gain "" FLOAT32_IEEE SWC_ETE_type_CM_single_gain 0 0 0.0 1.0 ECU_ADDRESS 0x0000 /* @ECU_Address@VDGL_MotDerateCoef_gain@ */ /end MEASUREMENT
/begin MEASUREMENT VDGL_PCBDerateCoef_gain "" FLOAT32_IEEE SWC_ETE_type_CM_single_gain 0 0 0.0 1.0 ECU_ADDRESS 0x0000 /* @ECU_Address@VDGL_PCBDerateCoef_gain@ */ /end MEASUREMENT
/begin MEASUREMENT VDGL_OilDerateCoef_gain "" FLOAT32_IEEE SWC_ETE_type_CM_single_gain 0 0 0.0 1.0 ECU_ADDRESS 0x0000 /* @ECU_Address@VDGL_OilDerateCoef_gain@ */ /end MEASUREMENT
/begin MEASUREMENT VDGL_UdcOverDerateCoef_gain "" FLOAT32_IEEE SWC_ETE_type_CM_single_gain 0 0 0.0 1.0 ECU_ADDRESS 0x0000 /* @ECU_Address@VDGL_UdcOverDerateCoef_gain@ */ /end MEASUREMENT
/begin MEASUREMENT VDGL_UdcLowDerateCoef_gain "" FLOAT32_IEEE SWC_ETE_type_CM_single_gain 0 0 0.0 1.0 ECU_ADDRESS 0x0000 /* @ECU_Address@VDGL_UdcLowDerateCoef_gain@ */ /end MEASUREMENT
/begin MEASUREMENT VSYL_facTorqueCoef_null "" FLOAT32_IEEE SWC_ETE_type_CM_single_null 0 0 0.0 1.0 ECU_ADDRESS 0x0000 /* @ECU_Address@VSYL_facTorqueCoef_null@ */ /end MEASUREMENT
/begin MEASUREMENT VSYL_tqTMTqMax_Nm "" FLOAT32_IEEE SWC_ETE_type_CM_single_Nm 0 0 -100000.0 100000.0 ECU_ADDRESS 0x0000 /* @ECU_Address@VSYL_tqTMTqMax_Nm@ */ /end MEASUREMENT
/begin MEASUREMENT VSYL_tqTMTqMin_Nm "" FLOAT32_IEEE SWC_ETE_type_CM_single_Nm 0 0 -100000.0 100000.0 ECU_ADDRESS 0x0000 /* @ECU_Address@VSYL_tqTMTqMin_Nm@ */ /end MEASUREMENT
/begin MEASUREMENT VCRM_IqCmd_A "" FLOAT32_IEEE SWC_ETE_type_CM_single_A 0 0 -100000.0 100000.0 ECU_ADDRESS 0x0000 /* @ECU_Address@VCRM_IqCmd_A@ */ /end MEASUREMENT
/begin MEASUREMENT VCRM_PwrEleAct_W "" FLOAT32_IEEE SWC_ETE_type_CM_single_W 0 0 -100000.0 100000.0 ECU_ADDRESS 0x0000 /* @ECU_Address@VCRM_PwrEleAct_W@ */ /end MEASUREMENT
/begin MEASUREMENT VCRM_BusCurr_A "" FLOAT32_IEEE SWC_ETE_type_CM_single_A 0 0 -100000.0 100000.0 ECU_ADDRESS 0x0000 /* @ECU_Address@VCRM_BusCurr_A@ */ /end MEASUREMENT
/begin MEASUREMENT VOUTP_tqTMTqMin_Nm "" FLOAT32_IEEE SWC_ETE_type_CM_single_Nm 0 0 -100000.0 100000.0 ECU_ADDRESS 0x0000 /* @ECU_Address@VOUTP_tqTMTqMin_Nm@ */ /end MEASUREMENT
/begin MEASUREMENT VOUTP_tqTMTqMax_Nm "" FLOAT32_IEEE SWC_ETE_type_CM_single_Nm 0 0 -100000.0 100000.0 ECU_ADDRESS 0x0000 /* @ECU_Address@VOUTP_tqTMTqMax_Nm@ */ /end MEASUREMENT
/begin MEASUREMENT VOUTP_volfCooltFlowTar_C "" FLOAT32_IEEE SWC_ETE_type_CM_single_C 0 0 -1000.0 1000.0 ECU_ADDRESS 0x0000 /* @ECU_Address@VOUTP_volfCooltFlowTar_C@ */ /end MEASUREMENT
/begin MEASUREMENT VOUTP_nEOPSpdReq_rpm "" FLOAT32_IEEE SWC_ETE_type_CM_single_rpm 0 0 -100000.0 100000.0 ECU_ADDRESS 0x0000 /* @ECU_Address@VOUTP_nEOPSpdReq_rpm@ */ /end MEASUREMENT
/begin MEASUREMENT VOUTP_PwrEleAct_W "" FLOAT32_IEEE SWC_ETE_type_CM_single_W 0 0 -100000.0 100000.0 ECU_ADDRESS 0x0000 /* @ECU_Address@VOUTP_PwrEleAct_W@ */ /end MEASUREMENT
/begin MEASUREMENT VOUTP_BusCurr_A "" FLOAT32_IEEE SWC_ETE_type_CM_single_A 0 0 -100000.0 100000.0 ECU_ADDRESS 0x0000 /* @ECU_Address@VOUTP_BusCurr_A@ */ /end MEASUREMENT
/begin MEASUREMENT VAPP_iDCurrAct_A "" FLOAT32_IEEE SWC_ETE_type_CM_single_A 0 0 -100000.0 100000.0 ECU_ADDRESS 0x0000 /* @ECU_Address@VAPP_iDCurrAct_A@ */ /end MEASUREMENT
/begin MEASUREMENT VAPP_iQCurrAct_A "" FLOAT32_IEEE SWC_ETE_type_CM_single_A 0 0 -100000.0 100000.0 ECU_ADDRESS 0x0000 /* @ECU_Address@VAPP_iQCurrAct_A@ */ /end MEASUREMENT
/begin MEASUREMENT VAPP_ADCKL30_V "" FLOAT32_IEEE SWC_ETE_type_CM_single_V 0 0 -100000.0 100000.0 ECU_ADDRESS 0x0000 /* @ECU_Address@VAPP_ADCKL30_V@ */ /end MEASUREMENT
/begin MEASUREMENT VAPP_ADCKL15_V "" FLOAT32_IEEE SWC_ETE_type_CM_single_V 0 0 -100000.0 100000.0 ECU_ADDRESS 0x0000 /* @ECU_Address@VAPP_ADCKL15_V@ */ /end MEASUREMENT
/begin MEASUREMENT VAPP_uDC_V "" FLOAT32_IEEE SWC_ETE_type_CM_single_V 0 0 -100000.0 100000.0 ECU_ADDRESS 0x0000 /* @ECU_Address@VAPP_uDC_V@ */ /end MEASUREMENT
/begin MEASUREMENT VAPP_RotSpd_rpm "" FLOAT32_IEEE SWC_ETE_type_CM_single_rpm 0 0 -100000.0 100000.0 ECU_ADDRESS 0x0000 /* @ECU_Address@VAPP_RotSpd_rpm@ */ /end MEASUREMENT
/begin MEASUREMENT VAPP_OilTemp_degC "" FLOAT32_IEEE SWC_ETE_type_CM_single_degC 0 0 -100000.0 100000.0 ECU_ADDRESS 0x0000 /* @ECU_Address@VAPP_OilTemp_degC@ */ /end MEASUREMENT
/begin MEASUREMENT VOUTP_OilTemp_degC "" FLOAT32_IEEE SWC_ETE_type_CM_single_degC 0 0 -100000.0 100000.0 ECU_ADDRESS 0x0000 /* @ECU_Address@VOUTP_OilTemp_degC@ */ /end MEASUREMENT
/begin MEASUREMENT VOUTP_RotSpd_rpm "" FLOAT32_IEEE SWC_ETE_type_CM_single_rpm 0 0 -100000.0 100000.0 ECU_ADDRESS 0x0000 /* @ECU_Address@VOUTP_RotSpd_rpm@ */ /end MEASUREMENT
/begin MEASUREMENT VOUTP_uDC_V "" FLOAT32_IEEE SWC_ETE_type_CM_single_V 0 0 -100000.0 100000.0 ECU_ADDRESS 0x0000 /* @ECU_Address@VOUTP_uDC_V@ */ /end MEASUREMENT
/begin MEASUREMENT VOUTP_ADCKL15_V "" FLOAT32_IEEE SWC_ETE_type_CM_single_V 0 0 -100000.0 100000.0 ECU_ADDRESS 0x0000 /* @ECU_Address@VOUTP_ADCKL15_V@ */ /end MEASUREMENT
/begin MEASUREMENT VOUTP_ADCKL30_V "" FLOAT32_IEEE SWC_ETE_type_CM_single_V 0 0 -100000.0 100000.0 ECU_ADDRESS 0x0000 /* @ECU_Address@VOUTP_ADCKL30_V@ */ /end MEASUREMENT
/begin MEASUREMENT VOUTP_iQCurrAct_A "" FLOAT32_IEEE SWC_ETE_type_CM_single_A 0 0 -100000.0 100000.0 ECU_ADDRESS 0x0000 /* @ECU_Address@VOUTP_iQCurrAct_A@ */ /end MEASUREMENT
/begin MEASUREMENT VOUTP_iDCurrAct_A "" FLOAT32_IEEE SWC_ETE_type_CM_single_A 0 0 -100000.0 100000.0 ECU_ADDRESS 0x0000 /* @ECU_Address@VOUTP_iDCurrAct_A@ */ /end MEASUREMENT
/begin MEASUREMENT VSYL_nTMSpdMin_RPM "" FLOAT32_IEEE SWC_ETE_type_CM_single_RPM 0 0 -100000.0 100000.0 ECU_ADDRESS 0x0000 /* @ECU_Address@VSYL_nTMSpdMin_RPM@ */ /end MEASUREMENT
/begin MEASUREMENT VSYL_nTMSpdMax_RPM "" FLOAT32_IEEE SWC_ETE_type_CM_single_RPM 0 0 -100000.0 100000.0 ECU_ADDRESS 0x0000 /* @ECU_Address@VSYL_nTMSpdMax_RPM@ */ /end MEASUREMENT
/begin MEASUREMENT VSYL_frqSwitchMax_Hz "" FLOAT32_IEEE SWC_ETE_type_CM_single_Hz 0 0 -100000.0 100000.0 ECU_ADDRESS 0x0000 /* @ECU_Address@VSYL_frqSwitchMax_Hz@ */ /end MEASUREMENT
/begin MEASUREMENT VFOC_ADCMCUTemp_degC "" FLOAT32_IEEE SWC_ETE_type_CM_single_degC 0 0 -10000.0 10000.0 ECU_ADDRESS 0x0000 /* @ECU_Address@VFOC_ADCMCUTemp_degC@ */ /end MEASUREMENT
/begin MEASUREMENT VFOC_ADCFlyBackTemp_degC "" FLOAT32_IEEE SWC_ETE_type_CM_single_degC 0 0 -10000.0 10000.0 ECU_ADDRESS 0x0000 /* @ECU_Address@VFOC_ADCFlyBackTemp_degC@ */ /end MEASUREMENT
/begin MEASUREMENT VFOC_ADCOilTemp_degC "" FLOAT32_IEEE SWC_ETE_type_CM_single_degC 0 0 -10000.0 10000.0 ECU_ADDRESS 0x0000 /* @ECU_Address@VFOC_ADCOilTemp_degC@ */ /end MEASUREMENT
/begin MEASUREMENT VFOC_ADCMotorUTemp_degC "" FLOAT32_IEEE SWC_ETE_type_CM_single_degC 0 0 -10000.0 10000.0 ECU_ADDRESS 0x0000 /* @ECU_Address@VFOC_ADCMotorUTemp_degC@ */ /end MEASUREMENT
/begin MEASUREMENT VFOC_ADCMotorVTemp_degC "" FLOAT32_IEEE SWC_ETE_type_CM_single_degC 0 0 -10000.0 10000.0 ECU_ADDRESS 0x0000 /* @ECU_Address@VFOC_ADCMotorVTemp_degC@ */ /end MEASUREMENT
/begin MEASUREMENT VFOC_ADCMotorWTemp_degC "" FLOAT32_IEEE SWC_ETE_type_CM_single_degC 0 0 -10000.0 10000.0 ECU_ADDRESS 0x0000 /* @ECU_Address@VFOC_ADCMotorWTemp_degC@ */ /end MEASUREMENT
/begin MEASUREMENT VFOC_ADCSicUTemp_degC "" FLOAT32_IEEE SWC_ETE_type_CM_single_degC 0 0 -10000.0 10000.0 ECU_ADDRESS 0x0000 /* @ECU_Address@VFOC_ADCSicUTemp_degC@ */ /end MEASUREMENT
/begin MEASUREMENT VFOC_ADCSicVTemp_degC "" FLOAT32_IEEE SWC_ETE_type_CM_single_degC 0 0 -10000.0 10000.0 ECU_ADDRESS 0x0000 /* @ECU_Address@VFOC_ADCSicVTemp_degC@ */ /end MEASUREMENT
/begin MEASUREMENT VFOC_ADCSicWTemp_degC "" FLOAT32_IEEE SWC_ETE_type_CM_single_degC 0 0 -10000.0 10000.0 ECU_ADDRESS 0x0000 /* @ECU_Address@VFOC_ADCSicWTemp_degC@ */ /end MEASUREMENT
/begin MEASUREMENT VLLC_volfCooltFlowTar_C "" FLOAT32_IEEE SWC_ETE_type_CM_single_C 0 0 -1000.0 1000.0 ECU_ADDRESS 0x0000 /* @ECU_Address@VLLC_volfCooltFlowTar_C@ */ /end MEASUREMENT
/begin MEASUREMENT VINP_EOPFVTRActualSpdSta_rpm "" FLOAT32_IEEE SWC_ETE_type_CM_single_rpm 0 0 0.0 8191.0 ECU_ADDRESS 0x0000 /* @ECU_Address@VINP_EOPFVTRActualSpdSta_rpm@ */ /end MEASUREMENT
/begin MEASUREMENT VINP_HVBattVolt_V "" FLOAT32_IEEE SWC_ETE_type_CM_single_V 0 0 0.0 819.0 ECU_ADDRESS 0x0000 /* @ECU_Address@VINP_HVBattVolt_V@ */ /end MEASUREMENT
/begin MEASUREMENT VINP_RrCoolantflow_Lpmin "" FLOAT32_IEEE SWC_ETE_type_CM_single_Lpmin 0 0 0.0 15.75 ECU_ADDRESS 0x0000 /* @ECU_Address@VINP_RrCoolantflow_Lpmin@ */ /end MEASUREMENT
/begin MEASUREMENT VINP_RrCoolanttemp_C "" FLOAT32_IEEE SWC_ETE_type_CM_single_C 0 0 -40.0 214.0 ECU_ADDRESS 0x0000 /* @ECU_Address@VINP_RrCoolanttemp_C@ */ /end MEASUREMENT
/begin MEASUREMENT VINP_FDCVCURrSpdMaxReq_rpm "" FLOAT32_IEEE SWC_ETE_type_CM_single_rpm 0 0 0.0 65535.0 ECU_ADDRESS 0x0000 /* @ECU_Address@VINP_FDCVCURrSpdMaxReq_rpm@ */ /end MEASUREMENT
/begin MEASUREMENT VINP_FDCVCURrSpdMinReq_rpm "" FLOAT32_IEEE SWC_ETE_type_CM_single_rpm 0 0 -22000.0 43535.0 ECU_ADDRESS 0x0000 /* @ECU_Address@VINP_FDCVCURrSpdMinReq_rpm@ */ /end MEASUREMENT
/begin MEASUREMENT VINP_FDCVCURrTMSpdReq_rpm "" FLOAT32_IEEE SWC_ETE_type_CM_single_rpm 0 0 -22000.0 43535.0 ECU_ADDRESS 0x0000 /* @ECU_Address@VINP_FDCVCURrTMSpdReq_rpm@ */ /end MEASUREMENT
/begin MEASUREMENT VINP_FDCVCURrTMTqReq_Nm "" FLOAT32_IEEE SWC_ETE_type_CM_single_Nm 0 0 -1000.0 5553.5 ECU_ADDRESS 0x0000 /* @ECU_Address@VINP_FDCVCURrTMTqReq_Nm@ */ /end MEASUREMENT
/begin MEASUREMENT VINP_FDCVCURrTqMaxReq_Nm "" FLOAT32_IEEE SWC_ETE_type_CM_single_Nm 0 0 0.0 4095.0 ECU_ADDRESS 0x0000 /* @ECU_Address@VINP_FDCVCURrTqMaxReq_Nm@ */ /end MEASUREMENT
/begin MEASUREMENT VINP_FDCVCURrTqMinReq_Nm "" FLOAT32_IEEE SWC_ETE_type_CM_single_Nm 0 0 -1022.0 3073.0 ECU_ADDRESS 0x0000 /* @ECU_Address@VINP_FDCVCURrTqMinReq_Nm@ */ /end MEASUREMENT
/begin MEASUREMENT VINP_IVITimeDay_DAY "" FLOAT32_IEEE SWC_ETE_type_CM_single_DAY 0 0 0.0 31.0 ECU_ADDRESS 0x0000 /* @ECU_Address@VINP_IVITimeDay_DAY@ */ /end MEASUREMENT
/begin MEASUREMENT VINP_IVITimeHour_hr "" FLOAT32_IEEE SWC_ETE_type_CM_single_hr 0 0 0.0 31.0 ECU_ADDRESS 0x0000 /* @ECU_Address@VINP_IVITimeHour_hr@ */ /end MEASUREMENT
/begin MEASUREMENT VINP_IVITimeMinute_min "" FLOAT32_IEEE SWC_ETE_type_CM_single_min 0 0 0.0 63.0 ECU_ADDRESS 0x0000 /* @ECU_Address@VINP_IVITimeMinute_min@ */ /end MEASUREMENT
/begin MEASUREMENT VINP_IVITimeMonth_MONTH "" FLOAT32_IEEE SWC_ETE_type_CM_single_MONTH 0 0 0.0 12.0 ECU_ADDRESS 0x0000 /* @ECU_Address@VINP_IVITimeMonth_MONTH@ */ /end MEASUREMENT
/begin MEASUREMENT VINP_IVITimeSecond_s "" FLOAT32_IEEE SWC_ETE_type_CM_single_s 0 0 0.0 63.0 ECU_ADDRESS 0x0000 /* @ECU_Address@VINP_IVITimeSecond_s@ */ /end MEASUREMENT
/begin MEASUREMENT VINP_VehSpeed_kph "" FLOAT32_IEEE SWC_ETE_type_CM_single_kph 0 0 0.0 255.875 ECU_ADDRESS 0x0000 /* @ECU_Address@VINP_VehSpeed_kph@ */ /end MEASUREMENT
/begin MEASUREMENT VFOC_GateICFrame0Vl_pct "" FLOAT32_IEEE SWC_ETE_type_CM_single_pct 0 0 -10000.0 10000.0 ECU_ADDRESS 0x0000 /* @ECU_Address@VFOC_GateICFrame0Vl_pct@ */ /end MEASUREMENT
/begin MEASUREMENT VFOC_GateICFrame0Wl_pct "" FLOAT32_IEEE SWC_ETE_type_CM_single_pct 0 0 -10000.0 10000.0 ECU_ADDRESS 0x0000 /* @ECU_Address@VFOC_GateICFrame0Wl_pct@ */ /end MEASUREMENT
/begin MEASUREMENT VFOC_GateICFrame1Vh_pct "" FLOAT32_IEEE SWC_ETE_type_CM_single_pct 0 0 -10000.0 10000.0 ECU_ADDRESS 0x0000 /* @ECU_Address@VFOC_GateICFrame1Vh_pct@ */ /end MEASUREMENT
/begin MEASUREMENT VFOC_GateICFrame1Wh_pct "" FLOAT32_IEEE SWC_ETE_type_CM_single_pct 0 0 -10000.0 10000.0 ECU_ADDRESS 0x0000 /* @ECU_Address@VFOC_GateICFrame1Wh_pct@ */ /end MEASUREMENT
/begin MEASUREMENT VFOC_GateICFrame1Ul_pct "" FLOAT32_IEEE SWC_ETE_type_CM_single_pct 0 0 -10000.0 10000.0 ECU_ADDRESS 0x0000 /* @ECU_Address@VFOC_GateICFrame1Ul_pct@ */ /end MEASUREMENT
/begin MEASUREMENT VFOC_GateICFrame0Uh_pct "" FLOAT32_IEEE SWC_ETE_type_CM_single_pct 0 0 -10000.0 10000.0 ECU_ADDRESS 0x0000 /* @ECU_Address@VFOC_GateICFrame0Uh_pct@ */ /end MEASUREMENT
/begin MEASUREMENT VFOC_GateICFrame0Vh_pct "" FLOAT32_IEEE SWC_ETE_type_CM_single_pct 0 0 -10000.0 10000.0 ECU_ADDRESS 0x0000 /* @ECU_Address@VFOC_GateICFrame0Vh_pct@ */ /end MEASUREMENT
/begin MEASUREMENT VFOC_GateICFrame0Wh_pct "" FLOAT32_IEEE SWC_ETE_type_CM_single_pct 0 0 -10000.0 10000.0 ECU_ADDRESS 0x0000 /* @ECU_Address@VFOC_GateICFrame0Wh_pct@ */ /end MEASUREMENT
/begin MEASUREMENT VFOC_GateICFrame1Vl_pct "" FLOAT32_IEEE SWC_ETE_type_CM_single_pct 0 0 -10000.0 10000.0 ECU_ADDRESS 0x0000 /* @ECU_Address@VFOC_GateICFrame1Vl_pct@ */ /end MEASUREMENT
/begin MEASUREMENT VFOC_GateICFrame1Wl_pct "" FLOAT32_IEEE SWC_ETE_type_CM_single_pct 0 0 -10000.0 10000.0 ECU_ADDRESS 0x0000 /* @ECU_Address@VFOC_GateICFrame1Wl_pct@ */ /end MEASUREMENT
/begin MEASUREMENT VFOC_GateICFrame1Uh_pct "" FLOAT32_IEEE SWC_ETE_type_CM_single_pct 0 0 -10000.0 10000.0 ECU_ADDRESS 0x0000 /* @ECU_Address@VFOC_GateICFrame1Uh_pct@ */ /end MEASUREMENT
/begin MEASUREMENT VFOC_GateICFrame0Ul_pct "" FLOAT32_IEEE SWC_ETE_type_CM_single_pct 0 0 -10000.0 10000.0 ECU_ADDRESS 0x0000 /* @ECU_Address@VFOC_GateICFrame0Ul_pct@ */ /end MEASUREMENT
/begin MEASUREMENT VEOP_nEOPSpdReq_rpm "" FLOAT32_IEEE SWC_ETE_type_CM_single_rpm 0 0 -100000.0 100000.0 ECU_ADDRESS 0x0000 /* @ECU_Address@VEOP_nEOPSpdReq_rpm@ */ /end MEASUREMENT
/begin MEASUREMENT VCRM_IdCmdinit_A "" FLOAT32_IEEE SWC_ETE_type_CM_single_A 0 0 -100000.0 100000.0 ECU_ADDRESS 0x0000 /* @ECU_Address@VCRM_IdCmdinit_A@ */ /end MEASUREMENT
/begin MEASUREMENT VCRM_IqCmdinit_A "" FLOAT32_IEEE SWC_ETE_type_CM_single_A 0 0 -100000.0 100000.0 ECU_ADDRESS 0x0000 /* @ECU_Address@VCRM_IqCmdinit_A@ */ /end MEASUREMENT
/begin MEASUREMENT VHAL_EOPFVTRLocal1CSSta_enum "" UBYTE SWC_ETE_type_CM_uint8_enum 0 0 0.0 255.0 ECU_ADDRESS 0x0000 /* @ECU_Address@VHAL_EOPFVTRLocal1CSSta_enum@ */ /end MEASUREMENT
/begin MEASUREMENT VHAL_EOPFVTRLocal1RCSta_enum "" UBYTE SWC_ETE_type_CM_uint8_enum 0 0 0.0 14.0 ECU_ADDRESS 0x0000 /* @ECU_Address@VHAL_EOPFVTRLocal1RCSta_enum@ */ /end MEASUREMENT
/begin MEASUREMENT VHAL_EOPFVTROverTempBCKSta_enum "" UBYTE SWC_ETE_type_CM_uint8_enum 0 0 0.0 3.0 ECU_ADDRESS 0x0000 /* @ECU_Address@VHAL_EOPFVTROverTempBCKSta_enum@ */ /end MEASUREMENT
/begin MEASUREMENT VHAL_EOPFVTROverVolSta_enum "" UBYTE SWC_ETE_type_CM_uint8_enum 0 0 0.0 3.0 ECU_ADDRESS 0x0000 /* @ECU_Address@VHAL_EOPFVTROverVolSta_enum@ */ /end MEASUREMENT
/begin MEASUREMENT VHAL_EOPFVTRRunStatusSta_enum "" UBYTE SWC_ETE_type_CM_uint8_enum 0 0 0.0 3.0 ECU_ADDRESS 0x0000 /* @ECU_Address@VHAL_EOPFVTRRunStatusSta_enum@ */ /end MEASUREMENT
/begin MEASUREMENT VHAL_EOPFVTRUnderVolSta_enum "" UBYTE SWC_ETE_type_CM_uint8_enum 0 0 0.0 3.0 ECU_ADDRESS 0x0000 /* @ECU_Address@VHAL_EOPFVTRUnderVolSta_enum@ */ /end MEASUREMENT
/begin MEASUREMENT VHAL_BatteryMode_enum "" UBYTE SWC_ETE_type_CM_uint8_enum 0 0 0.0 5.0 ECU_ADDRESS 0x0000 /* @ECU_Address@VHAL_BatteryMode_enum@ */ /end MEASUREMENT
/begin MEASUREMENT VHAL_CSVCU1_enum "" UBYTE SWC_ETE_type_CM_uint8_enum 0 0 0.0 255.0 ECU_ADDRESS 0x0000 /* @ECU_Address@VHAL_CSVCU1_enum@ */ /end MEASUREMENT
/begin MEASUREMENT VHAL_PwrSta_enum "" UBYTE SWC_ETE_type_CM_uint8_enum 0 0 0.0 7.0 ECU_ADDRESS 0x0000 /* @ECU_Address@VHAL_PwrSta_enum@ */ /end MEASUREMENT
/begin MEASUREMENT VHAL_RCVCU1_enum "" UBYTE SWC_ETE_type_CM_uint8_enum 0 0 0.0 14.0 ECU_ADDRESS 0x0000 /* @ECU_Address@VHAL_RCVCU1_enum@ */ /end MEASUREMENT
/begin MEASUREMENT VHAL_ShiftGearPosn_enum "" UBYTE SWC_ETE_type_CM_uint8_enum 0 0 0.0 7.0 ECU_ADDRESS 0x0000 /* @ECU_Address@VHAL_ShiftGearPosn_enum@ */ /end MEASUREMENT
/begin MEASUREMENT VHAL_CSVCU2CAN1_enum "" UBYTE SWC_ETE_type_CM_uint8_enum 0 0 0.0 255.0 ECU_ADDRESS 0x0000 /* @ECU_Address@VHAL_CSVCU2CAN1_enum@ */ /end MEASUREMENT
/begin MEASUREMENT VHAL_RCVCU2CAN1_enum "" UBYTE SWC_ETE_type_CM_uint8_enum 0 0 0.0 14.0 ECU_ADDRESS 0x0000 /* @ECU_Address@VHAL_RCVCU2CAN1_enum@ */ /end MEASUREMENT
/begin MEASUREMENT VHAL_FDCVCURrTMCtrlModeReq_enum "" UBYTE SWC_ETE_type_CM_uint8_enum 0 0 0.0 7.0 ECU_ADDRESS 0x0000 /* @ECU_Address@VHAL_FDCVCURrTMCtrlModeReq_enum@ */ /end MEASUREMENT
/begin MEASUREMENT VOUTP_IVTROpMode_enum "" UBYTE SWC_ETE_type_CM_uint8_enum 0 0 0.0 255.0 ECU_ADDRESS 0x0000 /* @ECU_Address@VOUTP_IVTROpMode_enum@ */ /end MEASUREMENT
/begin MEASUREMENT VOUTP_MotMod_enum "" UBYTE SWC_ETE_type_CM_uint8_enum 0 0 0.0 255.0 ECU_ADDRESS 0x0000 /* @ECU_Address@VOUTP_MotMod_enum@ */ /end MEASUREMENT
/begin MEASUREMENT VOPM_MotMod_enum "" UBYTE COMPU_METHOD_ENUM_MOTMOD 0 0 0.0 255.0 ECU_ADDRESS 0x0000 /* @ECU_Address@VOPM_MotMod_enum@ */ /end MEASUREMENT
/begin MEASUREMENT VOPM_IVTROpMode_enum "" UBYTE COMPU_METHOD_ENUM_IVTROPMODE 0 0 0.0 255.0 ECU_ADDRESS 0x0000 /* @ECU_Address@VOPM_IVTROpMode_enum@ */ /end MEASUREMENT
/begin MEASUREMENT VINP_EOPFVTROverVolSta_enum "" UBYTE SWC_ETE_type_CM_uint8_enum 0 0 0.0 3.0 ECU_ADDRESS 0x0000 /* @ECU_Address@VINP_EOPFVTROverVolSta_enum@ */ /end MEASUREMENT
/begin MEASUREMENT VINP_EOPFVTRRunStatusSta_enum "" UBYTE SWC_ETE_type_CM_uint8_enum 0 0 0.0 3.0 ECU_ADDRESS 0x0000 /* @ECU_Address@VINP_EOPFVTRRunStatusSta_enum@ */ /end MEASUREMENT
/begin MEASUREMENT VINP_EOPFVTRUnderVolSta_enum "" UBYTE SWC_ETE_type_CM_uint8_enum 0 0 0.0 3.0 ECU_ADDRESS 0x0000 /* @ECU_Address@VINP_EOPFVTRUnderVolSta_enum@ */ /end MEASUREMENT
/begin MEASUREMENT VINP_EOPFVTRLocal1CSSta_enum "" UBYTE SWC_ETE_type_CM_uint8_enum 0 0 0.0 255.0 ECU_ADDRESS 0x0000 /* @ECU_Address@VINP_EOPFVTRLocal1CSSta_enum@ */ /end MEASUREMENT
/begin MEASUREMENT VINP_EOPFVTRLocal1RCSta_enum "" UBYTE SWC_ETE_type_CM_uint8_enum 0 0 0.0 14.0 ECU_ADDRESS 0x0000 /* @ECU_Address@VINP_EOPFVTRLocal1RCSta_enum@ */ /end MEASUREMENT
/begin MEASUREMENT VINP_EOPFVTROverTempBCKSta_enum "" UBYTE SWC_ETE_type_CM_uint8_enum 0 0 0.0 3.0 ECU_ADDRESS 0x0000 /* @ECU_Address@VINP_EOPFVTROverTempBCKSta_enum@ */ /end MEASUREMENT
/begin MEASUREMENT VINP_BatteryMode_enum "" UBYTE SWC_ETE_type_CM_uint8_enum 0 0 0.0 5.0 ECU_ADDRESS 0x0000 /* @ECU_Address@VINP_BatteryMode_enum@ */ /end MEASUREMENT
/begin MEASUREMENT VINP_CSVCU1_enum "" UBYTE SWC_ETE_type_CM_uint8_enum 0 0 0.0 255.0 ECU_ADDRESS 0x0000 /* @ECU_Address@VINP_CSVCU1_enum@ */ /end MEASUREMENT
/begin MEASUREMENT VINP_PwrSta_enum "" UBYTE SWC_ETE_type_CM_uint8_enum 0 0 0.0 7.0 ECU_ADDRESS 0x0000 /* @ECU_Address@VINP_PwrSta_enum@ */ /end MEASUREMENT
/begin MEASUREMENT VINP_RCVCU1_enum "" UBYTE SWC_ETE_type_CM_uint8_enum 0 0 0.0 14.0 ECU_ADDRESS 0x0000 /* @ECU_Address@VINP_RCVCU1_enum@ */ /end MEASUREMENT
/begin MEASUREMENT VINP_ShiftGearPosn_enum "" UBYTE SWC_ETE_type_CM_uint8_enum 0 0 0.0 7.0 ECU_ADDRESS 0x0000 /* @ECU_Address@VINP_ShiftGearPosn_enum@ */ /end MEASUREMENT
/begin MEASUREMENT VINP_CSVCU2CAN1_enum "" UBYTE SWC_ETE_type_CM_uint8_enum 0 0 0.0 255.0 ECU_ADDRESS 0x0000 /* @ECU_Address@VINP_CSVCU2CAN1_enum@ */ /end MEASUREMENT
/begin MEASUREMENT VINP_RCVCU2CAN1_enum "" UBYTE SWC_ETE_type_CM_uint8_enum 0 0 0.0 14.0 ECU_ADDRESS 0x0000 /* @ECU_Address@VINP_RCVCU2CAN1_enum@ */ /end MEASUREMENT
/begin MEASUREMENT VINP_FDCVCURrTMCtrlModeReq_enum "" UBYTE SWC_ETE_type_CM_uint8_enum 0 0 0.0 7.0 ECU_ADDRESS 0x0000 /* @ECU_Address@VINP_FDCVCURrTMCtrlModeReq_enum@ */ /end MEASUREMENT
/begin MEASUREMENT VDGL_OverSpdErr_flg "" UBYTE SWC_ETE_type_CM_boolean_flg 0 0 0.0 1.0 ECU_ADDRESS 0x0000 /* @ECU_Address@VDGL_OverSpdErr_flg@ */ /end MEASUREMENT
/begin MEASUREMENT VHAL_EOPFVTRCSInvalidSta_flg "" UBYTE SWC_ETE_type_CM_boolean_flg 0 0 0.0 1.0 ECU_ADDRESS 0x0000 /* @ECU_Address@VHAL_EOPFVTRCSInvalidSta_flg@ */ /end MEASUREMENT
/begin MEASUREMENT VHAL_EOPFVTRCanLossSta_flg "" UBYTE SWC_ETE_type_CM_boolean_flg 0 0 0.0 1.0 ECU_ADDRESS 0x0000 /* @ECU_Address@VHAL_EOPFVTRCanLossSta_flg@ */ /end MEASUREMENT
/begin MEASUREMENT VHAL_EOPFVTREnableOffSta_flg "" UBYTE SWC_ETE_type_CM_boolean_flg 0 0 0.0 1.0 ECU_ADDRESS 0x0000 /* @ECU_Address@VHAL_EOPFVTREnableOffSta_flg@ */ /end MEASUREMENT
/begin MEASUREMENT VHAL_EOPFVTRHallSigErrSta_flg "" UBYTE SWC_ETE_type_CM_boolean_flg 0 0 0.0 1.0 ECU_ADDRESS 0x0000 /* @ECU_Address@VHAL_EOPFVTRHallSigErrSta_flg@ */ /end MEASUREMENT
/begin MEASUREMENT VHAL_EOPFVTROverTempSta_flg "" UBYTE SWC_ETE_type_CM_boolean_flg 0 0 0.0 1.0 ECU_ADDRESS 0x0000 /* @ECU_Address@VHAL_EOPFVTROverTempSta_flg@ */ /end MEASUREMENT
/begin MEASUREMENT VHAL_EOPFVTRPumpReadySta_flg "" UBYTE SWC_ETE_type_CM_boolean_flg 0 0 0.0 1.0 ECU_ADDRESS 0x0000 /* @ECU_Address@VHAL_EOPFVTRPumpReadySta_flg@ */ /end MEASUREMENT
/begin MEASUREMENT VHAL_EOPFVTRRCInvalidSta_flg "" UBYTE SWC_ETE_type_CM_boolean_flg 0 0 0.0 1.0 ECU_ADDRESS 0x0000 /* @ECU_Address@VHAL_EOPFVTRRCInvalidSta_flg@ */ /end MEASUREMENT
/begin MEASUREMENT VHAL_EOPFVTRStartFailureSta_flg "" UBYTE SWC_ETE_type_CM_boolean_flg 0 0 0.0 1.0 ECU_ADDRESS 0x0000 /* @ECU_Address@VHAL_EOPFVTRStartFailureSta_flg@ */ /end MEASUREMENT
/begin MEASUREMENT VHAL_BMS1CSErr_flg "" UBYTE SWC_ETE_type_CM_boolean_flg 0 0 0.0 1.0 ECU_ADDRESS 0x0000 /* @ECU_Address@VHAL_BMS1CSErr_flg@ */ /end MEASUREMENT
/begin MEASUREMENT VHAL_BMS1RCErr_flg "" UBYTE SWC_ETE_type_CM_boolean_flg 0 0 0.0 1.0 ECU_ADDRESS 0x0000 /* @ECU_Address@VHAL_BMS1RCErr_flg@ */ /end MEASUREMENT
/begin MEASUREMENT VHAL_BMS6CSErr_flg "" UBYTE SWC_ETE_type_CM_boolean_flg 0 0 0.0 1.0 ECU_ADDRESS 0x0000 /* @ECU_Address@VHAL_BMS6CSErr_flg@ */ /end MEASUREMENT
/begin MEASUREMENT VHAL_BMS6RCErr_flg "" UBYTE SWC_ETE_type_CM_boolean_flg 0 0 0.0 1.0 ECU_ADDRESS 0x0000 /* @ECU_Address@VHAL_BMS6RCErr_flg@ */ /end MEASUREMENT
/begin MEASUREMENT VHAL_HVBContactorSta_flg "" UBYTE SWC_ETE_type_CM_boolean_flg 0 0 0.0 1.0 ECU_ADDRESS 0x0000 /* @ECU_Address@VHAL_HVBContactorSta_flg@ */ /end MEASUREMENT
/begin MEASUREMENT VHAL_ActiveDischReq_flg "" UBYTE SWC_ETE_type_CM_boolean_flg 0 0 0.0 1.0 ECU_ADDRESS 0x0000 /* @ECU_Address@VHAL_ActiveDischReq_flg@ */ /end MEASUREMENT
/begin MEASUREMENT VHAL_RrActvDmpDisabReq_flg "" UBYTE SWC_ETE_type_CM_boolean_flg 0 0 0.0 1.0 ECU_ADDRESS 0x0000 /* @ECU_Address@VHAL_RrActvDmpDisabReq_flg@ */ /end MEASUREMENT
/begin MEASUREMENT VHAL_RrMCUEnaReq_flg "" UBYTE SWC_ETE_type_CM_boolean_flg 0 0 0.0 1.0 ECU_ADDRESS 0x0000 /* @ECU_Address@VHAL_RrMCUEnaReq_flg@ */ /end MEASUREMENT
/begin MEASUREMENT VDGL_DiagOverTrq_flg "" UBYTE SWC_ETE_type_CM_boolean_flg 0 0 0.0 1.0 ECU_ADDRESS 0x0000 /* @ECU_Address@VDGL_DiagOverTrq_flg@ */ /end MEASUREMENT
/begin MEASUREMENT VOPM_MCUEna_flg "" UBYTE SWC_ETE_type_CM_boolean_flg 0 0 0.0 1.0 ECU_ADDRESS 0x0000 /* @ECU_Address@VOPM_MCUEna_flg@ */ /end MEASUREMENT
/begin MEASUREMENT VOPM_TMReady_flg "" UBYTE SWC_ETE_type_CM_boolean_flg 0 0 0.0 1.0 ECU_ADDRESS 0x0000 /* @ECU_Address@VOPM_TMReady_flg@ */ /end MEASUREMENT
/begin MEASUREMENT VOPM_BoostOPSta_flg "" UBYTE SWC_ETE_type_CM_boolean_flg 0 0 0.0 1.0 ECU_ADDRESS 0x0000 /* @ECU_Address@VOPM_BoostOPSta_flg@ */ /end MEASUREMENT
/begin MEASUREMENT VOUTP_BoostOPSta_flg "" UBYTE SWC_ETE_type_CM_boolean_flg 0 0 0.0 1.0 ECU_ADDRESS 0x0000 /* @ECU_Address@VOUTP_BoostOPSta_flg@ */ /end MEASUREMENT
/begin MEASUREMENT VOUTP_TMReady_flg "" UBYTE SWC_ETE_type_CM_boolean_flg 0 0 0.0 1.0 ECU_ADDRESS 0x0000 /* @ECU_Address@VOUTP_TMReady_flg@ */ /end MEASUREMENT
/begin MEASUREMENT VOUTP_MCUEna_flg "" UBYTE SWC_ETE_type_CM_boolean_flg 0 0 0.0 1.0 ECU_ADDRESS 0x0000 /* @ECU_Address@VOUTP_MCUEna_flg@ */ /end MEASUREMENT
/begin MEASUREMENT VOUTP_bMotEnaReq_flg "" UBYTE SWC_ETE_type_CM_boolean_flg 0 0 0.0 1.0 ECU_ADDRESS 0x0000 /* @ECU_Address@VOUTP_bMotEnaReq_flg@ */ /end MEASUREMENT
/begin MEASUREMENT VHAL_CANMsgInvalidEOPFVTRLocal1_flg "" UBYTE SWC_ETE_type_CM_boolean_flg 0 0 0.0 1.0 ECU_ADDRESS 0x0000 /* @ECU_Address@VHAL_CANMsgInvalidEOPFVTRLocal1_flg@ */ /end MEASUREMENT
/begin MEASUREMENT VHAL_CANMsgInvalidBMS1_flg "" UBYTE SWC_ETE_type_CM_boolean_flg 0 0 0.0 1.0 ECU_ADDRESS 0x0000 /* @ECU_Address@VHAL_CANMsgInvalidBMS1_flg@ */ /end MEASUREMENT
/begin MEASUREMENT VHAL_CANMsgInvalidBMS6_flg "" UBYTE SWC_ETE_type_CM_boolean_flg 0 0 0.0 1.0 ECU_ADDRESS 0x0000 /* @ECU_Address@VHAL_CANMsgInvalidBMS6_flg@ */ /end MEASUREMENT
/begin MEASUREMENT VHAL_CANMsgInvalidFD3C1000_flg "" UBYTE SWC_ETE_type_CM_boolean_flg 0 0 0.0 1.0 ECU_ADDRESS 0x0000 /* @ECU_Address@VHAL_CANMsgInvalidFD3C1000_flg@ */ /end MEASUREMENT
/begin MEASUREMENT VHAL_CANMsgInvalidFD3VCU1_flg "" UBYTE SWC_ETE_type_CM_boolean_flg 0 0 0.0 1.0 ECU_ADDRESS 0x0000 /* @ECU_Address@VHAL_CANMsgInvalidFD3VCU1_flg@ */ /end MEASUREMENT
/begin MEASUREMENT VHAL_CANMsgInvalidFD3VCU2_flg "" UBYTE SWC_ETE_type_CM_boolean_flg 0 0 0.0 1.0 ECU_ADDRESS 0x0000 /* @ECU_Address@VHAL_CANMsgInvalidFD3VCU2_flg@ */ /end MEASUREMENT
/begin MEASUREMENT VHAL_CANMsgInvalidFD3VCU5_flg "" UBYTE SWC_ETE_type_CM_boolean_flg 0 0 0.0 1.0 ECU_ADDRESS 0x0000 /* @ECU_Address@VHAL_CANMsgInvalidFD3VCU5_flg@ */ /end MEASUREMENT
/begin MEASUREMENT VHAL_CANMsgInvalidGW3CE1000_flg "" UBYTE SWC_ETE_type_CM_boolean_flg 0 0 0.0 1.0 ECU_ADDRESS 0x0000 /* @ECU_Address@VHAL_CANMsgInvalidGW3CE1000_flg@ */ /end MEASUREMENT
/begin MEASUREMENT VDGL_DiagStall_flg "" UBYTE SWC_ETE_type_CM_boolean_flg 0 0 0.0 1.0 ECU_ADDRESS 0x0000 /* @ECU_Address@VDGL_DiagStall_flg@ */ /end MEASUREMENT
/begin MEASUREMENT VDGL_TempMotWarning_flg "" UBYTE SWC_ETE_type_CM_boolean_flg 0 0 0.0 1.0 ECU_ADDRESS 0x0000 /* @ECU_Address@VDGL_TempMotWarning_flg@ */ /end MEASUREMENT
/begin MEASUREMENT VDGL_TempMotFault_flg "" UBYTE SWC_ETE_type_CM_boolean_flg 0 0 0.0 1.0 ECU_ADDRESS 0x0000 /* @ECU_Address@VDGL_TempMotFault_flg@ */ /end MEASUREMENT
/begin MEASUREMENT VDGL_TempPCBWarning_flg "" UBYTE SWC_ETE_type_CM_boolean_flg 0 0 0.0 1.0 ECU_ADDRESS 0x0000 /* @ECU_Address@VDGL_TempPCBWarning_flg@ */ /end MEASUREMENT
/begin MEASUREMENT VDGL_TempPCBFault_flg "" UBYTE SWC_ETE_type_CM_boolean_flg 0 0 0.0 1.0 ECU_ADDRESS 0x0000 /* @ECU_Address@VDGL_TempPCBFault_flg@ */ /end MEASUREMENT
/begin MEASUREMENT VDGL_TempOilWarning_flg "" UBYTE SWC_ETE_type_CM_boolean_flg 0 0 0.0 1.0 ECU_ADDRESS 0x0000 /* @ECU_Address@VDGL_TempOilWarning_flg@ */ /end MEASUREMENT
/begin MEASUREMENT VDGL_TempOilFault_flg "" UBYTE SWC_ETE_type_CM_boolean_flg 0 0 0.0 1.0 ECU_ADDRESS 0x0000 /* @ECU_Address@VDGL_TempOilFault_flg@ */ /end MEASUREMENT
/begin MEASUREMENT VDGL_TempIGBTFault_flg "" UBYTE SWC_ETE_type_CM_boolean_flg 0 0 0.0 1.0 ECU_ADDRESS 0x0000 /* @ECU_Address@VDGL_TempIGBTFault_flg@ */ /end MEASUREMENT
/begin MEASUREMENT VDGL_TempIGBTWarning_flg "" UBYTE SWC_ETE_type_CM_boolean_flg 0 0 0.0 1.0 ECU_ADDRESS 0x0000 /* @ECU_Address@VDGL_TempIGBTWarning_flg@ */ /end MEASUREMENT
/begin MEASUREMENT VDGL_HVOverErr_flg "" UBYTE SWC_ETE_type_CM_boolean_flg 0 0 0.0 1.0 ECU_ADDRESS 0x0000 /* @ECU_Address@VDGL_HVOverErr_flg@ */ /end MEASUREMENT
/begin MEASUREMENT VDGL_HVOverWarn_flg "" UBYTE SWC_ETE_type_CM_boolean_flg 0 0 0.0 1.0 ECU_ADDRESS 0x0000 /* @ECU_Address@VDGL_HVOverWarn_flg@ */ /end MEASUREMENT
/begin MEASUREMENT VDGL_HVLowErr_flg "" UBYTE SWC_ETE_type_CM_boolean_flg 0 0 0.0 1.0 ECU_ADDRESS 0x0000 /* @ECU_Address@VDGL_HVLowErr_flg@ */ /end MEASUREMENT
/begin MEASUREMENT VDGL_HVLowWarn_flg "" UBYTE SWC_ETE_type_CM_boolean_flg 0 0 0.0 1.0 ECU_ADDRESS 0x0000 /* @ECU_Address@VDGL_HVLowWarn_flg@ */ /end MEASUREMENT
/begin MEASUREMENT VDGL_DiagEOPSpdDiff_flg "" UBYTE SWC_ETE_type_CM_boolean_flg 0 0 0.0 1.0 ECU_ADDRESS 0x0000 /* @ECU_Address@VDGL_DiagEOPSpdDiff_flg@ */ /end MEASUREMENT
/begin MEASUREMENT VOPM_CurLoopEna_flg "" UBYTE SWC_ETE_type_CM_boolean_flg 0 0 0.0 1.0 ECU_ADDRESS 0x0000 /* @ECU_Address@VOPM_CurLoopEna_flg@ */ /end MEASUREMENT
/begin MEASUREMENT VOPM_PsvDischrgEna_flg "" UBYTE SWC_ETE_type_CM_boolean_flg 0 0 0.0 1.0 ECU_ADDRESS 0x0000 /* @ECU_Address@VOPM_PsvDischrgEna_flg@ */ /end MEASUREMENT
/begin MEASUREMENT VINP_CANMsgValidEOPFVTRLocal1_flg "" UBYTE SWC_ETE_type_CM_boolean_flg 0 0 0.0 1.0 ECU_ADDRESS 0x0000 /* @ECU_Address@VINP_CANMsgValidEOPFVTRLocal1_flg@ */ /end MEASUREMENT
/begin MEASUREMENT VINP_EOPFVTROverTempSta_flg "" UBYTE SWC_ETE_type_CM_boolean_flg 0 0 0.0 1.0 ECU_ADDRESS 0x0000 /* @ECU_Address@VINP_EOPFVTROverTempSta_flg@ */ /end MEASUREMENT
/begin MEASUREMENT VINP_EOPFVTRPumpReadySta_flg "" UBYTE SWC_ETE_type_CM_boolean_flg 0 0 0.0 1.0 ECU_ADDRESS 0x0000 /* @ECU_Address@VINP_EOPFVTRPumpReadySta_flg@ */ /end MEASUREMENT
/begin MEASUREMENT VINP_EOPFVTRRCInvalidSta_flg "" UBYTE SWC_ETE_type_CM_boolean_flg 0 0 0.0 1.0 ECU_ADDRESS 0x0000 /* @ECU_Address@VINP_EOPFVTRRCInvalidSta_flg@ */ /end MEASUREMENT
/begin MEASUREMENT VINP_EOPFVTRStartFailureSta_flg "" UBYTE SWC_ETE_type_CM_boolean_flg 0 0 0.0 1.0 ECU_ADDRESS 0x0000 /* @ECU_Address@VINP_EOPFVTRStartFailureSta_flg@ */ /end MEASUREMENT
/begin MEASUREMENT VINP_EOPFVTRCSInvalidSta_flg "" UBYTE SWC_ETE_type_CM_boolean_flg 0 0 0.0 1.0 ECU_ADDRESS 0x0000 /* @ECU_Address@VINP_EOPFVTRCSInvalidSta_flg@ */ /end MEASUREMENT
/begin MEASUREMENT VINP_EOPFVTRCanLossSta_flg "" UBYTE SWC_ETE_type_CM_boolean_flg 0 0 0.0 1.0 ECU_ADDRESS 0x0000 /* @ECU_Address@VINP_EOPFVTRCanLossSta_flg@ */ /end MEASUREMENT
/begin MEASUREMENT VINP_EOPFVTREnableOffSta_flg "" UBYTE SWC_ETE_type_CM_boolean_flg 0 0 0.0 1.0 ECU_ADDRESS 0x0000 /* @ECU_Address@VINP_EOPFVTREnableOffSta_flg@ */ /end MEASUREMENT
/begin MEASUREMENT VINP_EOPFVTRHallSigErrSta_flg "" UBYTE SWC_ETE_type_CM_boolean_flg 0 0 0.0 1.0 ECU_ADDRESS 0x0000 /* @ECU_Address@VINP_EOPFVTRHallSigErrSta_flg@ */ /end MEASUREMENT
/begin MEASUREMENT VINP_CANMsgValidBMS1_flg "" UBYTE SWC_ETE_type_CM_boolean_flg 0 0 0.0 1.0 ECU_ADDRESS 0x0000 /* @ECU_Address@VINP_CANMsgValidBMS1_flg@ */ /end MEASUREMENT
/begin MEASUREMENT VINP_BMS1CSErr_flg "" UBYTE SWC_ETE_type_CM_boolean_flg 0 0 0.0 1.0 ECU_ADDRESS 0x0000 /* @ECU_Address@VINP_BMS1CSErr_flg@ */ /end MEASUREMENT
/begin MEASUREMENT VINP_CANMsgValidBMS6_flg "" UBYTE SWC_ETE_type_CM_boolean_flg 0 0 0.0 1.0 ECU_ADDRESS 0x0000 /* @ECU_Address@VINP_CANMsgValidBMS6_flg@ */ /end MEASUREMENT
/begin MEASUREMENT VINP_CANMsgValidFD3C1000_flg "" UBYTE SWC_ETE_type_CM_boolean_flg 0 0 0.0 1.0 ECU_ADDRESS 0x0000 /* @ECU_Address@VINP_CANMsgValidFD3C1000_flg@ */ /end MEASUREMENT
/begin MEASUREMENT VINP_CANMsgValidFD3VCU1_flg "" UBYTE SWC_ETE_type_CM_boolean_flg 0 0 0.0 1.0 ECU_ADDRESS 0x0000 /* @ECU_Address@VINP_CANMsgValidFD3VCU1_flg@ */ /end MEASUREMENT
/begin MEASUREMENT VINP_CANMsgValidFD3VCU2_flg "" UBYTE SWC_ETE_type_CM_boolean_flg 0 0 0.0 1.0 ECU_ADDRESS 0x0000 /* @ECU_Address@VINP_CANMsgValidFD3VCU2_flg@ */ /end MEASUREMENT
/begin MEASUREMENT VINP_CANMsgValidFD3VCU5_flg "" UBYTE SWC_ETE_type_CM_boolean_flg 0 0 0.0 1.0 ECU_ADDRESS 0x0000 /* @ECU_Address@VINP_CANMsgValidFD3VCU5_flg@ */ /end MEASUREMENT
/begin MEASUREMENT VINP_CANMsgValidGW3CE1000_flg "" UBYTE SWC_ETE_type_CM_boolean_flg 0 0 0.0 1.0 ECU_ADDRESS 0x0000 /* @ECU_Address@VINP_CANMsgValidGW3CE1000_flg@ */ /end MEASUREMENT
/begin MEASUREMENT VINP_BMS6CSErr_flg "" UBYTE SWC_ETE_type_CM_boolean_flg 0 0 0.0 1.0 ECU_ADDRESS 0x0000 /* @ECU_Address@VINP_BMS6CSErr_flg@ */ /end MEASUREMENT
/begin MEASUREMENT VINP_BMS6RCErr_flg "" UBYTE SWC_ETE_type_CM_boolean_flg 0 0 0.0 1.0 ECU_ADDRESS 0x0000 /* @ECU_Address@VINP_BMS6RCErr_flg@ */ /end MEASUREMENT
/begin MEASUREMENT VINP_HVBContactorSta_flg "" UBYTE SWC_ETE_type_CM_boolean_flg 0 0 0.0 1.0 ECU_ADDRESS 0x0000 /* @ECU_Address@VINP_HVBContactorSta_flg@ */ /end MEASUREMENT
/begin MEASUREMENT VINP_ActiveDischReq_flg "" UBYTE SWC_ETE_type_CM_boolean_flg 0 0 0.0 1.0 ECU_ADDRESS 0x0000 /* @ECU_Address@VINP_ActiveDischReq_flg@ */ /end MEASUREMENT
/begin MEASUREMENT VINP_RrActvDmpDisabReq_flg "" UBYTE SWC_ETE_type_CM_boolean_flg 0 0 0.0 1.0 ECU_ADDRESS 0x0000 /* @ECU_Address@VINP_RrActvDmpDisabReq_flg@ */ /end MEASUREMENT
/begin MEASUREMENT VINP_RrMCUEnaReq_flg "" UBYTE SWC_ETE_type_CM_boolean_flg 0 0 0.0 1.0 ECU_ADDRESS 0x0000 /* @ECU_Address@VINP_RrMCUEnaReq_flg@ */ /end MEASUREMENT
/begin MEASUREMENT VINP_BMS1RCErr_flg "" UBYTE SWC_ETE_type_CM_boolean_flg 0 0 0.0 1.0 ECU_ADDRESS 0x0000 /* @ECU_Address@VINP_BMS1RCErr_flg@ */ /end MEASUREMENT
/begin MEASUREMENT VEOP_bMotEnaReq_flg "" UBYTE SWC_ETE_type_CM_boolean_flg 0 0 0.0 1.0 ECU_ADDRESS 0x0000 /* @ECU_Address@VEOP_bMotEnaReq_flg@ */ /end MEASUREMENT
/begin MEASUREMENT VROT_FreqPWM_Tick "" ULONG SWC_ETE_type_CM_uint32_Tick 0 0 0.0 100000.0 ECU_ADDRESS 0x0000 /* @ECU_Address@VROT_FreqPWM_Tick@ */ /end MEASUREMENT
/begin MEASUREMENT VFOC_RotorPosnOffset_rad "" FLOAT32_IEEE SWC_ETE_type_CM_single_rad 0 0 -2000.0 2000.0 ECU_ADDRESS 0x0000 /* @ECU_Address@VFOC_RotorPosnOffset_rad@ */ /end MEASUREMENT
/begin MEASUREMENT VFOC_FakeRotorPosn_rad "" FLOAT32_IEEE SWC_ETE_type_CM_single_rad 0 0 -10000.0 10000.0 ECU_ADDRESS 0x0000 /* @ECU_Address@VFOC_FakeRotorPosn_rad@ */ /end MEASUREMENT
/begin MEASUREMENT VPDC_DutyA_raw "" FLOAT32_IEEE SWC_ETE_type_CM_single_raw 0 0 0.0 1.0 ECU_ADDRESS 0x0000 /* @ECU_Address@VPDC_DutyA_raw@ */ /end MEASUREMENT
/begin MEASUREMENT VPDC_DutyB_raw "" FLOAT32_IEEE SWC_ETE_type_CM_single_raw 0 0 0.0 1.0 ECU_ADDRESS 0x0000 /* @ECU_Address@VPDC_DutyB_raw@ */ /end MEASUREMENT
/begin MEASUREMENT VPDC_DutyC_raw "" FLOAT32_IEEE SWC_ETE_type_CM_single_raw 0 0 0.0 1.0 ECU_ADDRESS 0x0000 /* @ECU_Address@VPDC_DutyC_raw@ */ /end MEASUREMENT
/begin MEASUREMENT VFOC_VcmdAlpha_V "" FLOAT32_IEEE SWC_ETE_type_CM_single_V 0 0 -10000.0 10000.0 ECU_ADDRESS 0x0000 /* @ECU_Address@VFOC_VcmdAlpha_V@ */ /end MEASUREMENT
/begin MEASUREMENT VFOC_VcmdBeta_V "" FLOAT32_IEEE SWC_ETE_type_CM_single_V 0 0 -10000.0 10000.0 ECU_ADDRESS 0x0000 /* @ECU_Address@VFOC_VcmdBeta_V@ */ /end MEASUREMENT
/begin MEASUREMENT VDGH_SumErrPhCurU_A "" FLOAT32_IEEE SWC_ETE_type_CM_single_A 0 0 -100000.0 100000.0 ECU_ADDRESS 0x0000 /* @ECU_Address@VDGH_SumErrPhCurU_A@ */ /end MEASUREMENT
/begin MEASUREMENT VDGH_SumErrPhCurW_A "" FLOAT32_IEEE SWC_ETE_type_CM_single_A 0 0 -100000.0 100000.0 ECU_ADDRESS 0x0000 /* @ECU_Address@VDGH_SumErrPhCurW_A@ */ /end MEASUREMENT
/begin MEASUREMENT VDGH_SumErrPhCurV_A "" FLOAT32_IEEE SWC_ETE_type_CM_single_A 0 0 -100000.0 100000.0 ECU_ADDRESS 0x0000 /* @ECU_Address@VDGH_SumErrPhCurV_A@ */ /end MEASUREMENT
/begin MEASUREMENT VCCM_iDCurrAct_A "" FLOAT32_IEEE SWC_ETE_type_CM_single_A 0 0 -10000.0 10000.0 ECU_ADDRESS 0x0000 /* @ECU_Address@VCCM_iDCurrAct_A@ */ /end MEASUREMENT
/begin MEASUREMENT VMCM_VdFwd_V "" FLOAT32_IEEE SWC_ETE_type_CM_single_V 0 0 -10000.0 10000.0 ECU_ADDRESS 0x0000 /* @ECU_Address@VMCM_VdFwd_V@ */ /end MEASUREMENT
/begin MEASUREMENT VCCM_VdRef_V "" FLOAT32_IEEE SWC_ETE_type_CM_single_V 0 0 -10000.0 10000.0 ECU_ADDRESS 0x0000 /* @ECU_Address@VCCM_VdRef_V@ */ /end MEASUREMENT
/begin MEASUREMENT VCCM_iQCurrAct_A "" FLOAT32_IEEE SWC_ETE_type_CM_single_A 0 0 -10000.0 10000.0 ECU_ADDRESS 0x0000 /* @ECU_Address@VCCM_iQCurrAct_A@ */ /end MEASUREMENT
/begin MEASUREMENT VMCM_VqFwd_V "" FLOAT32_IEEE SWC_ETE_type_CM_single_V 0 0 -10000.0 10000.0 ECU_ADDRESS 0x0000 /* @ECU_Address@VMCM_VqFwd_V@ */ /end MEASUREMENT
/begin MEASUREMENT VCCM_VqRef_V "" FLOAT32_IEEE SWC_ETE_type_CM_single_V 0 0 -10000.0 10000.0 ECU_ADDRESS 0x0000 /* @ECU_Address@VCCM_VqRef_V@ */ /end MEASUREMENT
/begin MEASUREMENT VCCM_DcHiBatLim_V "" FLOAT32_IEEE SWC_ETE_type_CM_single_V 0 0 0.0 2000.0 ECU_ADDRESS 0x0000 /* @ECU_Address@VCCM_DcHiBatLim_V@ */ /end MEASUREMENT
/begin MEASUREMENT VCCM_VdCmd_V "" FLOAT32_IEEE SWC_ETE_type_CM_single_V 0 0 -10000.0 10000.0 ECU_ADDRESS 0x0000 /* @ECU_Address@VCCM_VdCmd_V@ */ /end MEASUREMENT
/begin MEASUREMENT VCCM_VqCmd_V "" FLOAT32_IEEE SWC_ETE_type_CM_single_V 0 0 -10000.0 10000.0 ECU_ADDRESS 0x0000 /* @ECU_Address@VCCM_VqCmd_V@ */ /end MEASUREMENT
/begin MEASUREMENT VCCM_uASCVd_V "" FLOAT32_IEEE SWC_ETE_type_CM_single_V 0 0 -10000.0 10000.0 ECU_ADDRESS 0x0000 /* @ECU_Address@VCCM_uASCVd_V@ */ /end MEASUREMENT
/begin MEASUREMENT VCCM_uASCVq_V "" FLOAT32_IEEE SWC_ETE_type_CM_single_V 0 0 -10000.0 10000.0 ECU_ADDRESS 0x0000 /* @ECU_Address@VCCM_uASCVq_V@ */ /end MEASUREMENT
/begin MEASUREMENT VCCM_uAlphaVoltTar_V "" FLOAT32_IEEE SWC_ETE_type_CM_single_V 0 0 -10000.0 10000.0 ECU_ADDRESS 0x0000 /* @ECU_Address@VCCM_uAlphaVoltTar_V@ */ /end MEASUREMENT
/begin MEASUREMENT VCCM_uBetaVoltTar_V "" FLOAT32_IEEE SWC_ETE_type_CM_single_V 0 0 -10000.0 10000.0 ECU_ADDRESS 0x0000 /* @ECU_Address@VCCM_uBetaVoltTar_V@ */ /end MEASUREMENT
/begin MEASUREMENT VMCM_TqAct_Nm "" FLOAT32_IEEE SWC_ETE_type_CM_single_Nm 0 0 -10000.0 10000.0 ECU_ADDRESS 0x0000 /* @ECU_Address@VMCM_TqAct_Nm@ */ /end MEASUREMENT
/begin MEASUREMENT VMCM_TqEst_Nm "" FLOAT32_IEEE SWC_ETE_type_CM_single_Nm 0 0 -10000.0 10000.0 ECU_ADDRESS 0x0000 /* @ECU_Address@VMCM_TqEst_Nm@ */ /end MEASUREMENT
/begin MEASUREMENT VCCM_VcmdBfLim_V "" FLOAT32_IEEE SWC_ETE_type_CM_single_V 0 0 0.0 2000.0 ECU_ADDRESS 0x0000 /* @ECU_Address@VCCM_VcmdBfLim_V@ */ /end MEASUREMENT
/begin MEASUREMENT VCCM_BattVolCirRadius_V "" FLOAT32_IEEE SWC_ETE_type_CM_single_V 0 0 0.0 2000.0 ECU_ADDRESS 0x0000 /* @ECU_Address@VCCM_BattVolCirRadius_V@ */ /end MEASUREMENT
/begin MEASUREMENT VCCM_VoltUtilize_pu "" FLOAT32_IEEE SWC_ETE_type_CM_single_pu 0 0 0.0 100.0 ECU_ADDRESS 0x0000 /* @ECU_Address@VCCM_VoltUtilize_pu@ */ /end MEASUREMENT
/begin MEASUREMENT VFOC_iARaw_raw "" FLOAT32_IEEE SWC_ETE_type_CM_single_raw 0 0 -10000.0 10000.0 ECU_ADDRESS 0x0000 /* @ECU_Address@VFOC_iARaw_raw@ */ /end MEASUREMENT
/begin MEASUREMENT VFOC_iBRaw_raw "" FLOAT32_IEEE SWC_ETE_type_CM_single_raw 0 0 -10000.0 10000.0 ECU_ADDRESS 0x0000 /* @ECU_Address@VFOC_iBRaw_raw@ */ /end MEASUREMENT
/begin MEASUREMENT VFOC_iCRaw_raw "" FLOAT32_IEEE SWC_ETE_type_CM_single_raw 0 0 -10000.0 10000.0 ECU_ADDRESS 0x0000 /* @ECU_Address@VFOC_iCRaw_raw@ */ /end MEASUREMENT
/begin MEASUREMENT VPCS_PhaWCur_A "" FLOAT32_IEEE SWC_ETE_type_CM_single_A 0 0 -1.0E+7 1.0E+7 ECU_ADDRESS 0x0000 /* @ECU_Address@VPCS_PhaWCur_A@ */ /end MEASUREMENT
/begin MEASUREMENT VPCS_PhaVCur_A "" FLOAT32_IEEE SWC_ETE_type_CM_single_A 0 0 -1.0E+7 1.0E+7 ECU_ADDRESS 0x0000 /* @ECU_Address@VPCS_PhaVCur_A@ */ /end MEASUREMENT
/begin MEASUREMENT VPCS_PhaUCur_A "" FLOAT32_IEEE SWC_ETE_type_CM_single_A 0 0 -1.0E+7 1.0E+7 ECU_ADDRESS 0x0000 /* @ECU_Address@VPCS_PhaUCur_A@ */ /end MEASUREMENT
/begin MEASUREMENT VPCS_MaxPhaCurW_A "" FLOAT32_IEEE SWC_ETE_type_CM_single_A 0 0 -1.0E+7 1.0E+7 ECU_ADDRESS 0x0000 /* @ECU_Address@VPCS_MaxPhaCurW_A@ */ /end MEASUREMENT
/begin MEASUREMENT VPCS_MaxPhaCurU_A "" FLOAT32_IEEE SWC_ETE_type_CM_single_A 0 0 -1.0E+7 1.0E+7 ECU_ADDRESS 0x0000 /* @ECU_Address@VPCS_MaxPhaCurU_A@ */ /end MEASUREMENT
/begin MEASUREMENT VPCS_MaxPhaCur_A "" FLOAT32_IEEE SWC_ETE_type_CM_single_A 0 0 -1.0E+7 1.0E+7 ECU_ADDRESS 0x0000 /* @ECU_Address@VPCS_MaxPhaCur_A@ */ /end MEASUREMENT
/begin MEASUREMENT VPCS_MaxPhaCurV_A "" FLOAT32_IEEE SWC_ETE_type_CM_single_A 0 0 -1.0E+7 1.0E+7 ECU_ADDRESS 0x0000 /* @ECU_Address@VPCS_MaxPhaCurV_A@ */ /end MEASUREMENT
/begin MEASUREMENT VFOC_DCBusRAW_V "" FLOAT32_IEEE SWC_ETE_type_CM_single_V 0 0 -10000.0 10000.0 ECU_ADDRESS 0x0000 /* @ECU_Address@VFOC_DCBusRAW_V@ */ /end MEASUREMENT
/begin MEASUREMENT VFOC_DCBusVoltage_V "" FLOAT32_IEEE SWC_ETE_type_CM_single_V 0 0 -10000.0 10000.0 ECU_ADDRESS 0x0000 /* @ECU_Address@VFOC_DCBusVoltage_V@ */ /end MEASUREMENT
/begin MEASUREMENT VROT_RotSpdERaw_rads "" FLOAT32_IEEE SWC_ETE_type_CM_single_rads 0 0 -100000.0 100000.0 ECU_ADDRESS 0x0000 /* @ECU_Address@VROT_RotSpdERaw_rads@ */ /end MEASUREMENT
/begin MEASUREMENT VROT_RotSpdM_rpm "" FLOAT32_IEEE SWC_ETE_type_CM_single_rpm 0 0 -100000.0 100000.0 ECU_ADDRESS 0x0000 /* @ECU_Address@VROT_RotSpdM_rpm@ */ /end MEASUREMENT
/begin MEASUREMENT VROT_RotAgECompL_rad "" FLOAT32_IEEE SWC_ETE_type_CM_single_rad 0 0 -10.0 10.0 ECU_ADDRESS 0x0000 /* @ECU_Address@VROT_RotAgECompL_rad@ */ /end MEASUREMENT
/begin MEASUREMENT VROT_RotAngleERaw_rad "" FLOAT32_IEEE SWC_ETE_type_CM_single_rad 0 0 -10.0 10.0 ECU_ADDRESS 0x0000 /* @ECU_Address@VROT_RotAngleERaw_rad@ */ /end MEASUREMENT
/begin MEASUREMENT VROT_RotAngleE_rad "" FLOAT32_IEEE SWC_ETE_type_CM_single_rad 0 0 -10.0 10.0 ECU_ADDRESS 0x0000 /* @ECU_Address@VROT_RotAngleE_rad@ */ /end MEASUREMENT
/begin MEASUREMENT VROT_RotSpdE_rads "" FLOAT32_IEEE SWC_ETE_type_CM_single_rads 0 0 -100000.0 100000.0 ECU_ADDRESS 0x0000 /* @ECU_Address@VROT_RotSpdE_rads@ */ /end MEASUREMENT
/begin MEASUREMENT VROT_RotAgECompV_rad "" FLOAT32_IEEE SWC_ETE_type_CM_single_rad 0 0 -10.0 10.0 ECU_ADDRESS 0x0000 /* @ECU_Address@VROT_RotAgECompV_rad@ */ /end MEASUREMENT
/begin MEASUREMENT VROT_RotAngleV_rad "" FLOAT32_IEEE SWC_ETE_type_CM_single_rad 0 0 -10.0 10.0 ECU_ADDRESS 0x0000 /* @ECU_Address@VROT_RotAngleV_rad@ */ /end MEASUREMENT
/begin MEASUREMENT VPCS_WCurOffsFil_V "" FLOAT32_IEEE SWC_ETE_type_CM_single_V 0 0 -100.0 100.0 ECU_ADDRESS 0x0000 /* @ECU_Address@VPCS_WCurOffsFil_V@ */ /end MEASUREMENT
/begin MEASUREMENT VPCS_VCurOffsFil_V "" FLOAT32_IEEE SWC_ETE_type_CM_single_V 0 0 -100.0 100.0 ECU_ADDRESS 0x0000 /* @ECU_Address@VPCS_VCurOffsFil_V@ */ /end MEASUREMENT
/begin MEASUREMENT VPCS_UCurOffsFil_V "" FLOAT32_IEEE SWC_ETE_type_CM_single_V 0 0 -100.0 100.0 ECU_ADDRESS 0x0000 /* @ECU_Address@VPCS_UCurOffsFil_V@ */ /end MEASUREMENT
/begin MEASUREMENT VPCS_WCurOffsRaw_V "" FLOAT32_IEEE SWC_ETE_type_CM_single_V 0 0 -100.0 100.0 ECU_ADDRESS 0x0000 /* @ECU_Address@VPCS_WCurOffsRaw_V@ */ /end MEASUREMENT
/begin MEASUREMENT VPCS_VCurOffsRaw_V "" FLOAT32_IEEE SWC_ETE_type_CM_single_V 0 0 -100.0 100.0 ECU_ADDRESS 0x0000 /* @ECU_Address@VPCS_VCurOffsRaw_V@ */ /end MEASUREMENT
/begin MEASUREMENT VPCS_UCurOffsRaw_V "" FLOAT32_IEEE SWC_ETE_type_CM_single_V 0 0 -100.0 100.0 ECU_ADDRESS 0x0000 /* @ECU_Address@VPCS_UCurOffsRaw_V@ */ /end MEASUREMENT
/begin MEASUREMENT VPDC_Ivtr1ModCmd_enum "" UBYTE SWC_ETE_type_CM_uint8_enum 0 0 0.0 10.0 ECU_ADDRESS 0x0000 /* @ECU_Address@VPDC_Ivtr1ModCmd_enum@ */ /end MEASUREMENT
/begin MEASUREMENT VDGH_RteFault_flg "" UBYTE SWC_ETE_type_CM_boolean_flg 0 0 0.0 1.0 ECU_ADDRESS 0x0000 /* @ECU_Address@VDGH_RteFault_flg@ */ /end MEASUREMENT
/begin MEASUREMENT VDGH_100usFaultLevel2_flg "" UBYTE SWC_ETE_type_CM_boolean_flg 0 0 0.0 1.0 ECU_ADDRESS 0x0000 /* @ECU_Address@VDGH_100usFaultLevel2_flg@ */ /end MEASUREMENT
/begin MEASUREMENT VDGH_FaultLevel2_flg "" UBYTE SWC_ETE_type_CM_boolean_flg 0 0 0.0 1.0 ECU_ADDRESS 0x0000 /* @ECU_Address@VDGH_FaultLevel2_flg@ */ /end MEASUREMENT
/begin MEASUREMENT VDGH_CurOffsErrLat_flg "" UBYTE SWC_ETE_type_CM_boolean_flg 0 0 0.0 1.0 ECU_ADDRESS 0x0000 /* @ECU_Address@VDGH_CurOffsErrLat_flg@ */ /end MEASUREMENT
/begin MEASUREMENT VPDC_bASCFlgRaw_flg "" UBYTE SWC_ETE_type_CM_boolean_flg 0 0 0.0 1.0 ECU_ADDRESS 0x0000 /* @ECU_Address@VPDC_bASCFlgRaw_flg@ */ /end MEASUREMENT
/begin MEASUREMENT VDGH_OverCurrent_flg "" UBYTE SWC_ETE_type_CM_boolean_flg 0 0 0.0 1.0 ECU_ADDRESS 0x0000 /* @ECU_Address@VDGH_OverCurrent_flg@ */ /end MEASUREMENT
/begin MEASUREMENT VDGH_PhaCurrOverDQ_flg "" UBYTE SWC_ETE_type_CM_boolean_flg 0 0 0.0 1.0 ECU_ADDRESS 0x0000 /* @ECU_Address@VDGH_PhaCurrOverDQ_flg@ */ /end MEASUREMENT
/begin MEASUREMENT VDGH_PhaCurrOverW_flg "" UBYTE SWC_ETE_type_CM_boolean_flg 0 0 0.0 1.0 ECU_ADDRESS 0x0000 /* @ECU_Address@VDGH_PhaCurrOverW_flg@ */ /end MEASUREMENT
/begin MEASUREMENT VDGH_PhaCurrOverV_flg "" UBYTE SWC_ETE_type_CM_boolean_flg 0 0 0.0 1.0 ECU_ADDRESS 0x0000 /* @ECU_Address@VDGH_PhaCurrOverV_flg@ */ /end MEASUREMENT
/begin MEASUREMENT VDGH_PhaCurrOverU_flg "" UBYTE SWC_ETE_type_CM_boolean_flg 0 0 0.0 1.0 ECU_ADDRESS 0x0000 /* @ECU_Address@VDGH_PhaCurrOverU_flg@ */ /end MEASUREMENT
/begin MEASUREMENT VDGH_HWOverVoltFltLat_flg "" UBYTE SWC_ETE_type_CM_boolean_flg 0 0 0.0 1.0 ECU_ADDRESS 0x0000 /* @ECU_Address@VDGH_HWOverVoltFltLat_flg@ */ /end MEASUREMENT
/begin MEASUREMENT VDGH_HWLsideFltLat_flg "" UBYTE SWC_ETE_type_CM_boolean_flg 0 0 0.0 1.0 ECU_ADDRESS 0x0000 /* @ECU_Address@VDGH_HWLsideFltLat_flg@ */ /end MEASUREMENT
/begin MEASUREMENT VDGH_HWHsideFltLat_flg "" UBYTE SWC_ETE_type_CM_boolean_flg 0 0 0.0 1.0 ECU_ADDRESS 0x0000 /* @ECU_Address@VDGH_HWHsideFltLat_flg@ */ /end MEASUREMENT
/begin MEASUREMENT VDGH_PosSenrFaultLat_flg "" UBYTE SWC_ETE_type_CM_boolean_flg 0 0 0.0 1.0 ECU_ADDRESS 0x0000 /* @ECU_Address@VDGH_PosSenrFaultLat_flg@ */ /end MEASUREMENT
/begin MEASUREMENT VDGH_CurrFaultLat_flg "" UBYTE SWC_ETE_type_CM_boolean_flg 0 0 0.0 1.0 ECU_ADDRESS 0x0000 /* @ECU_Address@VDGH_CurrFaultLat_flg@ */ /end MEASUREMENT
/begin MEASUREMENT VDGH_SumErr_flg "" UBYTE SWC_ETE_type_CM_boolean_flg 0 0 0.0 1.0 ECU_ADDRESS 0x0000 /* @ECU_Address@VDGH_SumErr_flg@ */ /end MEASUREMENT
/begin MEASUREMENT VCCM_bASCEna_flg "" UBYTE SWC_ETE_type_CM_boolean_flg 0 0 0.0 1.0 ECU_ADDRESS 0x0000 /* @ECU_Address@VCCM_bASCEna_flg@ */ /end MEASUREMENT
/begin MEASUREMENT VCCM_CurErrorOverThd2_flg "" UBYTE SWC_ETE_type_CM_boolean_flg 0 0 0.0 1.0 ECU_ADDRESS 0x0000 /* @ECU_Address@VCCM_CurErrorOverThd2_flg@ */ /end MEASUREMENT
/begin MEASUREMENT VCCM_CurErrorOverThd_flg "" UBYTE SWC_ETE_type_CM_boolean_flg 0 0 0.0 1.0 ECU_ADDRESS 0x0000 /* @ECU_Address@VCCM_CurErrorOverThd_flg@ */ /end MEASUREMENT
/begin MEASUREMENT VPCS_EnaSnsrSelfLrn_flg "" UBYTE SWC_ETE_type_CM_boolean_flg 0 0 0.0 1.0 ECU_ADDRESS 0x0000 /* @ECU_Address@VPCS_EnaSnsrSelfLrn_flg@ */ /end MEASUREMENT
/begin MEASUREMENT VPCS_SnsrSelfLrnCompl_flg "" UBYTE SWC_ETE_type_CM_boolean_flg 0 0 0.0 1.0 ECU_ADDRESS 0x0000 /* @ECU_Address@VPCS_SnsrSelfLrnCompl_flg@ */ /end MEASUREMENT
/begin MEASUREMENT VPCS_WCurOffsVolVld_flg "" UBYTE SWC_ETE_type_CM_boolean_flg 0 0 0.0 1.0 ECU_ADDRESS 0x0000 /* @ECU_Address@VPCS_WCurOffsVolVld_flg@ */ /end MEASUREMENT
/begin MEASUREMENT VPCS_VCurOffsVolVld_flg "" UBYTE SWC_ETE_type_CM_boolean_flg 0 0 0.0 1.0 ECU_ADDRESS 0x0000 /* @ECU_Address@VPCS_VCurOffsVolVld_flg@ */ /end MEASUREMENT
/begin MEASUREMENT VPCS_UCurOffsVolVld_flg "" UBYTE SWC_ETE_type_CM_boolean_flg 0 0 0.0 1.0 ECU_ADDRESS 0x0000 /* @ECU_Address@VPCS_UCurOffsVolVld_flg@ */ /end MEASUREMENT
/begin MEASUREMENT VPCS_bCurOffsVolVld_flg "" UBYTE SWC_ETE_type_CM_boolean_flg 0 0 0.0 1.0 ECU_ADDRESS 0x0000 /* @ECU_Address@VPCS_bCurOffsVolVld_flg@ */ /end MEASUREMENT
/begin COMPU_METHOD SWC_ETE_type_CM_single_rpm "Q = V" RAT_FUNC "%8.6" "rpm" COEFFS 0 1 0 0 0 1 /end COMPU_METHOD
/begin COMPU_METHOD SWC_ETE_type_CM_single_degC "Q = V" RAT_FUNC "%8.6" "degC" COEFFS 0 1 0 0 0 1 /end COMPU_METHOD
/begin COMPU_METHOD SWC_ETE_type_CM_single_flow "Q = V" RAT_FUNC "%8.6" "flow" COEFFS 0 1 0 0 0 1 /end COMPU_METHOD
/begin COMPU_METHOD SWC_ETE_type_CM_single_M "Q = V" RAT_FUNC "%8.6" "M" COEFFS 0 1 0 0 0 1 /end COMPU_METHOD
/begin COMPU_METHOD SWC_ETE_type_CM_single_kW "Q = V" RAT_FUNC "%8.6" "kW" COEFFS 0 1 0 0 0 1 /end COMPU_METHOD
/begin COMPU_METHOD SWC_ETE_type_CM_single_Nm "Q = V" RAT_FUNC "%8.6" "Nm" COEFFS 0 1 0 0 0 1 /end COMPU_METHOD
/begin COMPU_METHOD SWC_ETE_type_CM_single_V "Q = V" RAT_FUNC "%8.6" "V" COEFFS 0 1 0 0 0 1 /end COMPU_METHOD
/begin COMPU_METHOD SWC_ETE_type_CM_single_constant "Q = V" RAT_FUNC "%8.6" "constant" COEFFS 0 1 0 0 0 1 /end COMPU_METHOD
/begin COMPU_METHOD SWC_ETE_type_CM_single_RPM "Q = V" RAT_FUNC "%8.6" "RPM" COEFFS 0 1 0 0 0 1 /end COMPU_METHOD
/begin COMPU_METHOD SWC_ETE_type_CM_single_T "Q = V" RAT_FUNC "%8.6" "T" COEFFS 0 1 0 0 0 1 /end COMPU_METHOD
/begin COMPU_METHOD SWC_ETE_type_CM_single_A "Q = V" RAT_FUNC "%8.6" "A" COEFFS 0 1 0 0 0 1 /end COMPU_METHOD
/begin COMPU_METHOD SWC_ETE_type_CM_single_cnt "Q = V" RAT_FUNC "%8.6" "cnt" COEFFS 0 1 0 0 0 1 /end COMPU_METHOD
/begin COMPU_METHOD SWC_ETE_type_CM_single_deg "Q = V" RAT_FUNC "%8.6" "deg" COEFFS 0 1 0 0 0 1 /end COMPU_METHOD
/begin COMPU_METHOD SWC_ETE_type_CM_single_ms "Q = V" RAT_FUNC "%8.6" "ms" COEFFS 0 1 0 0 0 1 /end COMPU_METHOD
/begin COMPU_METHOD SWC_ETE_type_CM_single_s "Q = V" RAT_FUNC "%8.6" "s" COEFFS 0 1 0 0 0 1 /end COMPU_METHOD
/begin COMPU_METHOD SWC_ETE_type_CM_single_C "Q = V" RAT_FUNC "%8.6" "C" COEFFS 0 1 0 0 0 1 /end COMPU_METHOD
/begin COMPU_METHOD SWC_ETE_type_CM_single_DAY "Q = V" RAT_FUNC "%8.6" "DAY" COEFFS 0 1 0 0 0 1 /end COMPU_METHOD
/begin COMPU_METHOD SWC_ETE_type_CM_single_hr "Q = V" RAT_FUNC "%8.6" "hr" COEFFS 0 1 0 0 0 1 /end COMPU_METHOD
/begin COMPU_METHOD SWC_ETE_type_CM_single_min "Q = V" RAT_FUNC "%8.6" "min" COEFFS 0 1 0 0 0 1 /end COMPU_METHOD
/begin COMPU_METHOD SWC_ETE_type_CM_single_MONTH "Q = V" RAT_FUNC "%8.6" "MONTH" COEFFS 0 1 0 0 0 1 /end COMPU_METHOD
/begin COMPU_METHOD SWC_ETE_type_CM_single_Lpmin "Q = V" RAT_FUNC "%8.6" "Lpmin" COEFFS 0 1 0 0 0 1 /end COMPU_METHOD
/begin COMPU_METHOD SWC_ETE_type_CM_single_kph "Q = V" RAT_FUNC "%8.6" "kph" COEFFS 0 1 0 0 0 1 /end COMPU_METHOD
/begin COMPU_METHOD SWC_ETE_type_CM_single_W "Q = V" RAT_FUNC "%8.6" "W" COEFFS 0 1 0 0 0 1 /end COMPU_METHOD
/begin COMPU_METHOD SWC_ETE_type_CM_single_flag "Q = V" RAT_FUNC "%8.6" "flag" COEFFS 0 1 0 0 0 1 /end COMPU_METHOD
/begin COMPU_METHOD SWC_ETE_type_CM_single_Hz "Q = V" RAT_FUNC "%8.6" "Hz" COEFFS 0 1 0 0 0 1 /end COMPU_METHOD
/begin COMPU_METHOD SWC_ETE_type_CM_int16_cnt "Q = V" RAT_FUNC "%5.0" "cnt" COEFFS 0 1 0 0 0 1 /end COMPU_METHOD
/begin COMPU_METHOD SWC_ETE_type_CM_boolean_flg "Q = V" RAT_FUNC "%1.0" "flg" COEFFS 0 1 0 0 0 1 /end COMPU_METHOD
/begin COMPU_METHOD SWC_ETE_type_CM_boolean_flag "Q = V" RAT_FUNC "%1.0" "flag" COEFFS 0 1 0 0 0 1 /end COMPU_METHOD
/begin COMPU_METHOD SWC_ETE_type_CM_boolean_constant "Q = V" RAT_FUNC "%1.0" "constant" COEFFS 0 1 0 0 0 1 /end COMPU_METHOD
/begin COMPU_METHOD SWC_ETE_type_CM_uint8_enum "Q = V" RAT_FUNC "%3.0" "enum" COEFFS 0 1 0 0 0 1 /end COMPU_METHOD
/begin COMPU_METHOD SWC_ETE_type_CM_single_value "Q = V" RAT_FUNC "%8.6" "value" COEFFS 0 1 0 0 0 1 /end COMPU_METHOD
/begin COMPU_METHOD SWC_ETE_type_CM_single_gain "Q = V" RAT_FUNC "%8.6" "gain" COEFFS 0 1 0 0 0 1 /end COMPU_METHOD
/begin COMPU_METHOD SWC_ETE_type_CM_single_null "Q = V" RAT_FUNC "%8.6" "null" COEFFS 0 1 0 0 0 1 /end COMPU_METHOD
/begin COMPU_METHOD SWC_ETE_type_CM_single_pct "Q = V" RAT_FUNC "%8.6" "pct" COEFFS 0 1 0 0 0 1 /end COMPU_METHOD
/begin COMPU_METHOD SWC_ETE_type_CM_single_rad "Q = V" RAT_FUNC "%8.6" "rad" COEFFS 0 1 0 0 0 1 /end COMPU_METHOD
/begin COMPU_METHOD SWC_ETE_type_CM_single_raw "Q = V" RAT_FUNC "%8.6" "raw" COEFFS 0 1 0 0 0 1 /end COMPU_METHOD
/begin COMPU_METHOD SWC_ETE_type_CM_single_H "Q = V" RAT_FUNC "%8.6" "H" COEFFS 0 1 0 0 0 1 /end COMPU_METHOD
/begin COMPU_METHOD SWC_ETE_type_CM_single_factor "Q = V" RAT_FUNC "%8.6" "factor" COEFFS 0 1 0 0 0 1 /end COMPU_METHOD
/begin COMPU_METHOD SWC_ETE_type_CM_single_perc "Q = V" RAT_FUNC "%8.6" "perc" COEFFS 0 1 0 0 0 1 /end COMPU_METHOD
/begin COMPU_METHOD SWC_ETE_type_CM_single_phi "Q = V" RAT_FUNC "%8.6" "phi" COEFFS 0 1 0 0 0 1 /end COMPU_METHOD
/begin COMPU_METHOD SWC_ETE_type_CM_single_p "Q = V" RAT_FUNC "%8.6" "p" COEFFS 0 1 0 0 0 1 /end COMPU_METHOD
/begin COMPU_METHOD SWC_ETE_type_CM_single_flg "Q = V" RAT_FUNC "%8.6" "flg" COEFFS 0 1 0 0 0 1 /end COMPU_METHOD
/begin COMPU_METHOD SWC_ETE_type_CM_single_tbd "Q = V" RAT_FUNC "%8.6" "tbd" COEFFS 0 1 0 0 0 1 /end COMPU_METHOD
/begin COMPU_METHOD SWC_ETE_type_CM_uint16_cnt "Q = V" RAT_FUNC "%5.0" "cnt" COEFFS 0 1 0 0 0 1 /end COMPU_METHOD
/begin COMPU_METHOD SWC_ETE_type_CM_uint8_cnt "Q = V" RAT_FUNC "%3.0" "cnt" COEFFS 0 1 0 0 0 1 /end COMPU_METHOD
/begin COMPU_METHOD SWC_ETE_type_CM_uint32_Tick "Q = V" RAT_FUNC "%10.0" "Tick" COEFFS 0 1 0 0 0 1 /end COMPU_METHOD
/begin COMPU_METHOD SWC_ETE_type_CM_single_pu "Q = V" RAT_FUNC "%8.6" "pu" COEFFS 0 1 0 0 0 1 /end COMPU_METHOD
/begin COMPU_METHOD SWC_ETE_type_CM_single_rads "Q = V" RAT_FUNC "%8.6" "rads" COEFFS 0 1 0 0 0 1 /end COMPU_METHOD
/begin COMPU_METHOD COMPU_METHOD_ENUM_MOTMOD "" TAB_VERB "%0.2" "" COMPU_TAB_REF VTAB_COMPU_METHOD_ENUM_MOTMOD /end COMPU_METHOD
/begin COMPU_VTAB VTAB_COMPU_METHOD_ENUM_MOTMOD "" TAB_VERB 16 0 "INIT" 1 "STANDBY" 2 "READY" 3 "TQCTROL" 4 "SPDCTRL" 5 "FAILURE" 6 "AFTERRUN" 7 "DISCHARGE" 8 "RESOLVERADJUST" 9 "DIAGSERV" 10 "EMERPWRDOWN" 11 "HEATING" 12 "BOOSTCHRG" 13 "RESD0D" 14 "RESD0E" 15 "INVALID" /end COMPU_VTAB
/begin COMPU_METHOD COMPU_METHOD_ENUM_IVTROPMODE "" TAB_VERB "%0.2" "" COMPU_TAB_REF VTAB_COMPU_METHOD_ENUM_IVTROPMODE /end COMPU_METHOD
/begin COMPU_VTAB VTAB_COMPU_METHOD_ENUM_IVTROPMODE "" TAB_VERB 7 0 "FW" 1 "DTCYCTRL" 2 "ASCLO" 3 "ASCHI" 4 "FLTMOD" 5 "IVTROFF" 6 "ASC" /end COMPU_VTAB
/begin GROUP SWC_ETE_type "SWC_ETE_type" /* Root */ ROOT /begin SUB_GROUP Root_run_FOC_sys /end SUB_GROUP /end GROUP
/begin GROUP Root_run_FOC_sys "SWC_ETE_type/run_FOC_sys" /begin SUB_GROUP S2_MTPA_FOC /end SUB_GROUP /end GROUP
/begin GROUP S2_MTPA_FOC "SWC_ETE_type/run_FOC_sys/MTPA_FOC"
 /begin SUB_GROUP S3_ADC_RDC_Read S3_CCM_FVT S3_DGH S3_FOC_Mode_Judge S3_PDC S3_PWM_idle_Mode S3_RotorPositionHandle /end SUB_GROUP
 /begin REF_CHARACTERISTIC KFOC_FltActn_flg_ovrdflg KFOC_FltActn_flg_ovrdfval KFOC_GateICDisable_flg KFOC_GateICEnable_flg KFOC_IdCmd_A_ovrdflg KFOC_IdCmd_A_ovrdfval KFOC_IqCmd_A_ovrdflg KFOC_IqCmd_A_ovrdfval KFOC_OpMod_enum_ovrdflg KFOC_OpMod_enum_ovrdval KFOC_SensorMode_enum KFOC_SpdCmd_RPM /end REF_CHARACTERISTIC
/end GROUP
/begin GROUP S3_ADC_RDC_Read "SWC_ETE_type/run_FOC_sys/MTPA_FOC/ADC_RDC_Read" /begin SUB_GROUP S4_PCS S4_ROT1 /end SUB_GROUP
 /begin REF_CHARACTERISTIC KFOC_ADCReadEnum_enum KFOC_DCBusLPF_c KFOC_DCBusUseRaw_flg KFOC_DCBusVoltage_V_ovrdflg KFOC_DCBusVoltage_V_ovrdval /end REF_CHARACTERISTIC
 /begin REF_MEASUREMENT VFOC_DCBusRAW_V VFOC_DCBusVoltage_V VFOC_iARaw_raw VFOC_iBRaw_raw VFOC_iCRaw_raw /end REF_MEASUREMENT
/end GROUP
/begin GROUP S3_CCM_FVT "SWC_ETE_type/run_FOC_sys/MTPA_FOC/CCM_FVT" /begin SUB_GROUP S5_CurrLoop /end SUB_GROUP /end GROUP
/begin GROUP S3_DGH "SWC_ETE_type/run_FOC_sys/MTPA_FOC/DGH"
 /begin SUB_GROUP S6_CurrentSensor S6_ER_FF1 S6_ER_FF2 S6_ER_FF3 S6_ER_FF4 S6_ER_FF5 S6_OverCurrent /end SUB_GROUP
 /begin REF_CHARACTERISTIC KDGH_FaultLevel2_flg_ovrdflg KDGH_FaultLevel2_flg_ovrdval KDGH_bRstRteFault_flg /end REF_CHARACTERISTIC
 /begin REF_MEASUREMENT VDGH_100usFaultLevel2_flg VDGH_CurOffsErrLat_flg VDGH_FaultLevel2_flg VDGH_RteFault_flg /end REF_MEASUREMENT
/end GROUP
/begin GROUP S3_FOC_Mode_Judge "SWC_ETE_type/run_FOC_sys/MTPA_FOC/FOC_Mode_Judge" /begin REF_CHARACTERISTIC KFOC_VdCmd_V KFOC_VqCmd_V /end REF_CHARACTERISTIC /begin REF_MEASUREMENT VFOC_VcmdAlpha_V VFOC_VcmdBeta_V /end REF_MEASUREMENT /end GROUP
/begin GROUP S3_PDC "SWC_ETE_type/run_FOC_sys/MTPA_FOC/PDC" /begin SUB_GROUP S13_PWMCalculation /end SUB_GROUP /end GROUP
/begin GROUP S3_PWM_idle_Mode "SWC_ETE_type/run_FOC_sys/MTPA_FOC/PWM_idle_Mode" /begin REF_CHARACTERISTIC KFOC_PWMidle_flg /end REF_CHARACTERISTIC /end GROUP
/begin GROUP S3_RotorPositionHandle "SWC_ETE_type/run_FOC_sys/MTPA_FOC/RotorPositionHandle" /begin SUB_GROUP S15_Fake_RDC_Handler /end SUB_GROUP
 /begin REF_CHARACTERISTIC KFOC_RotPosnOffset_rad_ovrdflg KFOC_RotPosnOffset_rad_ovrdval /end REF_CHARACTERISTIC
 /begin REF_MEASUREMENT VFOC_RotorPosnOffset_rad /end REF_MEASUREMENT
/end GROUP
/begin GROUP S4_PCS "SWC_ETE_type/run_FOC_sys/MTPA_FOC/ADC_RDC_Read/PCS"
 /begin SUB_GROUP S19_CalcSelfLrnOffsVal S19_MaxPha S19_SelfLrnEna S19_SnsrOffsDiag /end SUB_GROUP
 /begin REF_CHARACTERISTIC KPCS_UCurSnsr_Gain KPCS_VCurSnsr_Gain KPCS_WCurSnsr_Gain /end REF_CHARACTERISTIC
 /begin REF_MEASUREMENT VPCS_PhaUCur_A VPCS_PhaVCur_A VPCS_PhaWCur_A VPCS_SnsrSelfLrnCompl_flg /end REF_MEASUREMENT
/end GROUP
/begin GROUP S4_ROT1 "SWC_ETE_type/run_FOC_sys/MTPA_FOC/ADC_RDC_Read/ROT1" /begin SUB_GROUP S20_Subsystem S20_Variable_Fc S20_Wrapp_ S20_Wrapp_1 /end SUB_GROUP
 /begin REF_CHARACTERISTIC KFOC_PolePairs_p KROT_CurLoopPrd_t KROT_RotAngleE_rad_ovrdflg KROT_RotAngleE_rad_ovrdval KROT_RotSpdMRaw_rpm_ovrdflg KROT_RotSpdMRaw_rpm_ovrdval KROT_SpdCutoffFreq_Hz MROT_ParkCompAngle_Y_rad MROT_VolPosnOffsWiSpd_Y_deg /end REF_CHARACTERISTIC
 /begin REF_MEASUREMENT VROT_RotAgECompL_rad VROT_RotAgECompV_rad VROT_RotAngleERaw_rad VROT_RotSpdERaw_rads VROT_RotSpdE_rads VROT_RotSpdM_rpm /end REF_MEASUREMENT
/end GROUP
/begin GROUP S5_CurrLoop "SWC_ETE_type/run_FOC_sys/MTPA_FOC/CCM_FVT/CurrLoop"
 /begin SUB_GROUP S43_ASCCal S43_ActCurrDQ S43_Anti_Park S43_CurErrorOverThd S43_FwTqEsti S43_PI S43_VdqLim /end SUB_GROUP
 /begin REF_CHARACTERISTIC KRCM_IdCmd_A KRCM_IqCmd_A /end REF_CHARACTERISTIC
/end GROUP
/begin GROUP S6_CurrentSensor "SWC_ETE_type/run_FOC_sys/MTPA_FOC/DGH/CurrentSensor" /begin SUB_GROUP S107_Subsystem /end SUB_GROUP /end GROUP
/begin GROUP S6_ER_FF1 "SWC_ETE_type/run_FOC_sys/MTPA_FOC/DGH/ER_FF1" /begin SUB_GROUP S108_SWT2 /end SUB_GROUP /end GROUP
/begin GROUP S6_ER_FF2 "SWC_ETE_type/run_FOC_sys/MTPA_FOC/DGH/ER_FF2" /begin SUB_GROUP S109_SWT2 /end SUB_GROUP /end GROUP
/begin GROUP S6_ER_FF3 "SWC_ETE_type/run_FOC_sys/MTPA_FOC/DGH/ER_FF3" /begin SUB_GROUP S110_SWT2 /end SUB_GROUP /end GROUP
/begin GROUP S6_ER_FF4 "SWC_ETE_type/run_FOC_sys/MTPA_FOC/DGH/ER_FF4" /begin SUB_GROUP S111_SWT2 /end SUB_GROUP /end GROUP
/begin GROUP S6_ER_FF5 "SWC_ETE_type/run_FOC_sys/MTPA_FOC/DGH/ER_FF5" /begin SUB_GROUP S112_SWT2 /end SUB_GROUP /end GROUP
/begin GROUP S6_OverCurrent "SWC_ETE_type/run_FOC_sys/MTPA_FOC/DGH/OverCurrent" /begin SUB_GROUP S113_ER_FF S113_ER_FF1 S113_ER_FF2 S113_ER_FF3 /end SUB_GROUP
 /begin REF_CHARACTERISTIC KDGH_OverCurrentErr_C KDGH_OverCurrentHeal_C KDGH_OverCurrent_A KDGH_OverCurrent_flg_ovrdflg KDGH_OverCurrent_flg_ovrdval KDGH_PhaCurrOverU_A KDGH_PhaCurrOverV_A KDGH_PhaCurrOverW_A KDGH_RstPhaCurrOver_flg /end REF_CHARACTERISTIC
 /begin REF_MEASUREMENT VDGH_OverCurrent_flg /end REF_MEASUREMENT
/end GROUP
/begin GROUP S13_PWMCalculation "SWC_ETE_type/run_FOC_sys/MTPA_FOC/PDC/PWMCalculation"
 /begin SUB_GROUP S171_DeadTimeCompensation S171_Inverter_Control_ S171_PWMCmdCtrlEnable /end SUB_GROUP
 /begin REF_CHARACTERISTIC KPDC_facScalePWM_C /end REF_CHARACTERISTIC
 /begin REF_MEASUREMENT VPDC_DutyA_raw VPDC_DutyB_raw VPDC_DutyC_raw VPDC_bASCFlgRaw_flg /end REF_MEASUREMENT
/end GROUP
/begin GROUP S15_Fake_RDC_Handler "SWC_ETE_type/run_FOC_sys/MTPA_FOC/RotorPositionHandle/Fake_RDC_Handler" /begin REF_MEASUREMENT VFOC_FakeRotorPosn_rad /end REF_MEASUREMENT /end GROUP
/begin GROUP S19_CalcSelfLrnOffsVal "SWC_ETE_type/run_FOC_sys/MTPA_FOC/ADC_RDC_Read/PCS/CalcSelfLrnOffsVal" /begin REF_CHARACTERISTIC KPCS_OffsFilCoeff_fac /end REF_CHARACTERISTIC /begin REF_MEASUREMENT VPCS_UCurOffsRaw_V VPCS_VCurOffsRaw_V VPCS_WCurOffsRaw_V /end REF_MEASUREMENT /end GROUP
/begin GROUP S19_MaxPha "SWC_ETE_type/run_FOC_sys/MTPA_FOC/ADC_RDC_Read/PCS/MaxPha" /begin REF_CHARACTERISTIC KPCS_MaxCurrReset_flg /end REF_CHARACTERISTIC
 /begin REF_MEASUREMENT VPCS_MaxPhaCurU_A VPCS_MaxPhaCurV_A VPCS_MaxPhaCurW_A VPCS_MaxPhaCur_A /end REF_MEASUREMENT
/end GROUP
/begin GROUP S19_SelfLrnEna "SWC_ETE_type/run_FOC_sys/MTPA_FOC/ADC_RDC_Read/PCS/SelfLrnEna"
 /begin REF_CHARACTERISTIC KPCS_EnaSnsrSelfLrn_flg_ovrdflg KPCS_EnaSnsrSelfLrn_flg_ovrdval KPCS_OffsFilTi_cnt /end REF_CHARACTERISTIC
 /begin REF_MEASUREMENT VPCS_EnaSnsrSelfLrn_flg /end REF_MEASUREMENT
/end GROUP
/begin GROUP S19_SnsrOffsDiag "SWC_ETE_type/run_FOC_sys/MTPA_FOC/ADC_RDC_Read/PCS/SnsrOffsDiag"
 /begin REF_CHARACTERISTIC KPCS_PhaseCurSnsrVolDft_V KPCS_PhaseCurSnsrVolVldMax_V KPCS_PhaseCurSnsrVolVldMin_V KPCS_bCurOffsVolVld_flg_ovrdflg KPCS_bCurOffsVolVld_flg_ovrdval /end REF_CHARACTERISTIC
 /begin REF_MEASUREMENT VPCS_UCurOffsFil_V VPCS_UCurOffsVolVld_flg VPCS_VCurOffsFil_V VPCS_VCurOffsVolVld_flg VPCS_WCurOffsFil_V VPCS_WCurOffsVolVld_flg VPCS_bCurOffsVolVld_flg /end REF_MEASUREMENT
/end GROUP
/begin GROUP S20_Subsystem "SWC_ETE_type/run_FOC_sys/MTPA_FOC/ADC_RDC_Read/ROT1/Subsystem" /begin REF_MEASUREMENT VROT_FreqPWM_Tick /end REF_MEASUREMENT /end GROUP
/begin GROUP S20_Variable_Fc "SWC_ETE_type/run_FOC_sys/MTPA_FOC/ADC_RDC_Read/ROT1/Variable_Fc" /begin REF_CHARACTERISTIC KROT_bUseVariableFc_flg /end REF_CHARACTERISTIC /end GROUP
/begin GROUP S20_Wrapp_ "SWC_ETE_type/run_FOC_sys/MTPA_FOC/ADC_RDC_Read/ROT1/Wrapp " /begin REF_MEASUREMENT VROT_RotAngleV_rad /end REF_MEASUREMENT /end GROUP
/begin GROUP S20_Wrapp_1 "SWC_ETE_type/run_FOC_sys/MTPA_FOC/ADC_RDC_Read/ROT1/Wrapp 1" /begin REF_MEASUREMENT VROT_RotAngleE_rad /end REF_MEASUREMENT /end GROUP
/begin GROUP S43_ASCCal "SWC_ETE_type/run_FOC_sys/MTPA_FOC/CCM_FVT/CurrLoop/ASCCal" /begin SUB_GROUP S44_Subsystem1 /end SUB_GROUP /begin REF_CHARACTERISTIC KCCM_UdqASCEna_C /end REF_CHARACTERISTIC /begin REF_MEASUREMENT VCCM_bASCEna_flg VCCM_uASCVd_V VCCM_uASCVq_V /end REF_MEASUREMENT /end GROUP
/begin GROUP S43_ActCurrDQ "SWC_ETE_type/run_FOC_sys/MTPA_FOC/CCM_FVT/CurrLoop/ActCurrDQ" /begin SUB_GROUP S45_LowPass_Filter S45_LowPass_Filter1 /end SUB_GROUP /begin REF_CHARACTERISTIC MCCM_facLPFiDAct_Y_T MCCM_facLPFiQAct_Y_T /end REF_CHARACTERISTIC /end GROUP
/begin GROUP S43_Anti_Park "SWC_ETE_type/run_FOC_sys/MTPA_FOC/CCM_FVT/CurrLoop/Anti Park" /begin REF_MEASUREMENT VCCM_uAlphaVoltTar_V VCCM_uBetaVoltTar_V /end REF_MEASUREMENT /end GROUP
/begin GROUP S43_CurErrorOverThd "SWC_ETE_type/run_FOC_sys/MTPA_FOC/CCM_FVT/CurrLoop/CurErrorOverThd" /begin SUB_GROUP S47_ER_FF S47_ER_FF1 /end SUB_GROUP
 /begin REF_CHARACTERISTIC KCCM_bRstCurErrorOverThd_C KCCM_tiCurErrOvr_C KDSM_CurErrorThd2_value KDSM_CurErrorThd_value SampleTimeFOC /end REF_CHARACTERISTIC
/end GROUP
/begin GROUP S43_FwTqEsti "SWC_ETE_type/run_FOC_sys/MTPA_FOC/CCM_FVT/CurrLoop/FwTqEsti"
 /begin REF_CHARACTERISTIC KFOC_MagFluxLinkage_C KFOC_PolePairs_p KMCM_DFwdCoef_null KMCM_QFwdCoef_null MCCM_facCCMLd_Z_T MCCM_facCCMLq_Z_T /end REF_CHARACTERISTIC
 /begin REF_MEASUREMENT VMCM_TqAct_Nm VMCM_TqEst_Nm VMCM_VdFwd_V VMCM_VqFwd_V /end REF_MEASUREMENT
/end GROUP
/begin GROUP S43_PI "SWC_ETE_type/run_FOC_sys/MTPA_FOC/CCM_FVT/CurrLoop/PI" /begin SUB_GROUP S49_IdPI S49_IqPI /end SUB_GROUP /end GROUP
/begin GROUP S43_VdqLim "SWC_ETE_type/run_FOC_sys/MTPA_FOC/CCM_FVT/CurrLoop/VdqLim" /begin SUB_GROUP S50_VdFilter S50_VdFilter1 /end SUB_GROUP
 /begin REF_CHARACTERISTIC KCCM_VdSpSwEna_flg KCCM_VdSp_V KCCM_VolMod_perc KCCM_VqSp_V /end REF_CHARACTERISTIC
 /begin REF_MEASUREMENT VCCM_DcHiBatLim_V VCCM_VdCmd_V VCCM_VoltUtilize_pu VCCM_VqCmd_V /end REF_MEASUREMENT
/end GROUP
/begin GROUP S107_Subsystem "SWC_ETE_type/run_FOC_sys/MTPA_FOC/DGH/CurrentSensor/Subsystem" /begin SUB_GROUP S114_Sum_Err /end SUB_GROUP /end GROUP
/begin GROUP S108_SWT2 "SWC_ETE_type/run_FOC_sys/MTPA_FOC/DGH/ER_FF1/SWT2" /begin REF_MEASUREMENT VDGH_CurrFaultLat_flg /end REF_MEASUREMENT /end GROUP
/begin GROUP S109_SWT2 "SWC_ETE_type/run_FOC_sys/MTPA_FOC/DGH/ER_FF2/SWT2" /begin REF_MEASUREMENT VDGH_PosSenrFaultLat_flg /end REF_MEASUREMENT /end GROUP
/begin GROUP S110_SWT2 "SWC_ETE_type/run_FOC_sys/MTPA_FOC/DGH/ER_FF3/SWT2" /begin REF_MEASUREMENT VDGH_HWHsideFltLat_flg /end REF_MEASUREMENT /end GROUP
/begin GROUP S111_SWT2 "SWC_ETE_type/run_FOC_sys/MTPA_FOC/DGH/ER_FF4/SWT2" /begin REF_MEASUREMENT VDGH_HWLsideFltLat_flg /end REF_MEASUREMENT /end GROUP
/begin GROUP S112_SWT2 "SWC_ETE_type/run_FOC_sys/MTPA_FOC/DGH/ER_FF5/SWT2" /begin REF_MEASUREMENT VDGH_HWOverVoltFltLat_flg /end REF_MEASUREMENT /end GROUP
/begin GROUP S113_ER_FF "SWC_ETE_type/run_FOC_sys/MTPA_FOC/DGH/OverCurrent/ER_FF" /begin SUB_GROUP S147_SWT2 /end SUB_GROUP /end GROUP
/begin GROUP S113_ER_FF1 "SWC_ETE_type/run_FOC_sys/MTPA_FOC/DGH/OverCurrent/ER_FF1" /begin SUB_GROUP S148_SWT2 /end SUB_GROUP /end GROUP
/begin GROUP S113_ER_FF2 "SWC_ETE_type/run_FOC_sys/MTPA_FOC/DGH/OverCurrent/ER_FF2" /begin SUB_GROUP S149_SWT2 /end SUB_GROUP /end GROUP
/begin GROUP S113_ER_FF3 "SWC_ETE_type/run_FOC_sys/MTPA_FOC/DGH/OverCurrent/ER_FF3" /begin SUB_GROUP S150_SWT2 /end SUB_GROUP /end GROUP
/begin GROUP S171_DeadTimeCompensation "SWC_ETE_type/run_FOC_sys/MTPA_FOC/PDC/PWMCalculation/DeadTimeCompensation"
 /begin SUB_GROUP S183_MngSVMR_Base_MtrCntrl0_ProcessDCsForHWIO S183_ReInitSVMR_DeadTimeCompensation S183_ReInitSVMR_PWM_Modulation /end SUB_GROUP
 /begin REF_CHARACTERISTIC KeMCCR_b_UseMeasCrntDTC /end REF_CHARACTERISTIC
/end GROUP
/begin GROUP S171_Inverter_Control_ "SWC_ETE_type/run_FOC_sys/MTPA_FOC/PDC/PWMCalculation/Inverter Control "
 /begin REF_CHARACTERISTIC KDSM_DiagSpdH_rpm KDSM_DiagSpdL_rpm KDSM_bIvtrTarHiDebug_flg KOSP_IvtrTarMor_enum_ovrdflg KOSP_IvtrTarMor_enum_ovrdval KPDC_nPosnErrMaxSpd_C /end REF_CHARACTERISTIC
/end GROUP
/begin GROUP S171_PWMCmdCtrlEnable "SWC_ETE_type/run_FOC_sys/MTPA_FOC/PDC/PWMCalculation/PWMCmdCtrlEnable" /begin SUB_GROUP S185_ThreePhaseSC /end SUB_GROUP /begin REF_MEASUREMENT VPDC_Ivtr1ModCmd_enum /end REF_MEASUREMENT /end GROUP
/begin GROUP S44_Subsystem1 "SWC_ETE_type/run_FOC_sys/MTPA_FOC/CCM_FVT/CurrLoop/ASCCal/Subsystem1" /begin REF_CHARACTERISTIC KCCM_UdqASCTagValue_C KCCM_UdqASCTimesValue_C /end REF_CHARACTERISTIC /end GROUP
/begin GROUP S45_LowPass_Filter "SWC_ETE_type/run_FOC_sys/MTPA_FOC/CCM_FVT/CurrLoop/ActCurrDQ/LowPass_Filter" /begin REF_MEASUREMENT VCCM_iDCurrAct_A /end REF_MEASUREMENT /end GROUP
/begin GROUP S45_LowPass_Filter1 "SWC_ETE_type/run_FOC_sys/MTPA_FOC/CCM_FVT/CurrLoop/ActCurrDQ/LowPass_Filter1" /begin REF_MEASUREMENT VCCM_iQCurrAct_A /end REF_MEASUREMENT /end GROUP
/begin GROUP S47_ER_FF "SWC_ETE_type/run_FOC_sys/MTPA_FOC/CCM_FVT/CurrLoop/CurErrorOverThd/ER_FF" /begin SUB_GROUP S56_SWT2 /end SUB_GROUP /end GROUP
/begin GROUP S47_ER_FF1 "SWC_ETE_type/run_FOC_sys/MTPA_FOC/CCM_FVT/CurrLoop/CurErrorOverThd/ER_FF1" /begin SUB_GROUP S57_SWT2 /end SUB_GROUP /end GROUP
/begin GROUP S49_IdPI "SWC_ETE_type/run_FOC_sys/MTPA_FOC/CCM_FVT/CurrLoop/PI/IdPI" /begin SUB_GROUP S92_Id_Regulator /end SUB_GROUP
 /begin REF_CHARACTERISTIC KCCM_CurLoopPrd_t KCCM_FwdMask_c KCCM_IdKi_null KCCM_IdKt_null MCCM_IdKp_Y_value /end REF_CHARACTERISTIC
/end GROUP
/begin GROUP S49_IqPI "SWC_ETE_type/run_FOC_sys/MTPA_FOC/CCM_FVT/CurrLoop/PI/IqPI" /begin SUB_GROUP S93_Iq_Regulator /end SUB_GROUP
 /begin REF_CHARACTERISTIC KCCM_CurLoopPrd_t KCCM_FwdMask_c KCCM_IqKi_null KCCM_IqKt_null MCCM_IqKp_Y_value /end REF_CHARACTERISTIC
/end GROUP
/begin GROUP S50_VdFilter "SWC_ETE_type/run_FOC_sys/MTPA_FOC/CCM_FVT/CurrLoop/VdqLim/VdFilter" /begin REF_CHARACTERISTIC KCCM_BattVolFilTi_fac /end REF_CHARACTERISTIC /begin REF_MEASUREMENT VCCM_VcmdBfLim_V /end REF_MEASUREMENT /end GROUP
/begin GROUP S50_VdFilter1 "SWC_ETE_type/run_FOC_sys/MTPA_FOC/CCM_FVT/CurrLoop/VdqLim/VdFilter1" /begin REF_CHARACTERISTIC KCCM_BattVolFilTi_fac /end REF_CHARACTERISTIC /begin REF_MEASUREMENT VCCM_BattVolCirRadius_V /end REF_MEASUREMENT /end GROUP
/begin GROUP S114_Sum_Err "SWC_ETE_type/run_FOC_sys/MTPA_FOC/DGH/CurrentSensor/Subsystem/Sum_Err"
 /begin REF_CHARACTERISTIC KDGH_RstSumErr_flg KDGH_SumErrErr_C KDGH_SumErrHeal_C KDGH_SumErr_A KDGH_SumErr_flg_ovrdflg KDGH_SumErr_flg_ovrdval /end REF_CHARACTERISTIC
 /begin REF_MEASUREMENT VDGH_SumErrPhCurU_A VDGH_SumErrPhCurV_A VDGH_SumErrPhCurW_A VDGH_SumErr_flg /end REF_MEASUREMENT
/end GROUP
/begin GROUP S147_SWT2 "SWC_ETE_type/run_FOC_sys/MTPA_FOC/DGH/OverCurrent/ER_FF/SWT2" /begin REF_MEASUREMENT VDGH_PhaCurrOverU_flg /end REF_MEASUREMENT /end GROUP
/begin GROUP S148_SWT2 "SWC_ETE_type/run_FOC_sys/MTPA_FOC/DGH/OverCurrent/ER_FF1/SWT2" /begin REF_MEASUREMENT VDGH_PhaCurrOverV_flg /end REF_MEASUREMENT /end GROUP
/begin GROUP S149_SWT2 "SWC_ETE_type/run_FOC_sys/MTPA_FOC/DGH/OverCurrent/ER_FF2/SWT2" /begin REF_MEASUREMENT VDGH_PhaCurrOverW_flg /end REF_MEASUREMENT /end GROUP
/begin GROUP S150_SWT2 "SWC_ETE_type/run_FOC_sys/MTPA_FOC/DGH/OverCurrent/ER_FF3/SWT2" /begin REF_MEASUREMENT VDGH_PhaCurrOverDQ_flg /end REF_MEASUREMENT /end GROUP
/begin GROUP S183_MngSVMR_Base_MtrCntrl0_ProcessDCsForHWIO "SWC_ETE_type/run_FOC_sys/MTPA_FOC/PDC/PWMCalculation/DeadTimeCompensation/MngSVMR_Base_MtrCntrl0_ProcessDCsForHWIO" /begin SUB_GROUP S187_If_Action_Subsystem /end SUB_GROUP /end GROUP
/begin GROUP S183_ReInitSVMR_DeadTimeCompensation "SWC_ETE_type/run_FOC_sys/MTPA_FOC/PDC/PWMCalculation/DeadTimeCompensation/ReInitSVMR_DeadTimeCompensation" /begin REF_CHARACTERISTIC KeSVMR_FullDTCCurr_A KeSVMR_PWMPrd_cnt KeSVMR_t_DeadTime /end REF_CHARACTERISTIC /end GROUP
/begin GROUP S183_ReInitSVMR_PWM_Modulation "SWC_ETE_type/run_FOC_sys/MTPA_FOC/PDC/PWMCalculation/DeadTimeCompensation/ReInitSVMR_PWM_Modulation" /begin SUB_GROUP S189_Not_SVPWM_StrictClamp S189_SVPWM_StrictClamp /end SUB_GROUP /begin REF_CHARACTERISTIC KeSVMR_PWMPrd_cnt KeSVMR_b_UseStrictClamp /end REF_CHARACTERISTIC /end GROUP
/begin GROUP S185_ThreePhaseSC "SWC_ETE_type/run_FOC_sys/MTPA_FOC/PDC/PWMCalculation/PWMCmdCtrlEnable/ThreePhaseSC" /begin REF_CHARACTERISTIC KPDC_FWCnt_C /end REF_CHARACTERISTIC /end GROUP
/begin GROUP S56_SWT2 "SWC_ETE_type/run_FOC_sys/MTPA_FOC/CCM_FVT/CurrLoop/CurErrorOverThd/ER_FF/SWT2" /begin REF_MEASUREMENT VCCM_CurErrorOverThd_flg /end REF_MEASUREMENT /end GROUP
/begin GROUP S57_SWT2 "SWC_ETE_type/run_FOC_sys/MTPA_FOC/CCM_FVT/CurrLoop/CurErrorOverThd/ER_FF1/SWT2" /begin REF_MEASUREMENT VCCM_CurErrorOverThd2_flg /end REF_MEASUREMENT /end GROUP
/begin GROUP S92_Id_Regulator "SWC_ETE_type/run_FOC_sys/MTPA_FOC/CCM_FVT/CurrLoop/PI/IdPI/Id_Regulator" /begin REF_MEASUREMENT VCCM_VdRef_V /end REF_MEASUREMENT /end GROUP
/begin GROUP S93_Iq_Regulator "SWC_ETE_type/run_FOC_sys/MTPA_FOC/CCM_FVT/CurrLoop/PI/IqPI/Iq_Regulator" /begin REF_MEASUREMENT VCCM_VqRef_V /end REF_MEASUREMENT /end GROUP
/begin GROUP S187_If_Action_Subsystem "SWC_ETE_type/run_FOC_sys/MTPA_FOC/PDC/PWMCalculation/DeadTimeCompensation/MngSVMR_Base_MtrCntrl0_ProcessDCsForHWIO/If Action Subsystem"
 /begin SUB_GROUP S190_SetSVMR_SmartClamps_PhsA S190_SetSVMR_SmartClamps_PhsB S190_SetSVMR_SmartClamps_PhsC /end SUB_GROUP
/end GROUP
/begin GROUP S189_Not_SVPWM_StrictClamp "SWC_ETE_type/run_FOC_sys/MTPA_FOC/PDC/PWMCalculation/DeadTimeCompensation/ReInitSVMR_PWM_Modulation/Not_SVPWM_StrictClamp" /begin REF_CHARACTERISTIC KeSVMR_t_DeadTime KeSVMR_t_MinPulseWidth /end REF_CHARACTERISTIC /end GROUP
/begin GROUP S189_SVPWM_StrictClamp "SWC_ETE_type/run_FOC_sys/MTPA_FOC/PDC/PWMCalculation/DeadTimeCompensation/ReInitSVMR_PWM_Modulation/SVPWM_StrictClamp" /begin REF_CHARACTERISTIC KeSVMR_StrClampMaxDuty_pct KeSVMR_StrClampMinDuty_pct /end REF_CHARACTERISTIC /end GROUP
/begin GROUP S190_SetSVMR_SmartClamps_PhsA "SWC_ETE_type/run_FOC_sys/MTPA_FOC/PDC/PWMCalculation/DeadTimeCompensation/MngSVMR_Base_MtrCntrl0_ProcessDCsForHWIO/If Action Subsystem/SetSVMR_SmartClamps_PhsA" /begin REF_CHARACTERISTIC KeSVMR_b_UseStrictClamp /end REF_CHARACTERISTIC /end GROUP
/begin GROUP S190_SetSVMR_SmartClamps_PhsB "SWC_ETE_type/run_FOC_sys/MTPA_FOC/PDC/PWMCalculation/DeadTimeCompensation/MngSVMR_Base_MtrCntrl0_ProcessDCsForHWIO/If Action Subsystem/SetSVMR_SmartClamps_PhsB" /begin REF_CHARACTERISTIC KeSVMR_b_UseStrictClamp /end REF_CHARACTERISTIC /end GROUP
/begin GROUP S190_SetSVMR_SmartClamps_PhsC "SWC_ETE_type/run_FOC_sys/MTPA_FOC/PDC/PWMCalculation/DeadTimeCompensation/MngSVMR_Base_MtrCntrl0_ProcessDCsForHWIO/If Action Subsystem/SetSVMR_SmartClamps_PhsC" /begin REF_CHARACTERISTIC KeSVMR_b_UseStrictClamp /end REF_CHARACTERISTIC /end GROUP
/end MODULE
/end PROJECT
/* (add any file trailer comments here) */
/* EOF SWC_ETE_type.a2l */
