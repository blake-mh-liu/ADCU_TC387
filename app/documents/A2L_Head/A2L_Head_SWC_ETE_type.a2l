/******************************************************************************
* ASAP2 file: hcu_main.a2l
* Code generation for model "hcu_main".
* Model version : 3.10
* Simulink Coder version : 9.6 (R2021b) 14-May-2021
* C source code generated on : Wed Sep 28 09:25:40 2022
* Target selection: ert.tlc
* Embedded hardware selection: ARM Compatible->ARM 10
* Code generation objectives: Unspecified
* Validation result: Not run
* (add additional file header information here)
******************************************************************************/ ASAP2_VERSION 1 60
/* Version 1.60 */
/begin PROJECT ProjectName "Project Comment Goes Here"
/begin HEADER "Header Comments go here" /end HEADER
/begin MODULE ModuleName "Module Comment Goes Here"
/begin MOD_COMMON "Mod Common Comment Here" BYTE_ORDER MSB_LAST ALIGNMENT_BYTE 1 ALIGNMENT_WORD 2 ALIGNMENT_LONG 2 ALIGNMENT_FLOAT32_IEEE 2 ALIGNMENT_FLOAT64_IEEE 4 /end MOD_COMMON
/begin IF_DATA XCPplus
 /begin PROTOCOL_LAYER 0x0104 /* XCP protocol layer version 1.04 */ 2000 /* T1 [ms] */ 2000 /* T2 [ms] */ 2000 /* T3 [ms] */ 2000 /* T4 [ms] */ 2000 /* T5 [ms] */ 0005 /* T6 [ms] */ 0005 /* T7 [ms] */ 0x8 /* MAX_CTO */ 0x40 /* MAX_DTO */ BYTE_ORDER_MSB_LAST ADDRESS_GRANULARITY_BYTE /* SEED_AND_KEY_EXTERNAL_FUNCTION "stm32f1_seed_key.dll" */ OPTIONAL_CMD GET_COMM_MODE_INFO OPTIONAL_CMD GET_ID OPTIONAL_CMD SET_REQUEST OPTIONAL_CMD GET_SEED OPTIONAL_CMD UNLOCK OPTIONAL_CMD SET_MTA OPTIONAL_CMD UPLOAD OPTIONAL_CMD SHORT_UPLOAD OPTIONAL_CMD BUILD_CHECKSUM OPTIONAL_CMD TRANSPORT_LAYER_CMD OPTIONAL_CMD USER_CMD OPTIONAL_CMD DOWNLOAD OPTIONAL_CMD DOWNLOAD_NEXT OPTIONAL_CMD SET_CAL_PAGE OPTIONAL_CMD GET_CAL_PAGE OPTIONAL_CMD GET_PAG_PROCESSOR_INFO OPTIONAL_CMD SET_DAQ_PTR OPTIONAL_CMD WRITE_DAQ OPTIONAL_CMD SET_DAQ_LIST_MODE OPTIONAL_CMD GET_DAQ_LIST_MODE OPTIONAL_CMD START_STOP_DAQ_LIST OPTIONAL_CMD START_STOP_SYNCH OPTIONAL_CMD GET_DAQ_CLOCK OPTIONAL_CMD READ_DAQ OPTIONAL_CMD GET_DAQ_PROCESSOR_INFO OPTIONAL_CMD GET_DAQ_RESOLUTION_INFO OPTIONAL_CMD GET_DAQ_LIST_INFO OPTIONAL_CMD GET_DAQ_EVENT_INFO OPTIONAL_CMD FREE_DAQ OPTIONAL_CMD ALLOC_DAQ OPTIONAL_CMD ALLOC_ODT OPTIONAL_CMD ALLOC_ODT_ENTRY OPTIONAL_CMD PROGRAM_START OPTIONAL_CMD PROGRAM OPTIONAL_CMD PROGRAM_CLEAR OPTIONAL_CMD PROGRAM_RESET OPTIONAL_CMD PROGRAM_NEXT OPTIONAL_CMD COPY_CAL_PAGE OPTIONAL_CMD MODIFY_BITS
  /begin COMMUNICATION_MODE_SUPPORTED /begin BLOCK SLAVE MASTER 0xff 100 /end BLOCK /end COMMUNICATION_MODE_SUPPORTED
 /end PROTOCOL_LAYER
 /begin DAQ STATIC /* DAQ_CONFIG_TYPE */ 0x03 /* MAX_DAQ */ 0x03 /* MAX_EVENT_CHANNEL */ 0x00 /* MIN_DAQ */ OPTIMISATION_TYPE_DEFAULT /* OPTIMISATION_TYPE */ ADDRESS_EXTENSION_FREE /* ADDRESS_EXTENSION */ IDENTIFICATION_FIELD_TYPE_ABSOLUTE /* IDENTIFICATION_FIELD */ GRANULARITY_ODT_ENTRY_SIZE_DAQ_BYTE /* GRANULARITY_ODT_ENTRY_SIZE_DAQ */ 0x08 /* MAX_ODT_ENTRY_SIZE_DAQ */ NO_OVERLOAD_INDICATION PRESCALER_SUPPORTED
  /begin TIMESTAMP_SUPPORTED 1 /* TIMESTAMP_TICKS */ SIZE_WORD /* TIMESTAMP_SIZE */ UNIT_1MS /* TIMESTAMP_UNIT */ /end TIMESTAMP_SUPPORTED
  /begin DAQ_LIST 0 DAQ_LIST_TYPE DAQ MAX_ODT 2 MAX_ODT_ENTRIES 63 FIRST_PID 0 EVENT_FIXED 0 /end DAQ_LIST
  /begin DAQ_LIST 1 DAQ_LIST_TYPE DAQ MAX_ODT 2 MAX_ODT_ENTRIES 63 FIRST_PID 16 EVENT_FIXED 1 /end DAQ_LIST
  /begin DAQ_LIST 2 DAQ_LIST_TYPE DAQ MAX_ODT 2 MAX_ODT_ENTRIES 63 FIRST_PID 32 EVENT_FIXED 2 /end DAQ_LIST
  /begin EVENT "10ms" "10ms" 0 DAQ_STIM 0xff 10 6 0 /end EVENT
  /begin EVENT "20ms" "20ms" 1 DAQ_STIM 0xff 20 6 0 /end EVENT
  /begin EVENT "100ms" "100ms" 2 DAQ_STIM 0xff 10 7 0 /end EVENT
 /end DAQ
 /begin PAG 0x02 /* MAX_SEGMENTS */ FREEZE_SUPPORTED /end PAG
 /begin PGM PGM_MODE_ABSOLUTE 3 /* MAX_SECTORS */ 0x08 /* MAX_CTO_PGM */ /begin SECTOR "sector 0" 0 0x0 0x1000 2 2 0 /end SECTOR /begin SECTOR "sector 1" 1 0x1000 0x2000 1 1 0 /end SECTOR /begin SECTOR "sector 2" 2 0x3000 0x3000 0 0 0 /end SECTOR COMMUNICATION_MODE_SUPPORTED BLOCK SLAVE MASTER 0xff /* MAX_BS_PGM */ 100 /* MIN_ST_PGM */ /end PGM
 /begin XCP_ON_CAN 0x0104 /* XCP on CAN version */ CAN_ID_MASTER 0x0667 /* CMD/STIM */ CAN_ID_SLAVE 0x0621 /* RES/ERR/EV/SERV */ BAUDRATE 500000 /* BAUDRATE */ SAMPLE_POINT 80 /* SAMPLE POINT */ SAMPLE_RATE SINGLE /* SAMPLE RATE */ BTL_CYCLES 0 /* BTL CYCLES */ SJW 2 /* SJW */ SYNC_EDGE SINGLE /* SYNC EDGE */
  /begin CAN_FD MAX_DLC 64 /* 8, 12, 16, 20, 24, 32, 48 or 64 */ CAN_FD_DATA_TRANSFER_BAUDRATE 2000000 SAMPLE_POINT 80 BTL_CYCLES 0x14 SJW 0x04 /* MAX_DLC_REQUIRED */ SECONDARY_SAMPLE_POINT 0x00 TRANSCEIVER_DELAY_COMPENSATION OFF /end CAN_FD
  /begin DAQ_LIST_CAN_ID 0 FIXED 0x0621 /end DAQ_LIST_CAN_ID
  /begin DAQ_LIST_CAN_ID 1 FIXED 0x0621 /end DAQ_LIST_CAN_ID
  /begin DAQ_LIST_CAN_ID 2 FIXED 0x0621 /end DAQ_LIST_CAN_ID
 /end XCP_ON_CAN
/end IF_DATA
/begin MOD_PAR "MOD PAR Comment Goes Here" VERSION "V0.1" ADDR_EPK 0x0 EPK "" SUPPLIER "FVT" CUSTOMER "FVT internal + Demosample" CUSTOMER_NO "NONE Demo" USER "ETAS-PGA/EAP - Dm" PHONE_NO "0" ECU "S32G274A / CAN " CPU_TYPE "S32G274A" NO_OF_INTERFACES 1 /* CODE (ROM) */
 /begin MEMORY_SEGMENT APP_CODE "" CODE FLASH INTERN 0x80005000 /* int_sram start Address (rom start)*/ 0x10000 /* int_sram Size (rom size)*/ -1 -1 -1 -1 -1 /* no mirrored segments */
  /begin IF_DATA XCP
   /begin SEGMENT 0x00 /* segment logical number */ 0x01 /* number of pages */ 0x00 /* address extension */ 0x00 /* Compression method */ 0x00 /* Encryption method */
    /begin CHECKSUM XCP_CRC_16_CITT /* checksum through external function */ MAX_BLOCK_SIZE 0x00000800 /* maximum block size */ /end CHECKSUM
    /begin PAGE 0x00 /* page number */ ECU_ACCESS_WITH_XCP_ONLY XCP_READ_ACCESS_WITH_ECU_ONLY XCP_WRITE_ACCESS_NOT_ALLOWED /end PAGE
   /end SEGMENT
  /end IF_DATA
 /end MEMORY_SEGMENT
 /* REFERENCE PAGE (ROM) */
 /begin MEMORY_SEGMENT APP_CALIBDATA_Core1 "" DATA FLASH INTERN 0x803ec000 /* CAL START ADDRESS (CAL1 start)*/ 0x14000 /* CAL PAGE SIZE (All CALx size combine)*/ -1 -1 -1 -1 -1
  /begin IF_DATA XCP
   /begin SEGMENT 0x01 /* segment logical number */ 0x01 /* number of pages */ 0x00 /* address extension */ 0x00 /* Compression method */ 0x00 /* Encryption method */
    /begin CHECKSUM XCP_CRC_16_CITT /* checksum through external function */ MAX_BLOCK_SIZE 0x00000800 /* maximum block size */ /end CHECKSUM
    /begin PAGE 0x00 /* page number */ ECU_ACCESS_WITH_XCP_ONLY XCP_READ_ACCESS_WITH_ECU_ONLY XCP_WRITE_ACCESS_WITH_ECU_ONLY INIT_SEGMENT 0x00 /end PAGE
    /begin ADDRESS_MAPPING 0x803ec000 /* CAL from (CAL1 start)*/ 0xb0000000 /* CAL to (CAL1 start)*/ 0x14000 /* CAL length (All CALx size combine)*/ /end ADDRESS_MAPPING
   /end SEGMENT
  /end IF_DATA
 /end MEMORY_SEGMENT
 ECU_CALIBRATION_OFFSET 0xd03ec000 /* VARIABLE PAGE (RAM) */
 /begin MEMORY_SEGMENT DATA_BSS_CORE0 "" RESERVED RAM INTERN 0x70037800 /* data_bss_sram START ADDRESS (VAR1 start)*/ 0x800 /* data_bss_sram SIZE (All VARx size combine)*/ -1 -1 -1 -1 -1 /end MEMORY_SEGMENT
 /begin MEMORY_SEGMENT RAM_CORE0_CALIBDATA "" VARIABLES /* CALIBRATION_VARIABLES */ RAM INTERN 0xb0000000 /* VARIABLE PAGE START ADDRESS (VAR1 start)*/ 0x800 /* VARIABLE PAGE SIZE (All VARx size combine)*/ -1 -1 -1 -1 -1 /end MEMORY_SEGMENT
 /begin MEMORY_SEGMENT DATA_BSS_CORE1 "" RESERVED RAM INTERN 0x60037000 /* data_bss_sram START ADDRESS (VAR1 start)*/ 0x1000 /* data_bss_sram SIZE (All VARx size combine)*/ -1 -1 -1 -1 -1 /end MEMORY_SEGMENT
 /begin MEMORY_SEGMENT RAM_CORE1_CALIBDATA "" VARIABLES /* CALIBRATION_VARIABLES */ RAM INTERN 0xb0010000 /* VARIABLE PAGE START ADDRESS (VAR1 start)*/ 0x4000 /* VARIABLE PAGE SIZE (All VARx size combine)*/ -1 -1 -1 -1 -1 /end MEMORY_SEGMENT
/end MOD_PAR
/end MODULE
/end PROJECT
