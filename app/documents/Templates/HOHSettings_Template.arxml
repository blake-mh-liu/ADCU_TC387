AUTOSAR XML (schema 4-3-0)
HOH_1_CAN3 (CanHardwareObject): CanHandleType=BASIC, CanHwFIFOThreshold=1, CanHwObjectCount=12, CanIdType=STANDARD, CanObjectId=0, CanObjectType=RECEIVE, CanControllerRef=CAN3
  CanHwFilter: CanHwFilterCode=339, CanHwFilterMask=2047
