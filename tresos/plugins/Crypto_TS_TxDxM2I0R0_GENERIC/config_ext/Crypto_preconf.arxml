AUTOSAR XML (schema 4-3-0)
package /TS_TxDxM2I0R0_GENERIC
  module config Crypto_preconf: definition=Crypto, implementation-config-variant=VARIANT-PRE-COMPILE
    PublishedInformation: PbcfgMSupport=false
    CryptoKeyElements
      30 x CryptoKeyElement:
        CryptoKeyElement_CRYPTO_KE_CIPHER_KEY: CryptoKeyElementId=1
        CryptoKeyElement_CRYPTO_KE_CIPHER_IV: CryptoKeyElementId=5
        CryptoKeyElement_CRYPTO_KE_CIPHER_PROOF: CryptoKeyElementId=6
        CryptoKeyElement_CRYPTO_KE_CIPHER_2NDKEY: CryptoKeyElementId=7
        CryptoKeyElement_CRYPTO_XVIX_XAIX_KE_CCM_MAC_LEN: CryptoKeyElementId=1008
        CryptoKeyElement_CRYPTO_KE_MAC_KEY: CryptoKeyElementId=1
        CryptoKeyElement_CRYPTO_KE_MAC_PROOF: CryptoKeyElementId=2
        CryptoKeyElement_CRYPTO_KE_SIGNATURE_KEY: CryptoKeyElementId=1
        CryptoKeyElement_CRYPTO_KE_SIGNATURE_CURVETYPE: CryptoKeyElementId=29
        CryptoKeyElement_CRYPTO_KE_RANDOM_SEED_STATE: CryptoKeyElementId=3
        CryptoKeyElement_CRYPTO_KE_RANDOM_ALGORITHM: CryptoKeyElementId=4
        CryptoKeyElement_CRYPTO_KE_KEYEXCHANGE_BASE: CryptoKeyElementId=8
        CryptoKeyElement_CRYPTO_KE_KEYEXCHANGE_PRIVKEY: CryptoKeyElementId=9
        CryptoKeyElement_CRYPTO_KE_KEYEXCHANGE_OWNPUBKEY: CryptoKeyElementId=10
        CryptoKeyElement_CYRPTO_KE_KEYEXCHANGE_SHAREDVALUE: CryptoKeyElementId=1
        CryptoKeyElement_CRYPTO_KE_KEYEXCHANGE_ALGORITHM: CryptoKeyElementId=12
        CryptoKeyElement_CRYPTO_KE_KEYDERIVATION_PASSWORD: CryptoKeyElementId=1
        CryptoKeyElement_CRYPTO_KE_KEYDERIVATION_SALT: CryptoKeyElementId=13
        CryptoKeyElement_CRYPTO_KE_KEYDERIVATION_ITERATIONS: CryptoKeyElementId=14
        CryptoKeyElement_CRYPTO_KE_KEYDERIVATION_ALGORITHM: CryptoKeyElementId=15
        CryptoKeyElement_CRYPTO_XVIX_XAIX_KE_KEYDERIVATION_FIXEDINFOID: CryptoKeyElementId=1007
        CryptoKeyElement_CRYPTO_XVIX_XAIX_INT_KMN_KEYDERIVE_SINGLESTEPKDF_NOTSET_KEYTARGETID: CryptoKeyElementId=1
        CryptoKeyElement_CRYPTO_KE_KEYGENERATE_KEY: CryptoKeyElementId=1
        CryptoKeyElement_CRYPTO_KE_KEYGENERATE_SEED: CryptoKeyElementId=16
        CryptoKeyElement_CRYPTO_KE_KEYGENERATE_ALGORITHM: CryptoKeyElementId=17
        CryptoKeyElement_CRYPTO_KE_AES_EXPANDEDKEY: CryptoKeyElementId=1000
        CryptoKeyElement_CRYPTO_KE_CMAC_K1: CryptoKeyElementId=1001
        CryptoKeyElement_CRYPTO_KE_CMAC_K2: CryptoKeyElementId=1002
        CryptoKeyElement_CRYPTO_KE_RSA_BARRETT: CryptoKeyElementId=1003
        CryptoKeyElement_CRYPTO_KE_KMNCOMMON_WORKSPACE: CryptoKeyElementId=1006
    CryptoKeyTypes
      7 x CryptoKeyType:
        CryptoKeyType_CIPHER: CryptoKeyElementRef=CryptoKeyElement_CRYPTO_KE_CIPHER_KEY
        CryptoKeyType_MAC: CryptoKeyElementRef=CryptoKeyElement_CRYPTO_KE_MAC_KEY
        CryptoKeyType_SIGNATURE: CryptoKeyElementRef=CryptoKeyElement_CRYPTO_KE_SIGNATURE_KEY
        CryptoKeyType_RANDOM: CryptoKeyElementRef=CryptoKeyElement_CRYPTO_KE_RANDOM_SEED_STATE, CryptoKeyElementRef=CryptoKeyElement_CRYPTO_KE_RANDOM_ALGORITHM
        CryptoKeyType_KEYEXCHANGE: CryptoKeyElementRef=CryptoKeyElement_CRYPTO_KE_KEYEXCHANGE_BASE, CryptoKeyElementRef=CryptoKeyElement_CRYPTO_KE_KEYEXCHANGE_PRIVKEY, CryptoKeyElementRef=CryptoKeyElement_CRYPTO_KE_KEYEXCHANGE_OWNPUBKEY, CryptoKeyElementRef=CryptoKeyElement_CYRPTO_KE_KEYEXCHANGE_SHAREDVALUE, CryptoKeyElementRef=CryptoKeyElement_CRYPTO_KE_KEYEXCHANGE_ALGORITHM, CryptoKeyElementRef=CryptoKeyElement_CRYPTO_KE_KMNCOMMON_WORKSPACE
        CryptoKeyType_KEYDERIVE: CryptoKeyElementRef=CryptoKeyElement_CRYPTO_KE_KEYDERIVATION_PASSWORD, CryptoKeyElementRef=CryptoKeyElement_CRYPTO_XVIX_XAIX_KE_KEYDERIVATION_FIXEDINFOID, CryptoKeyElementRef=CryptoKeyElement_CRYPTO_KE_KEYDERIVATION_ALGORITHM
        CryptoKeyType_KEYGENERATE: CryptoKeyElementRef=CryptoKeyElement_CRYPTO_KE_KEYGENERATE_KEY
    CryptoPrimitives
      94 x CryptoPrimitive:
        CryptoPrimitive_AEADDECRYPT_AES_CCM: CryptoPrimitiveAlgorithmFamiliy=CRYPTO_ALGOFAM_AES, CryptoPrimitiveAlgorithmMode=CRYPTO_ALGOMODE_CCM, CryptoPrimitiveAlgorithmSecondaryFamiliy=CRYPTO_ALGOFAM_NOT_SET, CryptoPrimitiveService=AEAD_DECRYPT
        CryptoPrimitive_AEADDECRYPT_AES_GCM: CryptoPrimitiveAlgorithmFamiliy=CRYPTO_ALGOFAM_AES, CryptoPrimitiveAlgorithmMode=CRYPTO_ALGOMODE_GCM, CryptoPrimitiveAlgorithmSecondaryFamiliy=CRYPTO_ALGOFAM_NOT_SET, CryptoPrimitiveService=AEAD_DECRYPT
        CryptoPrimitive_AEADENCRYPT_AES_CCM: CryptoPrimitiveAlgorithmFamiliy=CRYPTO_ALGOFAM_AES, CryptoPrimitiveAlgorithmMode=CRYPTO_ALGOMODE_CCM, CryptoPrimitiveAlgorithmSecondaryFamiliy=CRYPTO_ALGOFAM_NOT_SET, CryptoPrimitiveService=AEAD_ENCRYPT
        CryptoPrimitive_AEADENCRYPT_AES_GCM: CryptoPrimitiveAlgorithmFamiliy=CRYPTO_ALGOFAM_AES, CryptoPrimitiveAlgorithmMode=CRYPTO_ALGOMODE_GCM, CryptoPrimitiveAlgorithmSecondaryFamiliy=CRYPTO_ALGOFAM_NOT_SET, CryptoPrimitiveService=AEAD_ENCRYPT
        CryptoPrimitive_DECRYPT_AES_CBC_PADDINGPKCS7: CryptoPrimitiveAlgorithmFamiliy=CRYPTO_ALGOFAM_AES, CryptoPrimitiveAlgorithmMode=CRYPTO_ALGOMODE_CBC, CryptoPrimitiveAlgorithmSecondaryFamiliy=CRYPTO_ALGOFAM_PADDING_PKCS7, CryptoPrimitiveService=DECRYPT
        CryptoPrimitive_DECRYPT_AES_CBC_PADDINGTLS12: CryptoPrimitiveAlgorithmFamiliy=CRYPTO_ALGOFAM_AES, CryptoPrimitiveAlgorithmMode=CRYPTO_ALGOMODE_CBC, CryptoPrimitiveAlgorithmSecondaryFamiliy=CRYPTO_ALGOFAM_PADDING_TLS12, CryptoPrimitiveService=DECRYPT
        CryptoPrimitive_DECRYPT_AES_CBC: CryptoPrimitiveAlgorithmFamiliy=CRYPTO_ALGOFAM_AES, CryptoPrimitiveAlgorithmMode=CRYPTO_ALGOMODE_CBC, CryptoPrimitiveAlgorithmSecondaryFamiliy=CRYPTO_ALGOFAM_NOT_SET, CryptoPrimitiveService=DECRYPT
        CryptoPrimitive_DECRYPT_AES_ECB: CryptoPrimitiveAlgorithmFamiliy=CRYPTO_ALGOFAM_AES, CryptoPrimitiveAlgorithmMode=CRYPTO_ALGOMODE_ECB, CryptoPrimitiveAlgorithmSecondaryFamiliy=CRYPTO_ALGOFAM_NOT_SET, CryptoPrimitiveService=DECRYPT
        CryptoPrimitive_DECRYPT_LZSS_STREAMBIT: CryptoPrimitiveAlgorithmFamiliy=CRYPTO_ALGOFAM_LZSS, CryptoPrimitiveAlgorithmMode=CRYPTO_ALGOMODE_STREAMBIT, CryptoPrimitiveAlgorithmSecondaryFamiliy=CRYPTO_ALGOFAM_NOT_SET, CryptoPrimitiveService=DECRYPT
        CryptoPrimitive_DECRYPT_LZSS_STREAMBYTE: CryptoPrimitiveAlgorithmFamiliy=CRYPTO_ALGOFAM_LZSS, CryptoPrimitiveAlgorithmMode=CRYPTO_ALGOMODE_STREAMBYTE, CryptoPrimitiveAlgorithmSecondaryFamiliy=CRYPTO_ALGOFAM_NOT_SET, CryptoPrimitiveService=DECRYPT
        CryptoPrimitive_DECRYPT_RSA_RSAESOAEP_SHA1: CryptoPrimitiveAlgorithmFamiliy=CRYPTO_ALGOFAM_RSA, CryptoPrimitiveAlgorithmMode=CRYPTO_ALGOMODE_RSAES_OAEP, CryptoPrimitiveAlgorithmSecondaryFamiliy=CRYPTO_ALGOFAM_SHA1, CryptoPrimitiveService=DECRYPT
        CryptoPrimitive_DECRYPT_RSA_RSAESOAEP_SHA2224: CryptoPrimitiveAlgorithmFamiliy=CRYPTO_ALGOFAM_RSA, CryptoPrimitiveAlgorithmMode=CRYPTO_ALGOMODE_RSAES_OAEP, CryptoPrimitiveAlgorithmSecondaryFamiliy=CRYPTO_ALGOFAM_SHA2_224, CryptoPrimitiveService=DECRYPT
        CryptoPrimitive_DECRYPT_RSA_RSAESOAEP_SHA2256: CryptoPrimitiveAlgorithmFamiliy=CRYPTO_ALGOFAM_RSA, CryptoPrimitiveAlgorithmMode=CRYPTO_ALGOMODE_RSAES_OAEP, CryptoPrimitiveAlgorithmSecondaryFamiliy=CRYPTO_ALGOFAM_SHA2_256, CryptoPrimitiveService=DECRYPT
        CryptoPrimitive_DECRYPT_RSA_RSAESOAEP_SHA2384: CryptoPrimitiveAlgorithmFamiliy=CRYPTO_ALGOFAM_RSA, CryptoPrimitiveAlgorithmMode=CRYPTO_ALGOMODE_RSAES_OAEP, CryptoPrimitiveAlgorithmSecondaryFamiliy=CRYPTO_ALGOFAM_SHA2_384, CryptoPrimitiveService=DECRYPT
        CryptoPrimitive_DECRYPT_RSA_RSAESOAEP_SHA2512: CryptoPrimitiveAlgorithmFamiliy=CRYPTO_ALGOFAM_RSA, CryptoPrimitiveAlgorithmMode=CRYPTO_ALGOMODE_RSAES_OAEP, CryptoPrimitiveAlgorithmSecondaryFamiliy=CRYPTO_ALGOFAM_SHA2_512, CryptoPrimitiveService=DECRYPT
        CryptoPrimitive_DECRYPT_RSA_RSAESOAEP_SHA3224: CryptoPrimitiveAlgorithmFamiliy=CRYPTO_ALGOFAM_RSA, CryptoPrimitiveAlgorithmMode=CRYPTO_ALGOMODE_RSAES_OAEP, CryptoPrimitiveAlgorithmSecondaryFamiliy=CRYPTO_ALGOFAM_SHA3_224, CryptoPrimitiveService=DECRYPT
        CryptoPrimitive_DECRYPT_RSA_RSAESOAEP_SHA3256: CryptoPrimitiveAlgorithmFamiliy=CRYPTO_ALGOFAM_RSA, CryptoPrimitiveAlgorithmMode=CRYPTO_ALGOMODE_RSAES_OAEP, CryptoPrimitiveAlgorithmSecondaryFamiliy=CRYPTO_ALGOFAM_SHA3_256, CryptoPrimitiveService=DECRYPT
        CryptoPrimitive_DECRYPT_RSA_RSAESOAEP_SHA3384: CryptoPrimitiveAlgorithmFamiliy=CRYPTO_ALGOFAM_RSA, CryptoPrimitiveAlgorithmMode=CRYPTO_ALGOMODE_RSAES_OAEP, CryptoPrimitiveAlgorithmSecondaryFamiliy=CRYPTO_ALGOFAM_SHA3_384, CryptoPrimitiveService=DECRYPT
        CryptoPrimitive_DECRYPT_RSA_RSAESOAEP_SHA3512: CryptoPrimitiveAlgorithmFamiliy=CRYPTO_ALGOFAM_RSA, CryptoPrimitiveAlgorithmMode=CRYPTO_ALGOMODE_RSAES_OAEP, CryptoPrimitiveAlgorithmSecondaryFamiliy=CRYPTO_ALGOFAM_SHA3_512, CryptoPrimitiveService=DECRYPT
        CryptoPrimitive_ENCRYPT_AES_CBC_PADDINGPKCS7: CryptoPrimitiveAlgorithmFamiliy=CRYPTO_ALGOFAM_AES, CryptoPrimitiveAlgorithmMode=CRYPTO_ALGOMODE_CBC, CryptoPrimitiveAlgorithmSecondaryFamiliy=CRYPTO_ALGOFAM_PADDING_PKCS7, CryptoPrimitiveService=ENCRYPT
        CryptoPrimitive_ENCRYPT_AES_CBC_PADDINGTLS12: CryptoPrimitiveAlgorithmFamiliy=CRYPTO_ALGOFAM_AES, CryptoPrimitiveAlgorithmMode=CRYPTO_ALGOMODE_CBC, CryptoPrimitiveAlgorithmSecondaryFamiliy=CRYPTO_ALGOFAM_PADDING_TLS12, CryptoPrimitiveService=ENCRYPT
        CryptoPrimitive_ENCRYPT_AES_CBC: CryptoPrimitiveAlgorithmFamiliy=CRYPTO_ALGOFAM_AES, CryptoPrimitiveAlgorithmMode=CRYPTO_ALGOMODE_CBC, CryptoPrimitiveAlgorithmSecondaryFamiliy=CRYPTO_ALGOFAM_NOT_SET, CryptoPrimitiveService=ENCRYPT
        CryptoPrimitive_ENCRYPT_AES_ECB: CryptoPrimitiveAlgorithmFamiliy=CRYPTO_ALGOFAM_AES, CryptoPrimitiveAlgorithmMode=CRYPTO_ALGOMODE_ECB, CryptoPrimitiveAlgorithmSecondaryFamiliy=CRYPTO_ALGOFAM_NOT_SET, CryptoPrimitiveService=ENCRYPT
        CryptoPrimitive_ENCRYPT_RSA_RSAESOAEP_SHA1: CryptoPrimitiveAlgorithmFamiliy=CRYPTO_ALGOFAM_RSA, CryptoPrimitiveAlgorithmMode=CRYPTO_ALGOMODE_RSAES_OAEP, CryptoPrimitiveAlgorithmSecondaryFamiliy=CRYPTO_ALGOFAM_SHA1, CryptoPrimitiveService=ENCRYPT
        CryptoPrimitive_ENCRYPT_RSA_RSAESOAEP_SHA2224: CryptoPrimitiveAlgorithmFamiliy=CRYPTO_ALGOFAM_RSA, CryptoPrimitiveAlgorithmMode=CRYPTO_ALGOMODE_RSAES_OAEP, CryptoPrimitiveAlgorithmSecondaryFamiliy=CRYPTO_ALGOFAM_SHA2_224, CryptoPrimitiveService=ENCRYPT
        CryptoPrimitive_ENCRYPT_RSA_RSAESOAEP_SHA2256: CryptoPrimitiveAlgorithmFamiliy=CRYPTO_ALGOFAM_RSA, CryptoPrimitiveAlgorithmMode=CRYPTO_ALGOMODE_RSAES_OAEP, CryptoPrimitiveAlgorithmSecondaryFamiliy=CRYPTO_ALGOFAM_SHA2_256, CryptoPrimitiveService=ENCRYPT
        CryptoPrimitive_ENCRYPT_RSA_RSAESOAEP_SHA2384: CryptoPrimitiveAlgorithmFamiliy=CRYPTO_ALGOFAM_RSA, CryptoPrimitiveAlgorithmMode=CRYPTO_ALGOMODE_RSAES_OAEP, CryptoPrimitiveAlgorithmSecondaryFamiliy=CRYPTO_ALGOFAM_SHA2_384, CryptoPrimitiveService=ENCRYPT
        CryptoPrimitive_ENCRYPT_RSA_RSAESOAEP_SHA2512: CryptoPrimitiveAlgorithmFamiliy=CRYPTO_ALGOFAM_RSA, CryptoPrimitiveAlgorithmMode=CRYPTO_ALGOMODE_RSAES_OAEP, CryptoPrimitiveAlgorithmSecondaryFamiliy=CRYPTO_ALGOFAM_SHA2_512, CryptoPrimitiveService=ENCRYPT
        CryptoPrimitive_ENCRYPT_RSA_RSAESOAEP_SHA3224: CryptoPrimitiveAlgorithmFamiliy=CRYPTO_ALGOFAM_RSA, CryptoPrimitiveAlgorithmMode=CRYPTO_ALGOMODE_RSAES_OAEP, CryptoPrimitiveAlgorithmSecondaryFamiliy=CRYPTO_ALGOFAM_SHA3_224, CryptoPrimitiveService=ENCRYPT
        CryptoPrimitive_ENCRYPT_RSA_RSAESOAEP_SHA3256: CryptoPrimitiveAlgorithmFamiliy=CRYPTO_ALGOFAM_RSA, CryptoPrimitiveAlgorithmMode=CRYPTO_ALGOMODE_RSAES_OAEP, CryptoPrimitiveAlgorithmSecondaryFamiliy=CRYPTO_ALGOFAM_SHA3_256, CryptoPrimitiveService=ENCRYPT
        CryptoPrimitive_ENCRYPT_RSA_RSAESOAEP_SHA3384: CryptoPrimitiveAlgorithmFamiliy=CRYPTO_ALGOFAM_RSA, CryptoPrimitiveAlgorithmMode=CRYPTO_ALGOMODE_RSAES_OAEP, CryptoPrimitiveAlgorithmSecondaryFamiliy=CRYPTO_ALGOFAM_SHA3_384, CryptoPrimitiveService=ENCRYPT
        CryptoPrimitive_ENCRYPT_RSA_RSAESOAEP_SHA3512: CryptoPrimitiveAlgorithmFamiliy=CRYPTO_ALGOFAM_RSA, CryptoPrimitiveAlgorithmMode=CRYPTO_ALGOMODE_RSAES_OAEP, CryptoPrimitiveAlgorithmSecondaryFamiliy=CRYPTO_ALGOFAM_SHA3_512, CryptoPrimitiveService=ENCRYPT
        CryptoPrimitive_HASH_SHA1_NOTSET: CryptoPrimitiveAlgorithmFamiliy=CRYPTO_ALGOFAM_SHA1, CryptoPrimitiveAlgorithmMode=CRYPTO_ALGOMODE_NOT_SET, CryptoPrimitiveAlgorithmSecondaryFamiliy=CRYPTO_ALGOFAM_NOT_SET, CryptoPrimitiveService=HASH
        CryptoPrimitive_HASH_SHA2224_NOTSET: CryptoPrimitiveAlgorithmFamiliy=CRYPTO_ALGOFAM_SHA2_224, CryptoPrimitiveAlgorithmMode=CRYPTO_ALGOMODE_NOT_SET, CryptoPrimitiveAlgorithmSecondaryFamiliy=CRYPTO_ALGOFAM_NOT_SET, CryptoPrimitiveService=HASH
        CryptoPrimitive_HASH_SHA2256_NOTSET: CryptoPrimitiveAlgorithmFamiliy=CRYPTO_ALGOFAM_SHA2_256, CryptoPrimitiveAlgorithmMode=CRYPTO_ALGOMODE_NOT_SET, CryptoPrimitiveAlgorithmSecondaryFamiliy=CRYPTO_ALGOFAM_NOT_SET, CryptoPrimitiveService=HASH
        CryptoPrimitive_HASH_SHA2384_NOTSET: CryptoPrimitiveAlgorithmFamiliy=CRYPTO_ALGOFAM_SHA2_384, CryptoPrimitiveAlgorithmMode=CRYPTO_ALGOMODE_NOT_SET, CryptoPrimitiveAlgorithmSecondaryFamiliy=CRYPTO_ALGOFAM_NOT_SET, CryptoPrimitiveService=HASH
        CryptoPrimitive_HASH_SHA2512_NOTSET: CryptoPrimitiveAlgorithmFamiliy=CRYPTO_ALGOFAM_SHA2_512, CryptoPrimitiveAlgorithmMode=CRYPTO_ALGOMODE_NOT_SET, CryptoPrimitiveAlgorithmSecondaryFamiliy=CRYPTO_ALGOFAM_NOT_SET, CryptoPrimitiveService=HASH
        CryptoPrimitive_HASH_SHA3224_NOTSET: CryptoPrimitiveAlgorithmFamiliy=CRYPTO_ALGOFAM_SHA3_224, CryptoPrimitiveAlgorithmMode=CRYPTO_ALGOMODE_NOT_SET, CryptoPrimitiveAlgorithmSecondaryFamiliy=CRYPTO_ALGOFAM_NOT_SET, CryptoPrimitiveService=HASH
        CryptoPrimitive_HASH_SHA3256_NOTSET: CryptoPrimitiveAlgorithmFamiliy=CRYPTO_ALGOFAM_SHA3_256, CryptoPrimitiveAlgorithmMode=CRYPTO_ALGOMODE_NOT_SET, CryptoPrimitiveAlgorithmSecondaryFamiliy=CRYPTO_ALGOFAM_NOT_SET, CryptoPrimitiveService=HASH
        CryptoPrimitive_HASH_SHA3384_NOTSET: CryptoPrimitiveAlgorithmFamiliy=CRYPTO_ALGOFAM_SHA3_384, CryptoPrimitiveAlgorithmMode=CRYPTO_ALGOMODE_NOT_SET, CryptoPrimitiveAlgorithmSecondaryFamiliy=CRYPTO_ALGOFAM_NOT_SET, CryptoPrimitiveService=HASH
        CryptoPrimitive_HASH_SHA3512_NOTSET: CryptoPrimitiveAlgorithmFamiliy=CRYPTO_ALGOFAM_SHA3_512, CryptoPrimitiveAlgorithmMode=CRYPTO_ALGOMODE_NOT_SET, CryptoPrimitiveAlgorithmSecondaryFamiliy=CRYPTO_ALGOFAM_NOT_SET, CryptoPrimitiveService=HASH
        CryptoPrimitive_MACGENERATE_AES_CMAC: CryptoPrimitiveAlgorithmFamiliy=CRYPTO_ALGOFAM_AES, CryptoPrimitiveAlgorithmMode=CRYPTO_ALGOMODE_CMAC, CryptoPrimitiveAlgorithmSecondaryFamiliy=CRYPTO_ALGOFAM_NOT_SET, CryptoPrimitiveService=MAC_GENERATE
        CryptoPrimitive_MACGENERATE_SHA1_HMAC: CryptoPrimitiveAlgorithmFamiliy=CRYPTO_ALGOFAM_SHA1, CryptoPrimitiveAlgorithmMode=CRYPTO_ALGOMODE_HMAC, CryptoPrimitiveAlgorithmSecondaryFamiliy=CRYPTO_ALGOFAM_NOT_SET, CryptoPrimitiveService=MAC_GENERATE
        CryptoPrimitive_MACGENERATE_SHA2224_HMAC: CryptoPrimitiveAlgorithmFamiliy=CRYPTO_ALGOFAM_SHA2_224, CryptoPrimitiveAlgorithmMode=CRYPTO_ALGOMODE_HMAC, CryptoPrimitiveAlgorithmSecondaryFamiliy=CRYPTO_ALGOFAM_NOT_SET, CryptoPrimitiveService=MAC_GENERATE
        CryptoPrimitive_MACGENERATE_SHA2256_HMAC: CryptoPrimitiveAlgorithmFamiliy=CRYPTO_ALGOFAM_SHA2_256, CryptoPrimitiveAlgorithmMode=CRYPTO_ALGOMODE_HMAC, CryptoPrimitiveAlgorithmSecondaryFamiliy=CRYPTO_ALGOFAM_NOT_SET, CryptoPrimitiveService=MAC_GENERATE
        CryptoPrimitive_MACGENERATE_SHA2384_HMAC: CryptoPrimitiveAlgorithmFamiliy=CRYPTO_ALGOFAM_SHA2_384, CryptoPrimitiveAlgorithmMode=CRYPTO_ALGOMODE_HMAC, CryptoPrimitiveAlgorithmSecondaryFamiliy=CRYPTO_ALGOFAM_NOT_SET, CryptoPrimitiveService=MAC_GENERATE
        CryptoPrimitive_MACGENERATE_SHA2512_HMAC: CryptoPrimitiveAlgorithmFamiliy=CRYPTO_ALGOFAM_SHA2_512, CryptoPrimitiveAlgorithmMode=CRYPTO_ALGOMODE_HMAC, CryptoPrimitiveAlgorithmSecondaryFamiliy=CRYPTO_ALGOFAM_NOT_SET, CryptoPrimitiveService=MAC_GENERATE
        CryptoPrimitive_MACGENERATE_SIPHASH_SIPHASH24: CryptoPrimitiveAlgorithmFamiliy=CRYPTO_ALGOFAM_SIPHASH, CryptoPrimitiveAlgorithmMode=CRYPTO_ALGOMODE_SIPHASH_2_4, CryptoPrimitiveAlgorithmSecondaryFamiliy=CRYPTO_ALGOFAM_NOT_SET, CryptoPrimitiveService=MAC_GENERATE
        CryptoPrimitive_MACVERIFY_AES_CMAC: CryptoPrimitiveAlgorithmFamiliy=CRYPTO_ALGOFAM_AES, CryptoPrimitiveAlgorithmMode=CRYPTO_ALGOMODE_CMAC, CryptoPrimitiveAlgorithmSecondaryFamiliy=CRYPTO_ALGOFAM_NOT_SET, CryptoPrimitiveService=MAC_VERIFY
        CryptoPrimitive_MACVERIFY_SHA1_HMAC: CryptoPrimitiveAlgorithmFamiliy=CRYPTO_ALGOFAM_SHA1, CryptoPrimitiveAlgorithmMode=CRYPTO_ALGOMODE_HMAC, CryptoPrimitiveAlgorithmSecondaryFamiliy=CRYPTO_ALGOFAM_NOT_SET, CryptoPrimitiveService=MAC_VERIFY
        CryptoPrimitive_MACVERIFY_SHA2224_HMAC: CryptoPrimitiveAlgorithmFamiliy=CRYPTO_ALGOFAM_SHA2_224, CryptoPrimitiveAlgorithmMode=CRYPTO_ALGOMODE_HMAC, CryptoPrimitiveAlgorithmSecondaryFamiliy=CRYPTO_ALGOFAM_NOT_SET, CryptoPrimitiveService=MAC_VERIFY
        CryptoPrimitive_MACVERIFY_SHA2256_HMAC: CryptoPrimitiveAlgorithmFamiliy=CRYPTO_ALGOFAM_SHA2_256, CryptoPrimitiveAlgorithmMode=CRYPTO_ALGOMODE_HMAC, CryptoPrimitiveAlgorithmSecondaryFamiliy=CRYPTO_ALGOFAM_NOT_SET, CryptoPrimitiveService=MAC_VERIFY
        CryptoPrimitive_MACVERIFY_SHA2384_HMAC: CryptoPrimitiveAlgorithmFamiliy=CRYPTO_ALGOFAM_SHA2_384, CryptoPrimitiveAlgorithmMode=CRYPTO_ALGOMODE_HMAC, CryptoPrimitiveAlgorithmSecondaryFamiliy=CRYPTO_ALGOFAM_NOT_SET, CryptoPrimitiveService=MAC_VERIFY
        CryptoPrimitive_MACVERIFY_SHA2512_HMAC: CryptoPrimitiveAlgorithmFamiliy=CRYPTO_ALGOFAM_SHA2_512, CryptoPrimitiveAlgorithmMode=CRYPTO_ALGOMODE_HMAC, CryptoPrimitiveAlgorithmSecondaryFamiliy=CRYPTO_ALGOFAM_NOT_SET, CryptoPrimitiveService=MAC_VERIFY
        CryptoPrimitive_MACVERIFY_SIPHASH_SIPHASH24: CryptoPrimitiveAlgorithmFamiliy=CRYPTO_ALGOFAM_SIPHASH, CryptoPrimitiveAlgorithmMode=CRYPTO_ALGOMODE_SIPHASH_2_4, CryptoPrimitiveAlgorithmSecondaryFamiliy=CRYPTO_ALGOFAM_NOT_SET, CryptoPrimitiveService=MAC_VERIFY
        CryptoPrimitive_RANDOMGENERATE_AES_CTRDRBG: CryptoPrimitiveAlgorithmFamiliy=CRYPTO_ALGOFAM_AES, CryptoPrimitiveAlgorithmMode=CRYPTO_ALGOMODE_CTRDRBG, CryptoPrimitiveAlgorithmSecondaryFamiliy=CRYPTO_ALGOFAM_NOT_SET, CryptoPrimitiveService=RANDOM
        CryptoPrimitive_RANDOMGENERATE_NOTSET_NOTSET: CryptoPrimitiveAlgorithmFamiliy=CRYPTO_ALGOFAM_NOT_SET, CryptoPrimitiveAlgorithmMode=CRYPTO_ALGOMODE_NOT_SET, CryptoPrimitiveAlgorithmSecondaryFamiliy=CRYPTO_ALGOFAM_NOT_SET, CryptoPrimitiveService=RANDOM
        CryptoPrimitive_SIGNATUREGENERATE_ED25519PH_NOTSET_SHA2512: CryptoPrimitiveAlgorithmFamiliy=CRYPTO_ALGOFAM_ED25519PH, CryptoPrimitiveAlgorithmMode=CRYPTO_ALGOMODE_NOT_SET, CryptoPrimitiveAlgorithmSecondaryFamiliy=CRYPTO_ALGOFAM_SHA2_512, CryptoPrimitiveService=SIGNATURE_GENERATE
        CryptoPrimitive_SIGNATUREGENERATE_ED25519_NOTSET_SHA2512: CryptoPrimitiveAlgorithmFamiliy=CRYPTO_ALGOFAM_ED25519, CryptoPrimitiveAlgorithmMode=CRYPTO_ALGOMODE_NOT_SET, CryptoPrimitiveAlgorithmSecondaryFamiliy=CRYPTO_ALGOFAM_SHA2_512, CryptoPrimitiveService=SIGNATURE_GENERATE
        CryptoPrimitive_SIGNATUREGENERATE_RSA_RSASSAPKCS1V15_SHA1: CryptoPrimitiveAlgorithmFamiliy=CRYPTO_ALGOFAM_RSA, CryptoPrimitiveAlgorithmMode=CRYPTO_ALGOMODE_RSASSA_PKCS1_v1_5, CryptoPrimitiveAlgorithmSecondaryFamiliy=CRYPTO_ALGOFAM_SHA1, CryptoPrimitiveService=SIGNATURE_GENERATE
        CryptoPrimitive_SIGNATUREGENERATE_RSA_RSASSAPKCS1V15_SHA2224: CryptoPrimitiveAlgorithmFamiliy=CRYPTO_ALGOFAM_RSA, CryptoPrimitiveAlgorithmMode=CRYPTO_ALGOMODE_RSASSA_PKCS1_v1_5, CryptoPrimitiveAlgorithmSecondaryFamiliy=CRYPTO_ALGOFAM_SHA2_224, CryptoPrimitiveService=SIGNATURE_GENERATE
        CryptoPrimitive_SIGNATUREGENERATE_RSA_RSASSAPKCS1V15_SHA2256: CryptoPrimitiveAlgorithmFamiliy=CRYPTO_ALGOFAM_RSA, CryptoPrimitiveAlgorithmMode=CRYPTO_ALGOMODE_RSASSA_PKCS1_v1_5, CryptoPrimitiveAlgorithmSecondaryFamiliy=CRYPTO_ALGOFAM_SHA2_256, CryptoPrimitiveService=SIGNATURE_GENERATE
        CryptoPrimitive_SIGNATUREGENERATE_RSA_RSASSAPKCS1V15_SHA2384: CryptoPrimitiveAlgorithmFamiliy=CRYPTO_ALGOFAM_RSA, CryptoPrimitiveAlgorithmMode=CRYPTO_ALGOMODE_RSASSA_PKCS1_v1_5, CryptoPrimitiveAlgorithmSecondaryFamiliy=CRYPTO_ALGOFAM_SHA2_384, CryptoPrimitiveService=SIGNATURE_GENERATE
        CryptoPrimitive_SIGNATUREGENERATE_RSA_RSASSAPKCS1V15_SHA2512: CryptoPrimitiveAlgorithmFamiliy=CRYPTO_ALGOFAM_RSA, CryptoPrimitiveAlgorithmMode=CRYPTO_ALGOMODE_RSASSA_PKCS1_v1_5, CryptoPrimitiveAlgorithmSecondaryFamiliy=CRYPTO_ALGOFAM_SHA2_512, CryptoPrimitiveService=SIGNATURE_GENERATE
        CryptoPrimitive_SIGNATUREGENERATE_RSA_RSASSAPKCS1V15_SHA3224: CryptoPrimitiveAlgorithmFamiliy=CRYPTO_ALGOFAM_RSA, CryptoPrimitiveAlgorithmMode=CRYPTO_ALGOMODE_RSASSA_PKCS1_v1_5, CryptoPrimitiveAlgorithmSecondaryFamiliy=CRYPTO_ALGOFAM_SHA3_224, CryptoPrimitiveService=SIGNATURE_GENERATE
        CryptoPrimitive_SIGNATUREGENERATE_RSA_RSASSAPKCS1V15_SHA3256: CryptoPrimitiveAlgorithmFamiliy=CRYPTO_ALGOFAM_RSA, CryptoPrimitiveAlgorithmMode=CRYPTO_ALGOMODE_RSASSA_PKCS1_v1_5, CryptoPrimitiveAlgorithmSecondaryFamiliy=CRYPTO_ALGOFAM_SHA3_256, CryptoPrimitiveService=SIGNATURE_GENERATE
        CryptoPrimitive_SIGNATUREGENERATE_RSA_RSASSAPKCS1V15_SHA3384: CryptoPrimitiveAlgorithmFamiliy=CRYPTO_ALGOFAM_RSA, CryptoPrimitiveAlgorithmMode=CRYPTO_ALGOMODE_RSASSA_PKCS1_v1_5, CryptoPrimitiveAlgorithmSecondaryFamiliy=CRYPTO_ALGOFAM_SHA3_384, CryptoPrimitiveService=SIGNATURE_GENERATE
        CryptoPrimitive_SIGNATUREGENERATE_RSA_RSASSAPKCS1V15_SHA3512: CryptoPrimitiveAlgorithmFamiliy=CRYPTO_ALGOFAM_RSA, CryptoPrimitiveAlgorithmMode=CRYPTO_ALGOMODE_RSASSA_PKCS1_v1_5, CryptoPrimitiveAlgorithmSecondaryFamiliy=CRYPTO_ALGOFAM_SHA3_512, CryptoPrimitiveService=SIGNATURE_GENERATE
        CryptoPrimitive_SIGNATUREVERIFY_ECDSA_NOTSET_SHA2256: CryptoPrimitiveAlgorithmFamiliy=CRYPTO_ALGOFAM_ECDSA, CryptoPrimitiveAlgorithmMode=CRYPTO_ALGOMODE_NOT_SET, CryptoPrimitiveAlgorithmSecondaryFamiliy=CRYPTO_ALGOFAM_SHA2_256, CryptoPrimitiveService=SIGNATURE_VERIFY
        CryptoPrimitive_SIGNATUREVERIFY_ECDSA_NOTSET_SHA2384: CryptoPrimitiveAlgorithmFamiliy=CRYPTO_ALGOFAM_ECDSA, CryptoPrimitiveAlgorithmMode=CRYPTO_ALGOMODE_NOT_SET, CryptoPrimitiveAlgorithmSecondaryFamiliy=CRYPTO_ALGOFAM_SHA2_384, CryptoPrimitiveService=SIGNATURE_VERIFY
        CryptoPrimitive_SIGNATUREVERIFY_ECDSA_NOTSET_SHA2512: CryptoPrimitiveAlgorithmFamiliy=CRYPTO_ALGOFAM_ECDSA, CryptoPrimitiveAlgorithmMode=CRYPTO_ALGOMODE_NOT_SET, CryptoPrimitiveAlgorithmSecondaryFamiliy=CRYPTO_ALGOFAM_SHA2_512, CryptoPrimitiveService=SIGNATURE_VERIFY
        CryptoPrimitive_SIGNATUREVERIFY_ECDSA_NOTSET_SHA3256: CryptoPrimitiveAlgorithmFamiliy=CRYPTO_ALGOFAM_ECDSA, CryptoPrimitiveAlgorithmMode=CRYPTO_ALGOMODE_NOT_SET, CryptoPrimitiveAlgorithmSecondaryFamiliy=CRYPTO_ALGOFAM_SHA3_256, CryptoPrimitiveService=SIGNATURE_VERIFY
        CryptoPrimitive_SIGNATUREVERIFY_ECDSA_NOTSET_SHA3384: CryptoPrimitiveAlgorithmFamiliy=CRYPTO_ALGOFAM_ECDSA, CryptoPrimitiveAlgorithmMode=CRYPTO_ALGOMODE_NOT_SET, CryptoPrimitiveAlgorithmSecondaryFamiliy=CRYPTO_ALGOFAM_SHA3_384, CryptoPrimitiveService=SIGNATURE_VERIFY
        CryptoPrimitive_SIGNATUREVERIFY_ECDSA_NOTSET_SHA3512: CryptoPrimitiveAlgorithmFamiliy=CRYPTO_ALGOFAM_ECDSA, CryptoPrimitiveAlgorithmMode=CRYPTO_ALGOMODE_NOT_SET, CryptoPrimitiveAlgorithmSecondaryFamiliy=CRYPTO_ALGOFAM_SHA3_512, CryptoPrimitiveService=SIGNATURE_VERIFY
        CryptoPrimitive_SIGNATUREVERIFY_ED25519PH_NOTSET_SHA2512: CryptoPrimitiveAlgorithmFamiliy=CRYPTO_ALGOFAM_ED25519PH, CryptoPrimitiveAlgorithmMode=CRYPTO_ALGOMODE_NOT_SET, CryptoPrimitiveAlgorithmSecondaryFamiliy=CRYPTO_ALGOFAM_SHA2_512, CryptoPrimitiveService=SIGNATURE_VERIFY
        CryptoPrimitive_SIGNATUREVERIFY_ED25519_NOTSET_SHA2512: CryptoPrimitiveAlgorithmFamiliy=CRYPTO_ALGOFAM_ED25519, CryptoPrimitiveAlgorithmMode=CRYPTO_ALGOMODE_NOT_SET, CryptoPrimitiveAlgorithmSecondaryFamiliy=CRYPTO_ALGOFAM_SHA2_512, CryptoPrimitiveService=SIGNATURE_VERIFY
        CryptoPrimitive_SIGNATUREVERIFY_RSA_RSASSAPKCS1V15_SHA1: CryptoPrimitiveAlgorithmFamiliy=CRYPTO_ALGOFAM_RSA, CryptoPrimitiveAlgorithmMode=CRYPTO_ALGOMODE_RSASSA_PKCS1_v1_5, CryptoPrimitiveAlgorithmSecondaryFamiliy=CRYPTO_ALGOFAM_SHA1, CryptoPrimitiveService=SIGNATURE_VERIFY
        CryptoPrimitive_SIGNATUREVERIFY_RSA_RSASSAPKCS1V15_SHA2224: CryptoPrimitiveAlgorithmFamiliy=CRYPTO_ALGOFAM_RSA, CryptoPrimitiveAlgorithmMode=CRYPTO_ALGOMODE_RSASSA_PKCS1_v1_5, CryptoPrimitiveAlgorithmSecondaryFamiliy=CRYPTO_ALGOFAM_SHA2_224, CryptoPrimitiveService=SIGNATURE_VERIFY
        CryptoPrimitive_SIGNATUREVERIFY_RSA_RSASSAPKCS1V15_SHA2256: CryptoPrimitiveAlgorithmFamiliy=CRYPTO_ALGOFAM_RSA, CryptoPrimitiveAlgorithmMode=CRYPTO_ALGOMODE_RSASSA_PKCS1_v1_5, CryptoPrimitiveAlgorithmSecondaryFamiliy=CRYPTO_ALGOFAM_SHA2_256, CryptoPrimitiveService=SIGNATURE_VERIFY
        CryptoPrimitive_SIGNATUREVERIFY_RSA_RSASSAPKCS1V15_SHA2384: CryptoPrimitiveAlgorithmFamiliy=CRYPTO_ALGOFAM_RSA, CryptoPrimitiveAlgorithmMode=CRYPTO_ALGOMODE_RSASSA_PKCS1_v1_5, CryptoPrimitiveAlgorithmSecondaryFamiliy=CRYPTO_ALGOFAM_SHA2_384, CryptoPrimitiveService=SIGNATURE_VERIFY
        CryptoPrimitive_SIGNATUREVERIFY_RSA_RSASSAPKCS1V15_SHA2512: CryptoPrimitiveAlgorithmFamiliy=CRYPTO_ALGOFAM_RSA, CryptoPrimitiveAlgorithmMode=CRYPTO_ALGOMODE_RSASSA_PKCS1_v1_5, CryptoPrimitiveAlgorithmSecondaryFamiliy=CRYPTO_ALGOFAM_SHA2_512, CryptoPrimitiveService=SIGNATURE_VERIFY
        CryptoPrimitive_SIGNATUREVERIFY_RSA_RSASSAPKCS1V15_SHA3224: CryptoPrimitiveAlgorithmFamiliy=CRYPTO_ALGOFAM_RSA, CryptoPrimitiveAlgorithmMode=CRYPTO_ALGOMODE_RSASSA_PKCS1_v1_5, CryptoPrimitiveAlgorithmSecondaryFamiliy=CRYPTO_ALGOFAM_SHA3_224, CryptoPrimitiveService=SIGNATURE_VERIFY
        CryptoPrimitive_SIGNATUREVERIFY_RSA_RSASSAPKCS1V15_SHA3256: CryptoPrimitiveAlgorithmFamiliy=CRYPTO_ALGOFAM_RSA, CryptoPrimitiveAlgorithmMode=CRYPTO_ALGOMODE_RSASSA_PKCS1_v1_5, CryptoPrimitiveAlgorithmSecondaryFamiliy=CRYPTO_ALGOFAM_SHA3_256, CryptoPrimitiveService=SIGNATURE_VERIFY
        CryptoPrimitive_SIGNATUREVERIFY_RSA_RSASSAPKCS1V15_SHA3384: CryptoPrimitiveAlgorithmFamiliy=CRYPTO_ALGOFAM_RSA, CryptoPrimitiveAlgorithmMode=CRYPTO_ALGOMODE_RSASSA_PKCS1_v1_5, CryptoPrimitiveAlgorithmSecondaryFamiliy=CRYPTO_ALGOFAM_SHA3_384, CryptoPrimitiveService=SIGNATURE_VERIFY
        CryptoPrimitive_SIGNATUREVERIFY_RSA_RSASSAPKCS1V15_SHA3512: CryptoPrimitiveAlgorithmFamiliy=CRYPTO_ALGOFAM_RSA, CryptoPrimitiveAlgorithmMode=CRYPTO_ALGOMODE_RSASSA_PKCS1_v1_5, CryptoPrimitiveAlgorithmSecondaryFamiliy=CRYPTO_ALGOFAM_SHA3_512, CryptoPrimitiveService=SIGNATURE_VERIFY
        CryptoPrimitive_SIGNATUREVERIFY_RSA_RSASSAPSS_SHA1: CryptoPrimitiveAlgorithmFamiliy=CRYPTO_ALGOFAM_RSA, CryptoPrimitiveAlgorithmMode=CRYPTO_ALGOMODE_RSASSA_PSS, CryptoPrimitiveAlgorithmSecondaryFamiliy=CRYPTO_ALGOFAM_SHA1, CryptoPrimitiveService=SIGNATURE_VERIFY
        CryptoPrimitive_SIGNATUREVERIFY_RSA_RSASSAPSS_SHA2224: CryptoPrimitiveAlgorithmFamiliy=CRYPTO_ALGOFAM_RSA, CryptoPrimitiveAlgorithmMode=CRYPTO_ALGOMODE_RSASSA_PSS, CryptoPrimitiveAlgorithmSecondaryFamiliy=CRYPTO_ALGOFAM_SHA2_224, CryptoPrimitiveService=SIGNATURE_VERIFY
        CryptoPrimitive_SIGNATUREVERIFY_RSA_RSASSAPSS_SHA2256: CryptoPrimitiveAlgorithmFamiliy=CRYPTO_ALGOFAM_RSA, CryptoPrimitiveAlgorithmMode=CRYPTO_ALGOMODE_RSASSA_PSS, CryptoPrimitiveAlgorithmSecondaryFamiliy=CRYPTO_ALGOFAM_SHA2_256, CryptoPrimitiveService=SIGNATURE_VERIFY
        CryptoPrimitive_SIGNATUREVERIFY_RSA_RSASSAPSS_SHA2384: CryptoPrimitiveAlgorithmFamiliy=CRYPTO_ALGOFAM_RSA, CryptoPrimitiveAlgorithmMode=CRYPTO_ALGOMODE_RSASSA_PSS, CryptoPrimitiveAlgorithmSecondaryFamiliy=CRYPTO_ALGOFAM_SHA2_384, CryptoPrimitiveService=SIGNATURE_VERIFY
        CryptoPrimitive_SIGNATUREVERIFY_RSA_RSASSAPSS_SHA2512: CryptoPrimitiveAlgorithmFamiliy=CRYPTO_ALGOFAM_RSA, CryptoPrimitiveAlgorithmMode=CRYPTO_ALGOMODE_RSASSA_PSS, CryptoPrimitiveAlgorithmSecondaryFamiliy=CRYPTO_ALGOFAM_SHA2_512, CryptoPrimitiveService=SIGNATURE_VERIFY
        CryptoPrimitive_SIGNATUREVERIFY_RSA_RSASSAPSS_SHA3224: CryptoPrimitiveAlgorithmFamiliy=CRYPTO_ALGOFAM_RSA, CryptoPrimitiveAlgorithmMode=CRYPTO_ALGOMODE_RSASSA_PSS, CryptoPrimitiveAlgorithmSecondaryFamiliy=CRYPTO_ALGOFAM_SHA3_224, CryptoPrimitiveService=SIGNATURE_VERIFY
        CryptoPrimitive_SIGNATUREVERIFY_RSA_RSASSAPSS_SHA3256: CryptoPrimitiveAlgorithmFamiliy=CRYPTO_ALGOFAM_RSA, CryptoPrimitiveAlgorithmMode=CRYPTO_ALGOMODE_RSASSA_PSS, CryptoPrimitiveAlgorithmSecondaryFamiliy=CRYPTO_ALGOFAM_SHA3_256, CryptoPrimitiveService=SIGNATURE_VERIFY
        CryptoPrimitive_SIGNATUREVERIFY_RSA_RSASSAPSS_SHA3384: CryptoPrimitiveAlgorithmFamiliy=CRYPTO_ALGOFAM_RSA, CryptoPrimitiveAlgorithmMode=CRYPTO_ALGOMODE_RSASSA_PSS, CryptoPrimitiveAlgorithmSecondaryFamiliy=CRYPTO_ALGOFAM_SHA3_384, CryptoPrimitiveService=SIGNATURE_VERIFY
        CryptoPrimitive_SIGNATUREVERIFY_RSA_RSASSAPSS_SHA3512: CryptoPrimitiveAlgorithmFamiliy=CRYPTO_ALGOFAM_RSA, CryptoPrimitiveAlgorithmMode=CRYPTO_ALGOMODE_RSASSA_PSS, CryptoPrimitiveAlgorithmSecondaryFamiliy=CRYPTO_ALGOFAM_SHA3_512, CryptoPrimitiveService=SIGNATURE_VERIFY
