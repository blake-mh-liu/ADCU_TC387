AUTOSAR XML (schema 00046)
package /TS_TxDxM2I0R0_GENERIC
  module config Crypto_recconf: definition=Crypto, implementation-config-variant=VARIANT-PRE-COMPILE
    PublishedInformation: PbcfgMSupport=false
    CryptoGeneral: CryptoDevErrorDetect=true, CryptoDetRuntimeChecks=true, CryptoVersionInfoApi=true, CryptoInstanceId=0
    CryptoDriverObjects
      CryptoDriverObject_CDO1 (CryptoDriverObject): CryptoDriverObjectId=0
    CryptoKeyElements
      30 x CryptoKeyElement, all with CryptoKeyElementPersist=false, CryptoKeyElementReadAccess=CRYPTO_RA_ALLOWED, CryptoKeyElementWriteAccess=CRYPTO_WA_ALLOWED, CryptoKeyElementFormat=CRYPTO_KE_FORMAT_BIN_OCTET:
        CryptoKeyElement_CRYPTO_KE_CIPHER_KEY: CryptoKeyElementSize=16, CryptoKeyElementAllowPartialAccess=false
        CryptoKeyElement_CRYPTO_KE_CIPHER_IV: CryptoKeyElementSize=16, CryptoKeyElementAllowPartialAccess=false
        CryptoKeyElement_CRYPTO_KE_CIPHER_PROOF: CryptoKeyElementSize=16, CryptoKeyElementAllowPartialAccess=false
        CryptoKeyElement_CRYPTO_KE_CIPHER_2NDKEY: CryptoKeyElementSize=16, CryptoKeyElementAllowPartialAccess=false
        CryptoKeyElement_CRYPTO_XVIX_XAIX_KE_CCM_MAC_LEN: CryptoKeyElementSize=1, CryptoKeyElementAllowPartialAccess=false
        CryptoKeyElement_CRYPTO_KE_MAC_KEY: CryptoKeyElementSize=16, CryptoKeyElementAllowPartialAccess=false
        CryptoKeyElement_CRYPTO_KE_MAC_PROOF: CryptoKeyElementSize=16, CryptoKeyElementAllowPartialAccess=false
        CryptoKeyElement_CRYPTO_KE_SIGNATURE_KEY: CryptoKeyElementSize=32, CryptoKeyElementAllowPartialAccess=false
        CryptoKeyElement_CRYPTO_KE_SIGNATURE_CURVETYPE: CryptoKeyElementSize=32, CryptoKeyElementAllowPartialAccess=true
        CryptoKeyElement_CRYPTO_KE_RANDOM_SEED_STATE: CryptoKeyElementId=3, CryptoKeyElementSize=16, CryptoKeyElementAllowPartialAccess=false
        CryptoKeyElement_CRYPTO_KE_RANDOM_ALGORITHM: CryptoKeyElementSize=2, CryptoKeyElementAllowPartialAccess=false
        CryptoKeyElement_CRYPTO_KE_KEYEXCHANGE_BASE: CryptoKeyElementSize=32, CryptoKeyElementAllowPartialAccess=false
        CryptoKeyElement_CRYPTO_KE_KEYEXCHANGE_PRIVKEY: CryptoKeyElementSize=32, CryptoKeyElementAllowPartialAccess=false
        CryptoKeyElement_CRYPTO_KE_KEYEXCHANGE_OWNPUBKEY: CryptoKeyElementSize=32, CryptoKeyElementAllowPartialAccess=false
        CryptoKeyElement_CYRPTO_KE_KEYEXCHANGE_SHAREDVALUE: CryptoKeyElementSize=32, CryptoKeyElementAllowPartialAccess=false
        CryptoKeyElement_CRYPTO_KE_KEYEXCHANGE_ALGORITHM: CryptoKeyElementSize=2, CryptoKeyElementAllowPartialAccess=false
        CryptoKeyElement_CRYPTO_KE_KEYDERIVATION_PASSWORD: CryptoKeyElementSize=32, CryptoKeyElementAllowPartialAccess=true
        CryptoKeyElement_CRYPTO_KE_KEYDERIVATION_SALT: CryptoKeyElementSize=32, CryptoKeyElementAllowPartialAccess=false
        CryptoKeyElement_CRYPTO_KE_KEYDERIVATION_ITERATIONS: CryptoKeyElementSize=32, CryptoKeyElementAllowPartialAccess=false
        CryptoKeyElement_CRYPTO_KE_KEYDERIVATION_ALGORITHM: CryptoKeyElementSize=2, CryptoKeyElementAllowPartialAccess=false
        CryptoKeyElement_CRYPTO_XVIX_XAIX_KE_KEYDERIVATION_FIXEDINFOID: CryptoKeyElementSize=32, CryptoKeyElementAllowPartialAccess=true
        CryptoKeyElement_CRYPTO_XVIX_XAIX_INT_KMN_KEYDERIVE_SINGLESTEPKDF_NOTSET_KEYTARGETID: CryptoKeyElementSize=64, CryptoKeyElementAllowPartialAccess=true
        CryptoKeyElement_CRYPTO_KE_KEYGENERATE_KEY: CryptoKeyElementSize=32, CryptoKeyElementAllowPartialAccess=false
        CryptoKeyElement_CRYPTO_KE_KEYGENERATE_SEED: CryptoKeyElementSize=32, CryptoKeyElementAllowPartialAccess=false
        CryptoKeyElement_CRYPTO_KE_KEYGENERATE_ALGORITHM: CryptoKeyElementSize=2, CryptoKeyElementAllowPartialAccess=false
        CryptoKeyElement_CRYPTO_KE_AES_EXPANDEDKEY: CryptoKeyElementSize=240, CryptoKeyElementAllowPartialAccess=false
        CryptoKeyElement_CRYPTO_KE_CMAC_K1: CryptoKeyElementSize=16, CryptoKeyElementAllowPartialAccess=false
        CryptoKeyElement_CRYPTO_KE_CMAC_K2: CryptoKeyElementSize=16, CryptoKeyElementAllowPartialAccess=false
        CryptoKeyElement_CRYPTO_KE_RSA_BARRETT: CryptoKeyElementSize=1, CryptoKeyElementAllowPartialAccess=false
        CryptoKeyElement_CRYPTO_KE_KMNCOMMON_WORKSPACE: CryptoKeyElementSize=408, CryptoKeyElementAllowPartialAccess=false
    CryptoKeyTypes
