AUTOSAR XML (schema 00046)
package /TS_TxDxM6I10R0
  module config CanIfRecConfigurationDflt: definition=CanIf
    6 x CanIfUpperLayerConfig, all with CanIfUpperLayerUseCanId=0:
      CAN_NM: CanIfTxPduUserTxConfirmationName=CanNm_TxConfirmation, CanIfRxPduUserRxIndicationName=CanNm_RxIndication
      CAN_TP: CanIfTxPduUserTxConfirmationName=CanTp_TxConfirmation, CanIfRxPduUserRxIndicationName=CanTp_RxIndication
      CAN_TSYN: CanIfTxPduUserTxConfirmationName=CanTSyn_TxConfirmation, CanIfRxPduUserRxIndicationName=CanTSyn_RxIndication
      PDUR: CanIfTxPduUserTxConfirmationName=PduR_CanIfTxConfirmation, CanIfRxPduUserRxIndicationName=PduR_CanIfRxIndication
      J1939NM: CanIfTxPduUserTxConfirmationName=J1939Nm_TxConfirmation, CanIfRxPduUserRxIndicationName=J1939Nm_RxIndication
      J1939TP: CanIfTxPduUserTxConfirmationName=J1939Tp_TxConfirmation, CanIfRxPduUserRxIndicationName=J1939Tp_RxIndication
