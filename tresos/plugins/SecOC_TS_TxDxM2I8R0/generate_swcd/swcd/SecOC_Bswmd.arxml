<?xml version="1.0" encoding="ISO-8859-1"?>
[!AUTOSPACING!]
<AUTOSAR xmlns="http://autosar.org/schema/r4.0"
  xmlns:xsi="http://www.w3.org/2001/XMLSchema-instance"
  xsi:schemaLocation="http://autosar.org/schema/r4.0 AUTOSAR_4-0-3.xsd">
  <AR-PACKAGES>
    <AR-PACKAGE>
      <SHORT-NAME>AUTOSAR_SecOC</SHORT-NAME>
          <AR-PACKAGES>
[!IF "SecOCEbGeneral/SecOCRteUsage = 'true'"!]
            <AR-PACKAGE>
              <SHORT-NAME>SwcBswMappings</SHORT-NAME>
              <ELEMENTS>
  [!IF "num:i(count(SecOCMainFunctionRx/*)) = 0 and num:i(count(SecOCMainFunctionTx/*)) = 0"!]
                <SWC-BSW-MAPPING>
                  <SHORT-NAME>SwcBswMapping_0</SHORT-NAME>
                  <BSW-BEHAVIOR-REF DEST="BSW-INTERNAL-BEHAVIOR">/AUTOSAR_SecOC/BswModuleDescriptions/SecOC/InternalBehavior_0</BSW-BEHAVIOR-REF>
                  <RUNNABLE-MAPPINGS>
    [!IF "count(SecOCRxPduProcessing/*) > 0 and num:i(count(SecOCMainFunctionRx/*)) = 0"!]
                    <SWC-BSW-RUNNABLE-MAPPING>
                      <BSW-ENTITY-REF DEST="BSW-SCHEDULABLE-ENTITY">/AUTOSAR_SecOC/BswModuleDescriptions/SecOC/InternalBehavior_0/SecOC_MainFunctionRx</BSW-ENTITY-REF>
                      <SWC-RUNNABLE-REF DEST="RUNNABLE-ENTITY">/AUTOSAR_SecOC/SwComponentTypes/SecOC/SecOCInternalBehavior/RE_MainFunctionRx</SWC-RUNNABLE-REF>
                    </SWC-BSW-RUNNABLE-MAPPING>
    [!ENDIF!]
    [!IF "count(SecOCTxPduProcessing/*) > 0 and num:i(count(SecOCMainFunctionRx/*)) = 0"!]
                    <SWC-BSW-RUNNABLE-MAPPING>
                      <BSW-ENTITY-REF DEST="BSW-SCHEDULABLE-ENTITY">/AUTOSAR_SecOC/BswModuleDescriptions/SecOC/InternalBehavior_0/SecOC_MainFunctionTx</BSW-ENTITY-REF>
                      <SWC-RUNNABLE-REF DEST="RUNNABLE-ENTITY">/AUTOSAR_SecOC/SwComponentTypes/SecOC/SecOCInternalBehavior/RE_MainFunctionTx</SWC-RUNNABLE-REF>
                    </SWC-BSW-RUNNABLE-MAPPING>
    [!ENDIF!]
                  </RUNNABLE-MAPPINGS>
                  <SWC-BEHAVIOR-REF DEST="SWC-INTERNAL-BEHAVIOR">/AUTOSAR_SecOC/SwComponentTypes/SecOC/SecOCInternalBehavior</SWC-BEHAVIOR-REF>
                </SWC-BSW-MAPPING>
  [!ENDIF!]
  [!LOOP "node:refs(as:modconf('SecOC')/SecOCMainFunctionRx/*/SecOCMainFunctionRxPartitionRef | as:modconf('SecOC')/SecOCMainFunctionTx/*/SecOCMainFunctionTxPartitionRef)"!]
    [!VAR "ecucPartition" = "node:name(.)"!]
                <SWC-BSW-MAPPING>
                  <SHORT-NAME>SwcBswMapping_[!"node:name(.)"!]</SHORT-NAME>
                  <BSW-BEHAVIOR-REF DEST="BSW-INTERNAL-BEHAVIOR">/AUTOSAR_SecOC/BswModuleDescriptions/SecOC/InternalBehavior_[!"node:name(.)"!]</BSW-BEHAVIOR-REF>
                  <RUNNABLE-MAPPINGS>
    [!LOOP "as:modconf('SecOC')/SecOCMainFunctionRx/*[node:name(node:ref(./SecOCMainFunctionRxPartitionRef)) = $ecucPartition]"!]
                    <SWC-BSW-RUNNABLE-MAPPING>
                      <BSW-ENTITY-REF DEST="BSW-SCHEDULABLE-ENTITY">/AUTOSAR_SecOC/BswModuleDescriptions/SecOC/InternalBehavior_[!"string($ecucPartition)"!]/SecOC_MainFunctionRx_[!"node:name(.)"!]</BSW-ENTITY-REF>
                      <SWC-RUNNABLE-REF DEST="RUNNABLE-ENTITY">/AUTOSAR_SecOC/SwComponentTypes/SecOC_[!"string($ecucPartition)"!]/SecOCInternalBehavior_[!"string($ecucPartition)"!]/RE_MainFunctionRx_[!"node:name(.)"!]</SWC-RUNNABLE-REF>
                    </SWC-BSW-RUNNABLE-MAPPING>
    [!ENDLOOP!]
    [!LOOP "as:modconf('SecOC')/SecOCMainFunctionTx/*[node:name(node:ref(./SecOCMainFunctionTxPartitionRef)) = $ecucPartition]"!]
                    <SWC-BSW-RUNNABLE-MAPPING>
                      <BSW-ENTITY-REF DEST="BSW-SCHEDULABLE-ENTITY">/AUTOSAR_SecOC/BswModuleDescriptions/SecOC/InternalBehavior_[!"string($ecucPartition)"!]/SecOC_MainFunctionTx_[!"node:name(.)"!]</BSW-ENTITY-REF>
                      <SWC-RUNNABLE-REF DEST="RUNNABLE-ENTITY">/AUTOSAR_SecOC/SwComponentTypes/SecOC_[!"string($ecucPartition)"!]/SecOCInternalBehavior_[!"string($ecucPartition)"!]/RE_MainFunctionTx_[!"node:name(.)"!]</SWC-RUNNABLE-REF>
                    </SWC-BSW-RUNNABLE-MAPPING>
    [!ENDLOOP!]
                  </RUNNABLE-MAPPINGS>
                  <SWC-BEHAVIOR-REF DEST="SWC-INTERNAL-BEHAVIOR">/AUTOSAR_SecOC/SwComponentTypes/SecOC_[!"string($ecucPartition)"!]/SecOCInternalBehavior_[!"string($ecucPartition)"!]</SWC-BEHAVIOR-REF>
                </SWC-BSW-MAPPING>
  [!ENDLOOP!]
              </ELEMENTS>
            </AR-PACKAGE>
[!ENDIF!]
            <AR-PACKAGE>
              <SHORT-NAME>BswModuleDescriptions</SHORT-NAME>
              <ELEMENTS>
                <BSW-MODULE-DESCRIPTION>
                  <SHORT-NAME>SecOC</SHORT-NAME>
                  <MODULE-ID>607</MODULE-ID>
                  <PROVIDED-ENTRYS>
[!IF "num:i(count(SecOCMainFunctionRx/*)) = 0 and num:i(count(SecOCMainFunctionTx/*)) = 0"!]
                    <BSW-MODULE-ENTRY-REF-CONDITIONAL>
                      <BSW-MODULE-ENTRY-REF DEST="BSW-MODULE-ENTRY">/AUTOSAR_SecOC/BswModuleEntrys/SecOC_Init</BSW-MODULE-ENTRY-REF>
                    </BSW-MODULE-ENTRY-REF-CONDITIONAL>
                    <BSW-MODULE-ENTRY-REF-CONDITIONAL>
                      <BSW-MODULE-ENTRY-REF DEST="BSW-MODULE-ENTRY">/AUTOSAR_SecOC/BswModuleEntrys/SecOC_DeInit</BSW-MODULE-ENTRY-REF>
                    </BSW-MODULE-ENTRY-REF-CONDITIONAL>
[!ENDIF!]
[!IF "count(SecOCRxPduProcessing/*) > 0 and num:i(count(SecOCMainFunctionRx/*)) = 0"!]
                    <BSW-MODULE-ENTRY-REF-CONDITIONAL>
                      <BSW-MODULE-ENTRY-REF DEST="BSW-MODULE-ENTRY">/AUTOSAR_SecOC/BswModuleEntrys/SecOC_MainFunctionRx</BSW-MODULE-ENTRY-REF>
                    </BSW-MODULE-ENTRY-REF-CONDITIONAL>
[!ENDIF!]
[!IF "count(SecOCTxPduProcessing/*) > 0 and num:i(count(SecOCMainFunctionTx/*)) = 0"!]
                    <BSW-MODULE-ENTRY-REF-CONDITIONAL>
                      <BSW-MODULE-ENTRY-REF DEST="BSW-MODULE-ENTRY">/AUTOSAR_SecOC/BswModuleEntrys/SecOC_MainFunctionTx</BSW-MODULE-ENTRY-REF>
                    </BSW-MODULE-ENTRY-REF-CONDITIONAL>
[!ENDIF!]
[!LOOP "node:refs(as:modconf('SecOC')/SecOCMainFunctionRx/*/SecOCMainFunctionRxPartitionRef | as:modconf('SecOC')/SecOCMainFunctionTx/*/SecOCMainFunctionTxPartitionRef)"!]
  [!VAR "ecucPartition" = "node:name(.)"!]
                    <BSW-MODULE-ENTRY-REF-CONDITIONAL>
                      <BSW-MODULE-ENTRY-REF DEST="BSW-MODULE-ENTRY">/AUTOSAR_SecOC/BswModuleEntrys/SecOC_Init_[!"node:name(.)"!]</BSW-MODULE-ENTRY-REF>
                    </BSW-MODULE-ENTRY-REF-CONDITIONAL>
                    <BSW-MODULE-ENTRY-REF-CONDITIONAL>
                      <BSW-MODULE-ENTRY-REF DEST="BSW-MODULE-ENTRY">/AUTOSAR_SecOC/BswModuleEntrys/SecOC_DeInit_[!"node:name(.)"!]</BSW-MODULE-ENTRY-REF>
                    </BSW-MODULE-ENTRY-REF-CONDITIONAL>
  [!LOOP "as:modconf('SecOC')/SecOCMainFunctionRx/*[node:name(node:ref(./SecOCMainFunctionRxPartitionRef)) = $ecucPartition]"!]
                    <BSW-MODULE-ENTRY-REF-CONDITIONAL>
                      <BSW-MODULE-ENTRY-REF DEST="BSW-MODULE-ENTRY">/AUTOSAR_SecOC/BswModuleEntrys/SecOC_MainFunctionRx_[!"node:name(.)"!]</BSW-MODULE-ENTRY-REF>
                    </BSW-MODULE-ENTRY-REF-CONDITIONAL>
  [!ENDLOOP!]
  [!LOOP "as:modconf('SecOC')/SecOCMainFunctionTx/*[node:name(node:ref(./SecOCMainFunctionTxPartitionRef)) = $ecucPartition]"!]
                    <BSW-MODULE-ENTRY-REF-CONDITIONAL>
                      <BSW-MODULE-ENTRY-REF DEST="BSW-MODULE-ENTRY">/AUTOSAR_SecOC/BswModuleEntrys/SecOC_MainFunctionTx_[!"node:name(.)"!]</BSW-MODULE-ENTRY-REF>
                    </BSW-MODULE-ENTRY-REF-CONDITIONAL>
  [!ENDLOOP!]
[!ENDLOOP!]
                  </PROVIDED-ENTRYS>
                  <INTERNAL-BEHAVIORS>
[!IF "num:i(count(SecOCMainFunctionRx/*)) = 0 and num:i(count(SecOCMainFunctionTx/*)) = 0"!]
                    <BSW-INTERNAL-BEHAVIOR>
                      <SHORT-NAME>InternalBehavior_0</SHORT-NAME>
                      <EXCLUSIVE-AREAS>
  [!IF "count(SecOCRxPduProcessing/*) > 0"!]
                        <EXCLUSIVE-AREA>
                          <SHORT-NAME>SCHM_SECOC_EXCLUSIVE_AREA_0</SHORT-NAME>
                        </EXCLUSIVE-AREA>
  [!ENDIF!]
  [!IF "count(SecOCTxPduProcessing/*) > 0"!]
                        <EXCLUSIVE-AREA>
                          <SHORT-NAME>SCHM_SECOC_EXCLUSIVE_AREA_1</SHORT-NAME>
                        </EXCLUSIVE-AREA>
  [!ENDIF!]
                      </EXCLUSIVE-AREAS>
                      <ENTITYS>
                        <BSW-CALLED-ENTITY>
                          <SHORT-NAME>SecOC_Init</SHORT-NAME>
                          <ADMIN-DATA>
                            <SDGS>
                              <SDG GID="EB:DnT">
                                 <SD GID="FunctionGroup">Extern</SD>
                                <SD GID="EnableTracing">false</SD>
                              </SDG>
                            </SDGS>
                          </ADMIN-DATA>
                          <MINIMUM-START-INTERVAL>0.0</MINIMUM-START-INTERVAL>
                          <IMPLEMENTED-ENTRY-REF DEST="BSW-MODULE-ENTRY">/AUTOSAR_SecOC/BswModuleEntrys/SecOC_Init</IMPLEMENTED-ENTRY-REF>
                        </BSW-CALLED-ENTITY>
                        <BSW-CALLED-ENTITY>
                          <SHORT-NAME>SecOC_DeInit</SHORT-NAME>
                          <ADMIN-DATA>
                            <SDGS>
                              <SDG GID="EB:DnT">
                                 <SD GID="FunctionGroup">Extern</SD>
                                <SD GID="EnableTracing">false</SD>
                              </SDG>
                            </SDGS>
                          </ADMIN-DATA>
                          <MINIMUM-START-INTERVAL>0.0</MINIMUM-START-INTERVAL>
                          <IMPLEMENTED-ENTRY-REF DEST="BSW-MODULE-ENTRY">/AUTOSAR_SecOC/BswModuleEntrys/SecOC_DeInit</IMPLEMENTED-ENTRY-REF>
                        </BSW-CALLED-ENTITY>
  [!IF "count(SecOCRxPduProcessing/*) > 0"!]
                        <BSW-SCHEDULABLE-ENTITY>
                          <SHORT-NAME>SecOC_MainFunctionRx</SHORT-NAME>
                          <ADMIN-DATA>
                            <SDGS>
                              <SDG GID="EB:DnT">
                                 <SD GID="FunctionGroup">Extern</SD>
                                <SD GID="EnableTracing">false</SD>
                              </SDG>
                            </SDGS>
                          </ADMIN-DATA>
                          <CAN-ENTER-EXCLUSIVE-AREA-REFS>
                            <CAN-ENTER-EXCLUSIVE-AREA-REF DEST="EXCLUSIVE-AREA">/AUTOSAR_SecOC/BswModuleDescriptions/SecOC/InternalBehavior_0/SCHM_SECOC_EXCLUSIVE_AREA_0</CAN-ENTER-EXCLUSIVE-AREA-REF>
                          </CAN-ENTER-EXCLUSIVE-AREA-REFS>
                          <MINIMUM-START-INTERVAL>0.0</MINIMUM-START-INTERVAL>
                          <IMPLEMENTED-ENTRY-REF DEST="BSW-MODULE-ENTRY">/AUTOSAR_SecOC/BswModuleEntrys/SecOC_MainFunctionRx</IMPLEMENTED-ENTRY-REF>
                        </BSW-SCHEDULABLE-ENTITY>
  [!ENDIF!]
  [!IF "count(SecOCTxPduProcessing/*) > 0"!]
                        <BSW-SCHEDULABLE-ENTITY>
                          <SHORT-NAME>SecOC_MainFunctionTx</SHORT-NAME>
                          <ADMIN-DATA>
                            <SDGS>
                              <SDG GID="EB:DnT">
                                 <SD GID="FunctionGroup">Extern</SD>
                                <SD GID="EnableTracing">false</SD>
                              </SDG>
                            </SDGS>
                          </ADMIN-DATA>
                          <CAN-ENTER-EXCLUSIVE-AREA-REFS>
                            <CAN-ENTER-EXCLUSIVE-AREA-REF DEST="EXCLUSIVE-AREA">/AUTOSAR_SecOC/BswModuleDescriptions/SecOC/InternalBehavior_0/SCHM_SECOC_EXCLUSIVE_AREA_1</CAN-ENTER-EXCLUSIVE-AREA-REF>
                          </CAN-ENTER-EXCLUSIVE-AREA-REFS>
                          <MINIMUM-START-INTERVAL>0.0</MINIMUM-START-INTERVAL>
                          <IMPLEMENTED-ENTRY-REF DEST="BSW-MODULE-ENTRY">/AUTOSAR_SecOC/BswModuleEntrys/SecOC_MainFunctionTx</IMPLEMENTED-ENTRY-REF>
                        </BSW-SCHEDULABLE-ENTITY>
  [!ENDIF!]
                      </ENTITYS>
                      <EVENTS>
  [!IF "count(SecOCRxPduProcessing/*) > 0"!]
                        <BSW-TIMING-EVENT>
                          <SHORT-NAME>TimingEvent_MainFunctionRx</SHORT-NAME>
                          <STARTS-ON-EVENT-REF DEST="BSW-SCHEDULABLE-ENTITY">/AUTOSAR_SecOC/BswModuleDescriptions/SecOC/InternalBehavior_0/SecOC_MainFunctionRx</STARTS-ON-EVENT-REF>
                          <!-- !LINKSTO SecOC.ASR430.Rx.SWS_SecOC_00173,1 -->
                          <PERIOD>[!"SecOCGeneral/SecOCMainFunctionPeriodRx"!]</PERIOD>
                        </BSW-TIMING-EVENT>
  [!ENDIF!]
  [!IF "count(SecOCTxPduProcessing/*) > 0"!]
                        <BSW-TIMING-EVENT>
                          <SHORT-NAME>TimingEvent_MainFunctionTx</SHORT-NAME>
                          <STARTS-ON-EVENT-REF DEST="BSW-SCHEDULABLE-ENTITY">/AUTOSAR_SecOC/BswModuleDescriptions/SecOC/InternalBehavior_0/SecOC_MainFunctionTx</STARTS-ON-EVENT-REF>
                          <!-- !LINKSTO SecOC.ASR430.Tx.SWS_SecOC_00178,1 -->
                          <PERIOD>[!"SecOCGeneral/SecOCMainFunctionPeriodTx"!]</PERIOD>
                        </BSW-TIMING-EVENT>
  [!ENDIF!]
                      </EVENTS>
                    </BSW-INTERNAL-BEHAVIOR>
[!ENDIF!]
[!LOOP "node:refs(as:modconf('SecOC')/SecOCMainFunctionRx/*/SecOCMainFunctionRxPartitionRef | as:modconf('SecOC')/SecOCMainFunctionTx/*/SecOCMainFunctionTxPartitionRef)"!]
  [!VAR "ecucPartition" = "node:name(.)"!]
                    <BSW-INTERNAL-BEHAVIOR>
                      <SHORT-NAME>InternalBehavior_[!"node:name(.)"!]</SHORT-NAME>
                      <EXCLUSIVE-AREAS>
  [!IF "count(as:modconf('SecOC')/SecOCMainFunctionRx/*[node:name(node:ref(./SecOCMainFunctionRxPartitionRef)) = $ecucPartition]) > 0"!]
                        <EXCLUSIVE-AREA>
                          <SHORT-NAME>SCHM_SECOC_EXCLUSIVE_AREA_0</SHORT-NAME>
                        </EXCLUSIVE-AREA>
  [!ENDIF!]
  [!IF "count(as:modconf('SecOC')/SecOCMainFunctionTx/*[node:name(node:ref(./SecOCMainFunctionTxPartitionRef)) = $ecucPartition]) > 0"!]
                        <EXCLUSIVE-AREA>
                          <SHORT-NAME>SCHM_SECOC_EXCLUSIVE_AREA_1</SHORT-NAME>
                        </EXCLUSIVE-AREA>
  [!ENDIF!]
                      </EXCLUSIVE-AREAS>
                      <ENTITYS>
                        <BSW-CALLED-ENTITY>
                          <SHORT-NAME>SecOC_Init_[!"node:name(.)"!]</SHORT-NAME>
                          <ADMIN-DATA>
                            <SDGS>
                              <SDG GID="EB:DnT">
                                 <SD GID="FunctionGroup">Extern</SD>
                                <SD GID="EnableTracing">false</SD>
                              </SDG>
                            </SDGS>
                          </ADMIN-DATA>
                          <MINIMUM-START-INTERVAL>0.0</MINIMUM-START-INTERVAL>
                          <IMPLEMENTED-ENTRY-REF DEST="BSW-MODULE-ENTRY">/AUTOSAR_SecOC/BswModuleEntrys/SecOC_Init_[!"node:name(.)"!]</IMPLEMENTED-ENTRY-REF>
                        </BSW-CALLED-ENTITY>
                        <BSW-CALLED-ENTITY>
                          <SHORT-NAME>SecOC_DeInit_[!"node:name(.)"!]</SHORT-NAME>
                          <ADMIN-DATA>
                            <SDGS>
                              <SDG GID="EB:DnT">
                                 <SD GID="FunctionGroup">Extern</SD>
                                <SD GID="EnableTracing">false</SD>
                              </SDG>
                            </SDGS>
                          </ADMIN-DATA>
                          <MINIMUM-START-INTERVAL>0.0</MINIMUM-START-INTERVAL>
                          <IMPLEMENTED-ENTRY-REF DEST="BSW-MODULE-ENTRY">/AUTOSAR_SecOC/BswModuleEntrys/SecOC_DeInit_[!"node:name(.)"!]</IMPLEMENTED-ENTRY-REF>
                        </BSW-CALLED-ENTITY>
  [!LOOP "as:modconf('SecOC')/SecOCMainFunctionRx/*[node:name(node:ref(./SecOCMainFunctionRxPartitionRef)) = $ecucPartition]"!]
                        <BSW-SCHEDULABLE-ENTITY>
                          <SHORT-NAME>SecOC_MainFunctionRx_[!"node:name(.)"!]</SHORT-NAME>
                          <ADMIN-DATA>
                            <SDGS>
                              <SDG GID="EB:DnT">
                                 <SD GID="FunctionGroup">Extern</SD>
                                <SD GID="EnableTracing">false</SD>
                              </SDG>
                            </SDGS>
                          </ADMIN-DATA>
                          <CAN-ENTER-EXCLUSIVE-AREA-REFS>
                            <CAN-ENTER-EXCLUSIVE-AREA-REF DEST="EXCLUSIVE-AREA">/AUTOSAR_SecOC/BswModuleDescriptions/SecOC/InternalBehavior_[!"string($ecucPartition)"!]/SCHM_SECOC_EXCLUSIVE_AREA_0</CAN-ENTER-EXCLUSIVE-AREA-REF>
                          </CAN-ENTER-EXCLUSIVE-AREA-REFS>
                          <MINIMUM-START-INTERVAL>0.0</MINIMUM-START-INTERVAL>
                          <IMPLEMENTED-ENTRY-REF DEST="BSW-MODULE-ENTRY">/AUTOSAR_SecOC/BswModuleEntrys/SecOC_MainFunctionRx_[!"node:name(.)"!]</IMPLEMENTED-ENTRY-REF>
                        </BSW-SCHEDULABLE-ENTITY>
  [!ENDLOOP!]
  [!LOOP "as:modconf('SecOC')/SecOCMainFunctionTx/*[node:name(node:ref(./SecOCMainFunctionTxPartitionRef)) = $ecucPartition]"!]
                        <BSW-SCHEDULABLE-ENTITY>
                          <SHORT-NAME>SecOC_MainFunctionTx_[!"node:name(.)"!]</SHORT-NAME>
                          <ADMIN-DATA>
                            <SDGS>
                              <SDG GID="EB:DnT">
                                 <SD GID="FunctionGroup">Extern</SD>
                                <SD GID="EnableTracing">false</SD>
                              </SDG>
                            </SDGS>
                          </ADMIN-DATA>
                          <CAN-ENTER-EXCLUSIVE-AREA-REFS>
                            <CAN-ENTER-EXCLUSIVE-AREA-REF DEST="EXCLUSIVE-AREA">/AUTOSAR_SecOC/BswModuleDescriptions/SecOC/InternalBehavior_[!"string($ecucPartition)"!]/SCHM_SECOC_EXCLUSIVE_AREA_1</CAN-ENTER-EXCLUSIVE-AREA-REF>
                          </CAN-ENTER-EXCLUSIVE-AREA-REFS>
                          <MINIMUM-START-INTERVAL>0.0</MINIMUM-START-INTERVAL>
                          <IMPLEMENTED-ENTRY-REF DEST="BSW-MODULE-ENTRY">/AUTOSAR_SecOC/BswModuleEntrys/SecOC_MainFunctionTx_[!"node:name(.)"!]</IMPLEMENTED-ENTRY-REF>
                        </BSW-SCHEDULABLE-ENTITY>
  [!ENDLOOP!]
                      </ENTITYS>
                      <EVENTS>
  [!LOOP "as:modconf('SecOC')/SecOCMainFunctionRx/*[node:name(node:ref(./SecOCMainFunctionRxPartitionRef)) = $ecucPartition]"!]
                        <BSW-TIMING-EVENT>
                          <SHORT-NAME>TimingEvent_MainFunctionRx_[!"node:name(.)"!]</SHORT-NAME>
                          <STARTS-ON-EVENT-REF DEST="BSW-SCHEDULABLE-ENTITY">/AUTOSAR_SecOC/BswModuleDescriptions/SecOC/InternalBehavior_[!"string($ecucPartition)"!]/SecOC_MainFunctionRx_[!"node:name(.)"!]</STARTS-ON-EVENT-REF>
                          <!-- !LINKSTO SecOC.ASR430.Rx.SWS_SecOC_00173,1 -->
                          <PERIOD>[!"./SecOCMainFunctionPeriodRx"!]</PERIOD>
                        </BSW-TIMING-EVENT>
  [!ENDLOOP!]
  [!LOOP "as:modconf('SecOC')/SecOCMainFunctionTx/*[node:name(node:ref(./SecOCMainFunctionTxPartitionRef)) = $ecucPartition]"!]
                        <BSW-TIMING-EVENT>
                          <SHORT-NAME>TimingEvent_MainFunctionTx_[!"node:name(.)"!]</SHORT-NAME>
                          <STARTS-ON-EVENT-REF DEST="BSW-SCHEDULABLE-ENTITY">/AUTOSAR_SecOC/BswModuleDescriptions/SecOC/InternalBehavior_[!"string($ecucPartition)"!]/SecOC_MainFunctionTx_[!"node:name(.)"!]</STARTS-ON-EVENT-REF>
                          <!-- !LINKSTO SecOC.ASR430.Tx.SWS_SecOC_00178,1 -->
                          <PERIOD>[!"./SecOCMainFunctionPeriodTx"!]</PERIOD>
                        </BSW-TIMING-EVENT>
  [!ENDLOOP!]
                      </EVENTS>
                    </BSW-INTERNAL-BEHAVIOR>
[!ENDLOOP!]
                  </INTERNAL-BEHAVIORS>
                </BSW-MODULE-DESCRIPTION>
              </ELEMENTS>
            </AR-PACKAGE>
            <AR-PACKAGE>
              <SHORT-NAME>BswModuleEntrys</SHORT-NAME>
              <ELEMENTS>
[!IF "num:i(count(SecOCMainFunctionRx/*)) = 0 and num:i(count(SecOCMainFunctionTx/*)) = 0"!]
                <BSW-MODULE-ENTRY>
                  <SHORT-NAME>SecOC_Init</SHORT-NAME>
                  <SERVICE-ID>1</SERVICE-ID>
                  <IS-REENTRANT>false</IS-REENTRANT>
                  <IS-SYNCHRONOUS>true</IS-SYNCHRONOUS>
                  <CALL-TYPE>REGULAR</CALL-TYPE>
                  <EXECUTION-CONTEXT>TASK</EXECUTION-CONTEXT>
                  <SW-SERVICE-IMPL-POLICY>STANDARD</SW-SERVICE-IMPL-POLICY>
                </BSW-MODULE-ENTRY>
                <BSW-MODULE-ENTRY>
                  <SHORT-NAME>SecOC_DeInit</SHORT-NAME>
                  <SERVICE-ID>1</SERVICE-ID>
                  <IS-REENTRANT>false</IS-REENTRANT>
                  <IS-SYNCHRONOUS>true</IS-SYNCHRONOUS>
                  <CALL-TYPE>REGULAR</CALL-TYPE>
                  <EXECUTION-CONTEXT>TASK</EXECUTION-CONTEXT>
                  <SW-SERVICE-IMPL-POLICY>STANDARD</SW-SERVICE-IMPL-POLICY>
                </BSW-MODULE-ENTRY>
[!ENDIF!]
[!IF "count(SecOCRxPduProcessing/*) > 0 and num:i(count(SecOCMainFunctionRx/*)) = 0"!]
                <BSW-MODULE-ENTRY>
                  <SHORT-NAME>SecOC_MainFunctionRx</SHORT-NAME>
                  <SERVICE-ID>6</SERVICE-ID>
                  <IS-REENTRANT>false</IS-REENTRANT>
                  <IS-SYNCHRONOUS>true</IS-SYNCHRONOUS>
                  <CALL-TYPE>SCHEDULED</CALL-TYPE>
                  <EXECUTION-CONTEXT>TASK</EXECUTION-CONTEXT>
                  <SW-SERVICE-IMPL-POLICY>STANDARD</SW-SERVICE-IMPL-POLICY>
                </BSW-MODULE-ENTRY>
[!ENDIF!]
[!IF "count(SecOCTxPduProcessing/*) > 0 and num:i(count(SecOCMainFunctionTx/*)) = 0"!]
                <BSW-MODULE-ENTRY>
                  <SHORT-NAME>SecOC_MainFunctionTx</SHORT-NAME>
                  <SERVICE-ID>3</SERVICE-ID>
                  <IS-REENTRANT>false</IS-REENTRANT>
                  <IS-SYNCHRONOUS>true</IS-SYNCHRONOUS>
                  <CALL-TYPE>SCHEDULED</CALL-TYPE>
                  <EXECUTION-CONTEXT>TASK</EXECUTION-CONTEXT>
                  <SW-SERVICE-IMPL-POLICY>STANDARD</SW-SERVICE-IMPL-POLICY>
                </BSW-MODULE-ENTRY>
[!ENDIF!]
[!LOOP "node:refs(as:modconf('SecOC')/SecOCMainFunctionRx/*/SecOCMainFunctionRxPartitionRef | as:modconf('SecOC')/SecOCMainFunctionTx/*/SecOCMainFunctionTxPartitionRef)"!]
  [!VAR "ecucPartition" = "node:name(.)"!]
                <BSW-MODULE-ENTRY>
                  <SHORT-NAME>SecOC_Init_[!"node:name(.)"!]</SHORT-NAME>
                  <SERVICE-ID>1</SERVICE-ID>
                  <IS-REENTRANT>false</IS-REENTRANT>
                  <IS-SYNCHRONOUS>true</IS-SYNCHRONOUS>
                  <CALL-TYPE>REGULAR</CALL-TYPE>
                  <EXECUTION-CONTEXT>TASK</EXECUTION-CONTEXT>
                  <SW-SERVICE-IMPL-POLICY>STANDARD</SW-SERVICE-IMPL-POLICY>
                </BSW-MODULE-ENTRY>
                <BSW-MODULE-ENTRY>
                  <SHORT-NAME>SecOC_DeInit_[!"node:name(.)"!]</SHORT-NAME>
                  <SERVICE-ID>1</SERVICE-ID>
                  <IS-REENTRANT>false</IS-REENTRANT>
                  <IS-SYNCHRONOUS>true</IS-SYNCHRONOUS>
                  <CALL-TYPE>REGULAR</CALL-TYPE>
                  <EXECUTION-CONTEXT>TASK</EXECUTION-CONTEXT>
                  <SW-SERVICE-IMPL-POLICY>STANDARD</SW-SERVICE-IMPL-POLICY>
                </BSW-MODULE-ENTRY>
  [!LOOP "as:modconf('SecOC')/SecOCMainFunctionRx/*[node:name(node:ref(./SecOCMainFunctionRxPartitionRef)) = $ecucPartition]"!]
                <BSW-MODULE-ENTRY>
                  <SHORT-NAME>SecOC_MainFunctionRx_[!"node:name(.)"!]</SHORT-NAME>
                  <SERVICE-ID>6</SERVICE-ID>
                  <IS-REENTRANT>false</IS-REENTRANT>
                  <IS-SYNCHRONOUS>true</IS-SYNCHRONOUS>
                  <CALL-TYPE>SCHEDULED</CALL-TYPE>
                  <EXECUTION-CONTEXT>TASK</EXECUTION-CONTEXT>
                  <SW-SERVICE-IMPL-POLICY>STANDARD</SW-SERVICE-IMPL-POLICY>
                </BSW-MODULE-ENTRY>
  [!ENDLOOP!]
  [!LOOP "as:modconf('SecOC')/SecOCMainFunctionTx/*[node:name(node:ref(./SecOCMainFunctionTxPartitionRef)) = $ecucPartition]"!]
                <BSW-MODULE-ENTRY>
                  <SHORT-NAME>SecOC_MainFunctionTx_[!"node:name(.)"!]</SHORT-NAME>
                  <SERVICE-ID>3</SERVICE-ID>
                  <IS-REENTRANT>false</IS-REENTRANT>
                  <IS-SYNCHRONOUS>true</IS-SYNCHRONOUS>
                  <CALL-TYPE>SCHEDULED</CALL-TYPE>
                  <EXECUTION-CONTEXT>TASK</EXECUTION-CONTEXT>
                  <SW-SERVICE-IMPL-POLICY>STANDARD</SW-SERVICE-IMPL-POLICY>
                </BSW-MODULE-ENTRY>
  [!ENDLOOP!]
[!ENDLOOP!]
              </ELEMENTS>
            </AR-PACKAGE>
          </AR-PACKAGES>
        </AR-PACKAGE>
    <AR-PACKAGE>
      <SHORT-NAME>EB_SecOC</SHORT-NAME>
      <AR-PACKAGES>
        <AR-PACKAGE>
          <SHORT-NAME>Implementations</SHORT-NAME>
          <ELEMENTS>
[!IF "num:i(count(SecOCMainFunctionRx/*)) = 0 and num:i(count(SecOCMainFunctionTx/*)) = 0"!]
            <BSW-IMPLEMENTATION>
              <SHORT-NAME>BswImplementation_0</SHORT-NAME>
              <CODE-DESCRIPTORS>
                <CODE>
                  <SHORT-NAME>Files</SHORT-NAME>
                  <ARTIFACT-DESCRIPTORS>
                    <AUTOSAR-ENGINEERING-OBJECT>
                      <SHORT-LABEL>Autosar::include::SecOC.h</SHORT-LABEL>
                      <CATEGORY>SWHDR</CATEGORY>
                    </AUTOSAR-ENGINEERING-OBJECT>
                    <AUTOSAR-ENGINEERING-OBJECT>
                      <SHORT-LABEL>Autosar::include::SecOC_Rx.h</SHORT-LABEL>
                      <CATEGORY>SWHDR</CATEGORY>
                    </AUTOSAR-ENGINEERING-OBJECT>
                    <AUTOSAR-ENGINEERING-OBJECT>
                      <SHORT-LABEL>Autosar::include::SecOC_Rx_Int.h</SHORT-LABEL>
                      <CATEGORY>SWHDR</CATEGORY>
                    </AUTOSAR-ENGINEERING-OBJECT>
                    <AUTOSAR-ENGINEERING-OBJECT>
                      <SHORT-LABEL>Autosar::include::SecOC_Tx.h</SHORT-LABEL>
                      <CATEGORY>SWHDR</CATEGORY>
                    </AUTOSAR-ENGINEERING-OBJECT>
                    <AUTOSAR-ENGINEERING-OBJECT>
                      <SHORT-LABEL>Autosar::include::SecOC_Tx_Int.h</SHORT-LABEL>
                      <CATEGORY>SWHDR</CATEGORY>
                    </AUTOSAR-ENGINEERING-OBJECT>
                    <AUTOSAR-ENGINEERING-OBJECT>
                      <SHORT-LABEL>Autosar::include::SecOC_Version.h</SHORT-LABEL>
                      <CATEGORY>SWHDR</CATEGORY>
                    </AUTOSAR-ENGINEERING-OBJECT>
                    <AUTOSAR-ENGINEERING-OBJECT>
                      <SHORT-LABEL>Autosar::src::SecOC.c</SHORT-LABEL>
                      <CATEGORY>SWSRC</CATEGORY>
                    </AUTOSAR-ENGINEERING-OBJECT>
                    <AUTOSAR-ENGINEERING-OBJECT>
                      <SHORT-LABEL>Autosar::src::SecOC_Rx.c</SHORT-LABEL>
                      <CATEGORY>SWSRC</CATEGORY>
                    </AUTOSAR-ENGINEERING-OBJECT>
                    <AUTOSAR-ENGINEERING-OBJECT>
                      <SHORT-LABEL>Autosar::src::SecOC_Tx.c</SHORT-LABEL>
                      <CATEGORY>SWSRC</CATEGORY>
                    </AUTOSAR-ENGINEERING-OBJECT>
                    <AUTOSAR-ENGINEERING-OBJECT>
                      <SHORT-LABEL>make::SecOC_defs.mak</SHORT-LABEL>
                      <CATEGORY>SWMAKE</CATEGORY>
                    </AUTOSAR-ENGINEERING-OBJECT>
                    <AUTOSAR-ENGINEERING-OBJECT>
                      <SHORT-LABEL>make::SecOC_rules.mak</SHORT-LABEL>
                      <CATEGORY>SWMAKE</CATEGORY>
                    </AUTOSAR-ENGINEERING-OBJECT>
                  </ARTIFACT-DESCRIPTORS>
                </CODE>
              </CODE-DESCRIPTORS>
              <PROGRAMMING-LANGUAGE>C</PROGRAMMING-LANGUAGE>
              <RESOURCE-CONSUMPTION>
                <SHORT-NAME>ResourceConsumption</SHORT-NAME>
                <MEMORY-SECTIONS>
                  <MEMORY-SECTION>
                    <SHORT-NAME>CODE</SHORT-NAME>
                    <SW-ADDRMETHOD-REF DEST="SW-ADDR-METHOD">/AUTOSAR_MemMap/SwAddrMethods/CODE</SW-ADDRMETHOD-REF>
                  </MEMORY-SECTION>
                  <MEMORY-SECTION>
                    <SHORT-NAME>VAR_CLEARED_UNSPECIFIED</SHORT-NAME>
                    <ALIGNMENT>UNSPECIFIED</ALIGNMENT>
                    <SW-ADDRMETHOD-REF DEST="SW-ADDR-METHOD">/AUTOSAR_MemMap/SwAddrMethods/VAR_CLEARED</SW-ADDRMETHOD-REF>
                  </MEMORY-SECTION>
                  <MEMORY-SECTION>
                    <SHORT-NAME>VAR_INIT_UNSPECIFIED</SHORT-NAME>
                    <ALIGNMENT>UNSPECIFIED</ALIGNMENT>
                    <SW-ADDRMETHOD-REF DEST="SW-ADDR-METHOD">/AUTOSAR_MemMap/SwAddrMethods/VAR</SW-ADDRMETHOD-REF>
                  </MEMORY-SECTION>
                  <MEMORY-SECTION>
                    <SHORT-NAME>VAR_INIT_8</SHORT-NAME>
                    <ALIGNMENT>8</ALIGNMENT>
                    <SW-ADDRMETHOD-REF DEST="SW-ADDR-METHOD">/AUTOSAR_MemMap/SwAddrMethods/VAR</SW-ADDRMETHOD-REF>
                  </MEMORY-SECTION>
                  <MEMORY-SECTION>
                    <SHORT-NAME>VAR_CLEARED_8</SHORT-NAME>
                    <ALIGNMENT>8</ALIGNMENT>
                    <SW-ADDRMETHOD-REF DEST="SW-ADDR-METHOD">/AUTOSAR_MemMap/SwAddrMethods/VAR_CLEARED</SW-ADDRMETHOD-REF>
                  </MEMORY-SECTION>
[!IF "num:i(count(SecOCRxPduProcessing/*[node:existsAndTrue(./SecOCRxSecuredPduLayer/SecOCSecuredRxPduVerification) and node:exists(as:ref(as:ref(./SecOCRxAuthServiceConfigRef)/CsmJobPrimitiveRef)/CsmSignatureVerify) = 'true' and node:value(as:ref(as:ref(./SecOCRxAuthServiceConfigRef)/CsmJobPrimitiveRef)/CsmSignatureVerify/CsmSignatureVerifyConfig/CsmSignatureVerifyProcessing) = 'CSM_ASYNCHRONOUS'])) > 0 or
      num:i(count(SecOCRxPduProcessing/*[node:existsAndTrue(./SecOCRxSecuredPduLayer/SecOCSecuredRxPduVerification) and node:exists(as:ref(as:ref(./SecOCRxAuthServiceConfigRef)/CsmJobPrimitiveRef)/CsmMacVerify) = 'true' and node:value(as:ref(as:ref(./SecOCRxAuthServiceConfigRef)/CsmJobPrimitiveRef)/CsmMacVerify/CsmMacVerifyConfig/CsmMacVerifyProcessing) = 'CSM_ASYNCHRONOUS'])) > 0 or
      num:i(count(SecOCTxPduProcessing/*[node:exists(as:ref(as:ref(./SecOCTxAuthServiceConfigRef)/CsmJobPrimitiveRef)/CsmMacGenerate) = 'true' and node:value(as:ref(as:ref(./SecOCTxAuthServiceConfigRef)/CsmJobPrimitiveRef)/CsmMacGenerate/CsmMacGenerateConfig/CsmMacGenerateProcessing) = 'CSM_ASYNCHRONOUS'])) > 0 or
      num:i(count(SecOCTxPduProcessing/*[node:exists(as:ref(as:ref(./SecOCTxAuthServiceConfigRef)/CsmJobPrimitiveRef)/CsmSignatureGenerate) = 'true' and node:value(as:ref(as:ref(./SecOCTxAuthServiceConfigRef)/CsmJobPrimitiveRef)/CsmSignatureGenerate/CsmSignatureGenerateConfig/CsmSignatureGenerateProcessing) = 'CSM_ASYNCHRONOUS'])) > 0 or
      num:i(count(SecOCMainFunctionRx/*)) > 0  or num:i(count(SecOCMainFunctionTx/*)) > 0"!]
                  <MEMORY-SECTION>
                    <SHORT-NAME>CONST_16</SHORT-NAME>
                    <ALIGNMENT>16</ALIGNMENT>
                    <SW-ADDRMETHOD-REF DEST="SW-ADDR-METHOD">/AUTOSAR_MemMap/SwAddrMethods/CONST</SW-ADDRMETHOD-REF>
                  </MEMORY-SECTION>
[!ENDIF!]
                  <MEMORY-SECTION>
                    <SHORT-NAME>CONST_32</SHORT-NAME>
                    <ALIGNMENT>32</ALIGNMENT>
                    <SW-ADDRMETHOD-REF DEST="SW-ADDR-METHOD">/AUTOSAR_MemMap/SwAddrMethods/CONST</SW-ADDRMETHOD-REF>
                  </MEMORY-SECTION>
                  <MEMORY-SECTION>
                    <SHORT-NAME>CONST_UNSPECIFIED</SHORT-NAME>
                    <ALIGNMENT>UNSPECIFIED</ALIGNMENT>
                    <SW-ADDRMETHOD-REF DEST="SW-ADDR-METHOD">/AUTOSAR_MemMap/SwAddrMethods/CONST</SW-ADDRMETHOD-REF>
                  </MEMORY-SECTION>
                  <MEMORY-SECTION>
                    <SHORT-NAME>CONFIG_DATA_UNSPECIFIED</SHORT-NAME>
                    <ALIGNMENT>UNSPECIFIED</ALIGNMENT>
                    <SW-ADDRMETHOD-REF DEST="SW-ADDR-METHOD">/AUTOSAR_MemMap/SwAddrMethods/CONFIG_DATA</SW-ADDRMETHOD-REF>
                  </MEMORY-SECTION>
                </MEMORY-SECTIONS>
              </RESOURCE-CONSUMPTION>
              <SW-VERSION>2.8.14</SW-VERSION>
[!IF "SecOCEbGeneral/SecOCRteUsage = 'true'"!]
              <SWC-BSW-MAPPING-REF DEST="SWC-BSW-MAPPING">/AUTOSAR_SecOC/SwcBswMappings/SwcBswMapping_0</SWC-BSW-MAPPING-REF>
[!ENDIF!]
              <VENDOR-ID>1</VENDOR-ID>
              <AR-RELEASE-VERSION>4.3.0</AR-RELEASE-VERSION>
              <BEHAVIOR-REF DEST="BSW-INTERNAL-BEHAVIOR">/AUTOSAR_SecOC/BswModuleDescriptions/SecOC/InternalBehavior_0</BEHAVIOR-REF>
              <VENDOR-SPECIFIC-MODULE-DEF-REFS>
                <VENDOR-SPECIFIC-MODULE-DEF-REF DEST="ECUC-MODULE-DEF">/TS_TxDxM2I8R0/SecOC</VENDOR-SPECIFIC-MODULE-DEF-REF>
              </VENDOR-SPECIFIC-MODULE-DEF-REFS>
            </BSW-IMPLEMENTATION>
[!ENDIF!]
[!LOOP "node:refs(as:modconf('SecOC')/SecOCMainFunctionRx/*/SecOCMainFunctionRxPartitionRef | as:modconf('SecOC')/SecOCMainFunctionTx/*/SecOCMainFunctionTxPartitionRef)"!]
            <BSW-IMPLEMENTATION>
              <SHORT-NAME>BswImplementation_[!"node:name(.)"!]</SHORT-NAME>
              <CODE-DESCRIPTORS>
                <CODE>
                  <SHORT-NAME>Files</SHORT-NAME>
                  <ARTIFACT-DESCRIPTORS>
                    <AUTOSAR-ENGINEERING-OBJECT>
                      <SHORT-LABEL>Autosar::include::SecOC.h</SHORT-LABEL>
                      <CATEGORY>SWHDR</CATEGORY>
                    </AUTOSAR-ENGINEERING-OBJECT>
                    <AUTOSAR-ENGINEERING-OBJECT>
                      <SHORT-LABEL>Autosar::include::SecOC_Rx.h</SHORT-LABEL>
                      <CATEGORY>SWHDR</CATEGORY>
                    </AUTOSAR-ENGINEERING-OBJECT>
                    <AUTOSAR-ENGINEERING-OBJECT>
                      <SHORT-LABEL>Autosar::include::SecOC_Rx_Int.h</SHORT-LABEL>
                      <CATEGORY>SWHDR</CATEGORY>
                    </AUTOSAR-ENGINEERING-OBJECT>
                    <AUTOSAR-ENGINEERING-OBJECT>
                      <SHORT-LABEL>Autosar::include::SecOC_Tx.h</SHORT-LABEL>
                      <CATEGORY>SWHDR</CATEGORY>
                    </AUTOSAR-ENGINEERING-OBJECT>
                    <AUTOSAR-ENGINEERING-OBJECT>
                      <SHORT-LABEL>Autosar::include::SecOC_Tx_Int.h</SHORT-LABEL>
                      <CATEGORY>SWHDR</CATEGORY>
                    </AUTOSAR-ENGINEERING-OBJECT>
                    <AUTOSAR-ENGINEERING-OBJECT>
                      <SHORT-LABEL>Autosar::include::SecOC_Version.h</SHORT-LABEL>
                      <CATEGORY>SWHDR</CATEGORY>
                    </AUTOSAR-ENGINEERING-OBJECT>
                    <AUTOSAR-ENGINEERING-OBJECT>
                      <SHORT-LABEL>Autosar::src::SecOC.c</SHORT-LABEL>
                      <CATEGORY>SWSRC</CATEGORY>
                    </AUTOSAR-ENGINEERING-OBJECT>
                    <AUTOSAR-ENGINEERING-OBJECT>
                      <SHORT-LABEL>Autosar::src::SecOC_Rx.c</SHORT-LABEL>
                      <CATEGORY>SWSRC</CATEGORY>
                    </AUTOSAR-ENGINEERING-OBJECT>
                    <AUTOSAR-ENGINEERING-OBJECT>
                      <SHORT-LABEL>Autosar::src::SecOC_Tx.c</SHORT-LABEL>
                      <CATEGORY>SWSRC</CATEGORY>
                    </AUTOSAR-ENGINEERING-OBJECT>
                    <AUTOSAR-ENGINEERING-OBJECT>
                      <SHORT-LABEL>make::SecOC_defs.mak</SHORT-LABEL>
                      <CATEGORY>SWMAKE</CATEGORY>
                    </AUTOSAR-ENGINEERING-OBJECT>
                    <AUTOSAR-ENGINEERING-OBJECT>
                      <SHORT-LABEL>make::SecOC_rules.mak</SHORT-LABEL>
                      <CATEGORY>SWMAKE</CATEGORY>
                    </AUTOSAR-ENGINEERING-OBJECT>
                  </ARTIFACT-DESCRIPTORS>
                </CODE>
              </CODE-DESCRIPTORS>
              <PROGRAMMING-LANGUAGE>C</PROGRAMMING-LANGUAGE>
              <RESOURCE-CONSUMPTION>
                <SHORT-NAME>ResourceConsumption</SHORT-NAME>
                <MEMORY-SECTIONS>
                  <MEMORY-SECTION>
                    <SHORT-NAME>CODE</SHORT-NAME>
                    <SW-ADDRMETHOD-REF DEST="SW-ADDR-METHOD">/AUTOSAR_MemMap/SwAddrMethods/CODE</SW-ADDRMETHOD-REF>
                  </MEMORY-SECTION>
                  <MEMORY-SECTION>
                    <SHORT-NAME>VAR_CLEARED_UNSPECIFIED</SHORT-NAME>
                    <ALIGNMENT>UNSPECIFIED</ALIGNMENT>
                    <SW-ADDRMETHOD-REF DEST="SW-ADDR-METHOD">/AUTOSAR_MemMap/SwAddrMethods/VAR_CLEARED</SW-ADDRMETHOD-REF>
                  </MEMORY-SECTION>
                  <MEMORY-SECTION>
                    <SHORT-NAME>VAR_INIT_UNSPECIFIED</SHORT-NAME>
                    <ALIGNMENT>UNSPECIFIED</ALIGNMENT>
                    <SW-ADDRMETHOD-REF DEST="SW-ADDR-METHOD">/AUTOSAR_MemMap/SwAddrMethods/VAR</SW-ADDRMETHOD-REF>
                  </MEMORY-SECTION>
                  <MEMORY-SECTION>
                    <SHORT-NAME>VAR_INIT_8</SHORT-NAME>
                    <ALIGNMENT>8</ALIGNMENT>
                    <SW-ADDRMETHOD-REF DEST="SW-ADDR-METHOD">/AUTOSAR_MemMap/SwAddrMethods/VAR</SW-ADDRMETHOD-REF>
                  </MEMORY-SECTION>
                  <MEMORY-SECTION>
                    <SHORT-NAME>VAR_CLEARED_8</SHORT-NAME>
                    <ALIGNMENT>8</ALIGNMENT>
                    <SW-ADDRMETHOD-REF DEST="SW-ADDR-METHOD">/AUTOSAR_MemMap/SwAddrMethods/VAR_CLEARED</SW-ADDRMETHOD-REF>
                  </MEMORY-SECTION>
  [!IF "num:i(count(as:modconf('SecOC')/SecOCRxPduProcessing/*[node:exists(as:ref(as:ref(./SecOCRxAuthServiceConfigRef)/CsmJobPrimitiveRef)/CsmSignatureVerify) = 'true' and node:value(as:ref(as:ref(./SecOCRxAuthServiceConfigRef)/CsmJobPrimitiveRef)/CsmSignatureVerify/CsmSignatureVerifyConfig/CsmSignatureVerifyProcessing) = 'CSM_ASYNCHRONOUS'])) > 0 or
      num:i(count(as:modconf('SecOC')/SecOCRxPduProcessing/*[node:exists(as:ref(as:ref(./SecOCRxAuthServiceConfigRef)/CsmJobPrimitiveRef)/CsmMacVerify) = 'true' and node:value(as:ref(as:ref(./SecOCRxAuthServiceConfigRef)/CsmJobPrimitiveRef)/CsmMacVerify/CsmMacVerifyConfig/CsmMacVerifyProcessing) = 'CSM_ASYNCHRONOUS'])) > 0 or
      num:i(count(as:modconf('SecOC')/SecOCTxPduProcessing/*[node:exists(as:ref(as:ref(./SecOCTxAuthServiceConfigRef)/CsmJobPrimitiveRef)/CsmMacGenerate) = 'true' and node:value(as:ref(as:ref(./SecOCTxAuthServiceConfigRef)/CsmJobPrimitiveRef)/CsmMacGenerate/CsmMacGenerateConfig/CsmMacGenerateProcessing) = 'CSM_ASYNCHRONOUS'])) > 0 or
      num:i(count(as:modconf('SecOC')/SecOCTxPduProcessing/*[node:exists(as:ref(as:ref(./SecOCTxAuthServiceConfigRef)/CsmJobPrimitiveRef)/CsmSignatureGenerate) = 'true' and node:value(as:ref(as:ref(./SecOCTxAuthServiceConfigRef)/CsmJobPrimitiveRef)/CsmSignatureGenerate/CsmSignatureGenerateConfig/CsmSignatureGenerateProcessing) = 'CSM_ASYNCHRONOUS'])) > 0 or
      num:i(count(as:modconf('SecOC')/SecOCMainFunctionRx/*)) > 0  or num:i(count(as:modconf('SecOC')/SecOCMainFunctionTx/*)) > 0"!]
                  <MEMORY-SECTION>
                    <SHORT-NAME>CONST_16</SHORT-NAME>
                    <ALIGNMENT>16</ALIGNMENT>
                    <SW-ADDRMETHOD-REF DEST="SW-ADDR-METHOD">/AUTOSAR_MemMap/SwAddrMethods/CONST</SW-ADDRMETHOD-REF>
                  </MEMORY-SECTION>
  [!ENDIF!]
                  <MEMORY-SECTION>
                    <SHORT-NAME>CONST_32</SHORT-NAME>
                    <ALIGNMENT>32</ALIGNMENT>
                    <SW-ADDRMETHOD-REF DEST="SW-ADDR-METHOD">/AUTOSAR_MemMap/SwAddrMethods/CONST</SW-ADDRMETHOD-REF>
                  </MEMORY-SECTION>
                  <MEMORY-SECTION>
                    <SHORT-NAME>CONST_UNSPECIFIED</SHORT-NAME>
                    <ALIGNMENT>UNSPECIFIED</ALIGNMENT>
                    <SW-ADDRMETHOD-REF DEST="SW-ADDR-METHOD">/AUTOSAR_MemMap/SwAddrMethods/CONST</SW-ADDRMETHOD-REF>
                  </MEMORY-SECTION>
                  <MEMORY-SECTION>
                    <SHORT-NAME>CONFIG_DATA_UNSPECIFIED</SHORT-NAME>
                    <ALIGNMENT>UNSPECIFIED</ALIGNMENT>
                    <SW-ADDRMETHOD-REF DEST="SW-ADDR-METHOD">/AUTOSAR_MemMap/SwAddrMethods/CONFIG_DATA</SW-ADDRMETHOD-REF>
                  </MEMORY-SECTION>
                </MEMORY-SECTIONS>
              </RESOURCE-CONSUMPTION>
              <SW-VERSION>2.8.14</SW-VERSION>
  [!IF "SecOCEbGeneral/SecOCRteUsage = 'true'"!]
              <SWC-BSW-MAPPING-REF DEST="SWC-BSW-MAPPING">/AUTOSAR_SecOC/SwcBswMappings/SwcBswMapping_[!"node:name(.)"!]</SWC-BSW-MAPPING-REF>
  [!ENDIF!]
              <VENDOR-ID>1</VENDOR-ID>
              <AR-RELEASE-VERSION>4.3.0</AR-RELEASE-VERSION>
              <BEHAVIOR-REF DEST="BSW-INTERNAL-BEHAVIOR">/AUTOSAR_SecOC/BswModuleDescriptions/SecOC/InternalBehavior_[!"node:name(.)"!]</BEHAVIOR-REF>
              <VENDOR-SPECIFIC-MODULE-DEF-REFS>
                <VENDOR-SPECIFIC-MODULE-DEF-REF DEST="ECUC-MODULE-DEF">/TS_TxDxM2I8R0/SecOC</VENDOR-SPECIFIC-MODULE-DEF-REF>
              </VENDOR-SPECIFIC-MODULE-DEF-REFS>
            </BSW-IMPLEMENTATION>
[!ENDLOOP!]
          </ELEMENTS>
        </AR-PACKAGE>
      </AR-PACKAGES>
    </AR-PACKAGE>
  </AR-PACKAGES>
</AUTOSAR>
