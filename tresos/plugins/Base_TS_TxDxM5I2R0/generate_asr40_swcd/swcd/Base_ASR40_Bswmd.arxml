<?xml version="1.0" encoding="ISO-8859-1"?>
<AUTOSAR xmlns="http://autosar.org/schema/r4.0"
  xmlns:xsi="http://www.w3.org/2001/XMLSchema-instance"
  xsi:schemaLocation="http://autosar.org/schema/r4.0 AUTOSAR_4-0-3.xsd">
[!INCLUDE "../../generate_macros/Base_Vars.m"!][!//
[!AUTOSPACING!]
[!VAR "AutosarBaseTypeList"="'boolean uint8 uint16 uint32 sint8 sint16 sint32 float32 float64'"!]
[!VAR "AutosarImplTypeList"="'boolean uint8 uint16 uint32 sint8 sint16 sint32 float32 float64 sint8_least sint16_least sint32_least uint8_least uint16_least uint32_least'"!]
[!IF "node:existsAndTrue(as:modconf('Base')[1]/BaseTypes/BaseTypes64bit)"!]
[!VAR "AutosarBaseTypeList"="concat($AutosarBaseTypeList,' sint64 uint64')"!]
[!VAR "AutosarImplTypeList"="concat($AutosarImplTypeList,' sint64 uint64')"!]
[!ENDIF!][!/*

* GetTypeInfo
*   Retrieve Native Type, Size and Alignment of an AUTOSAR Base type
*
*   Parameters:
*     AutosarType: Name of the AUTOSAR Base type
*
*/!][!MACRO "GetTypeInfo","AutosarType"!][!/*

  --- get Native Type --- */!][!//
  [!VAR "property"="concat('BaseType_',$AutosarType)"!]
  [!IF "node:exists(as:modconf('Base')[1]/BaseTypes/eb-list::*[node:name(.)=$property])"!]
    [!VAR "NativeType"="as:modconf('Base')[1]/BaseTypes/eb-list::*[node:name(.)=$property]"!]
    [!VAR "NativeTypeBase"="normalize-space(text:replace($NativeType,'(un)?signed',''))"!]
  [!ELSE!]
    [!ERROR!]
      Base: No mapping to C type found for AUTOSAR type [!"$AutosarType"!]
    [!ENDERROR!]
  [!ENDIF!][!/*

  --- get Size --- */!][!//
  [!VAR "property"="concat('BaseType_Size_',text:replace($NativeTypeBase,' ',''))"!]
  [!IF "node:exists(as:modconf('Base')[1]/BaseTypes/eb-list::*[node:name(.)=$property])"!]
    [!VAR "Size"="as:modconf('Base')[1]/BaseTypes/eb-list::*[node:name(.)=$property]"!]
    [!VAR "Size"="num:i(number($Size) * 8)"!]
  [!ELSE!]
    [!ERROR!]
      Base: Property '[!"$property"!]' not found for type '[!"$NativeTypeBase"!]'
    [!ENDERROR!]
  [!ENDIF!][!/*

  --- get Alignment --- */!][!//
  [!VAR "property"="concat('BaseType_Alignment_',text:replace($NativeTypeBase,' ',''))"!]
  [!IF "node:exists(as:modconf('Base')[1]/BaseTypes/eb-list::*[node:name(.)=$property])"!]
    [!VAR "Alignment"="as:modconf('Base')[1]/BaseTypes/eb-list::*[node:name(.)=$property]"!]
    [!VAR "Alignment"="num:i(number($Alignment) * 8)"!]
  [!ELSE!]
    [!ERROR!]
      Base: Property '[!"$property"!]' not found for type '[!"$NativeTypeBase"!]'
    [!ENDERROR!]
  [!ENDIF!][!/*

  --- determine Encoding --- */!][!//
  [!IF "text:match($NativeType,'(float)|(double)')"!]
    [!VAR "Encoding"="'IEEE754'"!]
  [!ELSEIF "text:match($AutosarType,'boolean')"!]
    [!VAR "Encoding"="'BOOLEAN'"!]
  [!ELSEIF "not(text:match($NativeType,'^\s*unsigned\s+.*$'))"!]
    [!VAR "Encoding"="'2C'"!]
  [!ELSE!]
    [!VAR "Encoding"="'NONE'"!]
  [!ENDIF!][!/*

  --- get LowerLimit and UpperLimit ---
      don't use size of type, as the size MIGHT be bigger than the allowed values
      instead use the bit width expected by AUTOSAR
      exception: 64 bit unsigned type is hard-coded because it is not supported by bit:shl */!][!//
  [!VAR "AutosarTypeBitWidth" = "normalize-space(text:replace($AutosarType,'^\s*[su]int(\d\d?)(_least)?\s*$','$1'))"!]
  [!IF "$AutosarType = 'boolean'"!]
    [!VAR "LowerLimit"="num:i(0)"!]
    [!VAR "UpperLimit"="num:i(1)"!]
  [!ELSEIF "$Encoding = 'NONE'"!]
    [!VAR "LowerLimit"="num:i(0)"!]
    [!IF "$AutosarTypeBitWidth = '64'"!]
      [!VAR "UpperLimit"="18446744073709551615"!]
    [!ELSE!]
      [!VAR "UpperLimit"="num:i(bit:shl(1,$AutosarTypeBitWidth) - 1)"!]
    [!ENDIF!]
  [!ELSEIF "$Encoding = '2C'"!]
    [!IF "$AutosarTypeBitWidth = '64'"!]
      [!VAR "LowerLimit"="-9223372036854775808"!]
      [!VAR "UpperLimit"="9223372036854775807"!]
    [!ELSE!]
      [!VAR "LowerLimit"="num:i(- bit:shl(1,$AutosarTypeBitWidth - 1))"!]
      [!VAR "UpperLimit"="num:i(bit:shl(1,$AutosarTypeBitWidth - 1) - 1)"!]
    [!ENDIF!]
  [!ELSE!]
    [!VAR "LowerLimit"="num:i(0)"!]
    [!VAR "UpperLimit"="num:i(0)"!]
  [!ENDIF!]
[!ENDMACRO!][!/*


* FindMatchingBaseType
*   Takes an ImplementationDataType as input and returns the name of the BaseType
*   1.) for all ImplementationDataType found in list of BaseTypes (var AutosarBaseTypeList)
*      return the name of the ImplementationDataType (input para) since there is a BaseType
*      of the same name.
*   2.) for all ImplementationDataType not contained in the list:
*      return the BaseType which matches with all of the following attributes:
*   - Size
*   - Encoding
*   - Alignment
*
* If there is no matching BaseType generation aborts
* with an error!
*
*/!][!MACRO "FindMatchingBaseType","ImplDataType"!]
  [!CALL "GetTypeInfo","AutosarType"="$ImplDataType"!]
  [!VAR "ImplTypeSize"="$Size"!]
  [!VAR "ImplTypeEncoding"="$Encoding"!]
  [!VAR "ImplTypeAlignment"="$Alignment"!]
  [!VAR "ImplTypeNativeType"="$NativeType"!]
  [!VAR "MatchingBaseType"="''"!]
  [!IF "text:match($AutosarBaseTypeList,$ImplDataType)"!]
    [!VAR "MatchingBaseType"="$ImplDataType"!]
  [!ELSE!]
    [!FOR "type"="1" TO  "num:i(count(text:split($AutosarBaseTypeList)))"!]
      [!VAR "BaseType"="text:split($AutosarBaseTypeList)[num:i($type)]"!]
      [!CALL "GetTypeInfo","AutosarType"="$BaseType"!]
      [!IF "($Size = $ImplTypeSize) and ($Encoding = $ImplTypeEncoding) and ($Alignment = $ImplTypeAlignment)"!]
        [!VAR "MatchingBaseType"="$AutosarType"!]
        [!BREAK!]
      [!ENDIF!]
    [!ENDFOR!]
  [!ENDIF!]
  [!IF "$MatchingBaseType = ''"!]
    [!ERROR!]
      Base: No matching BaseType found for ImplementationDataType [!"$ImplDataType"!]
      [!"$ImplTypeSize"!]
      [!"$ImplTypeEncoding"!]
      [!"$ImplTypeAlignment"!]
      [!"$ImplTypeNativeType"!]
    [!ENDERROR!]
  [!ENDIF!]
[!ENDMACRO!][!/*



* GetPduType
*   Get the base type of types in EcucPduCollection
*
*   Parameters:
*     TypeName: Name of the type in EcucPduCollection
*
*/!][!MACRO "GetPduTypeInfo","TypeName"!]
  [!IF "node:exists(as:modconf('EcuC')[1]/EcucPduCollection/eb-list::*[node:name(.)=$TypeName])"!]
    [!VAR "Type"="text:tolower(as:modconf('EcuC')[1]/EcucPduCollection/eb-list::*[node:name(.)=$TypeName])"!]
  [!ELSE!]
    [!VAR "Type" = "'uint16'"!]
  [!ENDIF!]
[!ENDMACRO!][!/*


* GenerateStdImplementationTypes
*   Generates the implementation types of the Std package
*
*   Parameters:
*     None.
*
*/!][!MACRO "GenerateStdImplementationTypes"!]
            <SHORT-NAME>ImplementationDataTypes</SHORT-NAME>
            <CATEGORY>STANDARD</CATEGORY>
            <ELEMENTS>
              <IMPLEMENTATION-DATA-TYPE>
                <SHORT-NAME>Std_ReturnType</SHORT-NAME>
                <CATEGORY>TYPE_REFERENCE</CATEGORY>
                <SW-DATA-DEF-PROPS>
                  <SW-DATA-DEF-PROPS-VARIANTS>
                    <SW-DATA-DEF-PROPS-CONDITIONAL>
                      <COMPU-METHOD-REF DEST="COMPU-METHOD">/AUTOSAR_Std/CompuMethods/Std_ReturnType</COMPU-METHOD-REF>
                      <IMPLEMENTATION-DATA-TYPE-REF DEST="IMPLEMENTATION-DATA-TYPE">/AUTOSAR_Platform/ImplementationDataTypes/uint8</IMPLEMENTATION-DATA-TYPE-REF>
                    </SW-DATA-DEF-PROPS-CONDITIONAL>
                  </SW-DATA-DEF-PROPS-VARIANTS>
                </SW-DATA-DEF-PROPS>
                <TYPE-EMITTER>Std_Types.h</TYPE-EMITTER>
              </IMPLEMENTATION-DATA-TYPE>
              <IMPLEMENTATION-DATA-TYPE>
                <SHORT-NAME>Std_VersionInfoType</SHORT-NAME>
                <CATEGORY>STRUCTURE</CATEGORY>
                <SUB-ELEMENTS>
                  <IMPLEMENTATION-DATA-TYPE-ELEMENT>
                    <SHORT-NAME>vendorID</SHORT-NAME>
                    <CATEGORY>TYPE_REFERENCE</CATEGORY>
                    <SW-DATA-DEF-PROPS>
                      <SW-DATA-DEF-PROPS-VARIANTS>
                        <SW-DATA-DEF-PROPS-CONDITIONAL>
                          <IMPLEMENTATION-DATA-TYPE-REF DEST="IMPLEMENTATION-DATA-TYPE">/AUTOSAR_Platform/ImplementationDataTypes/uint16</IMPLEMENTATION-DATA-TYPE-REF>
                        </SW-DATA-DEF-PROPS-CONDITIONAL>
                      </SW-DATA-DEF-PROPS-VARIANTS>
                    </SW-DATA-DEF-PROPS>
                  </IMPLEMENTATION-DATA-TYPE-ELEMENT>
                  <IMPLEMENTATION-DATA-TYPE-ELEMENT>
                    <SHORT-NAME>moduleID</SHORT-NAME>
                    <CATEGORY>TYPE_REFERENCE</CATEGORY>
                    <SW-DATA-DEF-PROPS>
                      <SW-DATA-DEF-PROPS-VARIANTS>
                        <SW-DATA-DEF-PROPS-CONDITIONAL>
                          <IMPLEMENTATION-DATA-TYPE-REF DEST="IMPLEMENTATION-DATA-TYPE">/AUTOSAR_Platform/ImplementationDataTypes/uint16</IMPLEMENTATION-DATA-TYPE-REF>
                        </SW-DATA-DEF-PROPS-CONDITIONAL>
                      </SW-DATA-DEF-PROPS-VARIANTS>
                    </SW-DATA-DEF-PROPS>
                  </IMPLEMENTATION-DATA-TYPE-ELEMENT>
                  <IMPLEMENTATION-DATA-TYPE-ELEMENT>
                    <SHORT-NAME>sw_major_version</SHORT-NAME>
                    <CATEGORY>TYPE_REFERENCE</CATEGORY>
                    <SW-DATA-DEF-PROPS>
                      <SW-DATA-DEF-PROPS-VARIANTS>
                        <SW-DATA-DEF-PROPS-CONDITIONAL>
                          <IMPLEMENTATION-DATA-TYPE-REF DEST="IMPLEMENTATION-DATA-TYPE">/AUTOSAR_Platform/ImplementationDataTypes/uint8</IMPLEMENTATION-DATA-TYPE-REF>
                        </SW-DATA-DEF-PROPS-CONDITIONAL>
                      </SW-DATA-DEF-PROPS-VARIANTS>
                    </SW-DATA-DEF-PROPS>
                  </IMPLEMENTATION-DATA-TYPE-ELEMENT>
                  <IMPLEMENTATION-DATA-TYPE-ELEMENT>
                    <SHORT-NAME>sw_minor_version</SHORT-NAME>
                    <CATEGORY>TYPE_REFERENCE</CATEGORY>
                    <SW-DATA-DEF-PROPS>
                      <SW-DATA-DEF-PROPS-VARIANTS>
                        <SW-DATA-DEF-PROPS-CONDITIONAL>
                          <IMPLEMENTATION-DATA-TYPE-REF DEST="IMPLEMENTATION-DATA-TYPE">/AUTOSAR_Platform/ImplementationDataTypes/uint8</IMPLEMENTATION-DATA-TYPE-REF>
                        </SW-DATA-DEF-PROPS-CONDITIONAL>
                      </SW-DATA-DEF-PROPS-VARIANTS>
                    </SW-DATA-DEF-PROPS>
                  </IMPLEMENTATION-DATA-TYPE-ELEMENT>
                  <IMPLEMENTATION-DATA-TYPE-ELEMENT>
                    <SHORT-NAME>sw_patch_version</SHORT-NAME>
                    <CATEGORY>TYPE_REFERENCE</CATEGORY>
                    <SW-DATA-DEF-PROPS>
                      <SW-DATA-DEF-PROPS-VARIANTS>
                        <SW-DATA-DEF-PROPS-CONDITIONAL>
                          <IMPLEMENTATION-DATA-TYPE-REF DEST="IMPLEMENTATION-DATA-TYPE">/AUTOSAR_Platform/ImplementationDataTypes/uint8</IMPLEMENTATION-DATA-TYPE-REF>
                        </SW-DATA-DEF-PROPS-CONDITIONAL>
                      </SW-DATA-DEF-PROPS-VARIANTS>
                    </SW-DATA-DEF-PROPS>
                  </IMPLEMENTATION-DATA-TYPE-ELEMENT>
                </SUB-ELEMENTS>
                <TYPE-EMITTER>Std_Types.h</TYPE-EMITTER>
              </IMPLEMENTATION-DATA-TYPE>
              <IMPLEMENTATION-DATA-TYPE>
                <SHORT-NAME>Std_MessageTypeType</SHORT-NAME>
                <CATEGORY>TYPE_REFERENCE</CATEGORY>
                <SW-DATA-DEF-PROPS>
                  <SW-DATA-DEF-PROPS-VARIANTS>
                    <SW-DATA-DEF-PROPS-CONDITIONAL>
                      <COMPU-METHOD-REF DEST="COMPU-METHOD">/AUTOSAR_Std/CompuMethods/Std_MessageTypeType</COMPU-METHOD-REF>
                      <IMPLEMENTATION-DATA-TYPE-REF DEST="IMPLEMENTATION-DATA-TYPE">/AUTOSAR_Platform/ImplementationDataTypes/uint8</IMPLEMENTATION-DATA-TYPE-REF>
                    </SW-DATA-DEF-PROPS-CONDITIONAL>
                  </SW-DATA-DEF-PROPS-VARIANTS>
                </SW-DATA-DEF-PROPS>
                <TYPE-EMITTER>Std_Types.h</TYPE-EMITTER>
              </IMPLEMENTATION-DATA-TYPE>
              <IMPLEMENTATION-DATA-TYPE>
                <SHORT-NAME>Std_MessageResultType</SHORT-NAME>
                <CATEGORY>TYPE_REFERENCE</CATEGORY>
                <SW-DATA-DEF-PROPS>
                  <SW-DATA-DEF-PROPS-VARIANTS>
                    <SW-DATA-DEF-PROPS-CONDITIONAL>
                      <COMPU-METHOD-REF DEST="COMPU-METHOD">/AUTOSAR_Std/CompuMethods/Std_MessageResultType</COMPU-METHOD-REF>
                      <IMPLEMENTATION-DATA-TYPE-REF DEST="IMPLEMENTATION-DATA-TYPE">/AUTOSAR_Platform/ImplementationDataTypes/uint8</IMPLEMENTATION-DATA-TYPE-REF>
                    </SW-DATA-DEF-PROPS-CONDITIONAL>
                  </SW-DATA-DEF-PROPS-VARIANTS>
                </SW-DATA-DEF-PROPS>
                <TYPE-EMITTER>Std_Types.h</TYPE-EMITTER>
              </IMPLEMENTATION-DATA-TYPE>
            </ELEMENTS>
[!ENDMACRO!][!/*

* GenerateStdCompuMethods
*   Generates the compu methods of the Std package
*
*   Parameters:
*     None.
*
*/!][!MACRO "GenerateStdCompuMethods"!]
            <SHORT-NAME>CompuMethods</SHORT-NAME>
            <CATEGORY>STANDARD</CATEGORY>
            <ELEMENTS>
              <COMPU-METHOD>
                 <SHORT-NAME>Std_ReturnType</SHORT-NAME>
                 <CATEGORY>TEXTTABLE</CATEGORY>
                 <COMPU-INTERNAL-TO-PHYS>
                    <COMPU-SCALES>
                       <COMPU-SCALE>
                          <LOWER-LIMIT INTERVAL-TYPE="CLOSED">0</LOWER-LIMIT>
                          <UPPER-LIMIT INTERVAL-TYPE="CLOSED">0</UPPER-LIMIT>
                          <COMPU-CONST>
                             <VT>E_OK</VT>
                          </COMPU-CONST>
                       </COMPU-SCALE>
                       <COMPU-SCALE>
                          <LOWER-LIMIT INTERVAL-TYPE="CLOSED">1</LOWER-LIMIT>
                          <UPPER-LIMIT INTERVAL-TYPE="CLOSED">1</UPPER-LIMIT>
                          <COMPU-CONST>
                             <VT>E_NOT_OK</VT>
                          </COMPU-CONST>
                       </COMPU-SCALE>
                    </COMPU-SCALES>
                 </COMPU-INTERNAL-TO-PHYS>
              </COMPU-METHOD>
              <COMPU-METHOD>
                 <SHORT-NAME>Std_MessageTypeType</SHORT-NAME>
                 <CATEGORY>TEXTTABLE</CATEGORY>
                 <COMPU-INTERNAL-TO-PHYS>
                    <COMPU-SCALES>
                       <COMPU-SCALE>
                          <LOWER-LIMIT INTERVAL-TYPE="CLOSED">0</LOWER-LIMIT>
                          <UPPER-LIMIT INTERVAL-TYPE="CLOSED">0</UPPER-LIMIT>
                          <COMPU-CONST>
                             <VT>STD_MESSAGETYPE_REQUEST</VT>
                          </COMPU-CONST>
                       </COMPU-SCALE>
                       <COMPU-SCALE>
                          <LOWER-LIMIT INTERVAL-TYPE="CLOSED">1</LOWER-LIMIT>
                          <UPPER-LIMIT INTERVAL-TYPE="CLOSED">1</UPPER-LIMIT>
                          <COMPU-CONST>
                             <VT>STD_MESSAGETYPE_RESPONSE</VT>
                          </COMPU-CONST>
                       </COMPU-SCALE>
                    </COMPU-SCALES>
                 </COMPU-INTERNAL-TO-PHYS>
              </COMPU-METHOD>
              <COMPU-METHOD>
                 <SHORT-NAME>Std_MessageResultType</SHORT-NAME>
                 <CATEGORY>TEXTTABLE</CATEGORY>
                 <COMPU-INTERNAL-TO-PHYS>
                    <COMPU-SCALES>
                       <COMPU-SCALE>
                          <LOWER-LIMIT INTERVAL-TYPE="CLOSED">0</LOWER-LIMIT>
                          <UPPER-LIMIT INTERVAL-TYPE="CLOSED">0</UPPER-LIMIT>
                          <COMPU-CONST>
                             <VT>STD_MESSAGERESULT_OK</VT>
                          </COMPU-CONST>
                       </COMPU-SCALE>
                       <COMPU-SCALE>
                          <LOWER-LIMIT INTERVAL-TYPE="CLOSED">1</LOWER-LIMIT>
                          <UPPER-LIMIT INTERVAL-TYPE="CLOSED">1</UPPER-LIMIT>
                          <COMPU-CONST>
                             <VT>STD_MESSAGERESULT_ERROR</VT>
                          </COMPU-CONST>
                       </COMPU-SCALE>
                    </COMPU-SCALES>
                 </COMPU-INTERNAL-TO-PHYS>
              </COMPU-METHOD>
           </ELEMENTS>
[!ENDMACRO!][!/*

* GeneratePlatformImplementationTypes
*   Generates the implementation types of the Platform package
*
*   Parameters:
*     None.
*
*/!][!MACRO "GeneratePlatformImplementationTypes"!]
            <SHORT-NAME>ImplementationDataTypes</SHORT-NAME>
            <CATEGORY>STANDARD</CATEGORY>
            <ELEMENTS>
              <!-- kept for backward compatibility, deprecated, AUTOSAR/GenDef/ImplementationDataTypes/ConstVoidPtr shall be used instead -->
              <IMPLEMENTATION-DATA-TYPE>
                <SHORT-NAME>ConstVoidPtr</SHORT-NAME>
                <CATEGORY>DATA_REFERENCE</CATEGORY>
                <SW-DATA-DEF-PROPS>
                  <SW-DATA-DEF-PROPS-VARIANTS>
                    <SW-DATA-DEF-PROPS-CONDITIONAL>
                      <SW-POINTER-TARGET-PROPS>
                        <TARGET-CATEGORY>VALUE</TARGET-CATEGORY>
                        <SW-DATA-DEF-PROPS>
                          <SW-DATA-DEF-PROPS-VARIANTS>
                            <SW-DATA-DEF-PROPS-CONDITIONAL>
                              <BASE-TYPE-REF DEST="SW-BASE-TYPE">/AUTOSAR_Platform/BaseTypes/void</BASE-TYPE-REF>
                              <SW-IMPL-POLICY>CONST</SW-IMPL-POLICY>
                            </SW-DATA-DEF-PROPS-CONDITIONAL>
                          </SW-DATA-DEF-PROPS-VARIANTS>
                        </SW-DATA-DEF-PROPS>
                      </SW-POINTER-TARGET-PROPS>
                    </SW-DATA-DEF-PROPS-CONDITIONAL>
                  </SW-DATA-DEF-PROPS-VARIANTS>
                </SW-DATA-DEF-PROPS>
                <TYPE-EMITTER>BSW</TYPE-EMITTER>
              </IMPLEMENTATION-DATA-TYPE>
              <!-- kept for backward compatibility, deprecated, AUTOSAR/GenDef/ImplementationDataTypes/VoidPtr shall be used instead -->
              <IMPLEMENTATION-DATA-TYPE>
                <SHORT-NAME>VoidPtr</SHORT-NAME>
                <CATEGORY>DATA_REFERENCE</CATEGORY>
                <SW-DATA-DEF-PROPS>
                  <SW-DATA-DEF-PROPS-VARIANTS>
                    <SW-DATA-DEF-PROPS-CONDITIONAL>
                      <SW-POINTER-TARGET-PROPS>
                        <TARGET-CATEGORY>VALUE</TARGET-CATEGORY>
                        <SW-DATA-DEF-PROPS>
                          <SW-DATA-DEF-PROPS-VARIANTS>
                            <SW-DATA-DEF-PROPS-CONDITIONAL>
                              <BASE-TYPE-REF DEST="SW-BASE-TYPE">/AUTOSAR_Platform/BaseTypes/void</BASE-TYPE-REF>
                            </SW-DATA-DEF-PROPS-CONDITIONAL>
                          </SW-DATA-DEF-PROPS-VARIANTS>
                        </SW-DATA-DEF-PROPS>
                      </SW-POINTER-TARGET-PROPS>
                    </SW-DATA-DEF-PROPS-CONDITIONAL>
                  </SW-DATA-DEF-PROPS-VARIANTS>
                </SW-DATA-DEF-PROPS>
                <TYPE-EMITTER>BSW</TYPE-EMITTER>
              </IMPLEMENTATION-DATA-TYPE>

              <!-- !LINKSTO Base.DataConstr.References, 1 -->
[!FOR "i"="1" TO  "num:i(count(text:split($AutosarImplTypeList)))"!]
  [!VAR "ImplDataType"="text:split($AutosarImplTypeList)[num:i($i)]"!]
  [!CALL "FindMatchingBaseType","ImplDataType"="$ImplDataType"!]
              <IMPLEMENTATION-DATA-TYPE>
                <SHORT-NAME>[!"$ImplDataType"!]</SHORT-NAME>
                <CATEGORY>VALUE</CATEGORY>
                <SW-DATA-DEF-PROPS>
                  <SW-DATA-DEF-PROPS-VARIANTS>
                    <SW-DATA-DEF-PROPS-CONDITIONAL>
                      <BASE-TYPE-REF DEST="SW-BASE-TYPE">/AUTOSAR_Platform/BaseTypes/[!"$MatchingBaseType"!]</BASE-TYPE-REF>
[!IF "$AutosarType = 'boolean'"!]
                      <COMPU-METHOD-REF DEST="COMPU-METHOD">/AUTOSAR_Platform/CompuMethods/boolean</COMPU-METHOD-REF>
  [!ENDIF!]
                    </SW-DATA-DEF-PROPS-CONDITIONAL>
                  </SW-DATA-DEF-PROPS-VARIANTS>
                </SW-DATA-DEF-PROPS>
                <TYPE-EMITTER>Platform_Types.h</TYPE-EMITTER>
              </IMPLEMENTATION-DATA-TYPE>
[!ENDFOR!]
            </ELEMENTS>
[!ENDMACRO!][!/*


* GenerateComtypeImplementationTypes
*   Generates the implementation types of the Comtype package
*
*   Parameters:
*     None.
*
*/!][!MACRO "GenerateComtypeImplementationTypes"!]
            <SHORT-NAME>ImplementationDataTypes</SHORT-NAME>
            <CATEGORY>STANDARD</CATEGORY>
            <ELEMENTS>
              <IMPLEMENTATION-DATA-TYPE>
                 <SHORT-NAME>IcomConfigIdType</SHORT-NAME>
                <CATEGORY>TYPE_REFERENCE</CATEGORY>
                <SW-DATA-DEF-PROPS>
                  <SW-DATA-DEF-PROPS-VARIANTS>
                    <SW-DATA-DEF-PROPS-CONDITIONAL>
                          <DATA-CONSTR-REF DEST="DATA-CONSTR">/AUTOSAR_ComStack_Types/DataConstrs/IcomConfigIdType</DATA-CONSTR-REF>
                          <IMPLEMENTATION-DATA-TYPE-REF DEST="IMPLEMENTATION-DATA-TYPE">/AUTOSAR_Platform/ImplementationDataTypes/uint8</IMPLEMENTATION-DATA-TYPE-REF>
                    </SW-DATA-DEF-PROPS-CONDITIONAL>
                  </SW-DATA-DEF-PROPS-VARIANTS>
                </SW-DATA-DEF-PROPS>
                <TYPE-EMITTER>BSW</TYPE-EMITTER>
              </IMPLEMENTATION-DATA-TYPE>
              <IMPLEMENTATION-DATA-TYPE>
                <SHORT-NAME>IcomSwitch_ErrorType</SHORT-NAME>
                <CATEGORY>TYPE_REFERENCE</CATEGORY>
                 <SW-DATA-DEF-PROPS>
                    <SW-DATA-DEF-PROPS-VARIANTS>
                       <SW-DATA-DEF-PROPS-CONDITIONAL>
                          <COMPU-METHOD-REF DEST="COMPU-METHOD">/AUTOSAR_ComStack_Types/CompuMethods/IcomSwitch_ErrorType</COMPU-METHOD-REF>
                          <DATA-CONSTR-REF DEST="DATA-CONSTR">/AUTOSAR_ComStack_Types/DataConstrs/IcomSwitch_ErrorType</DATA-CONSTR-REF>
                          <IMPLEMENTATION-DATA-TYPE-REF DEST="IMPLEMENTATION-DATA-TYPE">/AUTOSAR_Platform/ImplementationDataTypes/uint8</IMPLEMENTATION-DATA-TYPE-REF>
                       </SW-DATA-DEF-PROPS-CONDITIONAL>
                    </SW-DATA-DEF-PROPS-VARIANTS>
                 </SW-DATA-DEF-PROPS>
                <TYPE-EMITTER>BSW</TYPE-EMITTER>
              </IMPLEMENTATION-DATA-TYPE>
              <IMPLEMENTATION-DATA-TYPE>
                <SHORT-NAME>NetworkHandleType</SHORT-NAME>
                <CATEGORY>TYPE_REFERENCE</CATEGORY>
                <SW-DATA-DEF-PROPS>
                  <SW-DATA-DEF-PROPS-VARIANTS>
                    <SW-DATA-DEF-PROPS-CONDITIONAL>
                      <DATA-CONSTR-REF DEST="DATA-CONSTR">/AUTOSAR_ComStack_Types/DataConstrs/NetworkHandleType</DATA-CONSTR-REF>
                      <IMPLEMENTATION-DATA-TYPE-REF DEST="IMPLEMENTATION-DATA-TYPE">/AUTOSAR_Platform/ImplementationDataTypes/uint8</IMPLEMENTATION-DATA-TYPE-REF>
                    </SW-DATA-DEF-PROPS-CONDITIONAL>
                  </SW-DATA-DEF-PROPS-VARIANTS>
                </SW-DATA-DEF-PROPS>
                <TYPE-EMITTER>BSW</TYPE-EMITTER>
              </IMPLEMENTATION-DATA-TYPE>
              <IMPLEMENTATION-DATA-TYPE>
                <SHORT-NAME>PduInfoType</SHORT-NAME>
                <CATEGORY>STRUCTURE</CATEGORY>
                <SUB-ELEMENTS>
                  <IMPLEMENTATION-DATA-TYPE-ELEMENT>
                    <SHORT-NAME>SduDataPtr</SHORT-NAME>
                    <CATEGORY>DATA_REFERENCE</CATEGORY>
                    <SW-DATA-DEF-PROPS>
                      <SW-DATA-DEF-PROPS-VARIANTS>
                        <SW-DATA-DEF-PROPS-CONDITIONAL>
                          <SW-POINTER-TARGET-PROPS>
                            <TARGET-CATEGORY>TYPE_REFERENCE</TARGET-CATEGORY>
                            <SW-DATA-DEF-PROPS>
                              <SW-DATA-DEF-PROPS-VARIANTS>
                                <SW-DATA-DEF-PROPS-CONDITIONAL>
                                  <IMPLEMENTATION-DATA-TYPE-REF DEST="IMPLEMENTATION-DATA-TYPE">/AUTOSAR_Platform/ImplementationDataTypes/uint8</IMPLEMENTATION-DATA-TYPE-REF>
                                </SW-DATA-DEF-PROPS-CONDITIONAL>
                              </SW-DATA-DEF-PROPS-VARIANTS>
                            </SW-DATA-DEF-PROPS>
                          </SW-POINTER-TARGET-PROPS>
                        </SW-DATA-DEF-PROPS-CONDITIONAL>
                      </SW-DATA-DEF-PROPS-VARIANTS>
                    </SW-DATA-DEF-PROPS>
                  </IMPLEMENTATION-DATA-TYPE-ELEMENT>
                  <IMPLEMENTATION-DATA-TYPE-ELEMENT>
                    <SHORT-NAME>SduLength</SHORT-NAME>
                    <CATEGORY>TYPE_REFERENCE</CATEGORY>
                    <SW-DATA-DEF-PROPS>
                      <SW-DATA-DEF-PROPS-VARIANTS>
                        <SW-DATA-DEF-PROPS-CONDITIONAL>
                          <IMPLEMENTATION-DATA-TYPE-REF DEST="IMPLEMENTATION-DATA-TYPE">/AUTOSAR_ComStack_Types/ImplementationDataTypes/PduLengthType</IMPLEMENTATION-DATA-TYPE-REF>
                        </SW-DATA-DEF-PROPS-CONDITIONAL>
                      </SW-DATA-DEF-PROPS-VARIANTS>
                    </SW-DATA-DEF-PROPS>
                  </IMPLEMENTATION-DATA-TYPE-ELEMENT>
                </SUB-ELEMENTS>
                <TYPE-EMITTER>BSW</TYPE-EMITTER>
              </IMPLEMENTATION-DATA-TYPE>
              <IMPLEMENTATION-DATA-TYPE>
	              <SHORT-NAME>PNCHandleType</SHORT-NAME>
	              <CATEGORY>TYPE_REFERENCE</CATEGORY>
	              <SW-DATA-DEF-PROPS>
	                 <SW-DATA-DEF-PROPS-VARIANTS>
	                    <SW-DATA-DEF-PROPS-CONDITIONAL>
	                       <DATA-CONSTR-REF DEST="DATA-CONSTR">/AUTOSAR_ComStack_Types/DataConstrs/PNCHandleType</DATA-CONSTR-REF>
	                       <IMPLEMENTATION-DATA-TYPE-REF DEST="IMPLEMENTATION-DATA-TYPE">/AUTOSAR_Platform/ImplementationDataTypes/uint8</IMPLEMENTATION-DATA-TYPE-REF>
	                    </SW-DATA-DEF-PROPS-CONDITIONAL>
	                 </SW-DATA-DEF-PROPS-VARIANTS>
	              </SW-DATA-DEF-PROPS>
                <TYPE-EMITTER>BSW</TYPE-EMITTER>
	           </IMPLEMENTATION-DATA-TYPE>
	            <IMPLEMENTATION-DATA-TYPE>
                <SHORT-NAME>RetryInfoType</SHORT-NAME>
                <CATEGORY>STRUCTURE</CATEGORY>
                <SUB-ELEMENTS>
                  <IMPLEMENTATION-DATA-TYPE-ELEMENT>
                    <SHORT-NAME>TpDataState</SHORT-NAME>
                    <CATEGORY>TYPE_REFERENCE</CATEGORY>
                    <SW-DATA-DEF-PROPS>
                      <SW-DATA-DEF-PROPS-VARIANTS>
                        <SW-DATA-DEF-PROPS-CONDITIONAL>
                          <IMPLEMENTATION-DATA-TYPE-REF DEST="IMPLEMENTATION-DATA-TYPE">/AUTOSAR_ComStack_Types/ImplementationDataTypes/TpDataStateType</IMPLEMENTATION-DATA-TYPE-REF>
                        </SW-DATA-DEF-PROPS-CONDITIONAL>
                      </SW-DATA-DEF-PROPS-VARIANTS>
                    </SW-DATA-DEF-PROPS>
                  </IMPLEMENTATION-DATA-TYPE-ELEMENT>
                  <IMPLEMENTATION-DATA-TYPE-ELEMENT>
                    <SHORT-NAME>TxTpDataCnt</SHORT-NAME>
                    <CATEGORY>TYPE_REFERENCE</CATEGORY>
                    <SW-DATA-DEF-PROPS>
                      <SW-DATA-DEF-PROPS-VARIANTS>
                        <SW-DATA-DEF-PROPS-CONDITIONAL>
                          <IMPLEMENTATION-DATA-TYPE-REF DEST="IMPLEMENTATION-DATA-TYPE">/AUTOSAR_ComStack_Types/ImplementationDataTypes/PduLengthType</IMPLEMENTATION-DATA-TYPE-REF>
                        </SW-DATA-DEF-PROPS-CONDITIONAL>
                      </SW-DATA-DEF-PROPS-VARIANTS>
                    </SW-DATA-DEF-PROPS>
                  </IMPLEMENTATION-DATA-TYPE-ELEMENT>
                </SUB-ELEMENTS>
                <TYPE-EMITTER>BSW</TYPE-EMITTER>
              </IMPLEMENTATION-DATA-TYPE>
              <IMPLEMENTATION-DATA-TYPE>
                <SHORT-NAME>TpDataStateType</SHORT-NAME>
                <CATEGORY>TYPE_REFERENCE</CATEGORY>
                <SW-DATA-DEF-PROPS>
                  <SW-DATA-DEF-PROPS-VARIANTS>
                    <SW-DATA-DEF-PROPS-CONDITIONAL>
	                    <COMPU-METHOD-REF DEST="COMPU-METHOD">/AUTOSAR_ComStack_Types/CompuMethods/TpDataStateType</COMPU-METHOD-REF>
	                    <DATA-CONSTR-REF DEST="DATA-CONSTR">/AUTOSAR_ComStack_Types/DataConstrs/TpDataStateType</DATA-CONSTR-REF>
                      <IMPLEMENTATION-DATA-TYPE-REF DEST="IMPLEMENTATION-DATA-TYPE">/AUTOSAR_Platform/ImplementationDataTypes/uint8</IMPLEMENTATION-DATA-TYPE-REF>
                    </SW-DATA-DEF-PROPS-CONDITIONAL>
                  </SW-DATA-DEF-PROPS-VARIANTS>
                </SW-DATA-DEF-PROPS>
                <TYPE-EMITTER>BSW</TYPE-EMITTER>
              </IMPLEMENTATION-DATA-TYPE>
              <IMPLEMENTATION-DATA-TYPE>
                <SHORT-NAME>TPParameterType</SHORT-NAME>
                <CATEGORY>TYPE_REFERENCE</CATEGORY>
                <SW-DATA-DEF-PROPS>
                  <SW-DATA-DEF-PROPS-VARIANTS>
                    <SW-DATA-DEF-PROPS-CONDITIONAL>
	                   <COMPU-METHOD-REF DEST="COMPU-METHOD">/AUTOSAR_ComStack_Types/CompuMethods/TPParameterType</COMPU-METHOD-REF>
	                   <DATA-CONSTR-REF DEST="DATA-CONSTR">/AUTOSAR_ComStack_Types/DataConstrs/TPParameterType</DATA-CONSTR-REF>
                     <IMPLEMENTATION-DATA-TYPE-REF DEST="IMPLEMENTATION-DATA-TYPE">/AUTOSAR_Platform/ImplementationDataTypes/uint8</IMPLEMENTATION-DATA-TYPE-REF>
                    </SW-DATA-DEF-PROPS-CONDITIONAL>
                  </SW-DATA-DEF-PROPS-VARIANTS>
                </SW-DATA-DEF-PROPS>
                <TYPE-EMITTER>BSW</TYPE-EMITTER>
              </IMPLEMENTATION-DATA-TYPE>
              <IMPLEMENTATION-DATA-TYPE>
                <SHORT-NAME>PduIdType</SHORT-NAME>
                <CATEGORY>TYPE_REFERENCE</CATEGORY>
                <ADMIN-DATA>
                  <SDGS>
                    <SDG GID="EB:PROVIDING-HEADER-FILE">
                      <SD GID="PROVIDING-HEADER-FILE">ComStack_Types.h</SD>
                    </SDG>
                  </SDGS>
                </ADMIN-DATA>
                <SW-DATA-DEF-PROPS>
                  <SW-DATA-DEF-PROPS-VARIANTS>
                    <SW-DATA-DEF-PROPS-CONDITIONAL>
                      <DATA-CONSTR-REF DEST="DATA-CONSTR">/AUTOSAR_ComStack_Types/DataConstrs/PduIdType</DATA-CONSTR-REF>
                      [!CALL "GetPduTypeInfo", "TypeName"="'PduIdTypeEnum'"!]
                      <IMPLEMENTATION-DATA-TYPE-REF DEST="IMPLEMENTATION-DATA-TYPE">/AUTOSAR_Platform/ImplementationDataTypes/[!"$Type"!]</IMPLEMENTATION-DATA-TYPE-REF>
                    </SW-DATA-DEF-PROPS-CONDITIONAL>
                  </SW-DATA-DEF-PROPS-VARIANTS>
                </SW-DATA-DEF-PROPS>
                <TYPE-EMITTER>BSW</TYPE-EMITTER>
              </IMPLEMENTATION-DATA-TYPE>
              <IMPLEMENTATION-DATA-TYPE>
                <SHORT-NAME>PduLengthType</SHORT-NAME>
                <CATEGORY>TYPE_REFERENCE</CATEGORY>
                <ADMIN-DATA>
                  <SDGS>
                    <SDG GID="EB:PROVIDING-HEADER-FILE">
                      <SD GID="PROVIDING-HEADER-FILE">ComStack_Types.h</SD>
                    </SDG>
                  </SDGS>
                </ADMIN-DATA>
                <SW-DATA-DEF-PROPS>
                  <SW-DATA-DEF-PROPS-VARIANTS>
                    <SW-DATA-DEF-PROPS-CONDITIONAL>
                      <DATA-CONSTR-REF DEST="DATA-CONSTR">/AUTOSAR_ComStack_Types/DataConstrs/PduLengthType</DATA-CONSTR-REF>
                      [!CALL "GetPduTypeInfo", "TypeName"="'PduLengthTypeEnum'"!]
                      <IMPLEMENTATION-DATA-TYPE-REF DEST="IMPLEMENTATION-DATA-TYPE">/AUTOSAR_Platform/ImplementationDataTypes/[!"$Type"!]</IMPLEMENTATION-DATA-TYPE-REF>
                    </SW-DATA-DEF-PROPS-CONDITIONAL>
                  </SW-DATA-DEF-PROPS-VARIANTS>
                </SW-DATA-DEF-PROPS>
                <TYPE-EMITTER>BSW</TYPE-EMITTER>
              </IMPLEMENTATION-DATA-TYPE>
              <IMPLEMENTATION-DATA-TYPE>
                <SHORT-NAME>BufReq_ReturnType</SHORT-NAME>
                <CATEGORY>TYPE_REFERENCE</CATEGORY>
                <SW-DATA-DEF-PROPS>
                  <SW-DATA-DEF-PROPS-VARIANTS>
                    <SW-DATA-DEF-PROPS-CONDITIONAL>
                      <COMPU-METHOD-REF DEST="COMPU-METHOD">/AUTOSAR_ComStack_Types/CompuMethods/BufReq_ReturnType</COMPU-METHOD-REF>
                      <DATA-CONSTR-REF DEST="DATA-CONSTR">/AUTOSAR_ComStack_Types/DataConstrs/BufReq_ReturnType</DATA-CONSTR-REF>
                      <IMPLEMENTATION-DATA-TYPE-REF DEST="IMPLEMENTATION-DATA-TYPE">/AUTOSAR_Platform/ImplementationDataTypes/uint8</IMPLEMENTATION-DATA-TYPE-REF>
                    </SW-DATA-DEF-PROPS-CONDITIONAL>
                  </SW-DATA-DEF-PROPS-VARIANTS>
                </SW-DATA-DEF-PROPS>
                <TYPE-EMITTER>BSW</TYPE-EMITTER>
              </IMPLEMENTATION-DATA-TYPE>
              <IMPLEMENTATION-DATA-TYPE>
                <SHORT-NAME>NotifResultType</SHORT-NAME>
                <CATEGORY>TYPE_REFERENCE</CATEGORY>
                <SW-DATA-DEF-PROPS>
                  <SW-DATA-DEF-PROPS-VARIANTS>
                    <SW-DATA-DEF-PROPS-CONDITIONAL>
                      <IMPLEMENTATION-DATA-TYPE-REF DEST="IMPLEMENTATION-DATA-TYPE">/AUTOSAR_Platform/ImplementationDataTypes/uint8</IMPLEMENTATION-DATA-TYPE-REF>
                    </SW-DATA-DEF-PROPS-CONDITIONAL>
                  </SW-DATA-DEF-PROPS-VARIANTS>
                </SW-DATA-DEF-PROPS>
                <TYPE-EMITTER>BSW</TYPE-EMITTER>
              </IMPLEMENTATION-DATA-TYPE>
              <IMPLEMENTATION-DATA-TYPE>
                <SHORT-NAME>BusTrcvErrorType</SHORT-NAME>
                <CATEGORY>TYPE_REFERENCE</CATEGORY>
                <SW-DATA-DEF-PROPS>
                  <SW-DATA-DEF-PROPS-VARIANTS>
                    <SW-DATA-DEF-PROPS-CONDITIONAL>
                      <COMPU-METHOD-REF DEST="COMPU-METHOD">/AUTOSAR_ComStack_Types/CompuMethods/BusTrcvErrorType</COMPU-METHOD-REF>
                      <DATA-CONSTR-REF DEST="DATA-CONSTR">/AUTOSAR_ComStack_Types/DataConstrs/BusTrcvErrorType</DATA-CONSTR-REF>
                      <IMPLEMENTATION-DATA-TYPE-REF DEST="IMPLEMENTATION-DATA-TYPE">/AUTOSAR_Platform/ImplementationDataTypes/uint8</IMPLEMENTATION-DATA-TYPE-REF>
                    </SW-DATA-DEF-PROPS-CONDITIONAL>
                  </SW-DATA-DEF-PROPS-VARIANTS>
                </SW-DATA-DEF-PROPS>
                <TYPE-EMITTER>BSW</TYPE-EMITTER>
              </IMPLEMENTATION-DATA-TYPE>
            </ELEMENTS>
[!ENDMACRO!][!/*


* GenerateFrImplementationTypes
*   Generates the implementation types of the Fr package
*
*   Parameters:
*     None.
*
*/!][!MACRO "GenerateFrImplementationTypes"!]
            <SHORT-NAME>ImplementationDataTypes</SHORT-NAME>
            <CATEGORY>STANDARD</CATEGORY>
            <ELEMENTS>
              <IMPLEMENTATION-DATA-TYPE>
                <SHORT-NAME>Fr_SyncStateType</SHORT-NAME>
                <CATEGORY>TYPE_REFERENCE</CATEGORY>
                <SW-DATA-DEF-PROPS>
                  <SW-DATA-DEF-PROPS-VARIANTS>
                    <SW-DATA-DEF-PROPS-CONDITIONAL>
                      <COMPU-METHOD-REF DEST="COMPU-METHOD">/AUTOSAR_Fr/CompuMethods/Fr_SyncStateType_Literals</COMPU-METHOD-REF>
                      <IMPLEMENTATION-DATA-TYPE-REF DEST="IMPLEMENTATION-DATA-TYPE">/AUTOSAR_Platform/ImplementationDataTypes/uint32</IMPLEMENTATION-DATA-TYPE-REF>
                    </SW-DATA-DEF-PROPS-CONDITIONAL>
                  </SW-DATA-DEF-PROPS-VARIANTS>
                </SW-DATA-DEF-PROPS>
                <TYPE-EMITTER>BSW</TYPE-EMITTER>
              </IMPLEMENTATION-DATA-TYPE>
              <IMPLEMENTATION-DATA-TYPE>
                <SHORT-NAME>Fr_OffsetCorrectionType</SHORT-NAME>
                <CATEGORY>TYPE_REFERENCE</CATEGORY>
                <SW-DATA-DEF-PROPS>
                  <SW-DATA-DEF-PROPS-VARIANTS>
                    <SW-DATA-DEF-PROPS-CONDITIONAL>
                      <COMPU-METHOD-REF DEST="COMPU-METHOD">/AUTOSAR_Fr/CompuMethods/Fr_OffsetCorrectionType_Literals</COMPU-METHOD-REF>
                      <IMPLEMENTATION-DATA-TYPE-REF DEST="IMPLEMENTATION-DATA-TYPE">/AUTOSAR_Platform/ImplementationDataTypes/uint32</IMPLEMENTATION-DATA-TYPE-REF>
                    </SW-DATA-DEF-PROPS-CONDITIONAL>
                  </SW-DATA-DEF-PROPS-VARIANTS>
                </SW-DATA-DEF-PROPS>
                <TYPE-EMITTER>BSW</TYPE-EMITTER>
              </IMPLEMENTATION-DATA-TYPE>
              <IMPLEMENTATION-DATA-TYPE>
                <SHORT-NAME>Fr_RateCorrectionType</SHORT-NAME>
                <CATEGORY>TYPE_REFERENCE</CATEGORY>
                <SW-DATA-DEF-PROPS>
                  <SW-DATA-DEF-PROPS-VARIANTS>
                    <SW-DATA-DEF-PROPS-CONDITIONAL>
                      <COMPU-METHOD-REF DEST="COMPU-METHOD">/AUTOSAR_Fr/CompuMethods/Fr_RateCorrectionType_Literals</COMPU-METHOD-REF>
                      <IMPLEMENTATION-DATA-TYPE-REF DEST="IMPLEMENTATION-DATA-TYPE">/AUTOSAR_Platform/ImplementationDataTypes/uint32</IMPLEMENTATION-DATA-TYPE-REF>
                    </SW-DATA-DEF-PROPS-CONDITIONAL>
                  </SW-DATA-DEF-PROPS-VARIANTS>
                </SW-DATA-DEF-PROPS>
                <TYPE-EMITTER>BSW</TYPE-EMITTER>
              </IMPLEMENTATION-DATA-TYPE>
              <IMPLEMENTATION-DATA-TYPE>
                <SHORT-NAME>Fr_POCStateType</SHORT-NAME>
                <CATEGORY>TYPE_REFERENCE</CATEGORY>
                <SW-DATA-DEF-PROPS>
                  <SW-DATA-DEF-PROPS-VARIANTS>
                    <SW-DATA-DEF-PROPS-CONDITIONAL>
                      <COMPU-METHOD-REF DEST="COMPU-METHOD">/AUTOSAR_Fr/CompuMethods/Fr_POCStateType_Literals</COMPU-METHOD-REF>
                      <IMPLEMENTATION-DATA-TYPE-REF DEST="IMPLEMENTATION-DATA-TYPE">/AUTOSAR_Platform/ImplementationDataTypes/uint32</IMPLEMENTATION-DATA-TYPE-REF>
                    </SW-DATA-DEF-PROPS-CONDITIONAL>
                  </SW-DATA-DEF-PROPS-VARIANTS>
                </SW-DATA-DEF-PROPS>
                <TYPE-EMITTER>BSW</TYPE-EMITTER>
              </IMPLEMENTATION-DATA-TYPE>
              <IMPLEMENTATION-DATA-TYPE>
                <SHORT-NAME>Fr_SlotModeType</SHORT-NAME>
                <CATEGORY>TYPE_REFERENCE</CATEGORY>
                <SW-DATA-DEF-PROPS>
                  <SW-DATA-DEF-PROPS-VARIANTS>
                    <SW-DATA-DEF-PROPS-CONDITIONAL>
                      <COMPU-METHOD-REF DEST="COMPU-METHOD">/AUTOSAR_Fr/CompuMethods/Fr_SlotModeType_Literals</COMPU-METHOD-REF>
                      <IMPLEMENTATION-DATA-TYPE-REF DEST="IMPLEMENTATION-DATA-TYPE">/AUTOSAR_Platform/ImplementationDataTypes/uint32</IMPLEMENTATION-DATA-TYPE-REF>
                    </SW-DATA-DEF-PROPS-CONDITIONAL>
                  </SW-DATA-DEF-PROPS-VARIANTS>
                </SW-DATA-DEF-PROPS>
                <TYPE-EMITTER>BSW</TYPE-EMITTER>
              </IMPLEMENTATION-DATA-TYPE>
              <IMPLEMENTATION-DATA-TYPE>
                <SHORT-NAME>Fr_ErrorModeType</SHORT-NAME>
                <CATEGORY>TYPE_REFERENCE</CATEGORY>
                <SW-DATA-DEF-PROPS>
                  <SW-DATA-DEF-PROPS-VARIANTS>
                    <SW-DATA-DEF-PROPS-CONDITIONAL>
                      <COMPU-METHOD-REF DEST="COMPU-METHOD">/AUTOSAR_Fr/CompuMethods/Fr_ErrorModeType_Literals</COMPU-METHOD-REF>
                      <IMPLEMENTATION-DATA-TYPE-REF DEST="IMPLEMENTATION-DATA-TYPE">/AUTOSAR_Platform/ImplementationDataTypes/uint32</IMPLEMENTATION-DATA-TYPE-REF>
                    </SW-DATA-DEF-PROPS-CONDITIONAL>
                  </SW-DATA-DEF-PROPS-VARIANTS>
                </SW-DATA-DEF-PROPS>
                <TYPE-EMITTER>BSW</TYPE-EMITTER>
              </IMPLEMENTATION-DATA-TYPE>
              <IMPLEMENTATION-DATA-TYPE>
                <SHORT-NAME>Fr_WakeupStatusType</SHORT-NAME>
                <CATEGORY>TYPE_REFERENCE</CATEGORY>
                <SW-DATA-DEF-PROPS>
                  <SW-DATA-DEF-PROPS-VARIANTS>
                    <SW-DATA-DEF-PROPS-CONDITIONAL>
                      <COMPU-METHOD-REF DEST="COMPU-METHOD">/AUTOSAR_Fr/CompuMethods/Fr_WakeupStatusType_Literals</COMPU-METHOD-REF>
                      <IMPLEMENTATION-DATA-TYPE-REF DEST="IMPLEMENTATION-DATA-TYPE">/AUTOSAR_Platform/ImplementationDataTypes/uint32</IMPLEMENTATION-DATA-TYPE-REF>
                    </SW-DATA-DEF-PROPS-CONDITIONAL>
                  </SW-DATA-DEF-PROPS-VARIANTS>
                </SW-DATA-DEF-PROPS>
                <TYPE-EMITTER>BSW</TYPE-EMITTER>
              </IMPLEMENTATION-DATA-TYPE>
              <IMPLEMENTATION-DATA-TYPE>
                <SHORT-NAME>Fr_StartupStateType</SHORT-NAME>
                <CATEGORY>TYPE_REFERENCE</CATEGORY>
                <SW-DATA-DEF-PROPS>
                  <SW-DATA-DEF-PROPS-VARIANTS>
                    <SW-DATA-DEF-PROPS-CONDITIONAL>
                      <COMPU-METHOD-REF DEST="COMPU-METHOD">/AUTOSAR_Fr/CompuMethods/Fr_StartupStateType_Literals</COMPU-METHOD-REF>
                      <IMPLEMENTATION-DATA-TYPE-REF DEST="IMPLEMENTATION-DATA-TYPE">/AUTOSAR_Platform/ImplementationDataTypes/uint32</IMPLEMENTATION-DATA-TYPE-REF>
                    </SW-DATA-DEF-PROPS-CONDITIONAL>
                  </SW-DATA-DEF-PROPS-VARIANTS>
                </SW-DATA-DEF-PROPS>
                <TYPE-EMITTER>BSW</TYPE-EMITTER>
              </IMPLEMENTATION-DATA-TYPE>
              <IMPLEMENTATION-DATA-TYPE>
                <SHORT-NAME>Fr_POCStatusType</SHORT-NAME>
                <CATEGORY>STRUCTURE</CATEGORY>
                <SUB-ELEMENTS>
                  <IMPLEMENTATION-DATA-TYPE-ELEMENT>
                    <SHORT-NAME>CHIHaltRequest</SHORT-NAME>
                    <CATEGORY>TYPE_REFERENCE</CATEGORY>
                    <SW-DATA-DEF-PROPS>
                      <SW-DATA-DEF-PROPS-VARIANTS>
                        <SW-DATA-DEF-PROPS-CONDITIONAL>
                          <IMPLEMENTATION-DATA-TYPE-REF DEST="IMPLEMENTATION-DATA-TYPE">/AUTOSAR_Platform/ImplementationDataTypes/boolean</IMPLEMENTATION-DATA-TYPE-REF>
                        </SW-DATA-DEF-PROPS-CONDITIONAL>
                      </SW-DATA-DEF-PROPS-VARIANTS>
                    </SW-DATA-DEF-PROPS>
                  </IMPLEMENTATION-DATA-TYPE-ELEMENT>
                  <IMPLEMENTATION-DATA-TYPE-ELEMENT>
                    <SHORT-NAME>CHIReadyRequest</SHORT-NAME>
                    <CATEGORY>TYPE_REFERENCE</CATEGORY>
                    <SW-DATA-DEF-PROPS>
                      <SW-DATA-DEF-PROPS-VARIANTS>
                        <SW-DATA-DEF-PROPS-CONDITIONAL>
                          <IMPLEMENTATION-DATA-TYPE-REF DEST="IMPLEMENTATION-DATA-TYPE">/AUTOSAR_Platform/ImplementationDataTypes/boolean</IMPLEMENTATION-DATA-TYPE-REF>
                        </SW-DATA-DEF-PROPS-CONDITIONAL>
                      </SW-DATA-DEF-PROPS-VARIANTS>
                    </SW-DATA-DEF-PROPS>
                  </IMPLEMENTATION-DATA-TYPE-ELEMENT>
                  <IMPLEMENTATION-DATA-TYPE-ELEMENT>
                    <SHORT-NAME>ColdstartNoise</SHORT-NAME>
                    <CATEGORY>TYPE_REFERENCE</CATEGORY>
                    <SW-DATA-DEF-PROPS>
                      <SW-DATA-DEF-PROPS-VARIANTS>
                        <SW-DATA-DEF-PROPS-CONDITIONAL>
                          <IMPLEMENTATION-DATA-TYPE-REF DEST="IMPLEMENTATION-DATA-TYPE">/AUTOSAR_Platform/ImplementationDataTypes/boolean</IMPLEMENTATION-DATA-TYPE-REF>
                        </SW-DATA-DEF-PROPS-CONDITIONAL>
                      </SW-DATA-DEF-PROPS-VARIANTS>
                    </SW-DATA-DEF-PROPS>
                  </IMPLEMENTATION-DATA-TYPE-ELEMENT>
                  <IMPLEMENTATION-DATA-TYPE-ELEMENT>
                    <SHORT-NAME>ErrorMode</SHORT-NAME>
                    <CATEGORY>TYPE_REFERENCE</CATEGORY>
                    <SW-DATA-DEF-PROPS>
                      <SW-DATA-DEF-PROPS-VARIANTS>
                        <SW-DATA-DEF-PROPS-CONDITIONAL>
                          <IMPLEMENTATION-DATA-TYPE-REF DEST="IMPLEMENTATION-DATA-TYPE">/AUTOSAR_Fr/ImplementationDataTypes/Fr_ErrorModeType</IMPLEMENTATION-DATA-TYPE-REF>
                        </SW-DATA-DEF-PROPS-CONDITIONAL>
                      </SW-DATA-DEF-PROPS-VARIANTS>
                    </SW-DATA-DEF-PROPS>
                  </IMPLEMENTATION-DATA-TYPE-ELEMENT>
                  <IMPLEMENTATION-DATA-TYPE-ELEMENT>
                    <SHORT-NAME>Freeze</SHORT-NAME>
                    <CATEGORY>TYPE_REFERENCE</CATEGORY>
                    <SW-DATA-DEF-PROPS>
                      <SW-DATA-DEF-PROPS-VARIANTS>
                        <SW-DATA-DEF-PROPS-CONDITIONAL>
                          <IMPLEMENTATION-DATA-TYPE-REF DEST="IMPLEMENTATION-DATA-TYPE">/AUTOSAR_Platform/ImplementationDataTypes/boolean</IMPLEMENTATION-DATA-TYPE-REF>
                        </SW-DATA-DEF-PROPS-CONDITIONAL>
                      </SW-DATA-DEF-PROPS-VARIANTS>
                    </SW-DATA-DEF-PROPS>
                  </IMPLEMENTATION-DATA-TYPE-ELEMENT>
                  <IMPLEMENTATION-DATA-TYPE-ELEMENT>
                    <SHORT-NAME>SlotMode</SHORT-NAME>
                    <CATEGORY>TYPE_REFERENCE</CATEGORY>
                    <SW-DATA-DEF-PROPS>
                      <SW-DATA-DEF-PROPS-VARIANTS>
                        <SW-DATA-DEF-PROPS-CONDITIONAL>
                          <IMPLEMENTATION-DATA-TYPE-REF DEST="IMPLEMENTATION-DATA-TYPE">/AUTOSAR_Fr/ImplementationDataTypes/Fr_SlotModeType</IMPLEMENTATION-DATA-TYPE-REF>
                        </SW-DATA-DEF-PROPS-CONDITIONAL>
                      </SW-DATA-DEF-PROPS-VARIANTS>
                    </SW-DATA-DEF-PROPS>
                  </IMPLEMENTATION-DATA-TYPE-ELEMENT>
                  <IMPLEMENTATION-DATA-TYPE-ELEMENT>
                    <SHORT-NAME>StartupState</SHORT-NAME>
                    <CATEGORY>TYPE_REFERENCE</CATEGORY>
                    <SW-DATA-DEF-PROPS>
                      <SW-DATA-DEF-PROPS-VARIANTS>
                        <SW-DATA-DEF-PROPS-CONDITIONAL>
                          <IMPLEMENTATION-DATA-TYPE-REF DEST="IMPLEMENTATION-DATA-TYPE">/AUTOSAR_Fr/ImplementationDataTypes/Fr_StartupStateType</IMPLEMENTATION-DATA-TYPE-REF>
                        </SW-DATA-DEF-PROPS-CONDITIONAL>
                      </SW-DATA-DEF-PROPS-VARIANTS>
                    </SW-DATA-DEF-PROPS>
                  </IMPLEMENTATION-DATA-TYPE-ELEMENT>
                  <IMPLEMENTATION-DATA-TYPE-ELEMENT>
                    <SHORT-NAME>State</SHORT-NAME>
                    <CATEGORY>TYPE_REFERENCE</CATEGORY>
                    <SW-DATA-DEF-PROPS>
                      <SW-DATA-DEF-PROPS-VARIANTS>
                        <SW-DATA-DEF-PROPS-CONDITIONAL>
                          <IMPLEMENTATION-DATA-TYPE-REF DEST="IMPLEMENTATION-DATA-TYPE">/AUTOSAR_Fr/ImplementationDataTypes/Fr_POCStateType</IMPLEMENTATION-DATA-TYPE-REF>
                        </SW-DATA-DEF-PROPS-CONDITIONAL>
                      </SW-DATA-DEF-PROPS-VARIANTS>
                    </SW-DATA-DEF-PROPS>
                  </IMPLEMENTATION-DATA-TYPE-ELEMENT>
                  <IMPLEMENTATION-DATA-TYPE-ELEMENT>
                    <SHORT-NAME>WakeupStatus</SHORT-NAME>
                    <CATEGORY>TYPE_REFERENCE</CATEGORY>
                    <SW-DATA-DEF-PROPS>
                      <SW-DATA-DEF-PROPS-VARIANTS>
                        <SW-DATA-DEF-PROPS-CONDITIONAL>
                          <IMPLEMENTATION-DATA-TYPE-REF DEST="IMPLEMENTATION-DATA-TYPE">/AUTOSAR_Fr/ImplementationDataTypes/Fr_WakeupStatusType</IMPLEMENTATION-DATA-TYPE-REF>
                        </SW-DATA-DEF-PROPS-CONDITIONAL>
                      </SW-DATA-DEF-PROPS-VARIANTS>
                    </SW-DATA-DEF-PROPS>
                  </IMPLEMENTATION-DATA-TYPE-ELEMENT>
                </SUB-ELEMENTS>
                <TYPE-EMITTER>BSW</TYPE-EMITTER>
              </IMPLEMENTATION-DATA-TYPE>
              <IMPLEMENTATION-DATA-TYPE>
                <SHORT-NAME>Fr_TxLPduStatusType</SHORT-NAME>
                <CATEGORY>TYPE_REFERENCE</CATEGORY>
                <SW-DATA-DEF-PROPS>
                  <SW-DATA-DEF-PROPS-VARIANTS>
                    <SW-DATA-DEF-PROPS-CONDITIONAL>
                      <COMPU-METHOD-REF DEST="COMPU-METHOD">/AUTOSAR_Fr/CompuMethods/Fr_TxLPduStatusType_Literals</COMPU-METHOD-REF>
                      <IMPLEMENTATION-DATA-TYPE-REF DEST="IMPLEMENTATION-DATA-TYPE">/AUTOSAR_Platform/ImplementationDataTypes/uint32</IMPLEMENTATION-DATA-TYPE-REF>
                    </SW-DATA-DEF-PROPS-CONDITIONAL>
                  </SW-DATA-DEF-PROPS-VARIANTS>
                </SW-DATA-DEF-PROPS>
                <TYPE-EMITTER>BSW</TYPE-EMITTER>
              </IMPLEMENTATION-DATA-TYPE>
              <IMPLEMENTATION-DATA-TYPE>
                <SHORT-NAME>Fr_RxLPduStatusType</SHORT-NAME>
                <CATEGORY>TYPE_REFERENCE</CATEGORY>
                <SW-DATA-DEF-PROPS>
                  <SW-DATA-DEF-PROPS-VARIANTS>
                    <SW-DATA-DEF-PROPS-CONDITIONAL>
                      <COMPU-METHOD-REF DEST="COMPU-METHOD">/AUTOSAR_Fr/CompuMethods/Fr_RxLPduStatusType_Literals</COMPU-METHOD-REF>
                      <IMPLEMENTATION-DATA-TYPE-REF DEST="IMPLEMENTATION-DATA-TYPE">/AUTOSAR_Platform/ImplementationDataTypes/uint32</IMPLEMENTATION-DATA-TYPE-REF>
                    </SW-DATA-DEF-PROPS-CONDITIONAL>
                  </SW-DATA-DEF-PROPS-VARIANTS>
                </SW-DATA-DEF-PROPS>
                <TYPE-EMITTER>BSW</TYPE-EMITTER>
              </IMPLEMENTATION-DATA-TYPE>
              <IMPLEMENTATION-DATA-TYPE>
                <SHORT-NAME>Fr_MTSStatusType</SHORT-NAME>
                <CATEGORY>TYPE_REFERENCE</CATEGORY>
                <SW-DATA-DEF-PROPS>
                  <SW-DATA-DEF-PROPS-VARIANTS>
                    <SW-DATA-DEF-PROPS-CONDITIONAL>
                      <COMPU-METHOD-REF DEST="COMPU-METHOD">/AUTOSAR_Fr/CompuMethods/Fr_MTSStatusType_Literals</COMPU-METHOD-REF>
                      <IMPLEMENTATION-DATA-TYPE-REF DEST="IMPLEMENTATION-DATA-TYPE">/AUTOSAR_Platform/ImplementationDataTypes/uint32</IMPLEMENTATION-DATA-TYPE-REF>
                    </SW-DATA-DEF-PROPS-CONDITIONAL>
                  </SW-DATA-DEF-PROPS-VARIANTS>
                </SW-DATA-DEF-PROPS>
                <TYPE-EMITTER>BSW</TYPE-EMITTER>
              </IMPLEMENTATION-DATA-TYPE>
              <IMPLEMENTATION-DATA-TYPE>
                <SHORT-NAME>Fr_ChannelType</SHORT-NAME>
                <CATEGORY>TYPE_REFERENCE</CATEGORY>
                <SW-DATA-DEF-PROPS>
                  <SW-DATA-DEF-PROPS-VARIANTS>
                    <SW-DATA-DEF-PROPS-CONDITIONAL>
                      <COMPU-METHOD-REF DEST="COMPU-METHOD">/AUTOSAR_Fr/CompuMethods/Fr_ChannelType_Literals</COMPU-METHOD-REF>
                      <IMPLEMENTATION-DATA-TYPE-REF DEST="IMPLEMENTATION-DATA-TYPE">/AUTOSAR_Platform/ImplementationDataTypes/uint32</IMPLEMENTATION-DATA-TYPE-REF>
                    </SW-DATA-DEF-PROPS-CONDITIONAL>
                  </SW-DATA-DEF-PROPS-VARIANTS>
                </SW-DATA-DEF-PROPS>
                <TYPE-EMITTER>BSW</TYPE-EMITTER>
              </IMPLEMENTATION-DATA-TYPE>
            </ELEMENTS>
[!ENDMACRO!][!/*


* GenerateFrTrcvImplementationTypes
*   Generates the implementation types of the FrTrcv package
*
*   Parameters:
*     None.
*
*/!][!MACRO "GenerateFrTrcvImplementationTypes"!]
            <SHORT-NAME>ImplementationDataTypes</SHORT-NAME>
            <CATEGORY>STANDARD</CATEGORY>
            <ELEMENTS>
              <IMPLEMENTATION-DATA-TYPE>
                <SHORT-NAME>FrTrcv_TrcvModeType</SHORT-NAME>
                <CATEGORY>TYPE_REFERENCE</CATEGORY>
                <SW-DATA-DEF-PROPS>
                  <SW-DATA-DEF-PROPS-VARIANTS>
                    <SW-DATA-DEF-PROPS-CONDITIONAL>
                      <COMPU-METHOD-REF DEST="COMPU-METHOD">/AUTOSAR_FrTrcv/CompuMethods/FrTrcv_TrcvModeType_Literals</COMPU-METHOD-REF>
                      <IMPLEMENTATION-DATA-TYPE-REF DEST="IMPLEMENTATION-DATA-TYPE">/AUTOSAR_Platform/ImplementationDataTypes/uint32</IMPLEMENTATION-DATA-TYPE-REF>
                    </SW-DATA-DEF-PROPS-CONDITIONAL>
                  </SW-DATA-DEF-PROPS-VARIANTS>
                </SW-DATA-DEF-PROPS>
                <TYPE-EMITTER>BSW</TYPE-EMITTER>
              </IMPLEMENTATION-DATA-TYPE>
              <IMPLEMENTATION-DATA-TYPE>
                <SHORT-NAME>FrTrcv_TrcvWUReasonType</SHORT-NAME>
                <CATEGORY>TYPE_REFERENCE</CATEGORY>
                <SW-DATA-DEF-PROPS>
                  <SW-DATA-DEF-PROPS-VARIANTS>
                    <SW-DATA-DEF-PROPS-CONDITIONAL>
                      <COMPU-METHOD-REF DEST="COMPU-METHOD">/AUTOSAR_FrTrcv/CompuMethods/FrTrcv_TrcvWUReasonType_Literals</COMPU-METHOD-REF>
                      <IMPLEMENTATION-DATA-TYPE-REF DEST="IMPLEMENTATION-DATA-TYPE">/AUTOSAR_Platform/ImplementationDataTypes/uint32</IMPLEMENTATION-DATA-TYPE-REF>
                    </SW-DATA-DEF-PROPS-CONDITIONAL>
                  </SW-DATA-DEF-PROPS-VARIANTS>
                </SW-DATA-DEF-PROPS>
                <TYPE-EMITTER>BSW</TYPE-EMITTER>
              </IMPLEMENTATION-DATA-TYPE>
            </ELEMENTS>
[!ENDMACRO!][!/*


* GenerateCanImplementationTypes
*   Generates the implementation types of the Can package
*
*   Parameters:
*     None.
*
*/!][!MACRO "GenerateCanImplementationTypes"!]
            <SHORT-NAME>ImplementationDataTypes</SHORT-NAME>
            <CATEGORY>STANDARD</CATEGORY>
            <ELEMENTS>
              <IMPLEMENTATION-DATA-TYPE>
                <SHORT-NAME>Can_IdType</SHORT-NAME>
                <CATEGORY>TYPE_REFERENCE</CATEGORY>
                <SW-DATA-DEF-PROPS>
                  <SW-DATA-DEF-PROPS-VARIANTS>
                    <SW-DATA-DEF-PROPS-CONDITIONAL>
[!IF "node:exists(as:modconf('CanIf')[1]/CanIfPublicCfg/CanIfPublicCanIdTypeEnum) and (as:modconf('CanIf')[1]/CanIfPublicCfg/CanIfPublicCanIdTypeEnum = 'UINT16')"!]
                      <IMPLEMENTATION-DATA-TYPE-REF DEST="IMPLEMENTATION-DATA-TYPE">/AUTOSAR_Platform/ImplementationDataTypes/uint16</IMPLEMENTATION-DATA-TYPE-REF>
[!ELSE!]
                      <IMPLEMENTATION-DATA-TYPE-REF DEST="IMPLEMENTATION-DATA-TYPE">/AUTOSAR_Platform/ImplementationDataTypes/uint32</IMPLEMENTATION-DATA-TYPE-REF>
[!ENDIF!]
                    </SW-DATA-DEF-PROPS-CONDITIONAL>
                  </SW-DATA-DEF-PROPS-VARIANTS>
                </SW-DATA-DEF-PROPS>
                <TYPE-EMITTER>BSW</TYPE-EMITTER>
              </IMPLEMENTATION-DATA-TYPE>
              <IMPLEMENTATION-DATA-TYPE>
                <SHORT-NAME>Can_HwHandleType</SHORT-NAME>
                <CATEGORY>TYPE_REFERENCE</CATEGORY>
                <SW-DATA-DEF-PROPS>
                  <SW-DATA-DEF-PROPS-VARIANTS>
                    <SW-DATA-DEF-PROPS-CONDITIONAL>
[!IF "node:exists(as:modconf('CanIf')[1]/CanIfPublicCfg/CanIfPublicHandleTypeEnum) and (as:modconf('CanIf')[1]/CanIfPublicCfg/CanIfPublicHandleTypeEnum = 'UINT16')"!]
                      <IMPLEMENTATION-DATA-TYPE-REF DEST="IMPLEMENTATION-DATA-TYPE">/AUTOSAR_Platform/ImplementationDataTypes/uint16</IMPLEMENTATION-DATA-TYPE-REF>
[!ELSE!]
                      <IMPLEMENTATION-DATA-TYPE-REF DEST="IMPLEMENTATION-DATA-TYPE">/AUTOSAR_Platform/ImplementationDataTypes/uint8</IMPLEMENTATION-DATA-TYPE-REF>
[!ENDIF!]
                    </SW-DATA-DEF-PROPS-CONDITIONAL>
                  </SW-DATA-DEF-PROPS-VARIANTS>
                </SW-DATA-DEF-PROPS>
                <TYPE-EMITTER>BSW</TYPE-EMITTER>
              </IMPLEMENTATION-DATA-TYPE>
              <IMPLEMENTATION-DATA-TYPE>
                <SHORT-NAME>Can_PduType</SHORT-NAME>
                <CATEGORY>STRUCTURE</CATEGORY>
                <SUB-ELEMENTS>
                  <IMPLEMENTATION-DATA-TYPE-ELEMENT>
                    <SHORT-NAME>id</SHORT-NAME>
                    <CATEGORY>TYPE_REFERENCE</CATEGORY>
                    <SW-DATA-DEF-PROPS>
                      <SW-DATA-DEF-PROPS-VARIANTS>
                        <SW-DATA-DEF-PROPS-CONDITIONAL>
                          <IMPLEMENTATION-DATA-TYPE-REF DEST="IMPLEMENTATION-DATA-TYPE">/AUTOSAR_Can/ImplementationDataTypes/Can_IdType</IMPLEMENTATION-DATA-TYPE-REF>
                        </SW-DATA-DEF-PROPS-CONDITIONAL>
                      </SW-DATA-DEF-PROPS-VARIANTS>
                    </SW-DATA-DEF-PROPS>
                  </IMPLEMENTATION-DATA-TYPE-ELEMENT>
                  <IMPLEMENTATION-DATA-TYPE-ELEMENT>
                    <SHORT-NAME>length</SHORT-NAME>
                    <CATEGORY>TYPE_REFERENCE</CATEGORY>
                    <SW-DATA-DEF-PROPS>
                      <SW-DATA-DEF-PROPS-VARIANTS>
                        <SW-DATA-DEF-PROPS-CONDITIONAL>
                          <IMPLEMENTATION-DATA-TYPE-REF DEST="IMPLEMENTATION-DATA-TYPE">/AUTOSAR_Platform/ImplementationDataTypes/uint8</IMPLEMENTATION-DATA-TYPE-REF>
                        </SW-DATA-DEF-PROPS-CONDITIONAL>
                      </SW-DATA-DEF-PROPS-VARIANTS>
                    </SW-DATA-DEF-PROPS>
                  </IMPLEMENTATION-DATA-TYPE-ELEMENT>
                  <IMPLEMENTATION-DATA-TYPE-ELEMENT>
                    <SHORT-NAME>sdu</SHORT-NAME>
                    <CATEGORY>DATA_REFERENCE</CATEGORY>
                    <SW-DATA-DEF-PROPS>
                      <SW-DATA-DEF-PROPS-VARIANTS>
                        <SW-DATA-DEF-PROPS-CONDITIONAL>
                          <SW-POINTER-TARGET-PROPS>
                            <TARGET-CATEGORY>TYPE_REFERENCE</TARGET-CATEGORY>
                            <SW-DATA-DEF-PROPS>
                              <SW-DATA-DEF-PROPS-VARIANTS>
                                <SW-DATA-DEF-PROPS-CONDITIONAL>
                                  <IMPLEMENTATION-DATA-TYPE-REF DEST="IMPLEMENTATION-DATA-TYPE">/AUTOSAR_Platform/ImplementationDataTypes/uint8</IMPLEMENTATION-DATA-TYPE-REF>
                                </SW-DATA-DEF-PROPS-CONDITIONAL>
                              </SW-DATA-DEF-PROPS-VARIANTS>
                            </SW-DATA-DEF-PROPS>
                          </SW-POINTER-TARGET-PROPS>
                        </SW-DATA-DEF-PROPS-CONDITIONAL>
                      </SW-DATA-DEF-PROPS-VARIANTS>
                    </SW-DATA-DEF-PROPS>
                  </IMPLEMENTATION-DATA-TYPE-ELEMENT>
                  <IMPLEMENTATION-DATA-TYPE-ELEMENT>
                    <SHORT-NAME>swPduHandle</SHORT-NAME>
                    <CATEGORY>TYPE_REFERENCE</CATEGORY>
                    <SW-DATA-DEF-PROPS>
                      <SW-DATA-DEF-PROPS-VARIANTS>
                        <SW-DATA-DEF-PROPS-CONDITIONAL>
                          <IMPLEMENTATION-DATA-TYPE-REF DEST="IMPLEMENTATION-DATA-TYPE">/AUTOSAR_Comtype/ImplementationDataTypes/PduIdType</IMPLEMENTATION-DATA-TYPE-REF>
                        </SW-DATA-DEF-PROPS-CONDITIONAL>
                      </SW-DATA-DEF-PROPS-VARIANTS>
                    </SW-DATA-DEF-PROPS>
                  </IMPLEMENTATION-DATA-TYPE-ELEMENT>
                </SUB-ELEMENTS>
                <TYPE-EMITTER>BSW</TYPE-EMITTER>
              </IMPLEMENTATION-DATA-TYPE>
              <IMPLEMENTATION-DATA-TYPE>
                <SHORT-NAME>Can_StateTransitionType</SHORT-NAME>
                <CATEGORY>TYPE_REFERENCE</CATEGORY>
                <SW-DATA-DEF-PROPS>
                  <SW-DATA-DEF-PROPS-VARIANTS>
                    <SW-DATA-DEF-PROPS-CONDITIONAL>
                      <COMPU-METHOD-REF DEST="COMPU-METHOD">/AUTOSAR_Can/CompuMethods/Can_StateTransitionType_Literals</COMPU-METHOD-REF>
                      <IMPLEMENTATION-DATA-TYPE-REF DEST="IMPLEMENTATION-DATA-TYPE">/AUTOSAR_Platform/ImplementationDataTypes/uint32</IMPLEMENTATION-DATA-TYPE-REF>
                    </SW-DATA-DEF-PROPS-CONDITIONAL>
                  </SW-DATA-DEF-PROPS-VARIANTS>
                </SW-DATA-DEF-PROPS>
                <TYPE-EMITTER>BSW</TYPE-EMITTER>
              </IMPLEMENTATION-DATA-TYPE>
              <IMPLEMENTATION-DATA-TYPE>
                <SHORT-NAME>Can_ReturnType</SHORT-NAME>
                <CATEGORY>TYPE_REFERENCE</CATEGORY>
                <SW-DATA-DEF-PROPS>
                  <SW-DATA-DEF-PROPS-VARIANTS>
                    <SW-DATA-DEF-PROPS-CONDITIONAL>
                      <COMPU-METHOD-REF DEST="COMPU-METHOD">/AUTOSAR_Can/CompuMethods/Can_ReturnType_Literals</COMPU-METHOD-REF>
                      <IMPLEMENTATION-DATA-TYPE-REF DEST="IMPLEMENTATION-DATA-TYPE">/AUTOSAR_Platform/ImplementationDataTypes/uint32</IMPLEMENTATION-DATA-TYPE-REF>
                    </SW-DATA-DEF-PROPS-CONDITIONAL>
                  </SW-DATA-DEF-PROPS-VARIANTS>
                </SW-DATA-DEF-PROPS>
                <TYPE-EMITTER>BSW</TYPE-EMITTER>
              </IMPLEMENTATION-DATA-TYPE>
            </ELEMENTS>
[!ENDMACRO!][!/*


* GenerateCanTrcvImplementationTypes
*   Generates the implementation types of the CanTrcv package
*
*   Parameters:
*     None.
*
*/!][!MACRO "GenerateCanTrcvImplementationTypes"!]
            <SHORT-NAME>ImplementationDataTypes</SHORT-NAME>
            <CATEGORY>STANDARD</CATEGORY>
            <ELEMENTS>
              <IMPLEMENTATION-DATA-TYPE>
                <SHORT-NAME>CanTrcv_TrcvModeType</SHORT-NAME>
                <CATEGORY>TYPE_REFERENCE</CATEGORY>
                <SW-DATA-DEF-PROPS>
                  <SW-DATA-DEF-PROPS-VARIANTS>
                    <SW-DATA-DEF-PROPS-CONDITIONAL>
                      <COMPU-METHOD-REF DEST="COMPU-METHOD">/AUTOSAR_CanTrcv/CompuMethods/CanTrcv_TrcvModeType_Literals</COMPU-METHOD-REF>
                      <IMPLEMENTATION-DATA-TYPE-REF DEST="IMPLEMENTATION-DATA-TYPE">/AUTOSAR_Platform/ImplementationDataTypes/uint32</IMPLEMENTATION-DATA-TYPE-REF>
                    </SW-DATA-DEF-PROPS-CONDITIONAL>
                  </SW-DATA-DEF-PROPS-VARIANTS>
                </SW-DATA-DEF-PROPS>
                <TYPE-EMITTER>BSW</TYPE-EMITTER>
              </IMPLEMENTATION-DATA-TYPE>
              <IMPLEMENTATION-DATA-TYPE>
                <SHORT-NAME>CanTrcv_TrcvWakeupReasonType</SHORT-NAME>
                <CATEGORY>TYPE_REFERENCE</CATEGORY>
                <SW-DATA-DEF-PROPS>
                  <SW-DATA-DEF-PROPS-VARIANTS>
                    <SW-DATA-DEF-PROPS-CONDITIONAL>
                      <COMPU-METHOD-REF DEST="COMPU-METHOD">/AUTOSAR_CanTrcv/CompuMethods/CanTrcv_TrcvWakeupReasonType_Literals</COMPU-METHOD-REF>
                      <IMPLEMENTATION-DATA-TYPE-REF DEST="IMPLEMENTATION-DATA-TYPE">/AUTOSAR_Platform/ImplementationDataTypes/uint32</IMPLEMENTATION-DATA-TYPE-REF>
                    </SW-DATA-DEF-PROPS-CONDITIONAL>
                  </SW-DATA-DEF-PROPS-VARIANTS>
                </SW-DATA-DEF-PROPS>
                <TYPE-EMITTER>BSW</TYPE-EMITTER>
              </IMPLEMENTATION-DATA-TYPE>
              <IMPLEMENTATION-DATA-TYPE>
                <SHORT-NAME>CanTrcv_TrcvWakeupModeType</SHORT-NAME>
                <CATEGORY>TYPE_REFERENCE</CATEGORY>
                <SW-DATA-DEF-PROPS>
                  <SW-DATA-DEF-PROPS-VARIANTS>
                    <SW-DATA-DEF-PROPS-CONDITIONAL>
                      <COMPU-METHOD-REF DEST="COMPU-METHOD">/AUTOSAR_CanTrcv/CompuMethods/CanTrcv_TrcvWakeupModeType_Literals</COMPU-METHOD-REF>
                      <IMPLEMENTATION-DATA-TYPE-REF DEST="IMPLEMENTATION-DATA-TYPE">/AUTOSAR_Platform/ImplementationDataTypes/uint32</IMPLEMENTATION-DATA-TYPE-REF>
                    </SW-DATA-DEF-PROPS-CONDITIONAL>
                  </SW-DATA-DEF-PROPS-VARIANTS>
                </SW-DATA-DEF-PROPS>
                <TYPE-EMITTER>BSW</TYPE-EMITTER>
              </IMPLEMENTATION-DATA-TYPE>
              <IMPLEMENTATION-DATA-TYPE>
                <SHORT-NAME>CanTrcv_PNActivationType</SHORT-NAME>
                <CATEGORY>TYPE_REFERENCE</CATEGORY>
                <SW-DATA-DEF-PROPS>
                  <SW-DATA-DEF-PROPS-VARIANTS>
                    <SW-DATA-DEF-PROPS-CONDITIONAL>
                      <COMPU-METHOD-REF DEST="COMPU-METHOD">/AUTOSAR_CanTrcv/CompuMethods/CanTrcv_PNActivationType_Literals</COMPU-METHOD-REF>
                      <IMPLEMENTATION-DATA-TYPE-REF DEST="IMPLEMENTATION-DATA-TYPE">/AUTOSAR_Platform/ImplementationDataTypes/uint32</IMPLEMENTATION-DATA-TYPE-REF>
                    </SW-DATA-DEF-PROPS-CONDITIONAL>
                  </SW-DATA-DEF-PROPS-VARIANTS>
                </SW-DATA-DEF-PROPS>
                <TYPE-EMITTER>BSW</TYPE-EMITTER>
              </IMPLEMENTATION-DATA-TYPE>
              <IMPLEMENTATION-DATA-TYPE>
                <SHORT-NAME>CanTrcv_TrcvFlagStateType</SHORT-NAME>
                <CATEGORY>TYPE_REFERENCE</CATEGORY>
                <SW-DATA-DEF-PROPS>
                  <SW-DATA-DEF-PROPS-VARIANTS>
                    <SW-DATA-DEF-PROPS-CONDITIONAL>
                      <COMPU-METHOD-REF DEST="COMPU-METHOD">/AUTOSAR_CanTrcv/CompuMethods/CanTrcv_TrcvFlagStateType_Literals</COMPU-METHOD-REF>
                      <IMPLEMENTATION-DATA-TYPE-REF DEST="IMPLEMENTATION-DATA-TYPE">/AUTOSAR_Platform/ImplementationDataTypes/uint32</IMPLEMENTATION-DATA-TYPE-REF>
                    </SW-DATA-DEF-PROPS-CONDITIONAL>
                  </SW-DATA-DEF-PROPS-VARIANTS>
                </SW-DATA-DEF-PROPS>
                <TYPE-EMITTER>BSW</TYPE-EMITTER>
              </IMPLEMENTATION-DATA-TYPE>
            </ELEMENTS>
[!ENDMACRO!][!/*

* GenerateLinImplementationTypes
*   Generates the implementation types of the Lin package
*
*   Parameters:
*     None.
*
*/!][!MACRO "GenerateLinImplementationTypes"!]
            <SHORT-NAME>ImplementationDataTypes</SHORT-NAME>
            <CATEGORY>STANDARD</CATEGORY>
            <ELEMENTS>
              <IMPLEMENTATION-DATA-TYPE>
                <SHORT-NAME>Lin_FramePidType</SHORT-NAME>
                <CATEGORY>TYPE_REFERENCE</CATEGORY>
                <SW-DATA-DEF-PROPS>
                  <SW-DATA-DEF-PROPS-VARIANTS>
                    <SW-DATA-DEF-PROPS-CONDITIONAL>
                      <IMPLEMENTATION-DATA-TYPE-REF DEST="IMPLEMENTATION-DATA-TYPE">/AUTOSAR_Platform/ImplementationDataTypes/uint8</IMPLEMENTATION-DATA-TYPE-REF>
                    </SW-DATA-DEF-PROPS-CONDITIONAL>
                  </SW-DATA-DEF-PROPS-VARIANTS>
                </SW-DATA-DEF-PROPS>
                <TYPE-EMITTER>BSW</TYPE-EMITTER>
              </IMPLEMENTATION-DATA-TYPE>
              <IMPLEMENTATION-DATA-TYPE>
                <SHORT-NAME>Lin_FrameCsModelType</SHORT-NAME>
                <CATEGORY>TYPE_REFERENCE</CATEGORY>
                <SW-DATA-DEF-PROPS>
                  <SW-DATA-DEF-PROPS-VARIANTS>
                    <SW-DATA-DEF-PROPS-CONDITIONAL>
                      <COMPU-METHOD-REF DEST="COMPU-METHOD">/AUTOSAR_Lin/CompuMethods/Lin_FrameCsModelType_Literals</COMPU-METHOD-REF>
                      <IMPLEMENTATION-DATA-TYPE-REF DEST="IMPLEMENTATION-DATA-TYPE">/AUTOSAR_Platform/ImplementationDataTypes/uint32</IMPLEMENTATION-DATA-TYPE-REF>
                    </SW-DATA-DEF-PROPS-CONDITIONAL>
                  </SW-DATA-DEF-PROPS-VARIANTS>
                </SW-DATA-DEF-PROPS>
                <TYPE-EMITTER>BSW</TYPE-EMITTER>
              </IMPLEMENTATION-DATA-TYPE>
              <IMPLEMENTATION-DATA-TYPE>
                <SHORT-NAME>Lin_FrameResponseType</SHORT-NAME>
                <CATEGORY>TYPE_REFERENCE</CATEGORY>
                <SW-DATA-DEF-PROPS>
                  <SW-DATA-DEF-PROPS-VARIANTS>
                    <SW-DATA-DEF-PROPS-CONDITIONAL>
                      <COMPU-METHOD-REF DEST="COMPU-METHOD">/AUTOSAR_Lin/CompuMethods/Lin_FrameResponseType_Literals</COMPU-METHOD-REF>
                      <IMPLEMENTATION-DATA-TYPE-REF DEST="IMPLEMENTATION-DATA-TYPE">/AUTOSAR_Platform/ImplementationDataTypes/uint32</IMPLEMENTATION-DATA-TYPE-REF>
                    </SW-DATA-DEF-PROPS-CONDITIONAL>
                  </SW-DATA-DEF-PROPS-VARIANTS>
                </SW-DATA-DEF-PROPS>
                <TYPE-EMITTER>BSW</TYPE-EMITTER>
              </IMPLEMENTATION-DATA-TYPE>
              <IMPLEMENTATION-DATA-TYPE>
                <SHORT-NAME>Lin_FrameDlType</SHORT-NAME>
                <CATEGORY>TYPE_REFERENCE</CATEGORY>
                <SW-DATA-DEF-PROPS>
                  <SW-DATA-DEF-PROPS-VARIANTS>
                    <SW-DATA-DEF-PROPS-CONDITIONAL>
                      <IMPLEMENTATION-DATA-TYPE-REF DEST="IMPLEMENTATION-DATA-TYPE">/AUTOSAR_Platform/ImplementationDataTypes/uint8</IMPLEMENTATION-DATA-TYPE-REF>
                    </SW-DATA-DEF-PROPS-CONDITIONAL>
                  </SW-DATA-DEF-PROPS-VARIANTS>
                </SW-DATA-DEF-PROPS>
                <TYPE-EMITTER>BSW</TYPE-EMITTER>
              </IMPLEMENTATION-DATA-TYPE>
              <IMPLEMENTATION-DATA-TYPE>
                <SHORT-NAME>Lin_PduType</SHORT-NAME>
                <CATEGORY>STRUCTURE</CATEGORY>
                <SUB-ELEMENTS>
                  <IMPLEMENTATION-DATA-TYPE-ELEMENT>
                    <SHORT-NAME>Pid</SHORT-NAME>
                    <CATEGORY>TYPE_REFERENCE</CATEGORY>
                    <SW-DATA-DEF-PROPS>
                      <SW-DATA-DEF-PROPS-VARIANTS>
                        <SW-DATA-DEF-PROPS-CONDITIONAL>
                          <IMPLEMENTATION-DATA-TYPE-REF DEST="IMPLEMENTATION-DATA-TYPE">/AUTOSAR_Lin/ImplementationDataTypes/Lin_FramePidType</IMPLEMENTATION-DATA-TYPE-REF>
                        </SW-DATA-DEF-PROPS-CONDITIONAL>
                      </SW-DATA-DEF-PROPS-VARIANTS>
                    </SW-DATA-DEF-PROPS>
                  </IMPLEMENTATION-DATA-TYPE-ELEMENT>
                  <IMPLEMENTATION-DATA-TYPE-ELEMENT>
                    <SHORT-NAME>Cs</SHORT-NAME>
                    <CATEGORY>TYPE_REFERENCE</CATEGORY>
                    <SW-DATA-DEF-PROPS>
                      <SW-DATA-DEF-PROPS-VARIANTS>
                        <SW-DATA-DEF-PROPS-CONDITIONAL>
                          <IMPLEMENTATION-DATA-TYPE-REF DEST="IMPLEMENTATION-DATA-TYPE">/AUTOSAR_Lin/ImplementationDataTypes/Lin_FrameCsModelType</IMPLEMENTATION-DATA-TYPE-REF>
                        </SW-DATA-DEF-PROPS-CONDITIONAL>
                      </SW-DATA-DEF-PROPS-VARIANTS>
                    </SW-DATA-DEF-PROPS>
                  </IMPLEMENTATION-DATA-TYPE-ELEMENT>
                  <IMPLEMENTATION-DATA-TYPE-ELEMENT>
                    <SHORT-NAME>Drc</SHORT-NAME>
                    <CATEGORY>TYPE_REFERENCE</CATEGORY>
                    <SW-DATA-DEF-PROPS>
                      <SW-DATA-DEF-PROPS-VARIANTS>
                        <SW-DATA-DEF-PROPS-CONDITIONAL>
                          <IMPLEMENTATION-DATA-TYPE-REF DEST="IMPLEMENTATION-DATA-TYPE">/AUTOSAR_Lin/ImplementationDataTypes/Lin_FrameResponseType</IMPLEMENTATION-DATA-TYPE-REF>
                        </SW-DATA-DEF-PROPS-CONDITIONAL>
                      </SW-DATA-DEF-PROPS-VARIANTS>
                    </SW-DATA-DEF-PROPS>
                  </IMPLEMENTATION-DATA-TYPE-ELEMENT>
                  <IMPLEMENTATION-DATA-TYPE-ELEMENT>
                    <SHORT-NAME>Dl</SHORT-NAME>
                    <CATEGORY>TYPE_REFERENCE</CATEGORY>
                    <SW-DATA-DEF-PROPS>
                      <SW-DATA-DEF-PROPS-VARIANTS>
                        <SW-DATA-DEF-PROPS-CONDITIONAL>
                          <IMPLEMENTATION-DATA-TYPE-REF DEST="IMPLEMENTATION-DATA-TYPE">/AUTOSAR_Lin/ImplementationDataTypes/Lin_FrameDlType</IMPLEMENTATION-DATA-TYPE-REF>
                        </SW-DATA-DEF-PROPS-CONDITIONAL>
                      </SW-DATA-DEF-PROPS-VARIANTS>
                    </SW-DATA-DEF-PROPS>
                  </IMPLEMENTATION-DATA-TYPE-ELEMENT>
                  <IMPLEMENTATION-DATA-TYPE-ELEMENT>
                    <SHORT-NAME>SduPtr</SHORT-NAME>
                    <CATEGORY>DATA_REFERENCE</CATEGORY>
                    <SW-DATA-DEF-PROPS>
                      <SW-DATA-DEF-PROPS-VARIANTS>
                        <SW-DATA-DEF-PROPS-CONDITIONAL>
                          <SW-POINTER-TARGET-PROPS>
                            <TARGET-CATEGORY>TYPE_REFERENCE</TARGET-CATEGORY>
                            <SW-DATA-DEF-PROPS>
                              <SW-DATA-DEF-PROPS-VARIANTS>
                                <SW-DATA-DEF-PROPS-CONDITIONAL>
                                  <IMPLEMENTATION-DATA-TYPE-REF DEST="IMPLEMENTATION-DATA-TYPE">/AUTOSAR_Platform/ImplementationDataTypes/uint8</IMPLEMENTATION-DATA-TYPE-REF>
                                </SW-DATA-DEF-PROPS-CONDITIONAL>
                              </SW-DATA-DEF-PROPS-VARIANTS>
                            </SW-DATA-DEF-PROPS>
                          </SW-POINTER-TARGET-PROPS>
                        </SW-DATA-DEF-PROPS-CONDITIONAL>
                      </SW-DATA-DEF-PROPS-VARIANTS>
                    </SW-DATA-DEF-PROPS>
                  </IMPLEMENTATION-DATA-TYPE-ELEMENT>
                </SUB-ELEMENTS>
                <TYPE-EMITTER>BSW</TYPE-EMITTER>
              </IMPLEMENTATION-DATA-TYPE>
              <IMPLEMENTATION-DATA-TYPE>
                <SHORT-NAME>Lin_StatusType</SHORT-NAME>
                <CATEGORY>TYPE_REFERENCE</CATEGORY>
                <SW-DATA-DEF-PROPS>
                  <SW-DATA-DEF-PROPS-VARIANTS>
                    <SW-DATA-DEF-PROPS-CONDITIONAL>
                      <COMPU-METHOD-REF DEST="COMPU-METHOD">/AUTOSAR_Lin/CompuMethods/Lin_StatusType_Literals</COMPU-METHOD-REF>
                      <IMPLEMENTATION-DATA-TYPE-REF DEST="IMPLEMENTATION-DATA-TYPE">/AUTOSAR_Platform/ImplementationDataTypes/uint32</IMPLEMENTATION-DATA-TYPE-REF>
                    </SW-DATA-DEF-PROPS-CONDITIONAL>
                  </SW-DATA-DEF-PROPS-VARIANTS>
                </SW-DATA-DEF-PROPS>
                <TYPE-EMITTER>BSW</TYPE-EMITTER>
              </IMPLEMENTATION-DATA-TYPE>
            </ELEMENTS>
[!ENDMACRO!][!/*

* GenerateLinTrcvImplementationTypes
*   Generates the implementation types of the LinTrcv package
*
*   Parameters:
*     None.
*
*/!][!MACRO "GenerateLinTrcvImplementationTypes"!]
            <SHORT-NAME>ImplementationDataTypes</SHORT-NAME>
            <CATEGORY>STANDARD</CATEGORY>
            <ELEMENTS>
              <IMPLEMENTATION-DATA-TYPE>
                <SHORT-NAME>LinTrcv_TrcvModeType</SHORT-NAME>
                <CATEGORY>TYPE_REFERENCE</CATEGORY>
                <SW-DATA-DEF-PROPS>
                  <SW-DATA-DEF-PROPS-VARIANTS>
                    <SW-DATA-DEF-PROPS-CONDITIONAL>
                      <COMPU-METHOD-REF DEST="COMPU-METHOD">/AUTOSAR_LinTrcv/CompuMethods/LinTrcv_TrcvModeType_Literals</COMPU-METHOD-REF>
                      <IMPLEMENTATION-DATA-TYPE-REF DEST="IMPLEMENTATION-DATA-TYPE">/AUTOSAR_Platform/ImplementationDataTypes/uint32</IMPLEMENTATION-DATA-TYPE-REF>
                    </SW-DATA-DEF-PROPS-CONDITIONAL>
                  </SW-DATA-DEF-PROPS-VARIANTS>
                </SW-DATA-DEF-PROPS>
                <TYPE-EMITTER>BSW</TYPE-EMITTER>
              </IMPLEMENTATION-DATA-TYPE>
              <IMPLEMENTATION-DATA-TYPE>
                <SHORT-NAME>LinTrcv_TrcvWakeupModeType</SHORT-NAME>
                <CATEGORY>TYPE_REFERENCE</CATEGORY>
                <SW-DATA-DEF-PROPS>
                  <SW-DATA-DEF-PROPS-VARIANTS>
                    <SW-DATA-DEF-PROPS-CONDITIONAL>
                      <COMPU-METHOD-REF DEST="COMPU-METHOD">/AUTOSAR_LinTrcv/CompuMethods/LinTrcv_TrcvWakeupModeType_Literals</COMPU-METHOD-REF>
                      <IMPLEMENTATION-DATA-TYPE-REF DEST="IMPLEMENTATION-DATA-TYPE">/AUTOSAR_Platform/ImplementationDataTypes/uint32</IMPLEMENTATION-DATA-TYPE-REF>
                    </SW-DATA-DEF-PROPS-CONDITIONAL>
                  </SW-DATA-DEF-PROPS-VARIANTS>
                </SW-DATA-DEF-PROPS>
                <TYPE-EMITTER>BSW</TYPE-EMITTER>
              </IMPLEMENTATION-DATA-TYPE>
              <IMPLEMENTATION-DATA-TYPE>
                <SHORT-NAME>LinTrcv_TrcvWakeupReasonType</SHORT-NAME>
                <CATEGORY>TYPE_REFERENCE</CATEGORY>
                <SW-DATA-DEF-PROPS>
                  <SW-DATA-DEF-PROPS-VARIANTS>
                    <SW-DATA-DEF-PROPS-CONDITIONAL>
                      <COMPU-METHOD-REF DEST="COMPU-METHOD">/AUTOSAR_LinTrcv/CompuMethods/LinTrcv_TrcvWakeupReasonType_Literals</COMPU-METHOD-REF>
                      <IMPLEMENTATION-DATA-TYPE-REF DEST="IMPLEMENTATION-DATA-TYPE">/AUTOSAR_Platform/ImplementationDataTypes/uint32</IMPLEMENTATION-DATA-TYPE-REF>
                    </SW-DATA-DEF-PROPS-CONDITIONAL>
                  </SW-DATA-DEF-PROPS-VARIANTS>
                </SW-DATA-DEF-PROPS>
                <TYPE-EMITTER>BSW</TYPE-EMITTER>
              </IMPLEMENTATION-DATA-TYPE>
            </ELEMENTS>
[!ENDMACRO!][!/*

* GenerateMemMapSwAddrMethods
*   Generates the SwAddrMethods of the MemMap
*
*   Parameters:
*     None.
*
*/!][!MACRO "GenerateMemMapSwAddrMethods"!]
            <SHORT-NAME>SwAddrMethods</SHORT-NAME>
            <CATEGORY>STANDARD</CATEGORY>
            <ELEMENTS>
              <!-- !LINKSTO Base.VAR.CoreScope, 1
                   !LINKSTO Base.CODE.CoreScope, 1
                   !LINKSTO Base.Safety, 1-->
              <SW-ADDR-METHOD>
                <SHORT-NAME>CODE</SHORT-NAME>
                <MEMORY-ALLOCATION-KEYWORD-POLICY>ADDR-METHOD-SHORT-NAME</MEMORY-ALLOCATION-KEYWORD-POLICY>
                <SECTION-TYPE>CODE</SECTION-TYPE>
              </SW-ADDR-METHOD>
              <SW-ADDR-METHOD>
                <SHORT-NAME>CODE_ASIL_A</SHORT-NAME>
                <MEMORY-ALLOCATION-KEYWORD-POLICY>ADDR-METHOD-SHORT-NAME</MEMORY-ALLOCATION-KEYWORD-POLICY>
                <OPTIONS>
                  <OPTION>safetyAsilA</OPTION>
                </OPTIONS>
                <SECTION-TYPE>CODE</SECTION-TYPE>
              </SW-ADDR-METHOD>
              <SW-ADDR-METHOD>
                <SHORT-NAME>CODE_ASIL_B</SHORT-NAME>
                <MEMORY-ALLOCATION-KEYWORD-POLICY>ADDR-METHOD-SHORT-NAME</MEMORY-ALLOCATION-KEYWORD-POLICY>
                <OPTIONS>
                  <OPTION>safetyAsilB</OPTION>
                </OPTIONS>
                <SECTION-TYPE>CODE</SECTION-TYPE>
              </SW-ADDR-METHOD>
              <SW-ADDR-METHOD>
                <SHORT-NAME>CODE_ASIL_C</SHORT-NAME>
                <MEMORY-ALLOCATION-KEYWORD-POLICY>ADDR-METHOD-SHORT-NAME</MEMORY-ALLOCATION-KEYWORD-POLICY>
                <OPTIONS>
                  <OPTION>safetyAsilC</OPTION>
                </OPTIONS>
                <SECTION-TYPE>CODE</SECTION-TYPE>
              </SW-ADDR-METHOD>
              <SW-ADDR-METHOD>
                <SHORT-NAME>CODE_ASIL_D</SHORT-NAME>
                <MEMORY-ALLOCATION-KEYWORD-POLICY>ADDR-METHOD-SHORT-NAME</MEMORY-ALLOCATION-KEYWORD-POLICY>
                <OPTIONS>
                  <OPTION>safetyAsilD</OPTION>
                </OPTIONS>
                <SECTION-TYPE>CODE</SECTION-TYPE>
              </SW-ADDR-METHOD>
              <SW-ADDR-METHOD>
                <SHORT-NAME>CODE_LOCAL</SHORT-NAME>
                <MEMORY-ALLOCATION-KEYWORD-POLICY>ADDR-METHOD-SHORT-NAME</MEMORY-ALLOCATION-KEYWORD-POLICY>
                <OPTIONS>
                  <OPTION>coreLocal</OPTION>
                </OPTIONS>
                <SECTION-TYPE>CODE</SECTION-TYPE>
              </SW-ADDR-METHOD>
              <SW-ADDR-METHOD>
                <SHORT-NAME>CODE_ASIL_A_LOCAL</SHORT-NAME>
                <MEMORY-ALLOCATION-KEYWORD-POLICY>ADDR-METHOD-SHORT-NAME</MEMORY-ALLOCATION-KEYWORD-POLICY>
                <OPTIONS>
                  <OPTION>safetyAsilA</OPTION>
                  <OPTION>coreLocal</OPTION>
                </OPTIONS>
                <SECTION-TYPE>CODE</SECTION-TYPE>
              </SW-ADDR-METHOD>
              <SW-ADDR-METHOD>
                <SHORT-NAME>CODE_ASIL_B_LOCAL</SHORT-NAME>
                <MEMORY-ALLOCATION-KEYWORD-POLICY>ADDR-METHOD-SHORT-NAME</MEMORY-ALLOCATION-KEYWORD-POLICY>
                <OPTIONS>
                  <OPTION>safetyAsilB</OPTION>
                  <OPTION>coreLocal</OPTION>
                </OPTIONS>
                <SECTION-TYPE>CODE</SECTION-TYPE>
              </SW-ADDR-METHOD>
              <SW-ADDR-METHOD>
                <SHORT-NAME>CODE_ASIL_C_LOCAL</SHORT-NAME>
                <MEMORY-ALLOCATION-KEYWORD-POLICY>ADDR-METHOD-SHORT-NAME</MEMORY-ALLOCATION-KEYWORD-POLICY>
                <OPTIONS>
                  <OPTION>safetyAsilC</OPTION>
                  <OPTION>coreLocal</OPTION>
                </OPTIONS>
                <SECTION-TYPE>CODE</SECTION-TYPE>
              </SW-ADDR-METHOD>
              <SW-ADDR-METHOD>
                <SHORT-NAME>CODE_ASIL_D_LOCAL</SHORT-NAME>
                <MEMORY-ALLOCATION-KEYWORD-POLICY>ADDR-METHOD-SHORT-NAME</MEMORY-ALLOCATION-KEYWORD-POLICY>
                <OPTIONS>
                  <OPTION>safetyAsilD</OPTION>
                  <OPTION>coreLocal</OPTION>
                </OPTIONS>
                <SECTION-TYPE>CODE</SECTION-TYPE>
              </SW-ADDR-METHOD>
              <SW-ADDR-METHOD>
                <SHORT-NAME>CALLOUT_CODE</SHORT-NAME>
                <MEMORY-ALLOCATION-KEYWORD-POLICY>ADDR-METHOD-SHORT-NAME</MEMORY-ALLOCATION-KEYWORD-POLICY>
                <SECTION-TYPE>CODE</SECTION-TYPE>
              </SW-ADDR-METHOD>
              <SW-ADDR-METHOD>
                <SHORT-NAME>CALLOUT_CODE_ASIL_A</SHORT-NAME>
                <MEMORY-ALLOCATION-KEYWORD-POLICY>ADDR-METHOD-SHORT-NAME</MEMORY-ALLOCATION-KEYWORD-POLICY>
                <OPTIONS>
                  <OPTION>safetyAsilA</OPTION>
                </OPTIONS>
                <SECTION-TYPE>CODE</SECTION-TYPE>
              </SW-ADDR-METHOD>
              <SW-ADDR-METHOD>
                <SHORT-NAME>CALLOUT_CODE_ASIL_B</SHORT-NAME>
                <MEMORY-ALLOCATION-KEYWORD-POLICY>ADDR-METHOD-SHORT-NAME</MEMORY-ALLOCATION-KEYWORD-POLICY>
                <OPTIONS>
                  <OPTION>safetyAsilB</OPTION>
                </OPTIONS>
                <SECTION-TYPE>CODE</SECTION-TYPE>
              </SW-ADDR-METHOD>
              <SW-ADDR-METHOD>
                <SHORT-NAME>CALLOUT_CODE_ASIL_C</SHORT-NAME>
                <MEMORY-ALLOCATION-KEYWORD-POLICY>ADDR-METHOD-SHORT-NAME</MEMORY-ALLOCATION-KEYWORD-POLICY>
                <OPTIONS>
                  <OPTION>safetyAsilC</OPTION>
                </OPTIONS>
                <SECTION-TYPE>CODE</SECTION-TYPE>
              </SW-ADDR-METHOD>
              <SW-ADDR-METHOD>
                <SHORT-NAME>CALLOUT_CODE_ASIL_D</SHORT-NAME>
                <MEMORY-ALLOCATION-KEYWORD-POLICY>ADDR-METHOD-SHORT-NAME</MEMORY-ALLOCATION-KEYWORD-POLICY>
                <OPTIONS>
                  <OPTION>safetyAsilD</OPTION>
                </OPTIONS>
                <SECTION-TYPE>CODE</SECTION-TYPE>
              </SW-ADDR-METHOD>
              <SW-ADDR-METHOD>
                <SHORT-NAME>CALLOUT_CODE_LOCAL</SHORT-NAME>
                <MEMORY-ALLOCATION-KEYWORD-POLICY>ADDR-METHOD-SHORT-NAME</MEMORY-ALLOCATION-KEYWORD-POLICY>
                <OPTIONS>
                  <OPTION>coreLocal</OPTION>
                </OPTIONS>
                <SECTION-TYPE>CODE</SECTION-TYPE>
              </SW-ADDR-METHOD>
              <SW-ADDR-METHOD>
                <SHORT-NAME>CALLOUT_CODE_ASIL_A_LOCAL</SHORT-NAME>
                <MEMORY-ALLOCATION-KEYWORD-POLICY>ADDR-METHOD-SHORT-NAME</MEMORY-ALLOCATION-KEYWORD-POLICY>
                <OPTIONS>
                  <OPTION>safetyAsilA</OPTION>
                  <OPTION>coreLocal</OPTION>
                </OPTIONS>
                <SECTION-TYPE>CODE</SECTION-TYPE>
              </SW-ADDR-METHOD>
              <SW-ADDR-METHOD>
                <SHORT-NAME>CALLOUT_CODE_ASIL_B_LOCAL</SHORT-NAME>
                <MEMORY-ALLOCATION-KEYWORD-POLICY>ADDR-METHOD-SHORT-NAME</MEMORY-ALLOCATION-KEYWORD-POLICY>
                <OPTIONS>
                  <OPTION>safetyAsilB</OPTION>
                  <OPTION>coreLocal</OPTION>
                </OPTIONS>
                <SECTION-TYPE>CODE</SECTION-TYPE>
              </SW-ADDR-METHOD>
              <SW-ADDR-METHOD>
                <SHORT-NAME>CALLOUT_CODE_ASIL_C_LOCAL</SHORT-NAME>
                <MEMORY-ALLOCATION-KEYWORD-POLICY>ADDR-METHOD-SHORT-NAME</MEMORY-ALLOCATION-KEYWORD-POLICY>
                <OPTIONS>
                  <OPTION>safetyAsilC</OPTION>
                  <OPTION>coreLocal</OPTION>
                </OPTIONS>
                <SECTION-TYPE>CODE</SECTION-TYPE>
              </SW-ADDR-METHOD>
              <SW-ADDR-METHOD>
                <SHORT-NAME>CALLOUT_CODE_ASIL_D_LOCAL</SHORT-NAME>
                <MEMORY-ALLOCATION-KEYWORD-POLICY>ADDR-METHOD-SHORT-NAME</MEMORY-ALLOCATION-KEYWORD-POLICY>
                <OPTIONS>
                  <OPTION>safetyAsilD</OPTION>
                  <OPTION>coreLocal</OPTION>
                </OPTIONS>
                <SECTION-TYPE>CODE</SECTION-TYPE>
              </SW-ADDR-METHOD>
              <SW-ADDR-METHOD>
                <SHORT-NAME>VAR</SHORT-NAME> <!-- keeping this for legacy reasons -->
                <MEMORY-ALLOCATION-KEYWORD-POLICY>ADDR-METHOD-SHORT-NAME-AND-ALIGNMENT</MEMORY-ALLOCATION-KEYWORD-POLICY>
                <SECTION-INITIALIZATION-POLICY>INIT</SECTION-INITIALIZATION-POLICY>
                <SECTION-TYPE>VAR</SECTION-TYPE>
              </SW-ADDR-METHOD>
              <SW-ADDR-METHOD>
                <SHORT-NAME>VAR_INIT</SHORT-NAME>
                <MEMORY-ALLOCATION-KEYWORD-POLICY>ADDR-METHOD-SHORT-NAME-AND-ALIGNMENT</MEMORY-ALLOCATION-KEYWORD-POLICY>
                <SECTION-INITIALIZATION-POLICY>INIT</SECTION-INITIALIZATION-POLICY>
                <SECTION-TYPE>VAR</SECTION-TYPE>
              </SW-ADDR-METHOD>
              <SW-ADDR-METHOD>
                <SHORT-NAME>VAR_INIT_ASIL_A</SHORT-NAME>
                <MEMORY-ALLOCATION-KEYWORD-POLICY>ADDR-METHOD-SHORT-NAME-AND-ALIGNMENT</MEMORY-ALLOCATION-KEYWORD-POLICY>
                <OPTIONS>
                  <OPTION>safetyAsilA</OPTION>
                </OPTIONS>
                <SECTION-INITIALIZATION-POLICY>INIT</SECTION-INITIALIZATION-POLICY>
                <SECTION-TYPE>VAR</SECTION-TYPE>
              </SW-ADDR-METHOD>
              <SW-ADDR-METHOD>
                <SHORT-NAME>VAR_INIT_ASIL_B</SHORT-NAME>
                <MEMORY-ALLOCATION-KEYWORD-POLICY>ADDR-METHOD-SHORT-NAME-AND-ALIGNMENT</MEMORY-ALLOCATION-KEYWORD-POLICY>
                <OPTIONS>
                  <OPTION>safetyAsilB</OPTION>
                </OPTIONS>
                <SECTION-INITIALIZATION-POLICY>INIT</SECTION-INITIALIZATION-POLICY>
                <SECTION-TYPE>VAR</SECTION-TYPE>
              </SW-ADDR-METHOD>
              <SW-ADDR-METHOD>
                <SHORT-NAME>VAR_INIT_ASIL_C</SHORT-NAME>
                <MEMORY-ALLOCATION-KEYWORD-POLICY>ADDR-METHOD-SHORT-NAME-AND-ALIGNMENT</MEMORY-ALLOCATION-KEYWORD-POLICY>
                <OPTIONS>
                  <OPTION>safetyAsilC</OPTION>
                </OPTIONS>
                <SECTION-INITIALIZATION-POLICY>INIT</SECTION-INITIALIZATION-POLICY>
                <SECTION-TYPE>VAR</SECTION-TYPE>
              </SW-ADDR-METHOD>
              <SW-ADDR-METHOD>
                <SHORT-NAME>VAR_INIT_ASIL_D</SHORT-NAME>
                <MEMORY-ALLOCATION-KEYWORD-POLICY>ADDR-METHOD-SHORT-NAME-AND-ALIGNMENT</MEMORY-ALLOCATION-KEYWORD-POLICY>
                <OPTIONS>
                  <OPTION>safetyAsilD</OPTION>
                </OPTIONS>
                <SECTION-INITIALIZATION-POLICY>INIT</SECTION-INITIALIZATION-POLICY>
                <SECTION-TYPE>VAR</SECTION-TYPE>
              </SW-ADDR-METHOD>
              <SW-ADDR-METHOD>
                <SHORT-NAME>VAR_INIT_LOCAL</SHORT-NAME>
                <MEMORY-ALLOCATION-KEYWORD-POLICY>ADDR-METHOD-SHORT-NAME-AND-ALIGNMENT</MEMORY-ALLOCATION-KEYWORD-POLICY>
                <OPTIONS>
                  <OPTION>coreLocal</OPTION>
                </OPTIONS>
                <SECTION-INITIALIZATION-POLICY>INIT</SECTION-INITIALIZATION-POLICY>
                <SECTION-TYPE>VAR</SECTION-TYPE>
              </SW-ADDR-METHOD>
              <SW-ADDR-METHOD>
                <SHORT-NAME>VAR_INIT_ASIL_A_LOCAL</SHORT-NAME>
                <MEMORY-ALLOCATION-KEYWORD-POLICY>ADDR-METHOD-SHORT-NAME-AND-ALIGNMENT</MEMORY-ALLOCATION-KEYWORD-POLICY>
                <OPTIONS>
                  <OPTION>safetyAsilA</OPTION>
                  <OPTION>coreLocal</OPTION>
                </OPTIONS>
                <SECTION-INITIALIZATION-POLICY>INIT</SECTION-INITIALIZATION-POLICY>
                <SECTION-TYPE>VAR</SECTION-TYPE>
              </SW-ADDR-METHOD>
              <SW-ADDR-METHOD>
                <SHORT-NAME>VAR_INIT_ASIL_B_LOCAL</SHORT-NAME>
                <MEMORY-ALLOCATION-KEYWORD-POLICY>ADDR-METHOD-SHORT-NAME-AND-ALIGNMENT</MEMORY-ALLOCATION-KEYWORD-POLICY>
                <OPTIONS>
                  <OPTION>safetyAsilB</OPTION>
                  <OPTION>coreLocal</OPTION>
                </OPTIONS>
                <SECTION-INITIALIZATION-POLICY>INIT</SECTION-INITIALIZATION-POLICY>
                <SECTION-TYPE>VAR</SECTION-TYPE>
              </SW-ADDR-METHOD>
              <SW-ADDR-METHOD>
                <SHORT-NAME>VAR_INIT_ASIL_C_LOCAL</SHORT-NAME>
                <MEMORY-ALLOCATION-KEYWORD-POLICY>ADDR-METHOD-SHORT-NAME-AND-ALIGNMENT</MEMORY-ALLOCATION-KEYWORD-POLICY>
                <OPTIONS>
                  <OPTION>safetyAsilC</OPTION>
                  <OPTION>coreLocal</OPTION>
                </OPTIONS>
                <SECTION-INITIALIZATION-POLICY>INIT</SECTION-INITIALIZATION-POLICY>
                <SECTION-TYPE>VAR</SECTION-TYPE>
              </SW-ADDR-METHOD>
              <SW-ADDR-METHOD>
                <SHORT-NAME>VAR_INIT_ASIL_D_LOCAL</SHORT-NAME>
                <MEMORY-ALLOCATION-KEYWORD-POLICY>ADDR-METHOD-SHORT-NAME-AND-ALIGNMENT</MEMORY-ALLOCATION-KEYWORD-POLICY>
                <OPTIONS>
                  <OPTION>safetyAsilD</OPTION>
                  <OPTION>coreLocal</OPTION>
                </OPTIONS>
                <SECTION-INITIALIZATION-POLICY>INIT</SECTION-INITIALIZATION-POLICY>
                <SECTION-TYPE>VAR</SECTION-TYPE>
              </SW-ADDR-METHOD>
              <SW-ADDR-METHOD>
                <SHORT-NAME>VAR_NOINIT</SHORT-NAME> <!-- keeping this for legacy reasons -->
                <MEMORY-ALLOCATION-KEYWORD-POLICY>ADDR-METHOD-SHORT-NAME-AND-ALIGNMENT</MEMORY-ALLOCATION-KEYWORD-POLICY>
                <SECTION-INITIALIZATION-POLICY>NO-INIT</SECTION-INITIALIZATION-POLICY>
                <SECTION-TYPE>VAR</SECTION-TYPE>
              </SW-ADDR-METHOD>
              <SW-ADDR-METHOD>
                <SHORT-NAME>VAR_NO_INIT</SHORT-NAME>
                <MEMORY-ALLOCATION-KEYWORD-POLICY>ADDR-METHOD-SHORT-NAME-AND-ALIGNMENT</MEMORY-ALLOCATION-KEYWORD-POLICY>
                <SECTION-INITIALIZATION-POLICY>NO-INIT</SECTION-INITIALIZATION-POLICY>
                <SECTION-TYPE>VAR</SECTION-TYPE>
              </SW-ADDR-METHOD>
              <SW-ADDR-METHOD>
                <SHORT-NAME>VAR_NO_INIT_ASIL_A</SHORT-NAME>
                <MEMORY-ALLOCATION-KEYWORD-POLICY>ADDR-METHOD-SHORT-NAME-AND-ALIGNMENT</MEMORY-ALLOCATION-KEYWORD-POLICY>
                <OPTIONS>
                  <OPTION>safetyAsilA</OPTION>
                </OPTIONS>
                <SECTION-INITIALIZATION-POLICY>NO-INIT</SECTION-INITIALIZATION-POLICY>
                <SECTION-TYPE>VAR</SECTION-TYPE>
              </SW-ADDR-METHOD>
              <SW-ADDR-METHOD>
                <SHORT-NAME>VAR_NO_INIT_ASIL_B</SHORT-NAME>
                <MEMORY-ALLOCATION-KEYWORD-POLICY>ADDR-METHOD-SHORT-NAME-AND-ALIGNMENT</MEMORY-ALLOCATION-KEYWORD-POLICY>
                <OPTIONS>
                  <OPTION>safetyAsilB</OPTION>
                </OPTIONS>
                <SECTION-INITIALIZATION-POLICY>NO-INIT</SECTION-INITIALIZATION-POLICY>
                <SECTION-TYPE>VAR</SECTION-TYPE>
              </SW-ADDR-METHOD>
              <SW-ADDR-METHOD>
                <SHORT-NAME>VAR_NO_INIT_ASIL_C</SHORT-NAME>
                <MEMORY-ALLOCATION-KEYWORD-POLICY>ADDR-METHOD-SHORT-NAME-AND-ALIGNMENT</MEMORY-ALLOCATION-KEYWORD-POLICY>
                <OPTIONS>
                  <OPTION>safetyAsilC</OPTION>
                </OPTIONS>
                <SECTION-INITIALIZATION-POLICY>NO-INIT</SECTION-INITIALIZATION-POLICY>
                <SECTION-TYPE>VAR</SECTION-TYPE>
              </SW-ADDR-METHOD>
              <SW-ADDR-METHOD>
                <SHORT-NAME>VAR_NO_INIT_ASIL_D</SHORT-NAME>
                <MEMORY-ALLOCATION-KEYWORD-POLICY>ADDR-METHOD-SHORT-NAME-AND-ALIGNMENT</MEMORY-ALLOCATION-KEYWORD-POLICY>
                <OPTIONS>
                  <OPTION>safetyAsilD</OPTION>
                </OPTIONS>
                <SECTION-INITIALIZATION-POLICY>NO-INIT</SECTION-INITIALIZATION-POLICY>
                <SECTION-TYPE>VAR</SECTION-TYPE>
              </SW-ADDR-METHOD>
              <SW-ADDR-METHOD>
                <SHORT-NAME>VAR_SAVED_ZONE</SHORT-NAME>
                <MEMORY-ALLOCATION-KEYWORD-POLICY>ADDR-METHOD-SHORT-NAME-AND-ALIGNMENT</MEMORY-ALLOCATION-KEYWORD-POLICY>
                <SECTION-INITIALIZATION-POLICY>NO-INIT</SECTION-INITIALIZATION-POLICY>
                <SECTION-TYPE>VAR</SECTION-TYPE>
              </SW-ADDR-METHOD>
              <SW-ADDR-METHOD>
                <SHORT-NAME>VAR_SAVED_ZONE_ASIL_A</SHORT-NAME>
                <MEMORY-ALLOCATION-KEYWORD-POLICY>ADDR-METHOD-SHORT-NAME-AND-ALIGNMENT</MEMORY-ALLOCATION-KEYWORD-POLICY>
                <OPTIONS>
                  <OPTION>safetyAsilA</OPTION>
                </OPTIONS>
                <SECTION-INITIALIZATION-POLICY>NO-INIT</SECTION-INITIALIZATION-POLICY>
                <SECTION-TYPE>VAR</SECTION-TYPE>
              </SW-ADDR-METHOD>
              <SW-ADDR-METHOD>
                <SHORT-NAME>VAR_SAVED_ZONE_ASIL_B</SHORT-NAME>
                <MEMORY-ALLOCATION-KEYWORD-POLICY>ADDR-METHOD-SHORT-NAME-AND-ALIGNMENT</MEMORY-ALLOCATION-KEYWORD-POLICY>
                <OPTIONS>
                  <OPTION>safetyAsilB</OPTION>
                </OPTIONS>
                <SECTION-INITIALIZATION-POLICY>NO-INIT</SECTION-INITIALIZATION-POLICY>
                <SECTION-TYPE>VAR</SECTION-TYPE>
              </SW-ADDR-METHOD>
              <SW-ADDR-METHOD>
                <SHORT-NAME>VAR_SAVED_ZONE_ASIL_C</SHORT-NAME>
                <MEMORY-ALLOCATION-KEYWORD-POLICY>ADDR-METHOD-SHORT-NAME-AND-ALIGNMENT</MEMORY-ALLOCATION-KEYWORD-POLICY>
                <OPTIONS>
                  <OPTION>safetyAsilC</OPTION>
                </OPTIONS>
                <SECTION-INITIALIZATION-POLICY>NO-INIT</SECTION-INITIALIZATION-POLICY>
                <SECTION-TYPE>VAR</SECTION-TYPE>
              </SW-ADDR-METHOD>
              <SW-ADDR-METHOD>
                <SHORT-NAME>VAR_SAVED_ZONE_ASIL_D</SHORT-NAME>
                <MEMORY-ALLOCATION-KEYWORD-POLICY>ADDR-METHOD-SHORT-NAME-AND-ALIGNMENT</MEMORY-ALLOCATION-KEYWORD-POLICY>
                <OPTIONS>
                  <OPTION>safetyAsilD</OPTION>
                </OPTIONS>
                <SECTION-INITIALIZATION-POLICY>NO-INIT</SECTION-INITIALIZATION-POLICY>
                <SECTION-TYPE>VAR</SECTION-TYPE>
              </SW-ADDR-METHOD>
              <SW-ADDR-METHOD>
                <SHORT-NAME>VAR_CLEARED</SHORT-NAME>
                <MEMORY-ALLOCATION-KEYWORD-POLICY>ADDR-METHOD-SHORT-NAME-AND-ALIGNMENT</MEMORY-ALLOCATION-KEYWORD-POLICY>
                <SECTION-INITIALIZATION-POLICY>CLEARED</SECTION-INITIALIZATION-POLICY>
                <SECTION-TYPE>VAR</SECTION-TYPE>
              </SW-ADDR-METHOD>
              <SW-ADDR-METHOD>
                <SHORT-NAME>VAR_CLEARED_ASIL_A</SHORT-NAME>
                <MEMORY-ALLOCATION-KEYWORD-POLICY>ADDR-METHOD-SHORT-NAME-AND-ALIGNMENT</MEMORY-ALLOCATION-KEYWORD-POLICY>
                <OPTIONS>
                  <OPTION>safetyAsilA</OPTION>
                </OPTIONS>
                <SECTION-INITIALIZATION-POLICY>CLEARED</SECTION-INITIALIZATION-POLICY>
                <SECTION-TYPE>VAR</SECTION-TYPE>
              </SW-ADDR-METHOD>
              <SW-ADDR-METHOD>
                <SHORT-NAME>VAR_CLEARED_ASIL_B</SHORT-NAME>
                <MEMORY-ALLOCATION-KEYWORD-POLICY>ADDR-METHOD-SHORT-NAME-AND-ALIGNMENT</MEMORY-ALLOCATION-KEYWORD-POLICY>
                <OPTIONS>
                  <OPTION>safetyAsilB</OPTION>
                </OPTIONS>
                <SECTION-INITIALIZATION-POLICY>CLEARED</SECTION-INITIALIZATION-POLICY>
                <SECTION-TYPE>VAR</SECTION-TYPE>
              </SW-ADDR-METHOD>
              <SW-ADDR-METHOD>
                <SHORT-NAME>VAR_CLEARED_ASIL_C</SHORT-NAME>
                <MEMORY-ALLOCATION-KEYWORD-POLICY>ADDR-METHOD-SHORT-NAME-AND-ALIGNMENT</MEMORY-ALLOCATION-KEYWORD-POLICY>
                <OPTIONS>
                  <OPTION>safetyAsilC</OPTION>
                </OPTIONS>
                <SECTION-INITIALIZATION-POLICY>CLEARED</SECTION-INITIALIZATION-POLICY>
                <SECTION-TYPE>VAR</SECTION-TYPE>
              </SW-ADDR-METHOD>
              <SW-ADDR-METHOD>
                <SHORT-NAME>VAR_CLEARED_ASIL_D</SHORT-NAME>
                <MEMORY-ALLOCATION-KEYWORD-POLICY>ADDR-METHOD-SHORT-NAME-AND-ALIGNMENT</MEMORY-ALLOCATION-KEYWORD-POLICY>
                <OPTIONS>
                  <OPTION>safetyAsilD</OPTION>
                </OPTIONS>
                <SECTION-INITIALIZATION-POLICY>CLEARED</SECTION-INITIALIZATION-POLICY>
                <SECTION-TYPE>VAR</SECTION-TYPE>
              </SW-ADDR-METHOD>
              <SW-ADDR-METHOD>
                <SHORT-NAME>VAR_CLEARED_LOCAL</SHORT-NAME>
                <MEMORY-ALLOCATION-KEYWORD-POLICY>ADDR-METHOD-SHORT-NAME-AND-ALIGNMENT</MEMORY-ALLOCATION-KEYWORD-POLICY>
                <OPTIONS>
                  <OPTION>coreLocal</OPTION>
                </OPTIONS>
                <SECTION-INITIALIZATION-POLICY>CLEARED</SECTION-INITIALIZATION-POLICY>
                <SECTION-TYPE>VAR</SECTION-TYPE>
              </SW-ADDR-METHOD>
              <SW-ADDR-METHOD>
                <SHORT-NAME>VAR_CLEARED_ASIL_A_LOCAL</SHORT-NAME>
                <MEMORY-ALLOCATION-KEYWORD-POLICY>ADDR-METHOD-SHORT-NAME-AND-ALIGNMENT</MEMORY-ALLOCATION-KEYWORD-POLICY>
                <OPTIONS>
                  <OPTION>safetyAsilA</OPTION>
                  <OPTION>coreLocal</OPTION>
                </OPTIONS>
                <SECTION-INITIALIZATION-POLICY>CLEARED</SECTION-INITIALIZATION-POLICY>
                <SECTION-TYPE>VAR</SECTION-TYPE>
              </SW-ADDR-METHOD>
              <SW-ADDR-METHOD>
                <SHORT-NAME>VAR_CLEARED_ASIL_B_LOCAL</SHORT-NAME>
                <MEMORY-ALLOCATION-KEYWORD-POLICY>ADDR-METHOD-SHORT-NAME-AND-ALIGNMENT</MEMORY-ALLOCATION-KEYWORD-POLICY>
                <OPTIONS>
                  <OPTION>safetyAsilB</OPTION>
                  <OPTION>coreLocal</OPTION>
                </OPTIONS>
                <SECTION-INITIALIZATION-POLICY>CLEARED</SECTION-INITIALIZATION-POLICY>
                <SECTION-TYPE>VAR</SECTION-TYPE>
              </SW-ADDR-METHOD>
              <SW-ADDR-METHOD>
                <SHORT-NAME>VAR_CLEARED_ASIL_C_LOCAL</SHORT-NAME>
                <MEMORY-ALLOCATION-KEYWORD-POLICY>ADDR-METHOD-SHORT-NAME-AND-ALIGNMENT</MEMORY-ALLOCATION-KEYWORD-POLICY>
                <OPTIONS>
                  <OPTION>safetyAsilC</OPTION>
                  <OPTION>coreLocal</OPTION>
                </OPTIONS>
                <SECTION-INITIALIZATION-POLICY>CLEARED</SECTION-INITIALIZATION-POLICY>
                <SECTION-TYPE>VAR</SECTION-TYPE>
              </SW-ADDR-METHOD>
              <SW-ADDR-METHOD>
                <SHORT-NAME>VAR_CLEARED_ASIL_D_LOCAL</SHORT-NAME>
                <MEMORY-ALLOCATION-KEYWORD-POLICY>ADDR-METHOD-SHORT-NAME-AND-ALIGNMENT</MEMORY-ALLOCATION-KEYWORD-POLICY>
                <OPTIONS>
                  <OPTION>safetyAsilD</OPTION>
                  <OPTION>coreLocal</OPTION>
                </OPTIONS>
                <SECTION-INITIALIZATION-POLICY>CLEARED</SECTION-INITIALIZATION-POLICY>
                <SECTION-TYPE>VAR</SECTION-TYPE>
              </SW-ADDR-METHOD>
              <SW-ADDR-METHOD>
                <SHORT-NAME>VAR_POWER_ON_INIT</SHORT-NAME>
                <MEMORY-ALLOCATION-KEYWORD-POLICY>ADDR-METHOD-SHORT-NAME-AND-ALIGNMENT</MEMORY-ALLOCATION-KEYWORD-POLICY>
                <SECTION-INITIALIZATION-POLICY>POWER-ON-INIT</SECTION-INITIALIZATION-POLICY>
                <SECTION-TYPE>VAR</SECTION-TYPE>
              </SW-ADDR-METHOD>
              <SW-ADDR-METHOD>
                <SHORT-NAME>VAR_POWER_ON_INIT_ASIL_A</SHORT-NAME>
                <MEMORY-ALLOCATION-KEYWORD-POLICY>ADDR-METHOD-SHORT-NAME-AND-ALIGNMENT</MEMORY-ALLOCATION-KEYWORD-POLICY>
                <OPTIONS>
                  <OPTION>safetyAsilA</OPTION>
                </OPTIONS>
                <SECTION-INITIALIZATION-POLICY>POWER-ON-INIT</SECTION-INITIALIZATION-POLICY>
                <SECTION-TYPE>VAR</SECTION-TYPE>
              </SW-ADDR-METHOD>
              <SW-ADDR-METHOD>
                <SHORT-NAME>VAR_POWER_ON_INIT_ASIL_B</SHORT-NAME>
                <MEMORY-ALLOCATION-KEYWORD-POLICY>ADDR-METHOD-SHORT-NAME-AND-ALIGNMENT</MEMORY-ALLOCATION-KEYWORD-POLICY>
                <OPTIONS>
                  <OPTION>safetyAsilB</OPTION>
                </OPTIONS>
                <SECTION-INITIALIZATION-POLICY>POWER-ON-INIT</SECTION-INITIALIZATION-POLICY>
                <SECTION-TYPE>VAR</SECTION-TYPE>
              </SW-ADDR-METHOD>
              <SW-ADDR-METHOD>
                <SHORT-NAME>VAR_POWER_ON_INIT_ASIL_C</SHORT-NAME>
                <MEMORY-ALLOCATION-KEYWORD-POLICY>ADDR-METHOD-SHORT-NAME-AND-ALIGNMENT</MEMORY-ALLOCATION-KEYWORD-POLICY>
                <OPTIONS>
                  <OPTION>safetyAsilC</OPTION>
                </OPTIONS>
                <SECTION-INITIALIZATION-POLICY>POWER-ON-INIT</SECTION-INITIALIZATION-POLICY>
                <SECTION-TYPE>VAR</SECTION-TYPE>
              </SW-ADDR-METHOD>
              <SW-ADDR-METHOD>
                <SHORT-NAME>VAR_POWER_ON_INIT_ASIL_D</SHORT-NAME>
                <MEMORY-ALLOCATION-KEYWORD-POLICY>ADDR-METHOD-SHORT-NAME-AND-ALIGNMENT</MEMORY-ALLOCATION-KEYWORD-POLICY>
                <OPTIONS>
                  <OPTION>safetyAsilD</OPTION>
                </OPTIONS>
                <SECTION-INITIALIZATION-POLICY>POWER-ON-INIT</SECTION-INITIALIZATION-POLICY>
                <SECTION-TYPE>VAR</SECTION-TYPE>
              </SW-ADDR-METHOD>
              <SW-ADDR-METHOD>
                <SHORT-NAME>VAR_POWER_ON_CLEARED</SHORT-NAME>
                <MEMORY-ALLOCATION-KEYWORD-POLICY>ADDR-METHOD-SHORT-NAME-AND-ALIGNMENT</MEMORY-ALLOCATION-KEYWORD-POLICY>
                <SECTION-INITIALIZATION-POLICY>POWER-ON-CLEARED</SECTION-INITIALIZATION-POLICY>
                <SECTION-TYPE>VAR</SECTION-TYPE>
              </SW-ADDR-METHOD>
              <SW-ADDR-METHOD>
                <SHORT-NAME>VAR_POWER_ON_CLEARED_ASIL_A</SHORT-NAME>
                <MEMORY-ALLOCATION-KEYWORD-POLICY>ADDR-METHOD-SHORT-NAME-AND-ALIGNMENT</MEMORY-ALLOCATION-KEYWORD-POLICY>
                <OPTIONS>
                  <OPTION>safetyAsilA</OPTION>
                </OPTIONS>
                <SECTION-INITIALIZATION-POLICY>POWER-ON-CLEARED</SECTION-INITIALIZATION-POLICY>
                <SECTION-TYPE>VAR</SECTION-TYPE>
              </SW-ADDR-METHOD>
              <SW-ADDR-METHOD>
                <SHORT-NAME>VAR_POWER_ON_CLEARED_ASIL_B</SHORT-NAME>
                <MEMORY-ALLOCATION-KEYWORD-POLICY>ADDR-METHOD-SHORT-NAME-AND-ALIGNMENT</MEMORY-ALLOCATION-KEYWORD-POLICY>
                <OPTIONS>
                  <OPTION>safetyAsilB</OPTION>
                </OPTIONS>
                <SECTION-INITIALIZATION-POLICY>POWER-ON-CLEARED</SECTION-INITIALIZATION-POLICY>
                <SECTION-TYPE>VAR</SECTION-TYPE>
              </SW-ADDR-METHOD>
              <SW-ADDR-METHOD>
                <SHORT-NAME>VAR_POWER_ON_CLEARED_ASIL_C</SHORT-NAME>
                <MEMORY-ALLOCATION-KEYWORD-POLICY>ADDR-METHOD-SHORT-NAME-AND-ALIGNMENT</MEMORY-ALLOCATION-KEYWORD-POLICY>
                <OPTIONS>
                  <OPTION>safetyAsilC</OPTION>
                </OPTIONS>
                <SECTION-INITIALIZATION-POLICY>POWER-ON-CLEARED</SECTION-INITIALIZATION-POLICY>
                <SECTION-TYPE>VAR</SECTION-TYPE>
              </SW-ADDR-METHOD>
              <SW-ADDR-METHOD>
                <SHORT-NAME>VAR_POWER_ON_CLEARED_ASIL_D</SHORT-NAME>
                <MEMORY-ALLOCATION-KEYWORD-POLICY>ADDR-METHOD-SHORT-NAME-AND-ALIGNMENT</MEMORY-ALLOCATION-KEYWORD-POLICY>
                <OPTIONS>
                  <OPTION>safetyAsilD</OPTION>
                </OPTIONS>
                <SECTION-INITIALIZATION-POLICY>POWER-ON-CLEARED</SECTION-INITIALIZATION-POLICY>
                <SECTION-TYPE>VAR</SECTION-TYPE>
              </SW-ADDR-METHOD>
              <SW-ADDR-METHOD>
                <SHORT-NAME>VAR_FAST</SHORT-NAME>
                <MEMORY-ALLOCATION-KEYWORD-POLICY>ADDR-METHOD-SHORT-NAME-AND-ALIGNMENT</MEMORY-ALLOCATION-KEYWORD-POLICY>
                <SECTION-INITIALIZATION-POLICY>INIT</SECTION-INITIALIZATION-POLICY>
                <SECTION-TYPE>VAR-FAST</SECTION-TYPE>
              </SW-ADDR-METHOD>
              <SW-ADDR-METHOD>
                <SHORT-NAME>VAR_FAST_ASIL_A</SHORT-NAME>
                <MEMORY-ALLOCATION-KEYWORD-POLICY>ADDR-METHOD-SHORT-NAME-AND-ALIGNMENT</MEMORY-ALLOCATION-KEYWORD-POLICY>
                <OPTIONS>
                  <OPTION>safetyAsilA</OPTION>
                </OPTIONS>
                <SECTION-INITIALIZATION-POLICY>INIT</SECTION-INITIALIZATION-POLICY>
                <SECTION-TYPE>VAR-FAST</SECTION-TYPE>
              </SW-ADDR-METHOD>
              <SW-ADDR-METHOD>
                <SHORT-NAME>VAR_FAST_ASIL_B</SHORT-NAME>
                <MEMORY-ALLOCATION-KEYWORD-POLICY>ADDR-METHOD-SHORT-NAME-AND-ALIGNMENT</MEMORY-ALLOCATION-KEYWORD-POLICY>
                <OPTIONS>
                  <OPTION>safetyAsilB</OPTION>
                </OPTIONS>
                <SECTION-INITIALIZATION-POLICY>INIT</SECTION-INITIALIZATION-POLICY>
                <SECTION-TYPE>VAR-FAST</SECTION-TYPE>
              </SW-ADDR-METHOD>
              <SW-ADDR-METHOD>
                <SHORT-NAME>VAR_FAST_ASIL_C</SHORT-NAME>
                <MEMORY-ALLOCATION-KEYWORD-POLICY>ADDR-METHOD-SHORT-NAME-AND-ALIGNMENT</MEMORY-ALLOCATION-KEYWORD-POLICY>
                <OPTIONS>
                  <OPTION>safetyAsilC</OPTION>
                </OPTIONS>
                <SECTION-INITIALIZATION-POLICY>INIT</SECTION-INITIALIZATION-POLICY>
                <SECTION-TYPE>VAR-FAST</SECTION-TYPE>
              </SW-ADDR-METHOD>
              <SW-ADDR-METHOD>
                <SHORT-NAME>VAR_FAST_ASIL_D</SHORT-NAME>
                <MEMORY-ALLOCATION-KEYWORD-POLICY>ADDR-METHOD-SHORT-NAME-AND-ALIGNMENT</MEMORY-ALLOCATION-KEYWORD-POLICY>
                <OPTIONS>
                  <OPTION>safetyAsilD</OPTION>
                </OPTIONS>
                <SECTION-INITIALIZATION-POLICY>INIT</SECTION-INITIALIZATION-POLICY>
                <SECTION-TYPE>VAR-FAST</SECTION-TYPE>
              </SW-ADDR-METHOD>
              <SW-ADDR-METHOD>
                <SHORT-NAME>VAR_FAST_LOCAL</SHORT-NAME>
                <MEMORY-ALLOCATION-KEYWORD-POLICY>ADDR-METHOD-SHORT-NAME-AND-ALIGNMENT</MEMORY-ALLOCATION-KEYWORD-POLICY>
                <OPTIONS>
                  <OPTION>coreLocal</OPTION>
                </OPTIONS>
                <SECTION-INITIALIZATION-POLICY>INIT</SECTION-INITIALIZATION-POLICY>
                <SECTION-TYPE>VAR-FAST</SECTION-TYPE>
              </SW-ADDR-METHOD>
              <SW-ADDR-METHOD>
                <SHORT-NAME>VAR_FAST_ASIL_A_LOCAL</SHORT-NAME>
                <MEMORY-ALLOCATION-KEYWORD-POLICY>ADDR-METHOD-SHORT-NAME-AND-ALIGNMENT</MEMORY-ALLOCATION-KEYWORD-POLICY>
                <OPTIONS>
                  <OPTION>safetyAsilA</OPTION>
                  <OPTION>coreLocal</OPTION>
                </OPTIONS>
                <SECTION-INITIALIZATION-POLICY>INIT</SECTION-INITIALIZATION-POLICY>
                <SECTION-TYPE>VAR-FAST</SECTION-TYPE>
              </SW-ADDR-METHOD>
              <SW-ADDR-METHOD>
                <SHORT-NAME>VAR_FAST_ASIL_B_LOCAL</SHORT-NAME>
                <MEMORY-ALLOCATION-KEYWORD-POLICY>ADDR-METHOD-SHORT-NAME-AND-ALIGNMENT</MEMORY-ALLOCATION-KEYWORD-POLICY>
                <OPTIONS>
                  <OPTION>safetyAsilB</OPTION>
                  <OPTION>coreLocal</OPTION>
                </OPTIONS>
                <SECTION-INITIALIZATION-POLICY>INIT</SECTION-INITIALIZATION-POLICY>
                <SECTION-TYPE>VAR-FAST</SECTION-TYPE>
              </SW-ADDR-METHOD>
              <SW-ADDR-METHOD>
                <SHORT-NAME>VAR_FAST_ASIL_C_LOCAL</SHORT-NAME>
                <MEMORY-ALLOCATION-KEYWORD-POLICY>ADDR-METHOD-SHORT-NAME-AND-ALIGNMENT</MEMORY-ALLOCATION-KEYWORD-POLICY>
                <OPTIONS>
                  <OPTION>safetyAsilC</OPTION>
                  <OPTION>coreLocal</OPTION>
                </OPTIONS>
                <SECTION-INITIALIZATION-POLICY>INIT</SECTION-INITIALIZATION-POLICY>
                <SECTION-TYPE>VAR-FAST</SECTION-TYPE>
              </SW-ADDR-METHOD>
              <SW-ADDR-METHOD>
                <SHORT-NAME>VAR_FAST_ASIL_D_LOCAL</SHORT-NAME>
                <MEMORY-ALLOCATION-KEYWORD-POLICY>ADDR-METHOD-SHORT-NAME-AND-ALIGNMENT</MEMORY-ALLOCATION-KEYWORD-POLICY>
                <OPTIONS>
                  <OPTION>safetyAsilD</OPTION>
                  <OPTION>coreLocal</OPTION>
                </OPTIONS>
                <SECTION-INITIALIZATION-POLICY>INIT</SECTION-INITIALIZATION-POLICY>
                <SECTION-TYPE>VAR-FAST</SECTION-TYPE>
              </SW-ADDR-METHOD>
              <SW-ADDR-METHOD>
                <SHORT-NAME>CONST</SHORT-NAME>
                <MEMORY-ALLOCATION-KEYWORD-POLICY>ADDR-METHOD-SHORT-NAME-AND-ALIGNMENT</MEMORY-ALLOCATION-KEYWORD-POLICY>
                <SECTION-TYPE>CONST</SECTION-TYPE>
              </SW-ADDR-METHOD>
              <SW-ADDR-METHOD>
                <SHORT-NAME>CONST_ASIL_A</SHORT-NAME>
                <MEMORY-ALLOCATION-KEYWORD-POLICY>ADDR-METHOD-SHORT-NAME-AND-ALIGNMENT</MEMORY-ALLOCATION-KEYWORD-POLICY>
                <OPTIONS>
                  <OPTION>safetyAsilA</OPTION>
                </OPTIONS>
                <SECTION-TYPE>CONST</SECTION-TYPE>
              </SW-ADDR-METHOD>
              <SW-ADDR-METHOD>
                <SHORT-NAME>CONST_ASIL_B</SHORT-NAME>
                <MEMORY-ALLOCATION-KEYWORD-POLICY>ADDR-METHOD-SHORT-NAME-AND-ALIGNMENT</MEMORY-ALLOCATION-KEYWORD-POLICY>
                <OPTIONS>
                  <OPTION>safetyAsilB</OPTION>
                </OPTIONS>
                <SECTION-TYPE>CONST</SECTION-TYPE>
              </SW-ADDR-METHOD>
              <SW-ADDR-METHOD>
                <SHORT-NAME>CONST_ASIL_C</SHORT-NAME>
                <MEMORY-ALLOCATION-KEYWORD-POLICY>ADDR-METHOD-SHORT-NAME-AND-ALIGNMENT</MEMORY-ALLOCATION-KEYWORD-POLICY>
                <OPTIONS>
                  <OPTION>safetyAsilC</OPTION>
                </OPTIONS>
                <SECTION-TYPE>CONST</SECTION-TYPE>
              </SW-ADDR-METHOD>
              <SW-ADDR-METHOD>
                <SHORT-NAME>CONST_ASIL_D</SHORT-NAME>
                <MEMORY-ALLOCATION-KEYWORD-POLICY>ADDR-METHOD-SHORT-NAME-AND-ALIGNMENT</MEMORY-ALLOCATION-KEYWORD-POLICY>
                <OPTIONS>
                  <OPTION>safetyAsilD</OPTION>
                </OPTIONS>
                <SECTION-TYPE>CONST</SECTION-TYPE>
              </SW-ADDR-METHOD>
              <SW-ADDR-METHOD>
                <SHORT-NAME>CALIB</SHORT-NAME>
                <MEMORY-ALLOCATION-KEYWORD-POLICY>ADDR-METHOD-SHORT-NAME-AND-ALIGNMENT</MEMORY-ALLOCATION-KEYWORD-POLICY>
                <SECTION-INITIALIZATION-POLICY>INIT</SECTION-INITIALIZATION-POLICY>
                <SECTION-TYPE>CALPRM</SECTION-TYPE>
              </SW-ADDR-METHOD>
              <SW-ADDR-METHOD>
                <SHORT-NAME>CALIB_ASIL_A</SHORT-NAME>
                <MEMORY-ALLOCATION-KEYWORD-POLICY>ADDR-METHOD-SHORT-NAME-AND-ALIGNMENT</MEMORY-ALLOCATION-KEYWORD-POLICY>
                <OPTIONS>
                  <OPTION>safetyAsilA</OPTION>
                </OPTIONS>
                <SECTION-INITIALIZATION-POLICY>INIT</SECTION-INITIALIZATION-POLICY>
                <SECTION-TYPE>CALPRM</SECTION-TYPE>
              </SW-ADDR-METHOD>
              <SW-ADDR-METHOD>
                <SHORT-NAME>CALIB_ASIL_B</SHORT-NAME>
                <MEMORY-ALLOCATION-KEYWORD-POLICY>ADDR-METHOD-SHORT-NAME-AND-ALIGNMENT</MEMORY-ALLOCATION-KEYWORD-POLICY>
                <OPTIONS>
                  <OPTION>safetyAsilB</OPTION>
                </OPTIONS>
                <SECTION-INITIALIZATION-POLICY>INIT</SECTION-INITIALIZATION-POLICY>
                <SECTION-TYPE>CALPRM</SECTION-TYPE>
              </SW-ADDR-METHOD>
              <SW-ADDR-METHOD>
                <SHORT-NAME>CALIB_ASIL_C</SHORT-NAME>
                <MEMORY-ALLOCATION-KEYWORD-POLICY>ADDR-METHOD-SHORT-NAME-AND-ALIGNMENT</MEMORY-ALLOCATION-KEYWORD-POLICY>
                <OPTIONS>
                  <OPTION>safetyAsilC</OPTION>
                </OPTIONS>
                <SECTION-INITIALIZATION-POLICY>INIT</SECTION-INITIALIZATION-POLICY>
                <SECTION-TYPE>CALPRM</SECTION-TYPE>
              </SW-ADDR-METHOD>
              <SW-ADDR-METHOD>
                <SHORT-NAME>CALIB_ASIL_D</SHORT-NAME>
                <MEMORY-ALLOCATION-KEYWORD-POLICY>ADDR-METHOD-SHORT-NAME-AND-ALIGNMENT</MEMORY-ALLOCATION-KEYWORD-POLICY>
                <OPTIONS>
                  <OPTION>safetyAsilD</OPTION>
                </OPTIONS>
                <SECTION-INITIALIZATION-POLICY>INIT</SECTION-INITIALIZATION-POLICY>
                <SECTION-TYPE>CALPRM</SECTION-TYPE>
              </SW-ADDR-METHOD>
              <SW-ADDR-METHOD>
                <SHORT-NAME>CONFIG_DATA</SHORT-NAME>
                <MEMORY-ALLOCATION-KEYWORD-POLICY>ADDR-METHOD-SHORT-NAME-AND-ALIGNMENT</MEMORY-ALLOCATION-KEYWORD-POLICY>
                <SECTION-TYPE>CONFIG-DATA</SECTION-TYPE>
              </SW-ADDR-METHOD>
              <SW-ADDR-METHOD>
                <SHORT-NAME>CONFIG_DATA_ASIL_A</SHORT-NAME>
                <MEMORY-ALLOCATION-KEYWORD-POLICY>ADDR-METHOD-SHORT-NAME-AND-ALIGNMENT</MEMORY-ALLOCATION-KEYWORD-POLICY>
                <OPTIONS>
                  <OPTION>safetyAsilA</OPTION>
                </OPTIONS>
                <SECTION-TYPE>CONFIG-DATA</SECTION-TYPE>
              </SW-ADDR-METHOD>
              <SW-ADDR-METHOD>
                <SHORT-NAME>CONFIG_DATA_ASIL_B</SHORT-NAME>
                <MEMORY-ALLOCATION-KEYWORD-POLICY>ADDR-METHOD-SHORT-NAME-AND-ALIGNMENT</MEMORY-ALLOCATION-KEYWORD-POLICY>
                <OPTIONS>
                  <OPTION>safetyAsilB</OPTION>
                </OPTIONS>
                <SECTION-TYPE>CONFIG-DATA</SECTION-TYPE>
              </SW-ADDR-METHOD>
              <SW-ADDR-METHOD>
                <SHORT-NAME>CONFIG_DATA_ASIL_C</SHORT-NAME>
                <MEMORY-ALLOCATION-KEYWORD-POLICY>ADDR-METHOD-SHORT-NAME-AND-ALIGNMENT</MEMORY-ALLOCATION-KEYWORD-POLICY>
                <OPTIONS>
                  <OPTION>safetyAsilC</OPTION>
                </OPTIONS>
                <SECTION-TYPE>CONFIG-DATA</SECTION-TYPE>
              </SW-ADDR-METHOD>
              <SW-ADDR-METHOD>
                <SHORT-NAME>CONFIG_DATA_ASIL_D</SHORT-NAME>
                <MEMORY-ALLOCATION-KEYWORD-POLICY>ADDR-METHOD-SHORT-NAME-AND-ALIGNMENT</MEMORY-ALLOCATION-KEYWORD-POLICY>
                <OPTIONS>
                  <OPTION>safetyAsilD</OPTION>
                </OPTIONS>
                <SECTION-TYPE>CONFIG-DATA</SECTION-TYPE>
              </SW-ADDR-METHOD>
            </ELEMENTS>
[!ENDMACRO!]
  <AR-PACKAGES>
    <AR-PACKAGE>
      <SHORT-NAME>AUTOSAR_Std</SHORT-NAME>
      <AR-PACKAGES>
        <AR-PACKAGE>
  [!CALL "GenerateStdImplementationTypes"!]
        </AR-PACKAGE>
        <AR-PACKAGE>
  [!CALL "GenerateStdCompuMethods"!]
        </AR-PACKAGE>
      </AR-PACKAGES>
    </AR-PACKAGE>
    <AR-PACKAGE>
      <SHORT-NAME>AUTOSAR_Platform</SHORT-NAME>
      <AR-PACKAGES>
        <AR-PACKAGE>
          <SHORT-NAME>BaseTypes</SHORT-NAME>
          <CATEGORY>STANDARD</CATEGORY>
          <ELEMENTS>
            <!--  Backward compatibility, deprecated and AUTOSAR/GenDef/BaseTypes/void shall be used instead -->
            <SW-BASE-TYPE>
              <SHORT-NAME>void</SHORT-NAME>
              <CATEGORY>FIXED_LENGTH</CATEGORY>
              <BASE-TYPE-SIZE>32</BASE-TYPE-SIZE>
              <BASE-TYPE-ENCODING>VOID</BASE-TYPE-ENCODING>
              <NATIVE-DECLARATION>void</NATIVE-DECLARATION>
            </SW-BASE-TYPE>
[!FOR "i"="1" TO  "num:i(count(text:split($AutosarBaseTypeList)))"!]
  [!VAR "AutosarType"="text:split($AutosarBaseTypeList)[num:i($i)]"!]
  [!CALL "GetTypeInfo","AutosarType"="$AutosarType"!]
            <SW-BASE-TYPE>
              <SHORT-NAME>[!"$AutosarType"!]</SHORT-NAME>
              <CATEGORY>FIXED_LENGTH</CATEGORY>
              <BASE-TYPE-SIZE>[!"$Size"!]</BASE-TYPE-SIZE>
              <BASE-TYPE-ENCODING>[!"$Encoding"!]</BASE-TYPE-ENCODING>
              <MEM-ALIGNMENT>[!"$Alignment"!]</MEM-ALIGNMENT>
              <NATIVE-DECLARATION>[!"$NativeType"!]</NATIVE-DECLARATION>
            </SW-BASE-TYPE>
[!ENDFOR!]
          </ELEMENTS>
        </AR-PACKAGE>

        <AR-PACKAGE>
          <SHORT-NAME>DataConstrs</SHORT-NAME>
          <CATEGORY>STANDARD</CATEGORY>
          <ELEMENTS>
            <!-- !LINKSTO Base.DataConstr.Availability, 1 -->
[!FOR "i"="1" TO  "num:i(count(text:split($AutosarImplTypeList)))"!]
  [!VAR "AutosarType"="text:split($AutosarImplTypeList)[num:i($i)]"!]
  [!CALL "GetTypeInfo","AutosarType"="$AutosarType"!]
  [!IF "$Encoding = '2C' or $Encoding = 'BOOLEAN' or $Encoding = 'NONE'"!]
            <DATA-CONSTR>
              <SHORT-NAME>[!"$AutosarType"!]</SHORT-NAME>
              <DATA-CONSTR-RULES>
                <DATA-CONSTR-RULE>
                  <INTERNAL-CONSTRS>
                    <LOWER-LIMIT INTERVAL-TYPE="CLOSED">[!"$LowerLimit"!]</LOWER-LIMIT>
                    <UPPER-LIMIT INTERVAL-TYPE="CLOSED">[!"$UpperLimit"!]</UPPER-LIMIT>
                  </INTERNAL-CONSTRS>
                </DATA-CONSTR-RULE>
              </DATA-CONSTR-RULES>
            </DATA-CONSTR>
  [!ENDIF!]
[!ENDFOR!]
          </ELEMENTS>
        </AR-PACKAGE>

        <AR-PACKAGE>
  [!CALL "GeneratePlatformImplementationTypes"!]
        </AR-PACKAGE>
        <AR-PACKAGE>
          <SHORT-NAME>CompuMethods</SHORT-NAME>
          <CATEGORY>STANDARD</CATEGORY>
          <ELEMENTS>
            <COMPU-METHOD>
              <SHORT-NAME>boolean</SHORT-NAME>
              <CATEGORY>TEXTTABLE</CATEGORY>
              <COMPU-INTERNAL-TO-PHYS>
                <COMPU-SCALES>
                  <COMPU-SCALE>
                    <LOWER-LIMIT INTERVAL-TYPE="CLOSED">0</LOWER-LIMIT>
                    <UPPER-LIMIT INTERVAL-TYPE="CLOSED">0</UPPER-LIMIT>
                    <COMPU-CONST><VT>FALSE</VT></COMPU-CONST>
                  </COMPU-SCALE>
                  <COMPU-SCALE>
                    <LOWER-LIMIT INTERVAL-TYPE="CLOSED">1</LOWER-LIMIT>
                    <UPPER-LIMIT INTERVAL-TYPE="CLOSED">1</UPPER-LIMIT>
                    <COMPU-CONST><VT>TRUE</VT></COMPU-CONST>
                  </COMPU-SCALE>
                </COMPU-SCALES>
              </COMPU-INTERNAL-TO-PHYS>
            </COMPU-METHOD>
          </ELEMENTS>
        </AR-PACKAGE>
      </AR-PACKAGES>
    </AR-PACKAGE>
    <!-- AUTOSAR_Comtype is kept for backward compatibility, /AUTOSAR/AUTOSAR_ComStack_Types shall be used instead -->
    <AR-PACKAGE>
      <SHORT-NAME>AUTOSAR_Comtype</SHORT-NAME>
      <AR-PACKAGES>
        <AR-PACKAGE>
  [!CALL "GenerateComtypeImplementationTypes"!]
        </AR-PACKAGE>

        <AR-PACKAGE>
          <SHORT-NAME>CompuMethods</SHORT-NAME>
          <CATEGORY>STANDARD</CATEGORY>
          <ELEMENTS>
            <COMPU-METHOD>
              <SHORT-NAME>TPParameterType_Literals</SHORT-NAME>
              <CATEGORY>TEXTTABLE</CATEGORY>
              <COMPU-INTERNAL-TO-PHYS>
                <COMPU-SCALES>
                  <COMPU-SCALE>
                    <LOWER-LIMIT INTERVAL-TYPE="CLOSED">0</LOWER-LIMIT>
                    <UPPER-LIMIT INTERVAL-TYPE="CLOSED">0</UPPER-LIMIT>
                    <COMPU-CONST><VT>TP_STMIN</VT></COMPU-CONST>
                  </COMPU-SCALE>
                  <COMPU-SCALE>
                    <LOWER-LIMIT INTERVAL-TYPE="CLOSED">1</LOWER-LIMIT>
                    <UPPER-LIMIT INTERVAL-TYPE="CLOSED">1</UPPER-LIMIT>
                    <COMPU-CONST><VT>TP_BS</VT></COMPU-CONST>
                  </COMPU-SCALE>
                  <COMPU-SCALE>
                    <LOWER-LIMIT INTERVAL-TYPE="CLOSED">2</LOWER-LIMIT>
                    <UPPER-LIMIT INTERVAL-TYPE="CLOSED">2</UPPER-LIMIT>
                    <COMPU-CONST><VT>TP_BC</VT></COMPU-CONST>
                  </COMPU-SCALE>
                </COMPU-SCALES>
              </COMPU-INTERNAL-TO-PHYS>
            </COMPU-METHOD>
            <COMPU-METHOD>
              <SHORT-NAME>BufReq_ReturnType_Literals</SHORT-NAME>
              <CATEGORY>TEXTTABLE</CATEGORY>
              <COMPU-INTERNAL-TO-PHYS>
                <COMPU-SCALES>
                  <COMPU-SCALE>
                    <LOWER-LIMIT INTERVAL-TYPE="CLOSED">0</LOWER-LIMIT>
                    <UPPER-LIMIT INTERVAL-TYPE="CLOSED">0</UPPER-LIMIT>
                    <COMPU-CONST><VT>BUFREQ_OK</VT></COMPU-CONST>
                  </COMPU-SCALE>
                  <COMPU-SCALE>
                    <LOWER-LIMIT INTERVAL-TYPE="CLOSED">1</LOWER-LIMIT>
                    <UPPER-LIMIT INTERVAL-TYPE="CLOSED">1</UPPER-LIMIT>
                    <COMPU-CONST><VT>BUFREQ_E_NOT_OK</VT></COMPU-CONST>
                  </COMPU-SCALE>
                  <COMPU-SCALE>
                    <LOWER-LIMIT INTERVAL-TYPE="CLOSED">2</LOWER-LIMIT>
                    <UPPER-LIMIT INTERVAL-TYPE="CLOSED">2</UPPER-LIMIT>
                    <COMPU-CONST><VT>BUFREQ_E_BUSY</VT></COMPU-CONST>
                  </COMPU-SCALE>
                  <COMPU-SCALE>
                    <LOWER-LIMIT INTERVAL-TYPE="CLOSED">3</LOWER-LIMIT>
                    <UPPER-LIMIT INTERVAL-TYPE="CLOSED">3</UPPER-LIMIT>
                    <COMPU-CONST><VT>BUFREQ_E_OVFL</VT></COMPU-CONST>
                  </COMPU-SCALE>
                </COMPU-SCALES>
              </COMPU-INTERNAL-TO-PHYS>
            </COMPU-METHOD>
            <COMPU-METHOD>
              <SHORT-NAME>TpDataStateType_Literals</SHORT-NAME>
              <CATEGORY>TEXTTABLE</CATEGORY>
              <COMPU-INTERNAL-TO-PHYS>
                <COMPU-SCALES>
                  <COMPU-SCALE>
                    <LOWER-LIMIT INTERVAL-TYPE="CLOSED">0</LOWER-LIMIT>
                    <UPPER-LIMIT INTERVAL-TYPE="CLOSED">0</UPPER-LIMIT>
                    <COMPU-CONST><VT>TP_DATACONF</VT></COMPU-CONST>
                  </COMPU-SCALE>
                  <COMPU-SCALE>
                    <LOWER-LIMIT INTERVAL-TYPE="CLOSED">1</LOWER-LIMIT>
                    <UPPER-LIMIT INTERVAL-TYPE="CLOSED">1</UPPER-LIMIT>
                    <COMPU-CONST><VT>TP_DATARETRY</VT></COMPU-CONST>
                  </COMPU-SCALE>
                  <COMPU-SCALE>
                    <LOWER-LIMIT INTERVAL-TYPE="CLOSED">2</LOWER-LIMIT>
                    <UPPER-LIMIT INTERVAL-TYPE="CLOSED">2</UPPER-LIMIT>
                    <COMPU-CONST><VT>TP_CONFPENDING</VT></COMPU-CONST>
                  </COMPU-SCALE>
                </COMPU-SCALES>
              </COMPU-INTERNAL-TO-PHYS>
            </COMPU-METHOD>
          </ELEMENTS>
        </AR-PACKAGE>
      </AR-PACKAGES>
    </AR-PACKAGE>
    <AR-PACKAGE>
      <SHORT-NAME>AUTOSAR_ComStack_Types</SHORT-NAME>
      <AR-PACKAGES>
        <AR-PACKAGE>
          <SHORT-NAME>DataConstrs</SHORT-NAME>
          <CATEGORY>STANDARD</CATEGORY>
          <ELEMENTS>
            <DATA-CONSTR>
               <SHORT-NAME>IcomConfigIdType</SHORT-NAME>
               <DATA-CONSTR-RULES>
                  <DATA-CONSTR-RULE>
                     <INTERNAL-CONSTRS>
                        <LOWER-LIMIT>0x00</LOWER-LIMIT>
                        <UPPER-LIMIT>0xFF</UPPER-LIMIT>
                     </INTERNAL-CONSTRS>
                  </DATA-CONSTR-RULE>
               </DATA-CONSTR-RULES>
            </DATA-CONSTR>
            <DATA-CONSTR>
               <SHORT-NAME>IcomSwitch_ErrorType</SHORT-NAME>
               <DATA-CONSTR-RULES>
                  <DATA-CONSTR-RULE>
                     <INTERNAL-CONSTRS>
                        <LOWER-LIMIT>0</LOWER-LIMIT>
                        <UPPER-LIMIT>1</UPPER-LIMIT>
                     </INTERNAL-CONSTRS>
                  </DATA-CONSTR-RULE>
               </DATA-CONSTR-RULES>
            </DATA-CONSTR>
            <DATA-CONSTR>
               <SHORT-NAME>NetworkHandleType</SHORT-NAME>
               <DATA-CONSTR-RULES>
                  <DATA-CONSTR-RULE>
                     <INTERNAL-CONSTRS>
                        <LOWER-LIMIT>0x00</LOWER-LIMIT>
                        <UPPER-LIMIT>0xFF</UPPER-LIMIT>
                     </INTERNAL-CONSTRS>
                  </DATA-CONSTR-RULE>
               </DATA-CONSTR-RULES>
            </DATA-CONSTR>
            <DATA-CONSTR>
               <SHORT-NAME>PNCHandleType</SHORT-NAME>
               <DATA-CONSTR-RULES>
                  <DATA-CONSTR-RULE>
                     <INTERNAL-CONSTRS>
                        <LOWER-LIMIT>0</LOWER-LIMIT>
                        <UPPER-LIMIT>255</UPPER-LIMIT>
                     </INTERNAL-CONSTRS>
                  </DATA-CONSTR-RULE>
               </DATA-CONSTR-RULES>
            </DATA-CONSTR>
            <DATA-CONSTR>
               <SHORT-NAME>TpDataStateType</SHORT-NAME>
               <DATA-CONSTR-RULES>
                  <DATA-CONSTR-RULE>
                     <INTERNAL-CONSTRS>
                        <LOWER-LIMIT>0</LOWER-LIMIT>
                        <UPPER-LIMIT>2</UPPER-LIMIT>
                     </INTERNAL-CONSTRS>
                  </DATA-CONSTR-RULE>
               </DATA-CONSTR-RULES>
            </DATA-CONSTR>
            <DATA-CONSTR>
               <SHORT-NAME>TPParameterType</SHORT-NAME>
               <DATA-CONSTR-RULES>
                  <DATA-CONSTR-RULE>
                     <INTERNAL-CONSTRS>
                        <LOWER-LIMIT>0</LOWER-LIMIT>
                        <UPPER-LIMIT>2</UPPER-LIMIT>
                     </INTERNAL-CONSTRS>
                  </DATA-CONSTR-RULE>
               </DATA-CONSTR-RULES>
            </DATA-CONSTR>
            <DATA-CONSTR>
               <SHORT-NAME>PduIdType</SHORT-NAME>
               <DATA-CONSTR-RULES>
                  <DATA-CONSTR-RULE>
                     <INTERNAL-CONSTRS>
                        [!CALL "GetPduTypeInfo", "TypeName"="'PduIdTypeEnum'"!]
                        [!CALL "GetTypeInfo", "AutosarType"="$Type"!]
                        <LOWER-LIMIT>[!"$LowerLimit"!]</LOWER-LIMIT>
                        <UPPER-LIMIT>[!"$UpperLimit"!]</UPPER-LIMIT>
                     </INTERNAL-CONSTRS>
                  </DATA-CONSTR-RULE>
               </DATA-CONSTR-RULES>
            </DATA-CONSTR>
            <DATA-CONSTR>
               <SHORT-NAME>PduLengthType</SHORT-NAME>
               <DATA-CONSTR-RULES>
                  <DATA-CONSTR-RULE>
                     <INTERNAL-CONSTRS>
                        [!CALL "GetPduTypeInfo", "TypeName"="'PduLengthTypeEnum'"!]
                        [!CALL "GetTypeInfo", "AutosarType"="$Type"!]
                        <LOWER-LIMIT>[!"$LowerLimit"!]</LOWER-LIMIT>
                        <UPPER-LIMIT>[!"$UpperLimit"!]</UPPER-LIMIT>
                     </INTERNAL-CONSTRS>
                  </DATA-CONSTR-RULE>
               </DATA-CONSTR-RULES>
            </DATA-CONSTR>
            <DATA-CONSTR>
               <SHORT-NAME>BufReq_ReturnType</SHORT-NAME>
               <DATA-CONSTR-RULES>
                  <DATA-CONSTR-RULE>
                     <INTERNAL-CONSTRS>
                        <LOWER-LIMIT>0</LOWER-LIMIT>
                        <UPPER-LIMIT>3</UPPER-LIMIT>
                     </INTERNAL-CONSTRS>
                  </DATA-CONSTR-RULE>
               </DATA-CONSTR-RULES>
            </DATA-CONSTR>
            <DATA-CONSTR>
               <SHORT-NAME>BusTrcvErrorType</SHORT-NAME>
               <DATA-CONSTR-RULES>
                  <DATA-CONSTR-RULE>
                     <INTERNAL-CONSTRS>
                        <LOWER-LIMIT>0x00</LOWER-LIMIT>
                        <UPPER-LIMIT>0x78</UPPER-LIMIT>
                     </INTERNAL-CONSTRS>
                  </DATA-CONSTR-RULE>
               </DATA-CONSTR-RULES>
            </DATA-CONSTR>
         </ELEMENTS>
        </AR-PACKAGE>
        <AR-PACKAGE>
          <SHORT-NAME>CompuMethods</SHORT-NAME>
          <CATEGORY>STANDARD</CATEGORY>
          <ELEMENTS>
            <COMPU-METHOD>
              <SHORT-NAME>IcomSwitch_ErrorType</SHORT-NAME>
              <CATEGORY>TEXTTABLE</CATEGORY>
              <COMPU-INTERNAL-TO-PHYS>
                 <COMPU-SCALES>
                    <COMPU-SCALE>
                       <LOWER-LIMIT INTERVAL-TYPE="CLOSED">0x00</LOWER-LIMIT>
                       <UPPER-LIMIT INTERVAL-TYPE="CLOSED">0x00</UPPER-LIMIT>
                       <COMPU-CONST>
                          <VT>ICOM_SWITCH_E_OK</VT>
                       </COMPU-CONST>
                    </COMPU-SCALE>
                    <COMPU-SCALE>
                       <LOWER-LIMIT INTERVAL-TYPE="CLOSED">0x01</LOWER-LIMIT>
                       <UPPER-LIMIT INTERVAL-TYPE="CLOSED">0x01</UPPER-LIMIT>
                       <COMPU-CONST>
                          <VT>ICOM_SWITCH_E_FAILED</VT>
                       </COMPU-CONST>
                    </COMPU-SCALE>
                 </COMPU-SCALES>
              </COMPU-INTERNAL-TO-PHYS>
           </COMPU-METHOD>
            <COMPU-METHOD>
              <SHORT-NAME>TPParameterType</SHORT-NAME>
              <CATEGORY>TEXTTABLE</CATEGORY>
              <COMPU-INTERNAL-TO-PHYS>
                <COMPU-SCALES>
                  <COMPU-SCALE>
                    <LOWER-LIMIT INTERVAL-TYPE="CLOSED">0</LOWER-LIMIT>
                    <UPPER-LIMIT INTERVAL-TYPE="CLOSED">0</UPPER-LIMIT>
                    <COMPU-CONST><VT>TP_STMIN</VT></COMPU-CONST>
                  </COMPU-SCALE>
                  <COMPU-SCALE>
                    <LOWER-LIMIT INTERVAL-TYPE="CLOSED">1</LOWER-LIMIT>
                    <UPPER-LIMIT INTERVAL-TYPE="CLOSED">1</UPPER-LIMIT>
                    <COMPU-CONST><VT>TP_BS</VT></COMPU-CONST>
                  </COMPU-SCALE>
                  <COMPU-SCALE>
                    <LOWER-LIMIT INTERVAL-TYPE="CLOSED">2</LOWER-LIMIT>
                    <UPPER-LIMIT INTERVAL-TYPE="CLOSED">2</UPPER-LIMIT>
                    <COMPU-CONST><VT>TP_BC</VT></COMPU-CONST>
                  </COMPU-SCALE>
                </COMPU-SCALES>
              </COMPU-INTERNAL-TO-PHYS>
            </COMPU-METHOD>
            <COMPU-METHOD>
               <SHORT-NAME>TpDataStateType</SHORT-NAME>
               <CATEGORY>TEXTTABLE</CATEGORY>
               <COMPU-INTERNAL-TO-PHYS>
                  <COMPU-SCALES>
                     <COMPU-SCALE>
                        <LOWER-LIMIT INTERVAL-TYPE="CLOSED">0x00</LOWER-LIMIT>
                        <UPPER-LIMIT INTERVAL-TYPE="CLOSED">0x00</UPPER-LIMIT>
                        <COMPU-CONST><VT>TP_DATACONF</VT></COMPU-CONST>
                     </COMPU-SCALE>
                     <COMPU-SCALE>
                        <LOWER-LIMIT INTERVAL-TYPE="CLOSED">0x01</LOWER-LIMIT>
                        <UPPER-LIMIT INTERVAL-TYPE="CLOSED">0x01</UPPER-LIMIT>
                        <COMPU-CONST><VT>TP_DATARETRY</VT></COMPU-CONST>
                     </COMPU-SCALE>
                     <COMPU-SCALE>
                        <LOWER-LIMIT INTERVAL-TYPE="CLOSED">0x02</LOWER-LIMIT>
                        <UPPER-LIMIT INTERVAL-TYPE="CLOSED">0x02</UPPER-LIMIT>
                        <COMPU-CONST><VT>TP_CONFPENDING</VT></COMPU-CONST>
                     </COMPU-SCALE>
                  </COMPU-SCALES>
               </COMPU-INTERNAL-TO-PHYS>
            </COMPU-METHOD>
            <COMPU-METHOD>
              <SHORT-NAME>BufReq_ReturnType</SHORT-NAME>
              <CATEGORY>TEXTTABLE</CATEGORY>
              <COMPU-INTERNAL-TO-PHYS>
                <COMPU-SCALES>
                  <COMPU-SCALE>
                    <LOWER-LIMIT INTERVAL-TYPE="CLOSED">0</LOWER-LIMIT>
                    <UPPER-LIMIT INTERVAL-TYPE="CLOSED">0</UPPER-LIMIT>
                    <COMPU-CONST><VT>BUFREQ_OK</VT></COMPU-CONST>
                  </COMPU-SCALE>
                  <COMPU-SCALE>
                    <LOWER-LIMIT INTERVAL-TYPE="CLOSED">1</LOWER-LIMIT>
                    <UPPER-LIMIT INTERVAL-TYPE="CLOSED">1</UPPER-LIMIT>
                    <COMPU-CONST><VT>BUFREQ_E_NOT_OK</VT></COMPU-CONST>
                  </COMPU-SCALE>
                  <COMPU-SCALE>
                    <LOWER-LIMIT INTERVAL-TYPE="CLOSED">2</LOWER-LIMIT>
                    <UPPER-LIMIT INTERVAL-TYPE="CLOSED">2</UPPER-LIMIT>
                    <COMPU-CONST><VT>BUFREQ_E_BUSY</VT></COMPU-CONST>
                  </COMPU-SCALE>
                  <COMPU-SCALE>
                    <LOWER-LIMIT INTERVAL-TYPE="CLOSED">3</LOWER-LIMIT>
                    <UPPER-LIMIT INTERVAL-TYPE="CLOSED">3</UPPER-LIMIT>
                    <COMPU-CONST><VT>BUFREQ_E_OVFL</VT></COMPU-CONST>
                  </COMPU-SCALE>
                </COMPU-SCALES>
              </COMPU-INTERNAL-TO-PHYS>
            </COMPU-METHOD>
            <COMPU-METHOD>
              <SHORT-NAME>BusTrcvErrorType</SHORT-NAME>
              <CATEGORY>TEXTTABLE</CATEGORY>
              <COMPU-INTERNAL-TO-PHYS>
                <COMPU-SCALES>
                  <COMPU-SCALE>
                    <LOWER-LIMIT INTERVAL-TYPE="CLOSED">0x00</LOWER-LIMIT>
                    <UPPER-LIMIT INTERVAL-TYPE="CLOSED">0x00</UPPER-LIMIT>
                    <COMPU-CONST>
                      <VT>BUSTRCV_OK</VT>
                    </COMPU-CONST>
                  </COMPU-SCALE>
                  <COMPU-SCALE>
                    <LOWER-LIMIT INTERVAL-TYPE="CLOSED">0x01</LOWER-LIMIT>
                    <UPPER-LIMIT INTERVAL-TYPE="CLOSED">0x01</UPPER-LIMIT>
                    <COMPU-CONST>
                      <VT>BUSTRCV_E_ERROR</VT>
                    </COMPU-CONST>
                  </COMPU-SCALE>
                </COMPU-SCALES>
              </COMPU-INTERNAL-TO-PHYS>
            </COMPU-METHOD>
          </ELEMENTS>
        </AR-PACKAGE>
        <AR-PACKAGE>
  [!CALL "GenerateComtypeImplementationTypes"!]
        </AR-PACKAGE>
      </AR-PACKAGES>
    </AR-PACKAGE>
    <AR-PACKAGE>
      <SHORT-NAME>AUTOSAR_GenDef</SHORT-NAME>
      <AR-PACKAGES>
        <AR-PACKAGE>
          <SHORT-NAME>BaseTypes</SHORT-NAME>
          <CATEGORY>STANDARD</CATEGORY>
          <ELEMENTS>
            <SW-BASE-TYPE>
              <SHORT-NAME>void</SHORT-NAME>
              <CATEGORY>VOID</CATEGORY>
              <BASE-TYPE-ENCODING>VOID</BASE-TYPE-ENCODING>
              <NATIVE-DECLARATION>void</NATIVE-DECLARATION>
            </SW-BASE-TYPE>
          </ELEMENTS>
        </AR-PACKAGE>
        <AR-PACKAGE>
          <SHORT-NAME>ImplementationDataTypes</SHORT-NAME>
          <CATEGORY>STANDARD</CATEGORY>
            <ELEMENTS>
              <IMPLEMENTATION-DATA-TYPE>
                 <SHORT-NAME>ConstVoidPtr</SHORT-NAME>
                 <CATEGORY>DATA_REFERENCE</CATEGORY>
                 <SW-DATA-DEF-PROPS>
                    <SW-DATA-DEF-PROPS-VARIANTS>
                       <SW-DATA-DEF-PROPS-CONDITIONAL>
                          <SW-POINTER-TARGET-PROPS>
                             <TARGET-CATEGORY>VALUE</TARGET-CATEGORY>
                             <SW-DATA-DEF-PROPS>
                                <SW-DATA-DEF-PROPS-VARIANTS>
                                   <SW-DATA-DEF-PROPS-CONDITIONAL>
                                      <BASE-TYPE-REF DEST="SW-BASE-TYPE">/AUTOSAR_GenDef/BaseTypes/void</BASE-TYPE-REF>
                                      <SW-IMPL-POLICY>CONST</SW-IMPL-POLICY>
                                   </SW-DATA-DEF-PROPS-CONDITIONAL>
                                </SW-DATA-DEF-PROPS-VARIANTS>
                             </SW-DATA-DEF-PROPS>
                          </SW-POINTER-TARGET-PROPS>
                       </SW-DATA-DEF-PROPS-CONDITIONAL>
                    </SW-DATA-DEF-PROPS-VARIANTS>
                 </SW-DATA-DEF-PROPS>
                <TYPE-EMITTER>BSW</TYPE-EMITTER>
              </IMPLEMENTATION-DATA-TYPE>
              <IMPLEMENTATION-DATA-TYPE>
                 <SHORT-NAME>VoidPtr</SHORT-NAME>
                 <CATEGORY>DATA_REFERENCE</CATEGORY>
                 <SW-DATA-DEF-PROPS>
                    <SW-DATA-DEF-PROPS-VARIANTS>
                       <SW-DATA-DEF-PROPS-CONDITIONAL>
                          <SW-POINTER-TARGET-PROPS>
                             <TARGET-CATEGORY>VALUE</TARGET-CATEGORY>
                             <SW-DATA-DEF-PROPS>
                                <SW-DATA-DEF-PROPS-VARIANTS>
                                   <SW-DATA-DEF-PROPS-CONDITIONAL>
                                      <BASE-TYPE-REF DEST="SW-BASE-TYPE">/AUTOSAR_GenDef/BaseTypes/void</BASE-TYPE-REF>
                                   </SW-DATA-DEF-PROPS-CONDITIONAL>
                                </SW-DATA-DEF-PROPS-VARIANTS>
                             </SW-DATA-DEF-PROPS>
                          </SW-POINTER-TARGET-PROPS>
                       </SW-DATA-DEF-PROPS-CONDITIONAL>
                    </SW-DATA-DEF-PROPS-VARIANTS>
                 </SW-DATA-DEF-PROPS>
                <TYPE-EMITTER>BSW</TYPE-EMITTER>
              </IMPLEMENTATION-DATA-TYPE>
           </ELEMENTS>
        </AR-PACKAGE>
      </AR-PACKAGES>
    </AR-PACKAGE>
[!IF "node:exists(as:modconf('Fr')) or node:exists(as:modconf('FrIf')) or node:exists(as:modconf('FrTrcv'))"!]
    <AR-PACKAGE>
      <SHORT-NAME>AUTOSAR_Fr</SHORT-NAME>
      <AR-PACKAGES>
        <AR-PACKAGE>
  [!CALL "GenerateFrImplementationTypes"!]
        </AR-PACKAGE>
        <AR-PACKAGE>
          <SHORT-NAME>CompuMethods</SHORT-NAME>
          <CATEGORY>STANDARD</CATEGORY>
          <ELEMENTS>
            <COMPU-METHOD>
              <SHORT-NAME>Fr_SyncStateType_Literals</SHORT-NAME>
              <CATEGORY>TEXTTABLE</CATEGORY>
              <COMPU-INTERNAL-TO-PHYS>
                <COMPU-SCALES>
                  <COMPU-SCALE>
                    <LOWER-LIMIT INTERVAL-TYPE="CLOSED">0</LOWER-LIMIT>
                    <UPPER-LIMIT INTERVAL-TYPE="CLOSED">0</UPPER-LIMIT>
                    <COMPU-CONST><VT>FR_ASYNC</VT></COMPU-CONST>
                  </COMPU-SCALE>
                  <COMPU-SCALE>
                    <LOWER-LIMIT INTERVAL-TYPE="CLOSED">1</LOWER-LIMIT>
                    <UPPER-LIMIT INTERVAL-TYPE="CLOSED">1</UPPER-LIMIT>
                    <COMPU-CONST><VT>FR_SYNC</VT></COMPU-CONST>
                  </COMPU-SCALE>
                </COMPU-SCALES>
              </COMPU-INTERNAL-TO-PHYS>
            </COMPU-METHOD>
            <COMPU-METHOD>
              <SHORT-NAME>Fr_OffsetCorrectionType_Literals</SHORT-NAME>
              <CATEGORY>TEXTTABLE</CATEGORY>
              <COMPU-INTERNAL-TO-PHYS>
                <COMPU-SCALES>
                  <COMPU-SCALE>
                    <LOWER-LIMIT INTERVAL-TYPE="CLOSED">0</LOWER-LIMIT>
                    <UPPER-LIMIT INTERVAL-TYPE="CLOSED">0</UPPER-LIMIT>
                    <COMPU-CONST><VT>FR_OFFSET_INC</VT></COMPU-CONST>
                  </COMPU-SCALE>
                  <COMPU-SCALE>
                    <LOWER-LIMIT INTERVAL-TYPE="CLOSED">1</LOWER-LIMIT>
                    <UPPER-LIMIT INTERVAL-TYPE="CLOSED">1</UPPER-LIMIT>
                    <COMPU-CONST><VT>FR_OFFSET_DEC</VT></COMPU-CONST>
                  </COMPU-SCALE>
                  <COMPU-SCALE>
                    <LOWER-LIMIT INTERVAL-TYPE="CLOSED">2</LOWER-LIMIT>
                    <UPPER-LIMIT INTERVAL-TYPE="CLOSED">2</UPPER-LIMIT>
                    <COMPU-CONST><VT>FR_OFFSET_NOCHANGE</VT></COMPU-CONST>
                  </COMPU-SCALE>
                </COMPU-SCALES>
              </COMPU-INTERNAL-TO-PHYS>
            </COMPU-METHOD>
            <COMPU-METHOD>
              <SHORT-NAME>Fr_RateCorrectionType_Literals</SHORT-NAME>
              <CATEGORY>TEXTTABLE</CATEGORY>
              <COMPU-INTERNAL-TO-PHYS>
                <COMPU-SCALES>
                  <COMPU-SCALE>
                    <LOWER-LIMIT INTERVAL-TYPE="CLOSED">0</LOWER-LIMIT>
                    <UPPER-LIMIT INTERVAL-TYPE="CLOSED">0</UPPER-LIMIT>
                    <COMPU-CONST><VT>FR_RATE_INC</VT></COMPU-CONST>
                  </COMPU-SCALE>
                  <COMPU-SCALE>
                    <LOWER-LIMIT INTERVAL-TYPE="CLOSED">1</LOWER-LIMIT>
                    <UPPER-LIMIT INTERVAL-TYPE="CLOSED">1</UPPER-LIMIT>
                    <COMPU-CONST><VT>FR_RATE_DEC</VT></COMPU-CONST>
                  </COMPU-SCALE>
                  <COMPU-SCALE>
                    <LOWER-LIMIT INTERVAL-TYPE="CLOSED">2</LOWER-LIMIT>
                    <UPPER-LIMIT INTERVAL-TYPE="CLOSED">2</UPPER-LIMIT>
                    <COMPU-CONST><VT>FR_RATE_NOCHANGE</VT></COMPU-CONST>
                  </COMPU-SCALE>
                </COMPU-SCALES>
              </COMPU-INTERNAL-TO-PHYS>
            </COMPU-METHOD>
            <COMPU-METHOD>
              <SHORT-NAME>Fr_POCStateType_Literals</SHORT-NAME>
              <CATEGORY>TEXTTABLE</CATEGORY>
              <COMPU-INTERNAL-TO-PHYS>
                <COMPU-SCALES>
                  <COMPU-SCALE>
                    <LOWER-LIMIT INTERVAL-TYPE="CLOSED">0</LOWER-LIMIT>
                    <UPPER-LIMIT INTERVAL-TYPE="CLOSED">0</UPPER-LIMIT>
                    <COMPU-CONST><VT>FR_POCSTATE_CONFIG</VT></COMPU-CONST>
                  </COMPU-SCALE>
                  <COMPU-SCALE>
                    <LOWER-LIMIT INTERVAL-TYPE="CLOSED">1</LOWER-LIMIT>
                    <UPPER-LIMIT INTERVAL-TYPE="CLOSED">1</UPPER-LIMIT>
                    <COMPU-CONST><VT>FR_POCSTATE_DEFAULT_CONFIG</VT></COMPU-CONST>
                  </COMPU-SCALE>
                  <COMPU-SCALE>
                    <LOWER-LIMIT INTERVAL-TYPE="CLOSED">2</LOWER-LIMIT>
                    <UPPER-LIMIT INTERVAL-TYPE="CLOSED">2</UPPER-LIMIT>
                    <COMPU-CONST><VT>FR_POCSTATE_HALT</VT></COMPU-CONST>
                  </COMPU-SCALE>
                  <COMPU-SCALE>
                    <LOWER-LIMIT INTERVAL-TYPE="CLOSED">3</LOWER-LIMIT>
                    <UPPER-LIMIT INTERVAL-TYPE="CLOSED">3</UPPER-LIMIT>
                    <COMPU-CONST><VT>FR_POCSTATE_NORMAL_ACTIVE</VT></COMPU-CONST>
                  </COMPU-SCALE>
                  <COMPU-SCALE>
                    <LOWER-LIMIT INTERVAL-TYPE="CLOSED">4</LOWER-LIMIT>
                    <UPPER-LIMIT INTERVAL-TYPE="CLOSED">4</UPPER-LIMIT>
                    <COMPU-CONST><VT>FR_POCSTATE_NORMAL_PASSIVE</VT></COMPU-CONST>
                  </COMPU-SCALE>
                  <COMPU-SCALE>
                    <LOWER-LIMIT INTERVAL-TYPE="CLOSED">5</LOWER-LIMIT>
                    <UPPER-LIMIT INTERVAL-TYPE="CLOSED">5</UPPER-LIMIT>
                    <COMPU-CONST><VT>FR_POCSTATE_READY</VT></COMPU-CONST>
                  </COMPU-SCALE>
                  <COMPU-SCALE>
                    <LOWER-LIMIT INTERVAL-TYPE="CLOSED">6</LOWER-LIMIT>
                    <UPPER-LIMIT INTERVAL-TYPE="CLOSED">6</UPPER-LIMIT>
                    <COMPU-CONST><VT>FR_POCSTATE_STARTUP</VT></COMPU-CONST>
                  </COMPU-SCALE>
                  <COMPU-SCALE>
                    <LOWER-LIMIT INTERVAL-TYPE="CLOSED">7</LOWER-LIMIT>
                    <UPPER-LIMIT INTERVAL-TYPE="CLOSED">7</UPPER-LIMIT>
                    <COMPU-CONST><VT>FR_POCSTATE_WAKEUP</VT></COMPU-CONST>
                  </COMPU-SCALE>
                </COMPU-SCALES>
              </COMPU-INTERNAL-TO-PHYS>
            </COMPU-METHOD>
            <COMPU-METHOD>
              <SHORT-NAME>Fr_SlotModeType_Literals</SHORT-NAME>
              <CATEGORY>TEXTTABLE</CATEGORY>
              <COMPU-INTERNAL-TO-PHYS>
                <COMPU-SCALES>
                  <COMPU-SCALE>
                    <LOWER-LIMIT INTERVAL-TYPE="CLOSED">0</LOWER-LIMIT>
                    <UPPER-LIMIT INTERVAL-TYPE="CLOSED">0</UPPER-LIMIT>
                    <COMPU-CONST><VT>FR_SLOTMODE_KEYSLOT</VT></COMPU-CONST>
                  </COMPU-SCALE>
                  <COMPU-SCALE>
                    <LOWER-LIMIT INTERVAL-TYPE="CLOSED">1</LOWER-LIMIT>
                    <UPPER-LIMIT INTERVAL-TYPE="CLOSED">1</UPPER-LIMIT>
                    <COMPU-CONST><VT>FR_SLOTMODE_ALL_PENDING</VT></COMPU-CONST>
                  </COMPU-SCALE>
                  <COMPU-SCALE>
                    <LOWER-LIMIT INTERVAL-TYPE="CLOSED">2</LOWER-LIMIT>
                    <UPPER-LIMIT INTERVAL-TYPE="CLOSED">2</UPPER-LIMIT>
                    <COMPU-CONST><VT>FR_SLOTMODE_ALL</VT></COMPU-CONST>
                  </COMPU-SCALE>
                </COMPU-SCALES>
              </COMPU-INTERNAL-TO-PHYS>
            </COMPU-METHOD>
            <COMPU-METHOD>
              <SHORT-NAME>Fr_ErrorModeType_Literals</SHORT-NAME>
              <CATEGORY>TEXTTABLE</CATEGORY>
              <COMPU-INTERNAL-TO-PHYS>
                <COMPU-SCALES>
                  <COMPU-SCALE>
                    <LOWER-LIMIT INTERVAL-TYPE="CLOSED">0</LOWER-LIMIT>
                    <UPPER-LIMIT INTERVAL-TYPE="CLOSED">0</UPPER-LIMIT>
                    <COMPU-CONST><VT>FR_ERRORMODE_ACTIVE</VT></COMPU-CONST>
                  </COMPU-SCALE>
                  <COMPU-SCALE>
                    <LOWER-LIMIT INTERVAL-TYPE="CLOSED">1</LOWER-LIMIT>
                    <UPPER-LIMIT INTERVAL-TYPE="CLOSED">1</UPPER-LIMIT>
                    <COMPU-CONST><VT>FR_ERRORMODE_PASSIVE</VT></COMPU-CONST>
                  </COMPU-SCALE>
                  <COMPU-SCALE>
                    <LOWER-LIMIT INTERVAL-TYPE="CLOSED">2</LOWER-LIMIT>
                    <UPPER-LIMIT INTERVAL-TYPE="CLOSED">2</UPPER-LIMIT>
                    <COMPU-CONST><VT>FR_ERRORMODE_COMM_HALT</VT></COMPU-CONST>
                  </COMPU-SCALE>
                </COMPU-SCALES>
              </COMPU-INTERNAL-TO-PHYS>
            </COMPU-METHOD>
            <COMPU-METHOD>
              <SHORT-NAME>Fr_WakeupStatusType_Literals</SHORT-NAME>
              <CATEGORY>TEXTTABLE</CATEGORY>
              <COMPU-INTERNAL-TO-PHYS>
                <COMPU-SCALES>
                  <COMPU-SCALE>
                    <LOWER-LIMIT INTERVAL-TYPE="CLOSED">0</LOWER-LIMIT>
                    <UPPER-LIMIT INTERVAL-TYPE="CLOSED">0</UPPER-LIMIT>
                    <COMPU-CONST><VT>FR_WAKEUP_UNDEFINED</VT></COMPU-CONST>
                  </COMPU-SCALE>
                  <COMPU-SCALE>
                    <LOWER-LIMIT INTERVAL-TYPE="CLOSED">1</LOWER-LIMIT>
                    <UPPER-LIMIT INTERVAL-TYPE="CLOSED">1</UPPER-LIMIT>
                    <COMPU-CONST><VT>FR_WAKEUP_RECEIVED_HEADER</VT></COMPU-CONST>
                  </COMPU-SCALE>
                  <COMPU-SCALE>
                    <LOWER-LIMIT INTERVAL-TYPE="CLOSED">2</LOWER-LIMIT>
                    <UPPER-LIMIT INTERVAL-TYPE="CLOSED">2</UPPER-LIMIT>
                    <COMPU-CONST><VT>FR_WAKEUP_RECEIVED_WUP</VT></COMPU-CONST>
                  </COMPU-SCALE>
                  <COMPU-SCALE>
                    <LOWER-LIMIT INTERVAL-TYPE="CLOSED">3</LOWER-LIMIT>
                    <UPPER-LIMIT INTERVAL-TYPE="CLOSED">3</UPPER-LIMIT>
                    <COMPU-CONST><VT>FR_WAKEUP_COLLISION_HEADER</VT></COMPU-CONST>
                  </COMPU-SCALE>
                  <COMPU-SCALE>
                    <LOWER-LIMIT INTERVAL-TYPE="CLOSED">4</LOWER-LIMIT>
                    <UPPER-LIMIT INTERVAL-TYPE="CLOSED">4</UPPER-LIMIT>
                    <COMPU-CONST><VT>FR_WAKEUP_COLLISION_WUP</VT></COMPU-CONST>
                  </COMPU-SCALE>
                  <COMPU-SCALE>
                    <LOWER-LIMIT INTERVAL-TYPE="CLOSED">5</LOWER-LIMIT>
                    <UPPER-LIMIT INTERVAL-TYPE="CLOSED">5</UPPER-LIMIT>
                    <COMPU-CONST><VT>FR_WAKEUP_COLLISION_UNKNOWN</VT></COMPU-CONST>
                  </COMPU-SCALE>
                  <COMPU-SCALE>
                    <LOWER-LIMIT INTERVAL-TYPE="CLOSED">6</LOWER-LIMIT>
                    <UPPER-LIMIT INTERVAL-TYPE="CLOSED">6</UPPER-LIMIT>
                    <COMPU-CONST><VT>FR_WAKEUP_TRANSMITTED</VT></COMPU-CONST>
                  </COMPU-SCALE>
                </COMPU-SCALES>
              </COMPU-INTERNAL-TO-PHYS>
            </COMPU-METHOD>
            <COMPU-METHOD>
              <SHORT-NAME>Fr_StartupStateType_Literals</SHORT-NAME>
              <CATEGORY>TEXTTABLE</CATEGORY>
              <COMPU-INTERNAL-TO-PHYS>
                <COMPU-SCALES>
                  <COMPU-SCALE>
                    <LOWER-LIMIT INTERVAL-TYPE="CLOSED">0</LOWER-LIMIT>
                    <UPPER-LIMIT INTERVAL-TYPE="CLOSED">0</UPPER-LIMIT>
                    <COMPU-CONST><VT>FR_STARTUP_UNDEFINED</VT></COMPU-CONST>
                  </COMPU-SCALE>
                  <COMPU-SCALE>
                    <LOWER-LIMIT INTERVAL-TYPE="CLOSED">1</LOWER-LIMIT>
                    <UPPER-LIMIT INTERVAL-TYPE="CLOSED">1</UPPER-LIMIT>
                    <COMPU-CONST><VT>FR_STARTUP_COLDSTART_LISTEN</VT></COMPU-CONST>
                  </COMPU-SCALE>
                  <COMPU-SCALE>
                    <LOWER-LIMIT INTERVAL-TYPE="CLOSED">2</LOWER-LIMIT>
                    <UPPER-LIMIT INTERVAL-TYPE="CLOSED">2</UPPER-LIMIT>
                    <COMPU-CONST><VT>FR_STARTUP_INTEGRATION_COLDSTART_CHECK</VT></COMPU-CONST>
                  </COMPU-SCALE>
                  <COMPU-SCALE>
                    <LOWER-LIMIT INTERVAL-TYPE="CLOSED">3</LOWER-LIMIT>
                    <UPPER-LIMIT INTERVAL-TYPE="CLOSED">3</UPPER-LIMIT>
                    <COMPU-CONST><VT>FR_STARTUP_COLDSTART_JOIN</VT></COMPU-CONST>
                  </COMPU-SCALE>
                  <COMPU-SCALE>
                    <LOWER-LIMIT INTERVAL-TYPE="CLOSED">4</LOWER-LIMIT>
                    <UPPER-LIMIT INTERVAL-TYPE="CLOSED">4</UPPER-LIMIT>
                    <COMPU-CONST><VT>FR_STARTUP_COLDSTART_COLLISION_RESOLUTION</VT></COMPU-CONST>
                  </COMPU-SCALE>
                  <COMPU-SCALE>
                    <LOWER-LIMIT INTERVAL-TYPE="CLOSED">5</LOWER-LIMIT>
                    <UPPER-LIMIT INTERVAL-TYPE="CLOSED">5</UPPER-LIMIT>
                    <COMPU-CONST><VT>FR_STARTUP_COLDSTART_CONSISTENCY_CHECK</VT></COMPU-CONST>
                  </COMPU-SCALE>
                  <COMPU-SCALE>
                    <LOWER-LIMIT INTERVAL-TYPE="CLOSED">6</LOWER-LIMIT>
                    <UPPER-LIMIT INTERVAL-TYPE="CLOSED">6</UPPER-LIMIT>
                    <COMPU-CONST><VT>FR_STARTUP_INTEGRATION_LISTEN</VT></COMPU-CONST>
                  </COMPU-SCALE>
                  <COMPU-SCALE>
                    <LOWER-LIMIT INTERVAL-TYPE="CLOSED">7</LOWER-LIMIT>
                    <UPPER-LIMIT INTERVAL-TYPE="CLOSED">7</UPPER-LIMIT>
                    <COMPU-CONST><VT>FR_STARTUP_INITIALIZE_SCHEDULE</VT></COMPU-CONST>
                  </COMPU-SCALE>
                  <COMPU-SCALE>
                    <LOWER-LIMIT INTERVAL-TYPE="CLOSED">8</LOWER-LIMIT>
                    <UPPER-LIMIT INTERVAL-TYPE="CLOSED">8</UPPER-LIMIT>
                    <COMPU-CONST><VT>FR_STARTUP_INTEGRATION_CONSISTENCY_CHECK</VT></COMPU-CONST>
                  </COMPU-SCALE>
                  <COMPU-SCALE>
                    <LOWER-LIMIT INTERVAL-TYPE="CLOSED">9</LOWER-LIMIT>
                    <UPPER-LIMIT INTERVAL-TYPE="CLOSED">9</UPPER-LIMIT>
                    <COMPU-CONST><VT>FR_STARTUP_COLDSTART_GAP</VT></COMPU-CONST>
                  </COMPU-SCALE>
                  <COMPU-SCALE>
                    <LOWER-LIMIT INTERVAL-TYPE="CLOSED">10</LOWER-LIMIT>
                    <UPPER-LIMIT INTERVAL-TYPE="CLOSED">10</UPPER-LIMIT>
                    <COMPU-CONST><VT>FR_STARTUP_EXTERNAL_STARTUP</VT></COMPU-CONST>
                  </COMPU-SCALE>
                </COMPU-SCALES>
              </COMPU-INTERNAL-TO-PHYS>
            </COMPU-METHOD>
            <COMPU-METHOD>
              <SHORT-NAME>Fr_TxLPduStatusType_Literals</SHORT-NAME>
              <CATEGORY>TEXTTABLE</CATEGORY>
              <COMPU-INTERNAL-TO-PHYS>
                <COMPU-SCALES>
                  <COMPU-SCALE>
                    <LOWER-LIMIT INTERVAL-TYPE="CLOSED">0</LOWER-LIMIT>
                    <UPPER-LIMIT INTERVAL-TYPE="CLOSED">0</UPPER-LIMIT>
                    <COMPU-CONST><VT>FR_TRANSMITTED</VT></COMPU-CONST>
                  </COMPU-SCALE>
                  <COMPU-SCALE>
                    <LOWER-LIMIT INTERVAL-TYPE="CLOSED">1</LOWER-LIMIT>
                    <UPPER-LIMIT INTERVAL-TYPE="CLOSED">1</UPPER-LIMIT>
                    <COMPU-CONST><VT>FR_NOT_TRANSMITTED</VT></COMPU-CONST>
                  </COMPU-SCALE>
                </COMPU-SCALES>
              </COMPU-INTERNAL-TO-PHYS>
            </COMPU-METHOD>
            <COMPU-METHOD>
              <SHORT-NAME>Fr_RxLPduStatusType_Literals</SHORT-NAME>
              <CATEGORY>TEXTTABLE</CATEGORY>
              <COMPU-INTERNAL-TO-PHYS>
                <COMPU-SCALES>
                  <COMPU-SCALE>
                    <LOWER-LIMIT INTERVAL-TYPE="CLOSED">0</LOWER-LIMIT>
                    <UPPER-LIMIT INTERVAL-TYPE="CLOSED">0</UPPER-LIMIT>
                    <COMPU-CONST><VT>FR_RECEIVED</VT></COMPU-CONST>
                  </COMPU-SCALE>
                  <COMPU-SCALE>
                    <LOWER-LIMIT INTERVAL-TYPE="CLOSED">1</LOWER-LIMIT>
                    <UPPER-LIMIT INTERVAL-TYPE="CLOSED">1</UPPER-LIMIT>
                    <COMPU-CONST><VT>FR_NOT_RECEIVED</VT></COMPU-CONST>
                  </COMPU-SCALE>
                  <COMPU-SCALE>
                    <LOWER-LIMIT INTERVAL-TYPE="CLOSED">2</LOWER-LIMIT>
                    <UPPER-LIMIT INTERVAL-TYPE="CLOSED">2</UPPER-LIMIT>
                    <COMPU-CONST><VT>FR_RECEIVED_MORE_DATA_AVAILABLE</VT></COMPU-CONST>
                  </COMPU-SCALE>
                </COMPU-SCALES>
              </COMPU-INTERNAL-TO-PHYS>
            </COMPU-METHOD>
            <COMPU-METHOD>
              <SHORT-NAME>Fr_MTSStatusType_Literals</SHORT-NAME>
              <CATEGORY>TEXTTABLE</CATEGORY>
              <COMPU-INTERNAL-TO-PHYS>
                <COMPU-SCALES>
                  <COMPU-SCALE>
                    <LOWER-LIMIT INTERVAL-TYPE="CLOSED">0</LOWER-LIMIT>
                    <UPPER-LIMIT INTERVAL-TYPE="CLOSED">0</UPPER-LIMIT>
                    <COMPU-CONST><VT>FR_MTS_RCV</VT></COMPU-CONST>
                  </COMPU-SCALE>
                  <COMPU-SCALE>
                    <LOWER-LIMIT INTERVAL-TYPE="CLOSED">1</LOWER-LIMIT>
                    <UPPER-LIMIT INTERVAL-TYPE="CLOSED">1</UPPER-LIMIT>
                    <COMPU-CONST><VT>FR_MTS_RCV_SYNERR</VT></COMPU-CONST>
                  </COMPU-SCALE>
                  <COMPU-SCALE>
                    <LOWER-LIMIT INTERVAL-TYPE="CLOSED">2</LOWER-LIMIT>
                    <UPPER-LIMIT INTERVAL-TYPE="CLOSED">2</UPPER-LIMIT>
                    <COMPU-CONST><VT>FR_MTS_RCV_BVIO</VT></COMPU-CONST>
                  </COMPU-SCALE>
                  <COMPU-SCALE>
                    <LOWER-LIMIT INTERVAL-TYPE="CLOSED">3</LOWER-LIMIT>
                    <UPPER-LIMIT INTERVAL-TYPE="CLOSED">3</UPPER-LIMIT>
                    <COMPU-CONST><VT>FR_MTS_RCV_SYNERR_BVIO</VT></COMPU-CONST>
                  </COMPU-SCALE>
                  <COMPU-SCALE>
                    <LOWER-LIMIT INTERVAL-TYPE="CLOSED">4</LOWER-LIMIT>
                    <UPPER-LIMIT INTERVAL-TYPE="CLOSED">4</UPPER-LIMIT>
                    <COMPU-CONST><VT>FR_MTS_NOT_RCV</VT></COMPU-CONST>
                  </COMPU-SCALE>
                  <COMPU-SCALE>
                    <LOWER-LIMIT INTERVAL-TYPE="CLOSED">5</LOWER-LIMIT>
                    <UPPER-LIMIT INTERVAL-TYPE="CLOSED">5</UPPER-LIMIT>
                    <COMPU-CONST><VT>FR_MTS_NOT_RCV_SYNERR</VT></COMPU-CONST>
                  </COMPU-SCALE>
                  <COMPU-SCALE>
                    <LOWER-LIMIT INTERVAL-TYPE="CLOSED">6</LOWER-LIMIT>
                    <UPPER-LIMIT INTERVAL-TYPE="CLOSED">6</UPPER-LIMIT>
                    <COMPU-CONST><VT>FR_MTS_NOT_RCV_BVIO</VT></COMPU-CONST>
                  </COMPU-SCALE>
                  <COMPU-SCALE>
                    <LOWER-LIMIT INTERVAL-TYPE="CLOSED">7</LOWER-LIMIT>
                    <UPPER-LIMIT INTERVAL-TYPE="CLOSED">7</UPPER-LIMIT>
                    <COMPU-CONST><VT>FR_MTS_NOT_RCV_SYNERR_BVIO</VT></COMPU-CONST>
                  </COMPU-SCALE>
                </COMPU-SCALES>
              </COMPU-INTERNAL-TO-PHYS>
            </COMPU-METHOD>
            <COMPU-METHOD>
              <SHORT-NAME>Fr_ChannelType_Literals</SHORT-NAME>
              <CATEGORY>TEXTTABLE</CATEGORY>
              <COMPU-INTERNAL-TO-PHYS>
                <COMPU-SCALES>
                  <COMPU-SCALE>
                    <LOWER-LIMIT INTERVAL-TYPE="CLOSED">[!"num:i($FrChannelAValue)"!]</LOWER-LIMIT>
                    <UPPER-LIMIT INTERVAL-TYPE="CLOSED">[!"num:i($FrChannelAValue)"!]</UPPER-LIMIT>
                    <COMPU-CONST><VT>FR_CHANNEL_A</VT></COMPU-CONST>
                  </COMPU-SCALE>
                  <COMPU-SCALE>
                    <LOWER-LIMIT INTERVAL-TYPE="CLOSED">[!"num:i($FrChannelAValue + 1)"!]</LOWER-LIMIT>
                    <UPPER-LIMIT INTERVAL-TYPE="CLOSED">[!"num:i($FrChannelAValue + 1)"!]</UPPER-LIMIT>
                    <COMPU-CONST><VT>FR_CHANNEL_B</VT></COMPU-CONST>
                  </COMPU-SCALE>
                  <COMPU-SCALE>
                    <LOWER-LIMIT INTERVAL-TYPE="CLOSED">[!"num:i($FrChannelAValue + 2)"!]</LOWER-LIMIT>
                    <UPPER-LIMIT INTERVAL-TYPE="CLOSED">[!"num:i($FrChannelAValue + 2)"!]</UPPER-LIMIT>
                    <COMPU-CONST><VT>FR_CHANNEL_AB</VT></COMPU-CONST>
                  </COMPU-SCALE>
                </COMPU-SCALES>
              </COMPU-INTERNAL-TO-PHYS>
            </COMPU-METHOD>
          </ELEMENTS>
        </AR-PACKAGE>
      </AR-PACKAGES>
    </AR-PACKAGE>
    <AR-PACKAGE>
      <SHORT-NAME>AUTOSAR_FrTrcv</SHORT-NAME>
      <AR-PACKAGES>
        <AR-PACKAGE>
  [!CALL "GenerateFrTrcvImplementationTypes"!]
        </AR-PACKAGE>
        <AR-PACKAGE>
          <SHORT-NAME>CompuMethods</SHORT-NAME>
          <CATEGORY>STANDARD</CATEGORY>
          <ELEMENTS>
            <COMPU-METHOD>
              <SHORT-NAME>FrTrcv_TrcvModeType_Literals</SHORT-NAME>
              <CATEGORY>TEXTTABLE</CATEGORY>
              <COMPU-INTERNAL-TO-PHYS>
                <COMPU-SCALES>
                  <COMPU-SCALE>
                    <LOWER-LIMIT INTERVAL-TYPE="CLOSED">0</LOWER-LIMIT>
                    <UPPER-LIMIT INTERVAL-TYPE="CLOSED">0</UPPER-LIMIT>
                    <COMPU-CONST><VT>FRTRCV_TRCVMODE_NORMAL</VT></COMPU-CONST>
                  </COMPU-SCALE>
                  <COMPU-SCALE>
                    <LOWER-LIMIT INTERVAL-TYPE="CLOSED">1</LOWER-LIMIT>
                    <UPPER-LIMIT INTERVAL-TYPE="CLOSED">1</UPPER-LIMIT>
                    <COMPU-CONST><VT>FRTRCV_TRCVMODE_STANDBY</VT></COMPU-CONST>
                  </COMPU-SCALE>
                  <COMPU-SCALE>
                    <LOWER-LIMIT INTERVAL-TYPE="CLOSED">2</LOWER-LIMIT>
                    <UPPER-LIMIT INTERVAL-TYPE="CLOSED">2</UPPER-LIMIT>
                    <COMPU-CONST><VT>FRTRCV_TRCVMODE_SLEEP</VT></COMPU-CONST>
                  </COMPU-SCALE>
                  <COMPU-SCALE>
                    <LOWER-LIMIT INTERVAL-TYPE="CLOSED">3</LOWER-LIMIT>
                    <UPPER-LIMIT INTERVAL-TYPE="CLOSED">3</UPPER-LIMIT>
                    <COMPU-CONST><VT>FRTRCV_TRCVMODE_RECEIVEONLY</VT></COMPU-CONST>
                  </COMPU-SCALE>
                </COMPU-SCALES>
              </COMPU-INTERNAL-TO-PHYS>
            </COMPU-METHOD>
            <COMPU-METHOD>
              <SHORT-NAME>FrTrcv_TrcvWUReasonType_Literals</SHORT-NAME>
              <CATEGORY>TEXTTABLE</CATEGORY>
              <COMPU-INTERNAL-TO-PHYS>
                <COMPU-SCALES>
                  <COMPU-SCALE>
                    <LOWER-LIMIT INTERVAL-TYPE="CLOSED">0</LOWER-LIMIT>
                    <UPPER-LIMIT INTERVAL-TYPE="CLOSED">0</UPPER-LIMIT>
                    <COMPU-CONST><VT>FRTRCV_WU_NOT_SUPPORTED</VT></COMPU-CONST>
                  </COMPU-SCALE>
                  <COMPU-SCALE>
                    <LOWER-LIMIT INTERVAL-TYPE="CLOSED">1</LOWER-LIMIT>
                    <UPPER-LIMIT INTERVAL-TYPE="CLOSED">1</UPPER-LIMIT>
                    <COMPU-CONST><VT>FRTRCV_WU_BY_BUS</VT></COMPU-CONST>
                  </COMPU-SCALE>
                  <COMPU-SCALE>
                    <LOWER-LIMIT INTERVAL-TYPE="CLOSED">2</LOWER-LIMIT>
                    <UPPER-LIMIT INTERVAL-TYPE="CLOSED">2</UPPER-LIMIT>
                    <COMPU-CONST><VT>FRTRCV_WU_BY_PIN</VT></COMPU-CONST>
                  </COMPU-SCALE>
                  <COMPU-SCALE>
                    <LOWER-LIMIT INTERVAL-TYPE="CLOSED">3</LOWER-LIMIT>
                    <UPPER-LIMIT INTERVAL-TYPE="CLOSED">3</UPPER-LIMIT>
                    <COMPU-CONST><VT>FRTRCV_WU_INTERNALLY</VT></COMPU-CONST>
                  </COMPU-SCALE>
                  <COMPU-SCALE>
                    <LOWER-LIMIT INTERVAL-TYPE="CLOSED">4</LOWER-LIMIT>
                    <UPPER-LIMIT INTERVAL-TYPE="CLOSED">4</UPPER-LIMIT>
                    <COMPU-CONST><VT>FRTRCV_WU_RESET</VT></COMPU-CONST>
                  </COMPU-SCALE>
                  <COMPU-SCALE>
                    <LOWER-LIMIT INTERVAL-TYPE="CLOSED">5</LOWER-LIMIT>
                    <UPPER-LIMIT INTERVAL-TYPE="CLOSED">5</UPPER-LIMIT>
                    <COMPU-CONST><VT>FRTRCV_WU_POWER_ON</VT></COMPU-CONST>
                  </COMPU-SCALE>
                </COMPU-SCALES>
              </COMPU-INTERNAL-TO-PHYS>
            </COMPU-METHOD>
          </ELEMENTS>
        </AR-PACKAGE>
      </AR-PACKAGES>
    </AR-PACKAGE>
[!ENDIF!]
[!IF "node:exists(as:modconf('CanTrcv')) or node:exists(as:modconf('Can')) or node:exists(as:modconf('CanIf')) or node:exists(as:modconf('CanSM'))"!]
    <AR-PACKAGE>
      <SHORT-NAME>AUTOSAR_Can</SHORT-NAME>
      <AR-PACKAGES>
        <AR-PACKAGE>
  [!CALL "GenerateCanImplementationTypes"!]
        </AR-PACKAGE>
        <AR-PACKAGE>
          <SHORT-NAME>CompuMethods</SHORT-NAME>
          <CATEGORY>STANDARD</CATEGORY>
          <ELEMENTS>
            <COMPU-METHOD>
              <SHORT-NAME>Can_StateTransitionType_Literals</SHORT-NAME>
              <CATEGORY>TEXTTABLE</CATEGORY>
              <COMPU-INTERNAL-TO-PHYS>
                <COMPU-SCALES>
                  <COMPU-SCALE>
                    <LOWER-LIMIT INTERVAL-TYPE="CLOSED">0</LOWER-LIMIT>
                    <UPPER-LIMIT INTERVAL-TYPE="CLOSED">0</UPPER-LIMIT>
                    <COMPU-CONST><VT>CAN_T_START</VT></COMPU-CONST>
                  </COMPU-SCALE>
                  <COMPU-SCALE>
                    <LOWER-LIMIT INTERVAL-TYPE="CLOSED">1</LOWER-LIMIT>
                    <UPPER-LIMIT INTERVAL-TYPE="CLOSED">1</UPPER-LIMIT>
                    <COMPU-CONST><VT>CAN_T_STOP</VT></COMPU-CONST>
                  </COMPU-SCALE>
                  <COMPU-SCALE>
                    <LOWER-LIMIT INTERVAL-TYPE="CLOSED">2</LOWER-LIMIT>
                    <UPPER-LIMIT INTERVAL-TYPE="CLOSED">2</UPPER-LIMIT>
                    <COMPU-CONST><VT>CAN_T_SLEEP</VT></COMPU-CONST>
                  </COMPU-SCALE>
                  <COMPU-SCALE>
                    <LOWER-LIMIT INTERVAL-TYPE="CLOSED">3</LOWER-LIMIT>
                    <UPPER-LIMIT INTERVAL-TYPE="CLOSED">3</UPPER-LIMIT>
                    <COMPU-CONST><VT>CAN_T_WAKEUP</VT></COMPU-CONST>
                  </COMPU-SCALE>
                </COMPU-SCALES>
              </COMPU-INTERNAL-TO-PHYS>
            </COMPU-METHOD>
            <COMPU-METHOD>
              <SHORT-NAME>Can_ReturnType_Literals</SHORT-NAME>
              <CATEGORY>TEXTTABLE</CATEGORY>
              <COMPU-INTERNAL-TO-PHYS>
                <COMPU-SCALES>
                  <COMPU-SCALE>
                    <LOWER-LIMIT INTERVAL-TYPE="CLOSED">0</LOWER-LIMIT>
                    <UPPER-LIMIT INTERVAL-TYPE="CLOSED">0</UPPER-LIMIT>
                    <COMPU-CONST><VT>CAN_OK</VT></COMPU-CONST>
                  </COMPU-SCALE>
                  <COMPU-SCALE>
                    <LOWER-LIMIT INTERVAL-TYPE="CLOSED">1</LOWER-LIMIT>
                    <UPPER-LIMIT INTERVAL-TYPE="CLOSED">1</UPPER-LIMIT>
                    <COMPU-CONST><VT>CAN_NOT_OK</VT></COMPU-CONST>
                  </COMPU-SCALE>
                   <COMPU-SCALE>
                    <LOWER-LIMIT INTERVAL-TYPE="CLOSED">2</LOWER-LIMIT>
                    <UPPER-LIMIT INTERVAL-TYPE="CLOSED">2</UPPER-LIMIT>
                    <COMPU-CONST><VT>CAN_BUSY</VT></COMPU-CONST>
                   </COMPU-SCALE>
                </COMPU-SCALES>
              </COMPU-INTERNAL-TO-PHYS>
            </COMPU-METHOD>
          </ELEMENTS>
        </AR-PACKAGE>
      </AR-PACKAGES>
    </AR-PACKAGE>
    <AR-PACKAGE>
      <SHORT-NAME>AUTOSAR_CanTrcv</SHORT-NAME>
      <AR-PACKAGES>
        <AR-PACKAGE>
  [!CALL "GenerateCanTrcvImplementationTypes"!]
        </AR-PACKAGE>
        <AR-PACKAGE>
          <SHORT-NAME>CompuMethods</SHORT-NAME>
          <CATEGORY>STANDARD</CATEGORY>
          <ELEMENTS>
            <COMPU-METHOD>
              <SHORT-NAME>CanTrcv_TrcvModeType_Literals</SHORT-NAME>
              <CATEGORY>TEXTTABLE</CATEGORY>
              <COMPU-INTERNAL-TO-PHYS>
                <COMPU-SCALES>
                  <COMPU-SCALE>
                    <LOWER-LIMIT INTERVAL-TYPE="CLOSED">0</LOWER-LIMIT>
                    <UPPER-LIMIT INTERVAL-TYPE="CLOSED">0</UPPER-LIMIT>
                    <COMPU-CONST><VT>CANTRCV_TRCVMODE_NORMAL</VT></COMPU-CONST>
                  </COMPU-SCALE>
                  <COMPU-SCALE>
                    <LOWER-LIMIT INTERVAL-TYPE="CLOSED">1</LOWER-LIMIT>
                    <UPPER-LIMIT INTERVAL-TYPE="CLOSED">1</UPPER-LIMIT>
                    <COMPU-CONST><VT>CANTRCV_TRCVMODE_SLEEP</VT></COMPU-CONST>
                  </COMPU-SCALE>
                  <COMPU-SCALE>
                    <LOWER-LIMIT INTERVAL-TYPE="CLOSED">2</LOWER-LIMIT>
                    <UPPER-LIMIT INTERVAL-TYPE="CLOSED">2</UPPER-LIMIT>
                    <COMPU-CONST><VT>CANTRCV_TRCVMODE_STANDBY</VT></COMPU-CONST>
                  </COMPU-SCALE>
                </COMPU-SCALES>
              </COMPU-INTERNAL-TO-PHYS>
            </COMPU-METHOD>
            <COMPU-METHOD>
              <SHORT-NAME>CanTrcv_TrcvWakeupReasonType_Literals</SHORT-NAME>
              <CATEGORY>TEXTTABLE</CATEGORY>
              <COMPU-INTERNAL-TO-PHYS>
                <COMPU-SCALES>
                  <COMPU-SCALE>
                    <LOWER-LIMIT INTERVAL-TYPE="CLOSED">0</LOWER-LIMIT>
                    <UPPER-LIMIT INTERVAL-TYPE="CLOSED">0</UPPER-LIMIT>
                    <COMPU-CONST><VT>CANTRCV_WU_ERROR</VT></COMPU-CONST>
                  </COMPU-SCALE>
                  <COMPU-SCALE>
                    <LOWER-LIMIT INTERVAL-TYPE="CLOSED">1</LOWER-LIMIT>
                    <UPPER-LIMIT INTERVAL-TYPE="CLOSED">1</UPPER-LIMIT>
                    <COMPU-CONST><VT>CANTRCV_WU_BY_BUS</VT></COMPU-CONST>
                  </COMPU-SCALE>
                  <COMPU-SCALE>
                    <LOWER-LIMIT INTERVAL-TYPE="CLOSED">2</LOWER-LIMIT>
                    <UPPER-LIMIT INTERVAL-TYPE="CLOSED">2</UPPER-LIMIT>
                    <COMPU-CONST><VT>CANTRCV_WU_BY_PIN</VT></COMPU-CONST>
                  </COMPU-SCALE>
                  <COMPU-SCALE>
                    <LOWER-LIMIT INTERVAL-TYPE="CLOSED">3</LOWER-LIMIT>
                    <UPPER-LIMIT INTERVAL-TYPE="CLOSED">3</UPPER-LIMIT>
                    <COMPU-CONST><VT>CANTRCV_WU_INTERNALLY</VT></COMPU-CONST>
                  </COMPU-SCALE>
                  <COMPU-SCALE>
                    <LOWER-LIMIT INTERVAL-TYPE="CLOSED">4</LOWER-LIMIT>
                    <UPPER-LIMIT INTERVAL-TYPE="CLOSED">4</UPPER-LIMIT>
                    <COMPU-CONST><VT>CANTRCV_WU_NOT_SUPPORTED</VT></COMPU-CONST>
                  </COMPU-SCALE>
                  <COMPU-SCALE>
                    <LOWER-LIMIT INTERVAL-TYPE="CLOSED">5</LOWER-LIMIT>
                    <UPPER-LIMIT INTERVAL-TYPE="CLOSED">5</UPPER-LIMIT>
                    <COMPU-CONST><VT>CANTRCV_WU_POWER_ON</VT></COMPU-CONST>
                  </COMPU-SCALE>
                  <COMPU-SCALE>
                    <LOWER-LIMIT INTERVAL-TYPE="CLOSED">6</LOWER-LIMIT>
                    <UPPER-LIMIT INTERVAL-TYPE="CLOSED">6</UPPER-LIMIT>
                    <COMPU-CONST><VT>CANTRCV_WU_RESET</VT></COMPU-CONST>
                  </COMPU-SCALE>
                  <COMPU-SCALE>
                    <LOWER-LIMIT INTERVAL-TYPE="CLOSED">7</LOWER-LIMIT>
                    <UPPER-LIMIT INTERVAL-TYPE="CLOSED">7</UPPER-LIMIT>
                    <COMPU-CONST><VT>CANTRCV_WU_BY_SYSERR</VT></COMPU-CONST>
                  </COMPU-SCALE>
                </COMPU-SCALES>
              </COMPU-INTERNAL-TO-PHYS>
            </COMPU-METHOD>
            <COMPU-METHOD>
              <SHORT-NAME>CanTrcv_TrcvWakeupModeType_Literals</SHORT-NAME>
              <CATEGORY>TEXTTABLE</CATEGORY>
              <COMPU-INTERNAL-TO-PHYS>
                <COMPU-SCALES>
                  <COMPU-SCALE>
                    <LOWER-LIMIT INTERVAL-TYPE="CLOSED">0</LOWER-LIMIT>
                    <UPPER-LIMIT INTERVAL-TYPE="CLOSED">0</UPPER-LIMIT>
                    <COMPU-CONST><VT>CANTRCV_WUMODE_CLEAR</VT></COMPU-CONST>
                  </COMPU-SCALE>
                  <COMPU-SCALE>
                    <LOWER-LIMIT INTERVAL-TYPE="CLOSED">1</LOWER-LIMIT>
                    <UPPER-LIMIT INTERVAL-TYPE="CLOSED">1</UPPER-LIMIT>
                    <COMPU-CONST><VT>CANTRCV_WUMODE_DISABLE</VT></COMPU-CONST>
                  </COMPU-SCALE>
                  <COMPU-SCALE>
                    <LOWER-LIMIT INTERVAL-TYPE="CLOSED">2</LOWER-LIMIT>
                    <UPPER-LIMIT INTERVAL-TYPE="CLOSED">2</UPPER-LIMIT>
                    <COMPU-CONST><VT>CANTRCV_WUMODE_ENABLE</VT></COMPU-CONST>
                  </COMPU-SCALE>
                </COMPU-SCALES>
              </COMPU-INTERNAL-TO-PHYS>
            </COMPU-METHOD>
            <COMPU-METHOD>
              <SHORT-NAME>CanTrcv_PNActivationType_Literals</SHORT-NAME>
              <CATEGORY>TEXTTABLE</CATEGORY>
              <COMPU-INTERNAL-TO-PHYS>
                <COMPU-SCALES>
                  <COMPU-SCALE>
                    <LOWER-LIMIT INTERVAL-TYPE="CLOSED">0</LOWER-LIMIT>
                    <UPPER-LIMIT INTERVAL-TYPE="CLOSED">0</UPPER-LIMIT>
                    <COMPU-CONST><VT>PN_ENABLED</VT></COMPU-CONST>
                  </COMPU-SCALE>
                  <COMPU-SCALE>
                    <LOWER-LIMIT INTERVAL-TYPE="CLOSED">1</LOWER-LIMIT>
                    <UPPER-LIMIT INTERVAL-TYPE="CLOSED">1</UPPER-LIMIT>
                    <COMPU-CONST><VT>PN_DISABLED</VT></COMPU-CONST>
                  </COMPU-SCALE>
                </COMPU-SCALES>
              </COMPU-INTERNAL-TO-PHYS>
            </COMPU-METHOD>
            <COMPU-METHOD>
              <SHORT-NAME>CanTrcv_TrcvFlagStateType_Literals</SHORT-NAME>
              <CATEGORY>TEXTTABLE</CATEGORY>
              <COMPU-INTERNAL-TO-PHYS>
                <COMPU-SCALES>
                  <COMPU-SCALE>
                    <LOWER-LIMIT INTERVAL-TYPE="CLOSED">0</LOWER-LIMIT>
                    <UPPER-LIMIT INTERVAL-TYPE="CLOSED">0</UPPER-LIMIT>
                    <COMPU-CONST><VT>CANTRCV_FLAG_SET</VT></COMPU-CONST>
                  </COMPU-SCALE>
                  <COMPU-SCALE>
                    <LOWER-LIMIT INTERVAL-TYPE="CLOSED">1</LOWER-LIMIT>
                    <UPPER-LIMIT INTERVAL-TYPE="CLOSED">1</UPPER-LIMIT>
                    <COMPU-CONST><VT>CANTRCV_FLAG_CLEARED</VT></COMPU-CONST>
                  </COMPU-SCALE>
                </COMPU-SCALES>
              </COMPU-INTERNAL-TO-PHYS>
            </COMPU-METHOD>
          </ELEMENTS>
        </AR-PACKAGE>
      </AR-PACKAGES>
    </AR-PACKAGE>
[!ENDIF!]
[!IF "node:exists(as:modconf('Lin')) or node:exists(as:modconf('LinIf')) or node:exists(as:modconf('LinTp')) or node:exists(as:modconf('LinTrcv')) or node:exists(as:modconf('LinSM'))"!]
    <AR-PACKAGE>
      <SHORT-NAME>AUTOSAR_Lin</SHORT-NAME>
      <AR-PACKAGES>
        <AR-PACKAGE>
  [!CALL "GenerateLinImplementationTypes"!]
        </AR-PACKAGE>
        <AR-PACKAGE>
          <SHORT-NAME>CompuMethods</SHORT-NAME>
          <CATEGORY>STANDARD</CATEGORY>
          <ELEMENTS>
            <COMPU-METHOD>
              <SHORT-NAME>Lin_FrameCsModelType_Literals</SHORT-NAME>
              <CATEGORY>TEXTTABLE</CATEGORY>
              <COMPU-INTERNAL-TO-PHYS>
                <COMPU-SCALES>
                  <COMPU-SCALE>
                    <LOWER-LIMIT INTERVAL-TYPE="CLOSED">0</LOWER-LIMIT>
                    <UPPER-LIMIT INTERVAL-TYPE="CLOSED">0</UPPER-LIMIT>
                    <COMPU-CONST><VT>LIN_ENHANCED_CS</VT></COMPU-CONST>
                  </COMPU-SCALE>
                  <COMPU-SCALE>
                    <LOWER-LIMIT INTERVAL-TYPE="CLOSED">1</LOWER-LIMIT>
                    <UPPER-LIMIT INTERVAL-TYPE="CLOSED">1</UPPER-LIMIT>
                    <COMPU-CONST><VT>LIN_CLASSIC_CS</VT></COMPU-CONST>
                  </COMPU-SCALE>
                </COMPU-SCALES>
              </COMPU-INTERNAL-TO-PHYS>
            </COMPU-METHOD>
            <COMPU-METHOD>
              <SHORT-NAME>Lin_FrameResponseType_Literals</SHORT-NAME>
              <CATEGORY>TEXTTABLE</CATEGORY>
              <COMPU-INTERNAL-TO-PHYS>
                <COMPU-SCALES>
                  <COMPU-SCALE>
                    <LOWER-LIMIT INTERVAL-TYPE="CLOSED">0</LOWER-LIMIT>
                    <UPPER-LIMIT INTERVAL-TYPE="CLOSED">0</UPPER-LIMIT>
                    <COMPU-CONST><VT>LIN_MASTER_RESPONSE</VT></COMPU-CONST>
                  </COMPU-SCALE>
                  <COMPU-SCALE>
                    <LOWER-LIMIT INTERVAL-TYPE="CLOSED">1</LOWER-LIMIT>
                    <UPPER-LIMIT INTERVAL-TYPE="CLOSED">1</UPPER-LIMIT>
                    <COMPU-CONST><VT>LIN_SLAVE_RESPONSE</VT></COMPU-CONST>
                  </COMPU-SCALE>
                  <COMPU-SCALE>
                    <LOWER-LIMIT INTERVAL-TYPE="CLOSED">2</LOWER-LIMIT>
                    <UPPER-LIMIT INTERVAL-TYPE="CLOSED">2</UPPER-LIMIT>
                    <COMPU-CONST><VT>LIN_SLAVE_TO_SLAVE</VT></COMPU-CONST>
                  </COMPU-SCALE>
                </COMPU-SCALES>
              </COMPU-INTERNAL-TO-PHYS>
            </COMPU-METHOD>
            <COMPU-METHOD>
              <SHORT-NAME>Lin_StatusType_Literals</SHORT-NAME>
              <CATEGORY>TEXTTABLE</CATEGORY>
              <COMPU-INTERNAL-TO-PHYS>
                <COMPU-SCALES>
                  <COMPU-SCALE>
                    <LOWER-LIMIT INTERVAL-TYPE="CLOSED">0</LOWER-LIMIT>
                    <UPPER-LIMIT INTERVAL-TYPE="CLOSED">0</UPPER-LIMIT>
                    <COMPU-CONST><VT>LIN_NOT_OK</VT></COMPU-CONST>
                  </COMPU-SCALE>
                  <COMPU-SCALE>
                    <LOWER-LIMIT INTERVAL-TYPE="CLOSED">1</LOWER-LIMIT>
                    <UPPER-LIMIT INTERVAL-TYPE="CLOSED">1</UPPER-LIMIT>
                    <COMPU-CONST><VT>LIN_TX_OK</VT></COMPU-CONST>
                  </COMPU-SCALE>
                  <COMPU-SCALE>
                    <LOWER-LIMIT INTERVAL-TYPE="CLOSED">2</LOWER-LIMIT>
                    <UPPER-LIMIT INTERVAL-TYPE="CLOSED">2</UPPER-LIMIT>
                    <COMPU-CONST><VT>LIN_TX_BUSY</VT></COMPU-CONST>
                  </COMPU-SCALE>
                  <COMPU-SCALE>
                    <LOWER-LIMIT INTERVAL-TYPE="CLOSED">3</LOWER-LIMIT>
                    <UPPER-LIMIT INTERVAL-TYPE="CLOSED">3</UPPER-LIMIT>
                    <COMPU-CONST><VT>LIN_TX_HEADER_ERROR</VT></COMPU-CONST>
                  </COMPU-SCALE>
                  <COMPU-SCALE>
                    <LOWER-LIMIT INTERVAL-TYPE="CLOSED">4</LOWER-LIMIT>
                    <UPPER-LIMIT INTERVAL-TYPE="CLOSED">4</UPPER-LIMIT>
                    <COMPU-CONST><VT>LIN_TX_ERROR</VT></COMPU-CONST>
                  </COMPU-SCALE>
                  <COMPU-SCALE>
                    <LOWER-LIMIT INTERVAL-TYPE="CLOSED">5</LOWER-LIMIT>
                    <UPPER-LIMIT INTERVAL-TYPE="CLOSED">5</UPPER-LIMIT>
                    <COMPU-CONST><VT>LIN_RX_OK</VT></COMPU-CONST>
                  </COMPU-SCALE>
                  <COMPU-SCALE>
                    <LOWER-LIMIT INTERVAL-TYPE="CLOSED">6</LOWER-LIMIT>
                    <UPPER-LIMIT INTERVAL-TYPE="CLOSED">6</UPPER-LIMIT>
                    <COMPU-CONST><VT>LIN_RX_BUSY</VT></COMPU-CONST>
                  </COMPU-SCALE>
                  <COMPU-SCALE>
                    <LOWER-LIMIT INTERVAL-TYPE="CLOSED">7</LOWER-LIMIT>
                    <UPPER-LIMIT INTERVAL-TYPE="CLOSED">7</UPPER-LIMIT>
                    <COMPU-CONST><VT>LIN_RX_ERROR</VT></COMPU-CONST>
                  </COMPU-SCALE>
                  <COMPU-SCALE>
                    <LOWER-LIMIT INTERVAL-TYPE="CLOSED">8</LOWER-LIMIT>
                    <UPPER-LIMIT INTERVAL-TYPE="CLOSED">8</UPPER-LIMIT>
                    <COMPU-CONST><VT>LIN_RX_NO_RESPONSE</VT></COMPU-CONST>
                  </COMPU-SCALE>
                  <COMPU-SCALE>
                    <LOWER-LIMIT INTERVAL-TYPE="CLOSED">9</LOWER-LIMIT>
                    <UPPER-LIMIT INTERVAL-TYPE="CLOSED">9</UPPER-LIMIT>
                    <COMPU-CONST><VT>LIN_OPERATIONAL</VT></COMPU-CONST>
                  </COMPU-SCALE>
                  <COMPU-SCALE>
                    <LOWER-LIMIT INTERVAL-TYPE="CLOSED">10</LOWER-LIMIT>
                    <UPPER-LIMIT INTERVAL-TYPE="CLOSED">10</UPPER-LIMIT>
                    <COMPU-CONST><VT>LIN_CH_SLEEP</VT></COMPU-CONST>
                  </COMPU-SCALE>
                </COMPU-SCALES>
              </COMPU-INTERNAL-TO-PHYS>
            </COMPU-METHOD>
          </ELEMENTS>
        </AR-PACKAGE>
      </AR-PACKAGES>
    </AR-PACKAGE>
    <AR-PACKAGE>
      <SHORT-NAME>AUTOSAR_LinTrcv</SHORT-NAME>
      <AR-PACKAGES>
        <AR-PACKAGE>
[!CALL "GenerateLinTrcvImplementationTypes"!]
        </AR-PACKAGE>
        <AR-PACKAGE>
          <SHORT-NAME>CompuMethods</SHORT-NAME>
          <CATEGORY>STANDARD</CATEGORY>
          <ELEMENTS>
            <COMPU-METHOD>
              <SHORT-NAME>LinTrcv_TrcvModeType_Literals</SHORT-NAME>
              <CATEGORY>TEXTTABLE</CATEGORY>
              <COMPU-INTERNAL-TO-PHYS>
                <COMPU-SCALES>
                  <COMPU-SCALE>
                    <LOWER-LIMIT INTERVAL-TYPE="CLOSED">0</LOWER-LIMIT>
                    <UPPER-LIMIT INTERVAL-TYPE="CLOSED">0</UPPER-LIMIT>
                    <COMPU-CONST><VT>LINTRCV_TRCV_MODE_NORMAL</VT></COMPU-CONST>
                  </COMPU-SCALE>
                  <COMPU-SCALE>
                    <LOWER-LIMIT INTERVAL-TYPE="CLOSED">1</LOWER-LIMIT>
                    <UPPER-LIMIT INTERVAL-TYPE="CLOSED">1</UPPER-LIMIT>
                    <COMPU-CONST><VT>LINTRCV_TRCV_MODE_STANDBY</VT></COMPU-CONST>
                  </COMPU-SCALE>
                  <COMPU-SCALE>
                    <LOWER-LIMIT INTERVAL-TYPE="CLOSED">2</LOWER-LIMIT>
                    <UPPER-LIMIT INTERVAL-TYPE="CLOSED">2</UPPER-LIMIT>
                    <COMPU-CONST><VT>LINTRCV_TRCV_MODE_SLEEP</VT></COMPU-CONST>
                  </COMPU-SCALE>
                </COMPU-SCALES>
              </COMPU-INTERNAL-TO-PHYS>
            </COMPU-METHOD>
            <COMPU-METHOD>
              <SHORT-NAME>LinTrcv_TrcvWakeupModeType_Literals</SHORT-NAME>
              <CATEGORY>TEXTTABLE</CATEGORY>
              <COMPU-INTERNAL-TO-PHYS>
                <COMPU-SCALES>
                  <COMPU-SCALE>
                    <LOWER-LIMIT INTERVAL-TYPE="CLOSED">0</LOWER-LIMIT>
                    <UPPER-LIMIT INTERVAL-TYPE="CLOSED">0</UPPER-LIMIT>
                    <COMPU-CONST><VT>LINTRCV_WUMODE_ENABLE</VT></COMPU-CONST>
                  </COMPU-SCALE>
                  <COMPU-SCALE>
                    <LOWER-LIMIT INTERVAL-TYPE="CLOSED">1</LOWER-LIMIT>
                    <UPPER-LIMIT INTERVAL-TYPE="CLOSED">1</UPPER-LIMIT>
                    <COMPU-CONST><VT>LINTRCV_WUMODE_DISABLE</VT></COMPU-CONST>
                  </COMPU-SCALE>
                  <COMPU-SCALE>
                    <LOWER-LIMIT INTERVAL-TYPE="CLOSED">2</LOWER-LIMIT>
                    <UPPER-LIMIT INTERVAL-TYPE="CLOSED">2</UPPER-LIMIT>
                    <COMPU-CONST><VT>LINTRCV_WUMODE_CLEAR</VT></COMPU-CONST>
                  </COMPU-SCALE>
                </COMPU-SCALES>
              </COMPU-INTERNAL-TO-PHYS>
            </COMPU-METHOD>
            <COMPU-METHOD>
              <SHORT-NAME>LinTrcv_TrcvWakeupReasonType_Literals</SHORT-NAME>
              <CATEGORY>TEXTTABLE</CATEGORY>
              <COMPU-INTERNAL-TO-PHYS>
                <COMPU-SCALES>
                  <COMPU-SCALE>
                    <LOWER-LIMIT INTERVAL-TYPE="CLOSED">0</LOWER-LIMIT>
                    <UPPER-LIMIT INTERVAL-TYPE="CLOSED">0</UPPER-LIMIT>
                    <COMPU-CONST><VT>LINTRCV_WU_ERROR</VT></COMPU-CONST>
                  </COMPU-SCALE>
                  <COMPU-SCALE>
                    <LOWER-LIMIT INTERVAL-TYPE="CLOSED">1</LOWER-LIMIT>
                    <UPPER-LIMIT INTERVAL-TYPE="CLOSED">1</UPPER-LIMIT>
                    <COMPU-CONST><VT>LINTRCV_WU_NOT_SUPPORTED</VT></COMPU-CONST>
                  </COMPU-SCALE>
                  <COMPU-SCALE>
                    <LOWER-LIMIT INTERVAL-TYPE="CLOSED">2</LOWER-LIMIT>
                    <UPPER-LIMIT INTERVAL-TYPE="CLOSED">2</UPPER-LIMIT>
                    <COMPU-CONST><VT>LINTRCV_WU_BY_BUS</VT></COMPU-CONST>
                  </COMPU-SCALE>
                  <COMPU-SCALE>
                    <LOWER-LIMIT INTERVAL-TYPE="CLOSED">3</LOWER-LIMIT>
                    <UPPER-LIMIT INTERVAL-TYPE="CLOSED">3</UPPER-LIMIT>
                    <COMPU-CONST><VT>LINTRCV_WU_BY_PIN</VT></COMPU-CONST>
                  </COMPU-SCALE>
                  <COMPU-SCALE>
                    <LOWER-LIMIT INTERVAL-TYPE="CLOSED">4</LOWER-LIMIT>
                    <UPPER-LIMIT INTERVAL-TYPE="CLOSED">4</UPPER-LIMIT>
                    <COMPU-CONST><VT>LINTRCV_WU_INTERNALLY</VT></COMPU-CONST>
                  </COMPU-SCALE>
                  <COMPU-SCALE>
                    <LOWER-LIMIT INTERVAL-TYPE="CLOSED">5</LOWER-LIMIT>
                    <UPPER-LIMIT INTERVAL-TYPE="CLOSED">5</UPPER-LIMIT>
                    <COMPU-CONST><VT>LINTRCV_WU_RESET</VT></COMPU-CONST>
                  </COMPU-SCALE>
                  <COMPU-SCALE>
                    <LOWER-LIMIT INTERVAL-TYPE="CLOSED">6</LOWER-LIMIT>
                    <UPPER-LIMIT INTERVAL-TYPE="CLOSED">6</UPPER-LIMIT>
                    <COMPU-CONST><VT>LINTRCV_WU_POWER_ON</VT></COMPU-CONST>
                  </COMPU-SCALE>
                </COMPU-SCALES>
              </COMPU-INTERNAL-TO-PHYS>
            </COMPU-METHOD>
          </ELEMENTS>
        </AR-PACKAGE>
      </AR-PACKAGES>
    </AR-PACKAGE>
[!ENDIF!]
    <AR-PACKAGE>
      <SHORT-NAME>AUTOSAR_MemMap</SHORT-NAME>
      <CATEGORY>STANDARD</CATEGORY>
      <AR-PACKAGES>
        <AR-PACKAGE>
  [!CALL "GenerateMemMapSwAddrMethods"!]
        </AR-PACKAGE>
      </AR-PACKAGES>
    </AR-PACKAGE>
    <AR-PACKAGE>
    <!-- pre AUTOSAR 3.2.2 and AUTOSAR 4.0.3 package structure -->
      <SHORT-NAME>AUTOSAR</SHORT-NAME>
      <AR-PACKAGES>
        <AR-PACKAGE>
          <SHORT-NAME>Std</SHORT-NAME>
          <AR-PACKAGES>
            <AR-PACKAGE>
  [!CALL "GenerateStdImplementationTypes"!]
            </AR-PACKAGE>
          </AR-PACKAGES>
        </AR-PACKAGE>
        <AR-PACKAGE>
          <SHORT-NAME>Platform</SHORT-NAME>
          <AR-PACKAGES>
            <AR-PACKAGE>
              <SHORT-NAME>BaseTypes</SHORT-NAME>
              <CATEGORY>STANDARD</CATEGORY>
              <ELEMENTS>
                <SW-BASE-TYPE>
                  <SHORT-NAME>void</SHORT-NAME>
                  <CATEGORY>FIXED_LENGTH</CATEGORY>
                  <BASE-TYPE-SIZE>32</BASE-TYPE-SIZE>
                  <BASE-TYPE-ENCODING>VOID</BASE-TYPE-ENCODING>
                  <NATIVE-DECLARATION>void</NATIVE-DECLARATION>
                </SW-BASE-TYPE>
              </ELEMENTS>
            </AR-PACKAGE>
            <AR-PACKAGE>
  [!CALL "GeneratePlatformImplementationTypes"!]
            </AR-PACKAGE>
          </AR-PACKAGES>
        </AR-PACKAGE>
        <AR-PACKAGE>
          <SHORT-NAME>Comtype</SHORT-NAME>
          <AR-PACKAGES>
            <AR-PACKAGE>
  [!CALL "GenerateComtypeImplementationTypes"!]
            </AR-PACKAGE>
          </AR-PACKAGES>
        </AR-PACKAGE>
[!IF "node:exists(as:modconf('Fr')) or node:exists(as:modconf('FrIf')) or node:exists(as:modconf('FrTrcv'))"!]
        <AR-PACKAGE>
          <SHORT-NAME>Fr</SHORT-NAME>
          <AR-PACKAGES>
            <AR-PACKAGE>
  [!CALL "GenerateFrImplementationTypes"!]
            </AR-PACKAGE>
          </AR-PACKAGES>
        </AR-PACKAGE>
        <AR-PACKAGE>
          <SHORT-NAME>FrTrcv</SHORT-NAME>
          <AR-PACKAGES>
            <AR-PACKAGE>
  [!CALL "GenerateFrTrcvImplementationTypes"!]
            </AR-PACKAGE>
          </AR-PACKAGES>
        </AR-PACKAGE>
[!ENDIF!]
[!IF "node:exists(as:modconf('CanTrcv')) or node:exists(as:modconf('Can')) or node:exists(as:modconf('CanIf')) or node:exists(as:modconf('CanSM'))"!]
        <AR-PACKAGE>
          <SHORT-NAME>Can</SHORT-NAME>
          <AR-PACKAGES>
            <AR-PACKAGE>
  [!CALL "GenerateCanImplementationTypes"!]
            </AR-PACKAGE>
          </AR-PACKAGES>
        </AR-PACKAGE>
        <AR-PACKAGE>
          <SHORT-NAME>CanTrcv</SHORT-NAME>
          <AR-PACKAGES>
            <AR-PACKAGE>
  [!CALL "GenerateCanTrcvImplementationTypes"!]
            </AR-PACKAGE>
          </AR-PACKAGES>
        </AR-PACKAGE>
[!ENDIF!]
[!IF "node:exists(as:modconf('Lin')) or node:exists(as:modconf('LinIf')) or node:exists(as:modconf('LinTp')) or node:exists(as:modconf('LinTrcv')) or node:exists(as:modconf('LinSM'))"!]
        <AR-PACKAGE>
          <SHORT-NAME>Lin</SHORT-NAME>
          <AR-PACKAGES>
            <AR-PACKAGE>
  [!CALL "GenerateLinImplementationTypes"!]
            </AR-PACKAGE>
          </AR-PACKAGES>
        </AR-PACKAGE>
        <AR-PACKAGE>
          <SHORT-NAME>LinTrcv</SHORT-NAME>
          <AR-PACKAGES>
            <AR-PACKAGE>
  [!CALL "GenerateLinTrcvImplementationTypes"!]
            </AR-PACKAGE>
          </AR-PACKAGES>
        </AR-PACKAGE>
[!ENDIF!]
        <AR-PACKAGE>
          <SHORT-NAME>MemMap</SHORT-NAME>
          <CATEGORY>STANDARD</CATEGORY>
          <AR-PACKAGES>
            <AR-PACKAGE>
  [!CALL "GenerateMemMapSwAddrMethods"!]
            </AR-PACKAGE>
          </AR-PACKAGES>
        </AR-PACKAGE>
      </AR-PACKAGES>
    </AR-PACKAGE>

    <AR-PACKAGE>
      <SHORT-NAME>AUTOSAR_Base</SHORT-NAME>
      <AR-PACKAGES>
        <AR-PACKAGE>
          <SHORT-NAME>BswModuleDescriptions</SHORT-NAME>
          <ELEMENTS>
            <BSW-MODULE-DESCRIPTION>
              <SHORT-NAME>Base</SHORT-NAME>
              <MODULE-ID>0</MODULE-ID>
              <PROVIDED-ENTRYS>
                <BSW-MODULE-ENTRY-REF-CONDITIONAL>
                  <BSW-MODULE-ENTRY-REF DEST="BSW-MODULE-ENTRY">/AUTOSAR_Base/BswModuleEntrys/TS_PlatformSigIsValid</BSW-MODULE-ENTRY-REF>
                </BSW-MODULE-ENTRY-REF-CONDITIONAL>
              </PROVIDED-ENTRYS>
              <INTERNAL-BEHAVIORS>
                <BSW-INTERNAL-BEHAVIOR>
                  <SHORT-NAME>InternalBehavior_0</SHORT-NAME>
                  <ENTITYS>
                    <BSW-CALLED-ENTITY>
                      <SHORT-NAME>TS_PlatformSigIsValid</SHORT-NAME>
                      <MINIMUM-START-INTERVAL>0.0</MINIMUM-START-INTERVAL>
                      <IMPLEMENTED-ENTRY-REF DEST="BSW-MODULE-ENTRY">/AUTOSAR_Base/BswModuleEntrys/TS_PlatformSigIsValid</IMPLEMENTED-ENTRY-REF>
                    </BSW-CALLED-ENTITY>
                  </ENTITYS>
                </BSW-INTERNAL-BEHAVIOR>
              </INTERNAL-BEHAVIORS>
            </BSW-MODULE-DESCRIPTION>
          </ELEMENTS>
        </AR-PACKAGE>
        <AR-PACKAGE>
          <SHORT-NAME>BswModuleEntrys</SHORT-NAME>
          <ELEMENTS>
            <BSW-MODULE-ENTRY>
              <SHORT-NAME>TS_PlatformSigIsValid</SHORT-NAME>
              <IS-REENTRANT>false</IS-REENTRANT>
              <IS-SYNCHRONOUS>true</IS-SYNCHRONOUS>
              <CALL-TYPE>REGULAR</CALL-TYPE>
              <EXECUTION-CONTEXT>TASK</EXECUTION-CONTEXT>
              <SW-SERVICE-IMPL-POLICY>STANDARD</SW-SERVICE-IMPL-POLICY>
            </BSW-MODULE-ENTRY>
          </ELEMENTS>
        </AR-PACKAGE>
      </AR-PACKAGES>
    </AR-PACKAGE>

    <AR-PACKAGE>
      <SHORT-NAME>EB_Base</SHORT-NAME>
      <AR-PACKAGES>
        <AR-PACKAGE>
          <SHORT-NAME>Implementations</SHORT-NAME>
          <ELEMENTS>
            <BSW-IMPLEMENTATION>
              <SHORT-NAME>BswImplementation_0</SHORT-NAME>
              <CODE-DESCRIPTORS>
                <CODE>
                  <SHORT-NAME>Files</SHORT-NAME>
                  <ARTIFACT-DESCRIPTORS>
                    <AUTOSAR-ENGINEERING-OBJECT>
                      <SHORT-LABEL>Autosar::include::Base.h</SHORT-LABEL>
                      <CATEGORY>SWHDR</CATEGORY>
                    </AUTOSAR-ENGINEERING-OBJECT>
                    <AUTOSAR-ENGINEERING-OBJECT>
                      <SHORT-LABEL>Autosar::include::Base_Version.h</SHORT-LABEL>
                      <CATEGORY>SWHDR</CATEGORY>
                    </AUTOSAR-ENGINEERING-OBJECT>
                    <AUTOSAR-ENGINEERING-OBJECT>
                      <SHORT-LABEL>Autosar::include::Can_GeneralTypes.h</SHORT-LABEL>
                      <CATEGORY>SWHDR</CATEGORY>
                    </AUTOSAR-ENGINEERING-OBJECT>
                    <AUTOSAR-ENGINEERING-OBJECT>
                      <SHORT-LABEL>Autosar::include::ComStackTypes.h</SHORT-LABEL>
                      <CATEGORY>SWHDR</CATEGORY>
                    </AUTOSAR-ENGINEERING-OBJECT>
                    <AUTOSAR-ENGINEERING-OBJECT>
                      <SHORT-LABEL>Autosar::include::ComStack_Helpers.h</SHORT-LABEL>
                      <CATEGORY>SWHDR</CATEGORY>
                    </AUTOSAR-ENGINEERING-OBJECT>
                    <AUTOSAR-ENGINEERING-OBJECT>
                      <SHORT-LABEL>Autosar::include::ComStack_Types.h</SHORT-LABEL>
                      <CATEGORY>SWHDR</CATEGORY>
                    </AUTOSAR-ENGINEERING-OBJECT>
                    <AUTOSAR-ENGINEERING-OBJECT>
                      <SHORT-LABEL>Autosar::include::Compiler_Common.h</SHORT-LABEL>
                      <CATEGORY>SWHDR</CATEGORY>
                    </AUTOSAR-ENGINEERING-OBJECT>
                    <AUTOSAR-ENGINEERING-OBJECT>
                      <SHORT-LABEL>Autosar::include::Eth_GeneralTypes.h</SHORT-LABEL>
                      <CATEGORY>SWHDR</CATEGORY>
                    </AUTOSAR-ENGINEERING-OBJECT>
                    <AUTOSAR-ENGINEERING-OBJECT>
                      <SHORT-LABEL>Autosar::include::Fr_GeneralTypes.h</SHORT-LABEL>
                      <CATEGORY>SWHDR</CATEGORY>
                    </AUTOSAR-ENGINEERING-OBJECT>
                    <AUTOSAR-ENGINEERING-OBJECT>
                      <SHORT-LABEL>Autosar::include::Lin_GeneralTypes.h</SHORT-LABEL>
                      <CATEGORY>SWHDR</CATEGORY>
                    </AUTOSAR-ENGINEERING-OBJECT>
                    <AUTOSAR-ENGINEERING-OBJECT>
                      <SHORT-LABEL>Autosar::include::PlatformTypes.h</SHORT-LABEL>
                      <CATEGORY>SWHDR</CATEGORY>
                    </AUTOSAR-ENGINEERING-OBJECT>
                    <AUTOSAR-ENGINEERING-OBJECT>
                      <SHORT-LABEL>Autosar::include::StandardTypes.h</SHORT-LABEL>
                      <CATEGORY>SWHDR</CATEGORY>
                    </AUTOSAR-ENGINEERING-OBJECT>
                    <AUTOSAR-ENGINEERING-OBJECT>
                      <SHORT-LABEL>Autosar::include::Std_Types.h</SHORT-LABEL>
                      <CATEGORY>SWHDR</CATEGORY>
                    </AUTOSAR-ENGINEERING-OBJECT>
                    <AUTOSAR-ENGINEERING-OBJECT>
                      <SHORT-LABEL>Autosar::include::TSAtomic_Assign.h</SHORT-LABEL>
                      <CATEGORY>SWHDR</CATEGORY>
                    </AUTOSAR-ENGINEERING-OBJECT>
                    <AUTOSAR-ENGINEERING-OBJECT>
                      <SHORT-LABEL>Autosar::include::TSAutosar.h</SHORT-LABEL>
                      <CATEGORY>SWHDR</CATEGORY>
                    </AUTOSAR-ENGINEERING-OBJECT>
                    <AUTOSAR-ENGINEERING-OBJECT>
                      <SHORT-LABEL>Autosar::include::TSCompiler_Default.h</SHORT-LABEL>
                      <CATEGORY>SWHDR</CATEGORY>
                    </AUTOSAR-ENGINEERING-OBJECT>
                    <AUTOSAR-ENGINEERING-OBJECT>
                      <SHORT-LABEL>Autosar::include::TSMem.h</SHORT-LABEL>
                      <CATEGORY>SWHDR</CATEGORY>
                    </AUTOSAR-ENGINEERING-OBJECT>
                    <AUTOSAR-ENGINEERING-OBJECT>
                      <SHORT-LABEL>Autosar::include::TSMemS.h</SHORT-LABEL>
                      <CATEGORY>SWHDR</CATEGORY>
                    </AUTOSAR-ENGINEERING-OBJECT>
                    <AUTOSAR-ENGINEERING-OBJECT>
                      <SHORT-LABEL>Autosar::include::TSPBConfig.h</SHORT-LABEL>
                      <CATEGORY>SWHDR</CATEGORY>
                    </AUTOSAR-ENGINEERING-OBJECT>
                    <AUTOSAR-ENGINEERING-OBJECT>
                      <SHORT-LABEL>Autosar::include::TSPBConfig_Access.h</SHORT-LABEL>
                      <CATEGORY>SWHDR</CATEGORY>
                    </AUTOSAR-ENGINEERING-OBJECT>
                    <AUTOSAR-ENGINEERING-OBJECT>
                      <SHORT-LABEL>Autosar::include::TSPBConfig_BasicTypes.h</SHORT-LABEL>
                      <CATEGORY>SWHDR</CATEGORY>
                    </AUTOSAR-ENGINEERING-OBJECT>
                    <AUTOSAR-ENGINEERING-OBJECT>
                      <SHORT-LABEL>Autosar::include::TSPBConfig_Init.h</SHORT-LABEL>
                      <CATEGORY>SWHDR</CATEGORY>
                    </AUTOSAR-ENGINEERING-OBJECT>
                    <AUTOSAR-ENGINEERING-OBJECT>
                      <SHORT-LABEL>Autosar::include::TSPBConfig_OffsetAlignment.h</SHORT-LABEL>
                      <CATEGORY>SWHDR</CATEGORY>
                    </AUTOSAR-ENGINEERING-OBJECT>
                    <AUTOSAR-ENGINEERING-OBJECT>
                      <SHORT-LABEL>Autosar::include::TSPBConfig_Signature.h</SHORT-LABEL>
                      <CATEGORY>SWHDR</CATEGORY>
                    </AUTOSAR-ENGINEERING-OBJECT>
                    <AUTOSAR-ENGINEERING-OBJECT>
                      <SHORT-LABEL>Autosar::include::TSPBConfig_Types.h</SHORT-LABEL>
                      <CATEGORY>SWHDR</CATEGORY>
                    </AUTOSAR-ENGINEERING-OBJECT>
                    <AUTOSAR-ENGINEERING-OBJECT>
                      <SHORT-LABEL>Autosar::include::TransformerTypes.h</SHORT-LABEL>
                      <CATEGORY>SWHDR</CATEGORY>
                    </AUTOSAR-ENGINEERING-OBJECT>
                    <AUTOSAR-ENGINEERING-OBJECT>
                      <SHORT-LABEL>Autosar::src::ComStack_Helpers.c</SHORT-LABEL>
                      <CATEGORY>SWSRC</CATEGORY>
                    </AUTOSAR-ENGINEERING-OBJECT>
                    <AUTOSAR-ENGINEERING-OBJECT>
                      <SHORT-LABEL>Autosar::src::TSMem.c</SHORT-LABEL>
                      <CATEGORY>SWSRC</CATEGORY>
                    </AUTOSAR-ENGINEERING-OBJECT>
                    <AUTOSAR-ENGINEERING-OBJECT>
                      <SHORT-LABEL>Autosar::src::TSMemS.c</SHORT-LABEL>
                      <CATEGORY>SWSRC</CATEGORY>
                    </AUTOSAR-ENGINEERING-OBJECT>
                    <AUTOSAR-ENGINEERING-OBJECT>
                      <SHORT-LABEL>Autosar::src::TSPBConfig.c</SHORT-LABEL>
                      <CATEGORY>SWSRC</CATEGORY>
                    </AUTOSAR-ENGINEERING-OBJECT>
                    <AUTOSAR-ENGINEERING-OBJECT>
                      <SHORT-LABEL>make::Base_defs.mak</SHORT-LABEL>
                      <CATEGORY>SWMAKE</CATEGORY>
                    </AUTOSAR-ENGINEERING-OBJECT>
                    <AUTOSAR-ENGINEERING-OBJECT>
                      <SHORT-LABEL>make::Base_rules.mak</SHORT-LABEL>
                      <CATEGORY>SWMAKE</CATEGORY>
                    </AUTOSAR-ENGINEERING-OBJECT>
                  </ARTIFACT-DESCRIPTORS>
                </CODE>
              </CODE-DESCRIPTORS>
              <PROGRAMMING-LANGUAGE>C</PROGRAMMING-LANGUAGE>
              <RESOURCE-CONSUMPTION>
                <SHORT-NAME>ResourceConsumption</SHORT-NAME>
                  <MEMORY-SECTIONS>
                    <MEMORY-SECTION>
                    <SHORT-NAME>CODE</SHORT-NAME>
                    <SW-ADDRMETHOD-REF DEST="SW-ADDR-METHOD">/AUTOSAR_MemMap/SwAddrMethods/CODE</SW-ADDRMETHOD-REF>
                  </MEMORY-SECTION>
                </MEMORY-SECTIONS>
              </RESOURCE-CONSUMPTION>
              <SW-VERSION>5.2.5</SW-VERSION>
              <VENDOR-ID>1</VENDOR-ID>
              <AR-RELEASE-VERSION>4.0.3</AR-RELEASE-VERSION>
              <BEHAVIOR-REF DEST="BSW-INTERNAL-BEHAVIOR">/AUTOSAR_Base/BswModuleDescriptions/Base/InternalBehavior_0</BEHAVIOR-REF>
              <VENDOR-SPECIFIC-MODULE-DEF-REFS>
                <VENDOR-SPECIFIC-MODULE-DEF-REF DEST="ECUC-MODULE-DEF">/TS_TxDxM5I2R0/Base</VENDOR-SPECIFIC-MODULE-DEF-REF>
              </VENDOR-SPECIFIC-MODULE-DEF-REFS>
            </BSW-IMPLEMENTATION>
          </ELEMENTS>
        </AR-PACKAGE>
      </AR-PACKAGES>
    </AR-PACKAGE>
  </AR-PACKAGES>
</AUTOSAR>
