AUTOSAR XML (schema 4-0-3)
package /AUTOSAR_CanTrcv/BswModuleDescriptions
  bsw module description CanTrcv: module-id=244, provided-entrys=CanTrcv_MainFunction
    bsw internal behavior InternalBehavior_0
      bsw schedulable entity CanTrcv_MainFunction: implemented-entry=CanTrcv_MainFunction
      bsw timing event TimingEvent_CanTrcv_MainFunction: starts-on-event=CanTrcv_MainFunction, period=0.02
package /AUTOSAR_CanTrcv/BswModuleEntrys
  bsw module entry CanTrcv_MainFunction: is-reentrant=false, is-synchronous=true, call-type=SCHEDULED, execution-context=TASK, sw-service-impl-policy=STANDARD
package /BSWM_CanTrcv/Implementations
  bsw implementation BswImplementation_0: programming-language=C, sw-version=1.0.0, vendor-id=1, ar-release-version=4.0.3, behavior=InternalBehavior_0
    code-descriptors:
      code Files
        artifact-descriptors:
          short-label=Autosar::include::CanTrcv.h, category=SWHDR
          short-label=Autosar::include::CanTrcv.c, category=SWSRC
    resource consumption ResourceConsumption
      memory section CODE: sw-addrmethod=CODE
