AUTOSAR XML (schema 00046)
package /TS_TxDxM2I13R0
  module config XcpRecConfigurationMaxAllConnections: definition=Xcp, implementation-config-variant=VARIANT-PRE-COMPILE
    CommonPublishedInformation:
      ArMajorVersion = 2
      ArMinorVersion = 0
      ArPatchVersion = 0
      SwMajorVersion = 2
      SwMinorVersion = 13
      SwPatchVersion = 1
      ModuleId = 212
      VendorId = 1
      Release = $3SOFT_DELIVERY_VERSION_INFORMATION$
    XcpConfig_0 (XcpConfig)
      3 x XcpEventChannel:
        XcpEventChannel_0: XcpEventChannelConsistency=DAQ, XcpEventChannelType=DAQ_STIM, XcpEventChannelMaxDaqList=1, XcpEventChannelNumber=0, XcpEventChannelPriority=10, XcpEventChannelTimeCycle=255, XcpEventChannelTimeUnit=TIMESTAMP_UNIT_1S
        XcpEventChannel_1: XcpEventChannelConsistency=EVENT, XcpEventChannelMaxDaqList=5, XcpEventChannelNumber=1, XcpEventChannelPriority=0, XcpEventChannelTimeCycle=0, XcpEventChannelType=DAQ
        XcpEventChannel_2: XcpEventChannelConsistency=DAQ, XcpEventChannelMaxDaqList=1, XcpEventChannelNumber=2, XcpEventChannelPriority=1, XcpEventChannelTimeCycle=0, XcpEventChannelType=DAQ
      9 x XcpPdu:
        XcpPdu_Rx_CAN_1
          XcpPdu_Rx_CAN_1 (XcpRxPdu): XcpRxPduId=0, XcpRxPduRef=XcpPdu_Rx_CAN_1
        XcpPdu_Rx_CAN_2
          XcpPdu_Rx_CAN_2 (XcpRxPdu): XcpRxPduId=1, XcpRxPduRef=XcpPdu_Rx_CAN_2
        XcpPdu_Rx_FLexRay_1
          XcpPdu_Rx_FlexRay_1 (XcpRxPdu): XcpRxPduId=2, XcpRxPduRef=Xcp_RxPdu_FlexRay_1
        XcpPdu_Tx_CAN_1
          XcpPdu_Tx_CAN_1 (XcpTxPdu): XcpTxPduId=0, XcpTxPduRef=Xcp_TxPdu_CAN_1
        XcpPdu_Tx_CAN_2
          XcpPdu_Tx_CAN_2 (XcpTxPdu): XcpTxPduId=1, XcpTxPduRef=Xcp_TxPdu_CAN_2
        XcpPdu_Tx_FlexRay_1
          XcpPdu_Tx_FlexRay_1 (XcpTxPdu): XcpTxPduId=2, XcpTxPduRef=Xcp_TxPdu_FlexRay_1
        XcpPdu_Tx_FlexRay_2
          XcpPdu_Tx_FlexRay_2 (XcpTxPdu): XcpTxPduId=3, XcpTxPduRef=Xcp_TxPdu_FlexRay_2
        XcpPdu_Tx_Ethernet_1
          XcpPdu_Tx_Ethernet_1 (XcpTxPdu): XcpTxPduId=4, XcpTxPduRef=XcpPdu_Tx_Ethernet_1
        XcpPdu_Rx_Ethernet_1
          XcpPdu_Rx_Ethernet_1 (XcpRxPdu): XcpRxPduId=3, XcpRxPduRef=XcpPdu_Rx_Ethernet_1
      4 x XcpConnectionCfg:
        XcpConnectionCfg_0: XcpConnectionId=0
          XcpConnectionInterfaceType
            XcpConnectionInterfaceType (XcpConnectionOverCAN): XcpCtoSlavePduRef=XcpRxPduConnectionInfo_0, XcpConnectionCanIfCfgRef=CanIfInitCfg_0, XcpBroadcastPduRef=XcpRxPduConnectionInfo_1
          XcpTxPduConnectionInfo_0 (XcpTxPduConnectionInfo):
            XcpPduSupportForResErrCtoType = 1
            XcpPduSupportForEvServCtoType = 1
            XcpPduSupportForDaqDtoType = 1
            XcpPduSupportTxFromTxConfirmation = 1
            XcpMapTxPdu2Connection = XcpPdu_Tx_CAN_1
          XcpRxPduConnectionInfo_0 (XcpRxPduConnectionInfo):
            XcpRxLowerLayerHandleId = 0
            XcpPduSupportForCmdCtoType = 1
            XcpPduSupportForStimDtoType = 1
            XcpPduSupportRxFromRxIndication = 1
            XcpMapRxPdu2Connection = XcpPdu_Rx_CAN_1
        XcpConnectionCfg_1: XcpConnectionId=1
          XcpConnectionInterfaceType
            XcpConnectionInterfaceType (XcpConnectionOverFlexRay):
              XcpFlxNodeAddress = 0
              XcpFlxHeaderAlignment = PACKET_ALIGNMENT_8
              XcpPackMultiMsgInOneFlexRayFrame = 1
              XcpMaxFlexMsgLengthInit = 254
              XcpConnectionFrIfCfgRef = FrIfConfig_0
          XcpTxPduConnectionInfo_0 (XcpTxPduConnectionInfo):
            XcpPduSupportForResErrCtoType = 1
            XcpPduSupportForEvServCtoType = 1
            XcpPduSupportForDaqDtoType = 1
            XcpPduSupportTxFromTxConfirmation = 1
            XcpMapTxPdu2Connection = XcpPdu_Tx_FlexRay_1
          XcpTxPduConnectionInfo_1 (XcpTxPduConnectionInfo):
            XcpPduSupportForResErrCtoType = 0
            XcpPduSupportForEvServCtoType = 1
            XcpPduSupportForDaqDtoType = 1
            XcpPduSupportTxFromTxConfirmation = 1
            XcpMapTxPdu2Connection = XcpPdu_Tx_FlexRay_2
          XcpRxPduConnectionInfo_0 (XcpRxPduConnectionInfo):
            XcpRxLowerLayerHandleId = 0
            XcpPduSupportForCmdCtoType = 1
            XcpPduSupportForStimDtoType = 1
            XcpPduSupportRxFromRxIndication = 1
            XcpMapRxPdu2Connection = XcpPdu_Rx_FlexRay_1
        XcpConnectionCfg_2: XcpConnectionId=2
          XcpConnectionInterfaceType
            XcpConnectionInterfaceType (XcpConnectionOverEthernet): XcpAutoOpenSoCon=1, XcpPackMultiMsgInOneEthernetFrame=1, XcpMaxEthernetMsgLengthInit=72, XcpConnectionSoAdConfigRef=SoAdConfig_0
          XcpTxPduConnectionInfo_0 (XcpTxPduConnectionInfo):
            XcpPduSupportForResErrCtoType = 1
            XcpPduSupportForEvServCtoType = 1
            XcpPduSupportForDaqDtoType = 1
            XcpPduSupportTxFromTxConfirmation = 1
            XcpMapTxPdu2Connection = XcpPdu_Tx_Ethernet_1
          XcpRxPduConnectionInfo_0 (XcpRxPduConnectionInfo):
            XcpRxLowerLayerHandleId = 0
            XcpPduSupportForCmdCtoType = 1
            XcpPduSupportForStimDtoType = 1
            XcpPduSupportRxFromRxIndication = 1
            XcpMapRxPdu2Connection = XcpPdu_Rx_Ethernet_1
        XcpConnectionCfg_3: XcpConnectionId=3
          XcpConnectionInterfaceType
            XcpConnectionInterfaceType (XcpConnectionOverCANFD):
              XcpCanFdMaxDlcRequired = 1
              XcpCanFdMaxDlc = 64
              XcpCanFdFillValue = 255
              XcpCanFdCtoSlavePduRef = XcpRxPduConnectionInfo_0
              XcpCanFdBroadcastPduRef = XcpRxPduConnectionInfo_0
              XcpConnectionCanFdCanIfCfgRef = CanIfInitCfg_0
          XcpTxPduConnectionInfo_0 (XcpTxPduConnectionInfo):
            XcpPduSupportForResErrCtoType = 1
            XcpPduSupportForEvServCtoType = 1
            XcpPduSupportForDaqDtoType = 1
            XcpPduSupportTxFromTxConfirmation = 1
            XcpMapTxPdu2Connection = XcpPdu_Tx_CAN_2
          XcpRxPduConnectionInfo_0 (XcpRxPduConnectionInfo):
            XcpRxLowerLayerHandleId = 1
            XcpPduSupportForCmdCtoType = 1
            XcpPduSupportForStimDtoType = 1
            XcpPduSupportRxFromRxIndication = 1
            XcpMapRxPdu2Connection = XcpPdu_Rx_CAN_2
      XcpMemoryAccessArea: XcpMemoryAccessAreasSupport=0
    XcpGeneral:
      XcpOnCanFDEnabled = 1
      XcpCalPagSupported = 1
      XcpDaqSupported = 1
      XcpStimSupported = 1
      XcpSlaveBlockModeSupported = 1
      XcpAddressGranularity = BYTE
      XcpGranularityOdtEntrySizeDaq = BYTE
      XcpGranularityOdtEntrySizeStim = BYTE
      XcpMasterBlockModeSupported = 1
      XcpMinST = 255
      XcpTimestampType = FOUR_BYTE
      XcpDaqConfigType = DAQ_DYNAMIC
      XcpOdtEntriesCount = 3
      XcpDaqCount = 10
      XcpPrescalerSupported = 1
      XcpOdtEntrySizeDaq = 2
      XcpOdtEntrySizeStim = 2
      XcpOdtCount = 5
      XcpIdentificationFieldType = RELATIVE_BYTE
      XcpTxRetryCount = 255
      XcpTimestampFixed = 1
      XcpTxBusRetry = 0
      XcpGetIdType1Callout = 0
      XcpDevErrorDetect = 1
      XcpMainFunctionPeriod = 0.001
      XcpMaxCto = 8
      XcpMaxDto = 8
      XcpMinDaq = 0
      XcpOnCanEnabled = 1
      XcpOnCddEnabled = 0
      XcpOnEthernetEnabled = 1
      XcpOnFlexRayEnabled = 1
      XcpVersionInfoApi = 1
      XcpUserHeader = 
      XcpSeedAndKeyEnabled = 1
      XcpEventPacketEnabled = 1
      XcpTimestampUnit = TIMESTAMP_UNIT_1MS
      XcpTimestampTicks = 1000
      XcpUserTimestampSupported = 1
      XcpStoreDaqSupported = 1
      XcpWriteDaqMultipleSupported = 0
      XcpBuildChecksumSupport = 1
      XcpBuildChecksumType = XCP_CRC_16_CITT
      XcpCalPagStoreSupported = 1
      XcpBuildChecksumMainFunctionSupport = 0
      XcpAddressTranslationSupport = 1
      XcpSuppressTxSupport = 0
      XcpMaxBS = 43
      XcpDynamicAreaSize = 2048
      XcpModifyBitsSupported = 1
      XcpEventTriggerMainFunc = 1
      XcpProcessMultiEventMainFunc = 1
      XcpDynamicMirrorAreaSize = 1024
      XcpPgmSupported = 0
      XcpTxBusTimeout = 2.0
      XcpBlockWriteReadMemoryRAMMechanism = 0
      XcpEnableXcpControlApi = 1
      XcpDefaultXcpModuleState = 1
      XcpSupportForOverloadMSB = 0
      XcpSupportForGetDaqId = 0
      XcpSupportForFlxTPCommands = 0
      XcpSupportDynamicComChannels = 0
      XcpSupportForPDURoutingTable = 0
      XcpServiceWrapper = 0
      XcpStoreDaqNvMBlock = NvMBlockDescriptor_0
    ReportToDem:
      XcpRetryFailedReportToDem = DET
      XcpRetryFailedDemDetErrorId = 30
      XcpIllegalMemoryAccessReportToDem = DISABLE
      XcpPduBufferLockedReportToDem = DISABLE
      XcpRespCTOQueueFullReportToDem = DISABLE
      XcpPDUBufferFullReportToDem = DISABLE
      XcpPDULostReportToDem = DISABLE
      XcpStimulationDataLostReportToDem = DISABLE
    XcpDefensiveProgramming:
      XcpDefProgEnabled = 0
      XcpPrecondAssertEnabled = 0
      XcpPostcondAssertEnabled = 0
      XcpStaticAssertEnabled = 0
      XcpUnreachAssertEnabled = 0
      XcpInvariantAssertEnabled = 0
