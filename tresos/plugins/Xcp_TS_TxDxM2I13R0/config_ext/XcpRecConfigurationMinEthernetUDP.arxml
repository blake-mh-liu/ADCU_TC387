AUTOSAR XML (schema 00046)
package /TS_TxDxM2I13R0
  module config XcpRecConfigurationMinEthernetUDP: definition=Xcp, implementation-config-variant=VARIANT-PRE-COMPILE
    CommonPublishedInformation: ArMajorVersion=2, ArMinorVersion=0, ArPatchVersion=0, SwMajorVersion=2, SwMinorVersion=13, SwPatchVersion=1, ModuleId=212, VendorId=1, Release=
    PublishedInformation: PbcfgMSupport=0
    XcpConfig_0 (XcpConfig)
      4 x XcpDaqList, all with XcpDaqEventFixed=0, XcpDaqListPriority=0, XcpDaqListPrescaler=1:
        XcpDaqList_0: XcpDaqListNumber=0, XcpDaqListType=DAQ
        XcpDaqList_1: XcpDaqListNumber=1, XcpDaqListType=DAQ_STIM
        XcpDaqList_2: XcpDaqListNumber=2, XcpDaqListType=STIM
        XcpDaqList_3: XcpDaqListNumber=3, XcpDaqListType=DAQ
      XcpEventChannel_0 (XcpEventChannel):
        XcpEventChannelConsistency = ODT
        XcpEventChannelMaxDaqList = 1
        XcpEventChannelNumber = 0
        XcpEventChannelPriority = 0
        XcpEventChannelTimeCycle = 1
        XcpEventChannelTimeUnit = TIMESTAMP_UNIT_1S
        XcpEventChannelType = DAQ_STIM
      XcpPdu_Rx (XcpPdu)
        XcpPdu_Rx (XcpRxPdu): XcpRxPduId=0, XcpRxPduRef=Pdu_Xcp_Rx
      XcpPdu_Tx (XcpPdu)
        XcpPdu_Tx (XcpTxPdu): XcpTxPduId=0, XcpTxPduRef=Pdu_Xcp_Tx
      XcpConnectionCfg_0 (XcpConnectionCfg): XcpConnectionId=0
        XcpConnectionInterfaceType
          XcpConnectionInterfaceType (XcpConnectionOverEthernet): XcpPackMultiMsgInOneEthernetFrame=0, XcpAutoOpenSoCon=1, XcpConnectionSoAdConfigRef=SoAdConfig_0
        XcpTxPduConnectionInfo_0 (XcpTxPduConnectionInfo): XcpPduSupportForResErrCtoType=1, XcpPduSupportForDaqDtoType=1, XcpPduSupportTxFromTxConfirmation=1, XcpMapTxPdu2Connection=XcpPdu_Tx
        XcpRxPduConnectionInfo_0 (XcpRxPduConnectionInfo):
          XcpRxLowerLayerHandleId = 0
          XcpPduSupportForCmdCtoType = 1
          XcpPduSupportForStimDtoType = 1
          XcpPduSupportRxFromRxIndication = 1
          XcpMapRxPdu2Connection = XcpPdu_Rx
      XcpMemoryAccessArea: XcpMemoryAccessAreasSupport=0
    XcpGeneral:
      XcpOnCanFDEnabled = 0
      XcpCalPagSupported = 0
      XcpDaqSupported = 1
      XcpStimSupported = 1
      XcpSlaveBlockModeSupported = 1
      XcpAddressGranularity = BYTE
      XcpMasterBlockModeSupported = 1
      XcpMaxBS = 43
      XcpMinST = 200
      XcpTimestampType = NO_TIME_STAMP
      XcpDaqConfigType = DAQ_DYNAMIC
      XcpPrescalerSupported = 0
      XcpOdtEntrySizeDaq = 1
      XcpOdtEntrySizeStim = 1
      XcpOdtCount = 1
      XcpIdentificationFieldType = ABSOLUTE
      XcpTxRetryCount = 0
      XcpTxBusRetry = 0
      XcpGetIdType1Callout = 0
      XcpDaqCount = 4
      XcpDevErrorDetect = 0
      XcpMainFunctionPeriod = 0.02
      XcpMaxCto = 8
      XcpMaxDto = 8
      XcpMinDaq = 4
      XcpOnCanEnabled = 0
      XcpOnCddEnabled = 0
      XcpOnEthernetEnabled = 1
      XcpOnFlexRayEnabled = 0
      XcpVersionInfoApi = 0
      XcpUserHeader = 
      XcpSeedAndKeyEnabled = 0
      XcpOdtEntriesCount = 1
      XcpSuppressTxSupport = 0
      XcpEventPacketEnabled = 0
      XcpWriteDaqMultipleSupported = 0
      XcpBuildChecksumSupport = 0
      XcpAddressTranslationSupport = 0
      XcpModifyBitsSupported = 0
      XcpEventTriggerMainFunc = 0
      XcpProcessMultiEventMainFunc = 0
      XcpDynamicAreaSize = 1024
      XcpDynamicMirrorAreaSize = 1024
      XcpPgmSupported = 0
      XcpTxBusTimeout = 2.0
      XcpBlockWriteReadMemoryRAMMechanism = 0
      XcpEnableXcpControlApi = 1
      XcpDefaultXcpModuleState = 1
      XcpSupportForOverloadMSB = 0
      XcpSupportDynamicComChannels = 0
      XcpSupportForPDURoutingTable = 0
      XcpServiceWrapper = 0
    ReportToDem:
      XcpRetryFailedReportToDem = DISABLE
      XcpIllegalMemoryAccessReportToDem = DISABLE
      XcpPduBufferLockedReportToDem = DISABLE
      XcpRespCTOQueueFullReportToDem = DISABLE
      XcpPDUBufferFullReportToDem = DISABLE
      XcpPDULostReportToDem = DISABLE
      XcpStimulationDataLostReportToDem = DISABLE
    XcpDefensiveProgramming:
      XcpDefProgEnabled = 0
      XcpPrecondAssertEnabled = 0
      XcpPostcondAssertEnabled = 0
      XcpStaticAssertEnabled = 0
      XcpUnreachAssertEnabled = 0
      XcpInvariantAssertEnabled = 0
