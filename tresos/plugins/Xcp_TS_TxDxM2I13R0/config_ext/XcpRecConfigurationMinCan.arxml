AUTOSAR XML (schema 00046)
package /TS_TxDxM2I13R0
  module config XcpRecConfigurationMinCan: definition=Xcp, implementation-config-variant=VARIANT-PRE-COMPILE
    CommonPublishedInformation: ArMajorVersion=2, ArMinorVersion=0, ArPatchVersion=0, SwMajorVersion=2, SwMinorVersion=13, SwPatchVersion=1, ModuleId=212, VendorId=1, Release=
    PublishedInformation: PbcfgMSupport=0
    XcpConfig_0 (XcpConfig)
      XcpEventChannel_0 (XcpEventChannel):
        XcpEventChannelConsistency = ODT
        XcpEventChannelMaxDaqList = 1
        XcpEventChannelNumber = 0
        XcpEventChannelPriority = 0
        XcpEventChannelTimeCycle = 1
        XcpEventChannelTimeUnit = TIMESTAMP_UNIT_100MS
        XcpEventChannelType = DAQ_STIM
      3 x XcpPdu:
        XcpPdu_Rx
          XcpPdu_Rx (XcpRxPdu): XcpRxPduId=0, XcpRxPduRef=XcpPdu_Rx
        XcpPdu_Tx
          XcpPdu_Tx (XcpTxPdu): XcpTxPduId=0, XcpTxPduRef=XcpPdu_Tx
        XcpPdu_RxBroadcast
          XcpPdu_RxBroadcast (XcpRxPdu): XcpRxPduId=1, XcpRxPduRef=XcpPdu_RxBroadcast
      XcpConnectionCfg_0 (XcpConnectionCfg): XcpConnectionId=0
        XcpConnectionInterfaceType
          XcpConnectionInterfaceType (XcpConnectionOverCAN): XcpCtoSlavePduRef=XcpRxPduConnectionInfo_0, XcpConnectionCanIfCfgRef=CanIfInitCfg, XcpBroadcastPduRef=XcpRxPduConnectionInfo_1
        XcpTxPduConnectionInfo_0 (XcpTxPduConnectionInfo):
          XcpPduSupportForResErrCtoType = 1
          XcpPduSupportForEvServCtoType = 1
          XcpPduSupportForDaqDtoType = 1
          XcpPduSupportTxFromTxConfirmation = 1
          XcpMapTxPdu2Connection = XcpPdu_Tx
        XcpRxPduConnectionInfo_0 (XcpRxPduConnectionInfo):
          XcpRxLowerLayerHandleId = 0
          XcpPduSupportForCmdCtoType = 1
          XcpPduSupportForStimDtoType = 1
          XcpPduSupportRxFromRxIndication = 0
          XcpMapRxPdu2Connection = XcpPdu_Rx
        XcpRxPduConnectionInfo_1 (XcpRxPduConnectionInfo):
          XcpRxLowerLayerHandleId = 0
          XcpPduSupportForCmdCtoType = 1
          XcpPduSupportForStimDtoType = 0
          XcpPduSupportRxFromRxIndication = 0
          XcpMapRxPdu2Connection = XcpPdu_RxBroadcast
      XcpMemoryAccessArea: XcpMemoryAccessAreasSupport=0
    XcpGeneral:
      XcpOnCanFDEnabled = 0
      XcpCalPagSupported = 0
      XcpDaqSupported = 1
      XcpStimSupported = 1
      XcpSlaveBlockModeSupported = 1
      XcpAddressGranularity = BYTE
      XcpGranularityOdtEntrySizeDaq = BYTE
      XcpGranularityOdtEntrySizeStim = BYTE
      XcpMasterBlockModeSupported = 1
      XcpMaxBS = 43
      XcpMinST = 200
      XcpTimestampType = NO_TIME_STAMP
      XcpDaqConfigType = DAQ_DYNAMIC
      XcpPrescalerSupported = 0
      XcpStoreDaqSupported = 0
      XcpOdtEntrySizeDaq = 1
      XcpOdtEntrySizeStim = 1
      XcpOdtCount = 4
      XcpIdentificationFieldType = ABSOLUTE
      XcpTxRetryCount = 0
      XcpTxBusRetry = 0
      XcpGetIdType1Callout = 0
      XcpDaqCount = 2
      XcpDevErrorDetect = 0
      XcpMainFunctionPeriod = 0.02
      XcpMaxCto = 8
      XcpMaxDto = 8
      XcpMinDaq = 0
      XcpOnCanEnabled = 1
      XcpOnCddEnabled = 0
      XcpOnEthernetEnabled = 0
      XcpOnFlexRayEnabled = 0
      XcpVersionInfoApi = 0
      XcpUserHeader = 
      XcpSeedAndKeyEnabled = 0
      XcpOdtEntriesCount = 7
      XcpSuppressTxSupport = 0
      XcpEventPacketEnabled = 1
      XcpWriteDaqMultipleSupported = 0
      XcpBuildChecksumSupport = 1
      XcpBuildChecksumType = XCP_CRC_16_CITT
      XcpBuildChecksumMainFunctionSupport = 0
      XcpAddressTranslationSupport = 0
      XcpModifyBitsSupported = 0
      XcpMaxCtoPgm = 8
      XcpEventTriggerMainFunc = 0
      XcpProcessMultiEventMainFunc = 0
      XcpDynamicAreaSize = 1024
      XcpDynamicMirrorAreaSize = 1024
      XcpPgmSupported = 1
      XcpMasterBlockModePgmSupported = 1
      XcpMaxBSPgm = 43
      XcpMinSTPgm = 200
      XcpTxBusTimeout = 2.0
      XcpBlockWriteReadMemoryRAMMechanism = 0
      XcpEnableXcpControlApi = 1
      XcpDefaultXcpModuleState = 1
      XcpSupportForOverloadMSB = 0
      XcpSupportForGetDaqId = 0
      XcpSupportDynamicComChannels = 0
      XcpSupportForPDURoutingTable = 0
      XcpServiceWrapper = 0
    ReportToDem:
      XcpRetryFailedReportToDem = DISABLE
      XcpIllegalMemoryAccessReportToDem = DISABLE
      XcpPduBufferLockedReportToDem = DISABLE
      XcpRespCTOQueueFullReportToDem = DISABLE
      XcpPDUBufferFullReportToDem = DISABLE
      XcpPDULostReportToDem = DISABLE
      XcpStimulationDataLostReportToDem = DISABLE
    XcpDefensiveProgramming:
      XcpDefProgEnabled = 0
      XcpPrecondAssertEnabled = 0
      XcpPostcondAssertEnabled = 0
      XcpStaticAssertEnabled = 0
      XcpUnreachAssertEnabled = 0
      XcpInvariantAssertEnabled = 0
