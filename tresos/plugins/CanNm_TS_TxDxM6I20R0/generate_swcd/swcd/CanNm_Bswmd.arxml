<?xml version="1.0" encoding="ISO-8859-1"?>
[!INCLUDE "CanNm_Macros.m"!][!//
[!IF "not(node:exists(as:modconf('CanNm')[1]/CanNmGlobalConfig/eb-list::*[1]))"!][!//
[!ERROR "No CanNm configuration exist"!][!//
[!ENDIF!][!//
[!VAR "VAR_CANNM_NUMBER_OF_CHANNELS"="num:i(count(CanNmGlobalConfig/eb-list::*[1]/CanNmChannelConfig/eb-list::*))"!][!//
[!AUTOSPACING!][!//
<!-- !LINKSTO CanNm.EB.BSWMDGeneration.3,1 -->
<AUTOSAR xmlns="http://autosar.org/schema/r4.0"
  xmlns:xsi="http://www.w3.org/2001/XMLSchema-instance"
  xsi:schemaLocation="http://autosar.org/schema/r4.0 AUTOSAR_4-2-1.xsd">
[!CALL "GetMulticorePerChannelSupport"!][!//
[!CALL "GetSynchronizedPncShutdownEnabled"!][!//
[!IF "$MulticorePerChannelSupport = 'true'"!][!//
[!VAR "bswModuleEntryPackageName" = "'BswModuleEntrys'"!][!//
  <AR-PACKAGES>
    <AR-PACKAGE>
      <SHORT-NAME>AUTOSAR_CanNm</SHORT-NAME>
      <AR-PACKAGES>
        <AR-PACKAGE>
          <SHORT-NAME>BswModuleDescriptions</SHORT-NAME>
          <ELEMENTS>
            <BSW-MODULE-DESCRIPTION>
              <SHORT-NAME>CanNm</SHORT-NAME>
              <MODULE-ID>31</MODULE-ID>
              <PROVIDED-ENTRYS>
[!IF "node:refvalid(as:modconf('ComM')[1]/ComMGeneral/ComMMasterPNCEcuCPartitionRef)"!][!//
                <BSW-MODULE-ENTRY-REF-CONDITIONAL>
                  <BSW-MODULE-ENTRY-REF DEST="BSW-MODULE-ENTRY">/AUTOSAR_CanNm/[!"$bswModuleEntryPackageName"!]/CanNm_MainFunction_Main</BSW-MODULE-ENTRY-REF>
                </BSW-MODULE-ENTRY-REF-CONDITIONAL>
[!ELSE!][!//
                <BSW-MODULE-ENTRY-REF-CONDITIONAL>
                  <BSW-MODULE-ENTRY-REF DEST="BSW-MODULE-ENTRY">/AUTOSAR_CanNm/[!"$bswModuleEntryPackageName"!]/CanNm_DummyMainFunction</BSW-MODULE-ENTRY-REF>
                </BSW-MODULE-ENTRY-REF-CONDITIONAL>
[!ENDIF!][!//
[!LOOP "as:modconf('CanNm')[1]/CanNmGlobalConfig/eb-list::*[1]/CanNmChannelConfig/eb-list::*"!][!//
                <BSW-MODULE-ENTRY-REF-CONDITIONAL>
                  <BSW-MODULE-ENTRY-REF DEST="BSW-MODULE-ENTRY">/AUTOSAR_CanNm/[!"$bswModuleEntryPackageName"!]/CanNm_MainFunction_[!"CanNmRxPdu/eb-list::*[1]/CanNmRxPduId"!]</BSW-MODULE-ENTRY-REF>
                </BSW-MODULE-ENTRY-REF-CONDITIONAL>
[!IF "node:refvalid(as:modconf('ComM')[1]/ComMGeneral/ComMMasterPNCEcuCPartitionRef)"!][!//
                <BSW-MODULE-ENTRY-REF-CONDITIONAL>
                  <BSW-MODULE-ENTRY-REF DEST="BSW-MODULE-ENTRY">/AUTOSAR_CanNm/[!"$bswModuleEntryPackageName"!]/CanNm_Main_RecieveFunction_[!"CanNmRxPdu/eb-list::*[1]/CanNmRxPduId"!]</BSW-MODULE-ENTRY-REF>
                </BSW-MODULE-ENTRY-REF-CONDITIONAL>
                <BSW-MODULE-ENTRY-REF-CONDITIONAL>
                  <BSW-MODULE-ENTRY-REF DEST="BSW-MODULE-ENTRY">/AUTOSAR_CanNm/[!"$bswModuleEntryPackageName"!]/CanNm_Channel_SendFunction_[!"CanNmRxPdu/eb-list::*[1]/CanNmRxPduId"!]</BSW-MODULE-ENTRY-REF>
                </BSW-MODULE-ENTRY-REF-CONDITIONAL>
[!ENDIF!][!//
[!ENDLOOP!][!//
              </PROVIDED-ENTRYS>

              <PROVIDED-DATAS>
[!LOOP "as:modconf('CanNm')[1]/CanNmGlobalConfig/eb-list::*[1]/CanNmChannelConfig/eb-list::*"!][!//
                <VARIABLE-DATA-PROTOTYPE>
                  <SHORT-NAME>Channel_DataSet_[!"CanNmRxPdu/eb-list::*[1]/CanNmRxPduId"!]</SHORT-NAME>
                  <TYPE-TREF DEST="IMPLEMENTATION-DATA-TYPE">/AUTOSAR_CanNm/ImplementationDataTypes/PnInfoArray</TYPE-TREF>
                </VARIABLE-DATA-PROTOTYPE>
[!ENDLOOP!][!//
              </PROVIDED-DATAS>

              <REQUIRED-DATAS>
[!LOOP "as:modconf('CanNm')[1]/CanNmGlobalConfig/eb-list::*[1]/CanNmChannelConfig/eb-list::*"!][!//
                <VARIABLE-DATA-PROTOTYPE>
                  <SHORT-NAME>Main_DataGet_[!"CanNmRxPdu/eb-list::*[1]/CanNmRxPduId"!]</SHORT-NAME>
                  <TYPE-TREF DEST="IMPLEMENTATION-DATA-TYPE">/AUTOSAR_CanNm/ImplementationDataTypes/PnInfoArray</TYPE-TREF>
                </VARIABLE-DATA-PROTOTYPE>
[!ENDLOOP!][!//
              </REQUIRED-DATAS>

              <INTERNAL-BEHAVIORS>
                <BSW-INTERNAL-BEHAVIOR>
                  <SHORT-NAME>InternalBehavior_Main</SHORT-NAME>
[!IF "node:refvalid(as:modconf('ComM')[1]/ComMGeneral/ComMMasterPNCEcuCPartitionRef)"!][!//
                  <EXCLUSIVE-AREAS>
                    <EXCLUSIVE-AREA>
                      <SHORT-NAME>SCHM_CANNM_EXCLUSIVE_AREA_MAIN</SHORT-NAME>
                    </EXCLUSIVE-AREA>
                  </EXCLUSIVE-AREAS>
                  <ENTITYS>
                    <!-- !LINKSTO CanNm.EB.CanNm_MainFunction_Main.Partition,1 -->
                    <BSW-SCHEDULABLE-ENTITY>
                      <SHORT-NAME>CanNm_MainFunction_Main</SHORT-NAME>
                      <CAN-ENTER-EXCLUSIVE-AREA-REFS>
                        <CAN-ENTER-EXCLUSIVE-AREA-REF DEST="EXCLUSIVE-AREA">/AUTOSAR_CanNm/BswModuleDescriptions/CanNm/InternalBehavior_Main/SCHM_CANNM_EXCLUSIVE_AREA_MAIN</CAN-ENTER-EXCLUSIVE-AREA-REF>
                      </CAN-ENTER-EXCLUSIVE-AREA-REFS>
                      <MINIMUM-START-INTERVAL>0.0</MINIMUM-START-INTERVAL>
                      <CALL-POINTS>
                      </CALL-POINTS>
                      <IMPLEMENTED-ENTRY-REF DEST="BSW-MODULE-ENTRY">/AUTOSAR_CanNm/[!"$bswModuleEntryPackageName"!]/CanNm_MainFunction_Main</IMPLEMENTED-ENTRY-REF>
                    </BSW-SCHEDULABLE-ENTITY>
[!LOOP "as:modconf('CanNm')[1]/CanNmGlobalConfig/eb-list::*[1]/CanNmChannelConfig/eb-list::*"!][!//
                    <!-- !LINKSTO CanNm.EB.CanNmChannelMultiCore.Receiver.Partition,1 -->
                    <!-- !LINKSTO CanNm.EB.CanNmChannelMultiCore.Receiver.Schedule,1 -->
                    <BSW-SCHEDULABLE-ENTITY>
                      <SHORT-NAME>CanNm_Main_RecieveFunction_[!"CanNmRxPdu/eb-list::*[1]/CanNmRxPduId"!]</SHORT-NAME>
                      <CAN-ENTER-EXCLUSIVE-AREA-REFS>
                        <CAN-ENTER-EXCLUSIVE-AREA-REF DEST="EXCLUSIVE-AREA">/AUTOSAR_CanNm/BswModuleDescriptions/CanNm/InternalBehavior_Main/SCHM_CANNM_EXCLUSIVE_AREA_MAIN</CAN-ENTER-EXCLUSIVE-AREA-REF>
                      </CAN-ENTER-EXCLUSIVE-AREA-REFS>
                      <MINIMUM-START-INTERVAL>0.0</MINIMUM-START-INTERVAL>
                      <DATA-RECEIVE-POINTS>
                        <BSW-VARIABLE-ACCESS>
                          <SHORT-NAME>BswVariableAccess_CanNm_Main_DataGet_[!"CanNmRxPdu/eb-list::*[1]/CanNmRxPduId"!]</SHORT-NAME>
                          <ACCESSED-VARIABLE-REF DEST="VARIABLE-DATA-PROTOTYPE">/AUTOSAR_CanNm/BswModuleDescriptions/CanNm/Main_DataGet_[!"CanNmRxPdu/eb-list::*[1]/CanNmRxPduId"!]</ACCESSED-VARIABLE-REF>
                        </BSW-VARIABLE-ACCESS>
                      </DATA-RECEIVE-POINTS>
                      <IMPLEMENTED-ENTRY-REF DEST="BSW-MODULE-ENTRY">/AUTOSAR_CanNm/[!"$bswModuleEntryPackageName"!]/CanNm_Main_RecieveFunction_[!"CanNmRxPdu/eb-list::*[1]/CanNmRxPduId"!]</IMPLEMENTED-ENTRY-REF>
                    </BSW-SCHEDULABLE-ENTITY>
[!ENDLOOP!][!//
                  </ENTITYS>
                  <EVENTS>
                    <BSW-TIMING-EVENT>
                      <SHORT-NAME>TimingEvent_MainFunction_Main</SHORT-NAME>
                      <STARTS-ON-EVENT-REF DEST="BSW-SCHEDULABLE-ENTITY">/AUTOSAR_CanNm/BswModuleDescriptions/CanNm/InternalBehavior_Main/CanNm_MainFunction_Main</STARTS-ON-EVENT-REF>
                      <PERIOD>[!"as:modconf('CanNm')[1]/CanNmGlobalConfig/eb-list::*[1]/CanNmMainFunctionPeriod"!]</PERIOD>
                    </BSW-TIMING-EVENT>
[!LOOP "as:modconf('CanNm')[1]/CanNmGlobalConfig/eb-list::*[1]/CanNmChannelConfig/eb-list::*"!][!//
                    <BSW-DATA-RECEIVED-EVENT>
                      <SHORT-NAME>Main_[!"CanNmRxPdu/eb-list::*[1]/CanNmRxPduId"!]_ReceivedEvent</SHORT-NAME>
                      <STARTS-ON-EVENT-REF DEST="BSW-SCHEDULABLE-ENTITY">/AUTOSAR_CanNm/BswModuleDescriptions/CanNm/InternalBehavior_Main/CanNm_Main_RecieveFunction_[!"CanNmRxPdu/eb-list::*[1]/CanNmRxPduId"!]</STARTS-ON-EVENT-REF>
                      <DATA-REF DEST="VARIABLE-DATA-PROTOTYPE">/AUTOSAR_CanNm/BswModuleDescriptions/CanNm/Main_DataGet_[!"CanNmRxPdu/eb-list::*[1]/CanNmRxPduId"!]</DATA-REF>
                    </BSW-DATA-RECEIVED-EVENT>
[!ENDLOOP!][!//
                  </EVENTS>
                  <RECEPTION-POLICYS>
[!LOOP "as:modconf('CanNm')[1]/CanNmGlobalConfig/eb-list::*[1]/CanNmChannelConfig/eb-list::*"!][!//
                    <BSW-QUEUED-DATA-RECEPTION-POLICY>
                      <ENABLE-TAKE-ADDRESS>true</ENABLE-TAKE-ADDRESS>
                      <RECEIVED-DATA-REF DEST="VARIABLE-DATA-PROTOTYPE">/AUTOSAR_CanNm/BswModuleDescriptions/CanNm/Main_DataGet_[!"CanNmRxPdu/eb-list::*[1]/CanNmRxPduId"!]</RECEIVED-DATA-REF>
[!IF "$SynchronizedPncShutdownEnabled = 'true'"!]
                      <QUEUE-LENGTH>3</QUEUE-LENGTH>
[!ELSE!]
                      <QUEUE-LENGTH>2</QUEUE-LENGTH>
[!ENDIF!]
                    </BSW-QUEUED-DATA-RECEPTION-POLICY>
[!ENDLOOP!][!//
                  </RECEPTION-POLICYS>
[!ELSE!][!//
                  <ENTITYS>
                    <BSW-SCHEDULABLE-ENTITY>
                      <SHORT-NAME>CanNm_DummyMainFunction</SHORT-NAME>
                      <MINIMUM-START-INTERVAL>0.0</MINIMUM-START-INTERVAL>
                      <IMPLEMENTED-ENTRY-REF DEST="BSW-MODULE-ENTRY">/AUTOSAR_CanNm/[!"$bswModuleEntryPackageName"!]/CanNm_DummyMainFunction</IMPLEMENTED-ENTRY-REF>
                    </BSW-SCHEDULABLE-ENTITY>
                  </ENTITYS>
[!ENDIF!][!//
                </BSW-INTERNAL-BEHAVIOR>
[!SELECT "as:modconf('Os')[1]/OsApplication/eb-list::*/OsAppEcucPartitionRef"!][!//
[!VAR "Partition" = "node:value(.)"!][!//
[!VAR "Application" = "node:name(..)"!][!//
[!IF "node:exists(as:modconf('ComM')[1]/ComMConfigSet/eb-list::*[1]/ComMChannel/eb-list::*[($Partition = node:value(ComMChannelPartitionRef)) and (ComMBusType = 'COMM_BUS_TYPE_CAN') and ((ComMNetworkManagement/ComMNmVariant = 'FULL') or (ComMNetworkManagement/ComMNmVariant = 'PASSIVE'))])"!][!//
                <BSW-INTERNAL-BEHAVIOR>
                  <SHORT-NAME>InternalBehavior_Ch_OsApplication_[!"$Application"!]</SHORT-NAME>
                  <EXCLUSIVE-AREAS>
                    <EXCLUSIVE-AREA>
                      <SHORT-NAME>SCHM_CANNM_EXCLUSIVE_AREA_[!"$Application"!]</SHORT-NAME>
                    </EXCLUSIVE-AREA>
                  </EXCLUSIVE-AREAS>
                  <STATIC-MEMORYS>
[!SELECT "as:modconf('CanNm')[1]/CanNmGlobalConfig/eb-list::*[1]/CanNmChannelConfig/eb-list::*[$Partition = node:value(node:ref(CanNmComMNetworkHandleRef)/ComMChannelPartitionRef)]"!][!//
[!VAR "Channel_Idx" = "CanNmRxPdu/eb-list::*[1]/CanNmRxPduId"!][!//
                    <VARIABLE-DATA-PROTOTYPE>
                      <SHORT-NAME>CanNm_HsmInstCanNm_StateId_[!"$Channel_Idx"!]</SHORT-NAME>
                        <ADMIN-DATA>
                          <SDGS>
                            <SDG GID="EB:DnT">
                              <SD GID="StateGroup">CanNm_HsmInstCanNm_StateId</SD>
                              <SD GID="StateId">[!"$Channel_Idx"!]</SD>
                              <SD GID="EnableTracing">true</SD>
                            </SDG>
                          </SDGS>
                        </ADMIN-DATA>
                      <SW-DATA-DEF-PROPS>
                        <SW-DATA-DEF-PROPS-VARIANTS>
                          <SW-DATA-DEF-PROPS-CONDITIONAL>
                            <SW-IMPL-POLICY>STANDARD</SW-IMPL-POLICY>
                          </SW-DATA-DEF-PROPS-CONDITIONAL>
                        </SW-DATA-DEF-PROPS-VARIANTS>
                      </SW-DATA-DEF-PROPS>
                      <TYPE-TREF DEST="IMPLEMENTATION-DATA-TYPE">/AUTOSAR_CanNm/ImplementationDataTypes/CanNm_HsmStateIdxType</TYPE-TREF>
                    </VARIABLE-DATA-PROTOTYPE>
[!ENDSELECT!][!//
                  </STATIC-MEMORYS>
                  <ENTITYS>
[!SELECT "as:modconf('CanNm')[1]/CanNmGlobalConfig/eb-list::*[1]/CanNmChannelConfig/eb-list::*[$Partition = node:value(node:ref(CanNmComMNetworkHandleRef)/ComMChannelPartitionRef)]"!][!//
[!VAR "Channel_Idx" = "CanNmRxPdu/eb-list::*[1]/CanNmRxPduId"!][!//
                    <!-- !LINKSTO CanNm.EB.CanNm_MainFunction_X.Partition,1 -->
                    <BSW-SCHEDULABLE-ENTITY>
                      <SHORT-NAME>CanNm_MainFunction_[!"$Channel_Idx"!]</SHORT-NAME>
                      <CAN-ENTER-EXCLUSIVE-AREA-REFS>
                        <CAN-ENTER-EXCLUSIVE-AREA-REF DEST="EXCLUSIVE-AREA">/AUTOSAR_CanNm/BswModuleDescriptions/CanNm/InternalBehavior_Ch_OsApplication_[!"$Application"!]/SCHM_CANNM_EXCLUSIVE_AREA_[!"$Application"!]</CAN-ENTER-EXCLUSIVE-AREA-REF>
                      </CAN-ENTER-EXCLUSIVE-AREA-REFS>
                      <MINIMUM-START-INTERVAL>0.0</MINIMUM-START-INTERVAL>
                      <CALL-POINTS>
                      </CALL-POINTS>
                      <IMPLEMENTED-ENTRY-REF DEST="BSW-MODULE-ENTRY">/AUTOSAR_CanNm/[!"$bswModuleEntryPackageName"!]/CanNm_MainFunction_[!"$Channel_Idx"!]</IMPLEMENTED-ENTRY-REF>
                    </BSW-SCHEDULABLE-ENTITY>
[!IF "node:refvalid(as:modconf('ComM')[1]/ComMGeneral/ComMMasterPNCEcuCPartitionRef)"!][!//
                    <!-- !LINKSTO CanNm.EB.CanNmChannelMultiCore.Sender,1 -->
                    <!-- !LINKSTO CanNm.EB.CanNmChannelMultiCore.Sender.Partition,1 -->
                    <!-- !LINKSTO CanNm.EB.CanNmChannelMultiCore.Sender.Rx,1 -->
                    <BSW-CALLED-ENTITY>
                      <SHORT-NAME>BswCalledEntity_Channel_DataSet_[!"$Channel_Idx"!]</SHORT-NAME>
                      <MINIMUM-START-INTERVAL>0.0</MINIMUM-START-INTERVAL>
                      <DATA-SEND-POINTS>
                        <BSW-VARIABLE-ACCESS>
                          <SHORT-NAME>BswVariableAccess_Channel_DataSet_[!"$Channel_Idx"!]</SHORT-NAME>
                          <ACCESSED-VARIABLE-REF DEST="VARIABLE-DATA-PROTOTYPE">/AUTOSAR_CanNm/BswModuleDescriptions/CanNm/Channel_DataSet_[!"$Channel_Idx"!]</ACCESSED-VARIABLE-REF>
                        </BSW-VARIABLE-ACCESS>
                      </DATA-SEND-POINTS>
                      <IMPLEMENTED-ENTRY-REF DEST="BSW-MODULE-ENTRY">/AUTOSAR_CanNm/[!"$bswModuleEntryPackageName"!]/CanNm_Channel_SendFunction_[!"$Channel_Idx"!]</IMPLEMENTED-ENTRY-REF>
                    </BSW-CALLED-ENTITY>
[!ENDIF!][!//
[!ENDSELECT!][!//
                  </ENTITYS>
                  <EVENTS>
[!SELECT "as:modconf('CanNm')[1]/CanNmGlobalConfig/eb-list::*[1]/CanNmChannelConfig/eb-list::*[$Partition = node:value(node:ref(CanNmComMNetworkHandleRef)/ComMChannelPartitionRef)]"!][!//
[!VAR "Channel_Idx" = "CanNmRxPdu/eb-list::*[1]/CanNmRxPduId"!][!//
                    <BSW-TIMING-EVENT>
                      <SHORT-NAME>TimingEvent_MainFunction_Channel_[!"$Channel_Idx"!]</SHORT-NAME>
                      <STARTS-ON-EVENT-REF DEST="BSW-SCHEDULABLE-ENTITY">/AUTOSAR_CanNm/BswModuleDescriptions/CanNm/InternalBehavior_Ch_OsApplication_[!"$Application"!]/CanNm_MainFunction_[!"$Channel_Idx"!]</STARTS-ON-EVENT-REF>
                      <PERIOD>[!"as:modconf('CanNm')[1]/CanNmGlobalConfig/eb-list::*[1]/CanNmMainFunctionPeriod"!]</PERIOD>
                    </BSW-TIMING-EVENT>
[!ENDSELECT!][!//
                  </EVENTS>
                </BSW-INTERNAL-BEHAVIOR>

[!ENDIF!][!//
[!ENDSELECT!][!//
              </INTERNAL-BEHAVIORS>
            </BSW-MODULE-DESCRIPTION>
          </ELEMENTS>
        </AR-PACKAGE>
        <AR-PACKAGE>
          <SHORT-NAME>BswModuleEntrys</SHORT-NAME>
          <ELEMENTS>
            <BSW-MODULE-ENTRY>
              <SHORT-NAME>CanNm_MainFunction_Main</SHORT-NAME>
              <SERVICE-ID>255</SERVICE-ID>
              <IS-REENTRANT>false</IS-REENTRANT>
              <IS-SYNCHRONOUS>true</IS-SYNCHRONOUS>
              <CALL-TYPE>SCHEDULED</CALL-TYPE>
              <EXECUTION-CONTEXT>TASK</EXECUTION-CONTEXT>
              <SW-SERVICE-IMPL-POLICY>STANDARD</SW-SERVICE-IMPL-POLICY>
              <ARGUMENTS>
              </ARGUMENTS>
            </BSW-MODULE-ENTRY>

[!LOOP "as:modconf('CanNm')[1]/CanNmGlobalConfig/eb-list::*[1]/CanNmChannelConfig/eb-list::*"!][!//
[!VAR "Channel_Idx" = "CanNmRxPdu/eb-list::*[1]/CanNmRxPduId"!][!//
            <BSW-MODULE-ENTRY>
              <SHORT-NAME>CanNm_MainFunction_[!"$Channel_Idx"!]</SHORT-NAME>
              <SERVICE-ID>255</SERVICE-ID>
              <IS-REENTRANT>false</IS-REENTRANT>
              <IS-SYNCHRONOUS>true</IS-SYNCHRONOUS>
              <CALL-TYPE>SCHEDULED</CALL-TYPE>
              <EXECUTION-CONTEXT>TASK</EXECUTION-CONTEXT>
              <SW-SERVICE-IMPL-POLICY>STANDARD</SW-SERVICE-IMPL-POLICY>
              <ARGUMENTS>
              </ARGUMENTS>
            </BSW-MODULE-ENTRY>

[!IF "node:refvalid(as:modconf('ComM')[1]/ComMGeneral/ComMMasterPNCEcuCPartitionRef)"!][!//
            <BSW-MODULE-ENTRY>
              <SHORT-NAME>CanNm_Main_RecieveFunction_[!"$Channel_Idx"!]</SHORT-NAME>
              <SERVICE-ID>255</SERVICE-ID>
              <IS-REENTRANT>true</IS-REENTRANT>
              <IS-SYNCHRONOUS>false</IS-SYNCHRONOUS>
              <CALL-TYPE>SCHEDULED</CALL-TYPE>
              <EXECUTION-CONTEXT>TASK</EXECUTION-CONTEXT>
              <SW-SERVICE-IMPL-POLICY>STANDARD</SW-SERVICE-IMPL-POLICY>
              <ARGUMENTS>
              </ARGUMENTS>
            </BSW-MODULE-ENTRY>
[!ENDIF!][!//

[!IF "node:refvalid(as:modconf('ComM')[1]/ComMGeneral/ComMMasterPNCEcuCPartitionRef)"!][!//
            <BSW-MODULE-ENTRY>
              <SHORT-NAME>CanNm_Channel_SendFunction_[!"$Channel_Idx"!]</SHORT-NAME>
              <ADMIN-DATA>
                <SDGS>
                  <SDG GID="EB:DnT">
                    <SD GID="FunctionGroup">Extern</SD>
                    <SD GID="EnableTracing">true</SD>
                  </SDG>
                 </SDGS>
              </ADMIN-DATA>
              <SERVICE-ID>255</SERVICE-ID>
              <IS-REENTRANT>true</IS-REENTRANT>
              <IS-SYNCHRONOUS>false</IS-SYNCHRONOUS>
              <CALL-TYPE>REGULAR</CALL-TYPE>
              <EXECUTION-CONTEXT>TASK</EXECUTION-CONTEXT>
              <SW-SERVICE-IMPL-POLICY>STANDARD</SW-SERVICE-IMPL-POLICY>
              <ARGUMENTS>
              </ARGUMENTS>
            </BSW-MODULE-ENTRY>
[!ENDIF!][!//

[!ENDLOOP!][!//

            <BSW-MODULE-ENTRY>
              <SHORT-NAME>CanNm_PassiveStartUp</SHORT-NAME>
              <ADMIN-DATA>
                <SDGS>
                  <SDG GID="EB:DnT">
                    <SD GID="FunctionGroup">Extern</SD>
                    <SD GID="EnableTracing">true</SD>
                  </SDG>
                 </SDGS>
              </ADMIN-DATA>
              <SERVICE-ID>1</SERVICE-ID>
              <IS-REENTRANT>false</IS-REENTRANT>
              <IS-SYNCHRONOUS>false</IS-SYNCHRONOUS>
              <CALL-TYPE>REGULAR</CALL-TYPE>
              <EXECUTION-CONTEXT>TASK</EXECUTION-CONTEXT>
              <SW-SERVICE-IMPL-POLICY>STANDARD</SW-SERVICE-IMPL-POLICY>
              <RETURN-TYPE>
                <SHORT-NAME>RetVal</SHORT-NAME>
                <DIRECTION>OUT</DIRECTION>
                <SW-DATA-DEF-PROPS>
                  <SW-DATA-DEF-PROPS-VARIANTS>
                    <SW-DATA-DEF-PROPS-CONDITIONAL>
                      <IMPLEMENTATION-DATA-TYPE-REF DEST="IMPLEMENTATION-DATA-TYPE">/AUTOSAR_Std/ImplementationDataTypes/Std_ReturnType</IMPLEMENTATION-DATA-TYPE-REF>
                    </SW-DATA-DEF-PROPS-CONDITIONAL>
                  </SW-DATA-DEF-PROPS-VARIANTS>
                </SW-DATA-DEF-PROPS>
              </RETURN-TYPE>
              <ARGUMENTS>
                <SW-SERVICE-ARG>
                  <SHORT-NAME>nmNetworkHandle</SHORT-NAME>
                  <DIRECTION>IN</DIRECTION>
                  <SW-DATA-DEF-PROPS>
                    <SW-DATA-DEF-PROPS-VARIANTS>
                      <SW-DATA-DEF-PROPS-CONDITIONAL>
                        <IMPLEMENTATION-DATA-TYPE-REF DEST="IMPLEMENTATION-DATA-TYPE">/AUTOSAR_Platform/ImplementationDataTypes/uint8</IMPLEMENTATION-DATA-TYPE-REF>
                      </SW-DATA-DEF-PROPS-CONDITIONAL>
                    </SW-DATA-DEF-PROPS-VARIANTS>
                  </SW-DATA-DEF-PROPS>
                </SW-SERVICE-ARG>
              </ARGUMENTS>
            </BSW-MODULE-ENTRY>

[!IF "node:existsAndFalse(as:modconf('CanNm')[1]/CanNmGlobalConfig/eb-list::*[1]/CanNmPassiveModeEnabled)"!][!//
            <BSW-MODULE-ENTRY>
              <SHORT-NAME>CanNm_NetworkRequest</SHORT-NAME>
              <ADMIN-DATA>
                <SDGS>
                  <SDG GID="EB:DnT">
                    <SD GID="FunctionGroup">Extern</SD>
                    <SD GID="EnableTracing">true</SD>
                  </SDG>
                 </SDGS>
              </ADMIN-DATA>
              <SERVICE-ID>2</SERVICE-ID>
              <IS-REENTRANT>false</IS-REENTRANT>
              <IS-SYNCHRONOUS>false</IS-SYNCHRONOUS>
              <CALL-TYPE>REGULAR</CALL-TYPE>
              <EXECUTION-CONTEXT>TASK</EXECUTION-CONTEXT>
              <SW-SERVICE-IMPL-POLICY>STANDARD</SW-SERVICE-IMPL-POLICY>
              <RETURN-TYPE>
                <SHORT-NAME>RetVal</SHORT-NAME>
                <DIRECTION>OUT</DIRECTION>
                <SW-DATA-DEF-PROPS>
                  <SW-DATA-DEF-PROPS-VARIANTS>
                    <SW-DATA-DEF-PROPS-CONDITIONAL>
                      <IMPLEMENTATION-DATA-TYPE-REF DEST="IMPLEMENTATION-DATA-TYPE">/AUTOSAR_Std/ImplementationDataTypes/Std_ReturnType</IMPLEMENTATION-DATA-TYPE-REF>
                    </SW-DATA-DEF-PROPS-CONDITIONAL>
                  </SW-DATA-DEF-PROPS-VARIANTS>
                </SW-DATA-DEF-PROPS>
              </RETURN-TYPE>
              <ARGUMENTS>
                <SW-SERVICE-ARG>
                  <SHORT-NAME>nmNetworkHandle</SHORT-NAME>
                  <DIRECTION>IN</DIRECTION>
                  <SW-DATA-DEF-PROPS>
                    <SW-DATA-DEF-PROPS-VARIANTS>
                      <SW-DATA-DEF-PROPS-CONDITIONAL>
                        <IMPLEMENTATION-DATA-TYPE-REF DEST="IMPLEMENTATION-DATA-TYPE">/AUTOSAR_Platform/ImplementationDataTypes/uint8</IMPLEMENTATION-DATA-TYPE-REF>
                      </SW-DATA-DEF-PROPS-CONDITIONAL>
                    </SW-DATA-DEF-PROPS-VARIANTS>
                  </SW-DATA-DEF-PROPS>
                </SW-SERVICE-ARG>
              </ARGUMENTS>
            </BSW-MODULE-ENTRY>
[!ENDIF!][!//

[!IF "node:existsAndFalse(as:modconf('CanNm')[1]/CanNmGlobalConfig/eb-list::*[1]/CanNmPassiveModeEnabled)"!][!//
            <BSW-MODULE-ENTRY>
              <SHORT-NAME>CanNm_NetworkGwEraRequest</SHORT-NAME>
              <ADMIN-DATA>
                <SDGS>
                  <SDG GID="EB:DnT">
                    <SD GID="FunctionGroup">Extern</SD>
                    <SD GID="EnableTracing">true</SD>
                  </SDG>
                 </SDGS>
              </ADMIN-DATA>
              <SERVICE-ID>254</SERVICE-ID>
              <IS-REENTRANT>false</IS-REENTRANT>
              <IS-SYNCHRONOUS>false</IS-SYNCHRONOUS>
              <CALL-TYPE>REGULAR</CALL-TYPE>
              <EXECUTION-CONTEXT>TASK</EXECUTION-CONTEXT>
              <SW-SERVICE-IMPL-POLICY>STANDARD</SW-SERVICE-IMPL-POLICY>
              <RETURN-TYPE>
                <SHORT-NAME>RetVal</SHORT-NAME>
                <DIRECTION>OUT</DIRECTION>
                <SW-DATA-DEF-PROPS>
                  <SW-DATA-DEF-PROPS-VARIANTS>
                    <SW-DATA-DEF-PROPS-CONDITIONAL>
                      <IMPLEMENTATION-DATA-TYPE-REF DEST="IMPLEMENTATION-DATA-TYPE">/AUTOSAR_Std/ImplementationDataTypes/Std_ReturnType</IMPLEMENTATION-DATA-TYPE-REF>
                    </SW-DATA-DEF-PROPS-CONDITIONAL>
                  </SW-DATA-DEF-PROPS-VARIANTS>
                </SW-DATA-DEF-PROPS>
              </RETURN-TYPE>
              <ARGUMENTS>
                <SW-SERVICE-ARG>
                  <SHORT-NAME>nmNetworkHandle</SHORT-NAME>
                  <DIRECTION>IN</DIRECTION>
                  <SW-DATA-DEF-PROPS>
                    <SW-DATA-DEF-PROPS-VARIANTS>
                      <SW-DATA-DEF-PROPS-CONDITIONAL>
                        <IMPLEMENTATION-DATA-TYPE-REF DEST="IMPLEMENTATION-DATA-TYPE">/AUTOSAR_Platform/ImplementationDataTypes/uint8</IMPLEMENTATION-DATA-TYPE-REF>
                      </SW-DATA-DEF-PROPS-CONDITIONAL>
                    </SW-DATA-DEF-PROPS-VARIANTS>
                  </SW-DATA-DEF-PROPS>
                </SW-SERVICE-ARG>
              </ARGUMENTS>
            </BSW-MODULE-ENTRY>
[!ENDIF!][!//

[!IF "node:existsAndFalse(as:modconf('CanNm')[1]/CanNmGlobalConfig/eb-list::*[1]/CanNmPassiveModeEnabled)"!][!//
            <BSW-MODULE-ENTRY>
              <SHORT-NAME>CanNm_NetworkRelease</SHORT-NAME>
              <ADMIN-DATA>
                <SDGS>
                  <SDG GID="EB:DnT">
                    <SD GID="FunctionGroup">Extern</SD>
                    <SD GID="EnableTracing">true</SD>
                  </SDG>
                 </SDGS>
              </ADMIN-DATA>
              <SERVICE-ID>3</SERVICE-ID>
              <IS-REENTRANT>false</IS-REENTRANT>
              <IS-SYNCHRONOUS>false</IS-SYNCHRONOUS>
              <CALL-TYPE>REGULAR</CALL-TYPE>
              <EXECUTION-CONTEXT>TASK</EXECUTION-CONTEXT>
              <SW-SERVICE-IMPL-POLICY>STANDARD</SW-SERVICE-IMPL-POLICY>
              <RETURN-TYPE>
                <SHORT-NAME>RetVal</SHORT-NAME>
                <DIRECTION>OUT</DIRECTION>
                <SW-DATA-DEF-PROPS>
                  <SW-DATA-DEF-PROPS-VARIANTS>
                    <SW-DATA-DEF-PROPS-CONDITIONAL>
                      <IMPLEMENTATION-DATA-TYPE-REF DEST="IMPLEMENTATION-DATA-TYPE">/AUTOSAR_Std/ImplementationDataTypes/Std_ReturnType</IMPLEMENTATION-DATA-TYPE-REF>
                    </SW-DATA-DEF-PROPS-CONDITIONAL>
                  </SW-DATA-DEF-PROPS-VARIANTS>
                </SW-DATA-DEF-PROPS>
              </RETURN-TYPE>
              <ARGUMENTS>
                <SW-SERVICE-ARG>
                  <SHORT-NAME>nmNetworkHandle</SHORT-NAME>
                  <DIRECTION>IN</DIRECTION>
                  <SW-DATA-DEF-PROPS>
                    <SW-DATA-DEF-PROPS-VARIANTS>
                      <SW-DATA-DEF-PROPS-CONDITIONAL>
                        <IMPLEMENTATION-DATA-TYPE-REF DEST="IMPLEMENTATION-DATA-TYPE">/AUTOSAR_Platform/ImplementationDataTypes/uint8</IMPLEMENTATION-DATA-TYPE-REF>
                      </SW-DATA-DEF-PROPS-CONDITIONAL>
                    </SW-DATA-DEF-PROPS-VARIANTS>
                  </SW-DATA-DEF-PROPS>
                </SW-SERVICE-ARG>
              </ARGUMENTS>
            </BSW-MODULE-ENTRY>
[!ENDIF!][!//

[!IF "node:existsAndTrue(as:modconf('CanNm')[1]/CanNmGlobalConfig/eb-list::*[1]/CanNmBusSynchronizationEnabled)"!][!//
            <BSW-MODULE-ENTRY>
              <SHORT-NAME>CanNm_RequestBusSynchronization</SHORT-NAME>
              <ADMIN-DATA>
                <SDGS>
                  <SDG GID="EB:DnT">
                    <SD GID="FunctionGroup">Extern</SD>
                    <SD GID="EnableTracing">true</SD>
                  </SDG>
                 </SDGS>
              </ADMIN-DATA>
              <SERVICE-ID>192</SERVICE-ID>
              <IS-REENTRANT>false</IS-REENTRANT>
              <IS-SYNCHRONOUS>false</IS-SYNCHRONOUS>
              <CALL-TYPE>REGULAR</CALL-TYPE>
              <EXECUTION-CONTEXT>TASK</EXECUTION-CONTEXT>
              <SW-SERVICE-IMPL-POLICY>STANDARD</SW-SERVICE-IMPL-POLICY>
              <RETURN-TYPE>
                <SHORT-NAME>RetVal</SHORT-NAME>
                <DIRECTION>OUT</DIRECTION>
                <SW-DATA-DEF-PROPS>
                  <SW-DATA-DEF-PROPS-VARIANTS>
                    <SW-DATA-DEF-PROPS-CONDITIONAL>
                      <IMPLEMENTATION-DATA-TYPE-REF DEST="IMPLEMENTATION-DATA-TYPE">/AUTOSAR_Std/ImplementationDataTypes/Std_ReturnType</IMPLEMENTATION-DATA-TYPE-REF>
                    </SW-DATA-DEF-PROPS-CONDITIONAL>
                  </SW-DATA-DEF-PROPS-VARIANTS>
                </SW-DATA-DEF-PROPS>
              </RETURN-TYPE>
              <ARGUMENTS>
                <SW-SERVICE-ARG>
                  <SHORT-NAME>nmNetworkHandle</SHORT-NAME>
                  <DIRECTION>IN</DIRECTION>
                  <SW-DATA-DEF-PROPS>
                    <SW-DATA-DEF-PROPS-VARIANTS>
                      <SW-DATA-DEF-PROPS-CONDITIONAL>
                        <IMPLEMENTATION-DATA-TYPE-REF DEST="IMPLEMENTATION-DATA-TYPE">/AUTOSAR_Platform/ImplementationDataTypes/uint8</IMPLEMENTATION-DATA-TYPE-REF>
                      </SW-DATA-DEF-PROPS-CONDITIONAL>
                    </SW-DATA-DEF-PROPS-VARIANTS>
                  </SW-DATA-DEF-PROPS>
                </SW-SERVICE-ARG>
              </ARGUMENTS>
            </BSW-MODULE-ENTRY>
[!ENDIF!][!//

[!IF "$SynchronizedPncShutdownEnabled = 'true'"!][!//
            <BSW-MODULE-ENTRY>
              <SHORT-NAME>CanNm_RequestSynchronizedPncShutdown</SHORT-NAME>
              <ADMIN-DATA>
                <SDGS>
                  <SDG GID="EB:DnT">
                    <SD GID="FunctionGroup">Extern</SD>
                    <SD GID="EnableTracing">true</SD>
                  </SDG>
                 </SDGS>
              </ADMIN-DATA>
              <SERVICE-ID>243</SERVICE-ID>
              <IS-REENTRANT>false</IS-REENTRANT>
              <IS-SYNCHRONOUS>true</IS-SYNCHRONOUS>
              <CALL-TYPE>REGULAR</CALL-TYPE>
              <EXECUTION-CONTEXT>TASK</EXECUTION-CONTEXT>
              <SW-SERVICE-IMPL-POLICY>STANDARD</SW-SERVICE-IMPL-POLICY>
              <RETURN-TYPE>
                <SHORT-NAME>RetVal</SHORT-NAME>
                <DIRECTION>OUT</DIRECTION>
                <SW-DATA-DEF-PROPS>
                  <SW-DATA-DEF-PROPS-VARIANTS>
                    <SW-DATA-DEF-PROPS-CONDITIONAL>
                      <IMPLEMENTATION-DATA-TYPE-REF DEST="IMPLEMENTATION-DATA-TYPE">/AUTOSAR_Std/ImplementationDataTypes/Std_ReturnType</IMPLEMENTATION-DATA-TYPE-REF>
                    </SW-DATA-DEF-PROPS-CONDITIONAL>
                  </SW-DATA-DEF-PROPS-VARIANTS>
                </SW-DATA-DEF-PROPS>
              </RETURN-TYPE>
              <ARGUMENTS>
                <SW-SERVICE-ARG>
                  <SHORT-NAME>nmChannelHandle</SHORT-NAME>
                  <DIRECTION>IN</DIRECTION>
                  <SW-DATA-DEF-PROPS>
                    <SW-DATA-DEF-PROPS-VARIANTS>
                      <SW-DATA-DEF-PROPS-CONDITIONAL>
                        <IMPLEMENTATION-DATA-TYPE-REF DEST="IMPLEMENTATION-DATA-TYPE">/AUTOSAR_Platform/ImplementationDataTypes/uint8</IMPLEMENTATION-DATA-TYPE-REF>
                      </SW-DATA-DEF-PROPS-CONDITIONAL>
                    </SW-DATA-DEF-PROPS-VARIANTS>
                  </SW-DATA-DEF-PROPS>
                </SW-SERVICE-ARG>
                <SW-SERVICE-ARG>
                  <SHORT-NAME>pncId</SHORT-NAME>
                  <DIRECTION>IN</DIRECTION>
                  <SW-DATA-DEF-PROPS>
                    <SW-DATA-DEF-PROPS-VARIANTS>
                      <SW-DATA-DEF-PROPS-CONDITIONAL>
                        <IMPLEMENTATION-DATA-TYPE-REF DEST="IMPLEMENTATION-DATA-TYPE">/AUTOSAR_Platform/ImplementationDataTypes/uint16</IMPLEMENTATION-DATA-TYPE-REF>
                      </SW-DATA-DEF-PROPS-CONDITIONAL>
                    </SW-DATA-DEF-PROPS-VARIANTS>
                  </SW-DATA-DEF-PROPS>
                </SW-SERVICE-ARG>
              </ARGUMENTS>
            </BSW-MODULE-ENTRY>
[!ENDIF!][!//

          </ELEMENTS>
        </AR-PACKAGE>
        <AR-PACKAGE>
          <SHORT-NAME>ImplementationDataTypes</SHORT-NAME>
          <ELEMENTS>
            <IMPLEMENTATION-DATA-TYPE>
              <SHORT-NAME>PnInfoArray</SHORT-NAME>
              <CATEGORY>ARRAY</CATEGORY>
              <SUB-ELEMENTS>
                <IMPLEMENTATION-DATA-TYPE-ELEMENT>
                  <SHORT-NAME>PnInfoArray</SHORT-NAME>
                  <CATEGORY>TYPE_REFERENCE</CATEGORY>
                  <ARRAY-SIZE>[!"as:modconf('CanNm')[1]/CanNmGlobalConfig/eb-list::*[1]/CanNmPnInfo/CanNmPnInfoLength"!]</ARRAY-SIZE>
                  <ARRAY-SIZE-SEMANTICS>FIXED-SIZE</ARRAY-SIZE-SEMANTICS>
                  <SW-DATA-DEF-PROPS>
                    <SW-DATA-DEF-PROPS-VARIANTS>
                      <SW-DATA-DEF-PROPS-CONDITIONAL>
                        <IMPLEMENTATION-DATA-TYPE-REF DEST="IMPLEMENTATION-DATA-TYPE">/AUTOSAR_Platform/ImplementationDataTypes/uint8</IMPLEMENTATION-DATA-TYPE-REF>
                      </SW-DATA-DEF-PROPS-CONDITIONAL>
                    </SW-DATA-DEF-PROPS-VARIANTS>
                  </SW-DATA-DEF-PROPS>
                </IMPLEMENTATION-DATA-TYPE-ELEMENT>
              </SUB-ELEMENTS>
            </IMPLEMENTATION-DATA-TYPE>
            <IMPLEMENTATION-DATA-TYPE>
              <SHORT-NAME>CanNm_HsmStatechartPtrType</SHORT-NAME>
              <CATEGORY>TYPE_REFERENCE</CATEGORY>
              <ADMIN-DATA>
                <SDGS>
                  <SDG GID="EB:DnT">
                    <SD GID="TypeGroup">CanNm_Types</SD>
                  </SDG>
                </SDGS>
              </ADMIN-DATA>
              <SW-DATA-DEF-PROPS>
                <SW-DATA-DEF-PROPS-VARIANTS>
                  <SW-DATA-DEF-PROPS-CONDITIONAL>
                    <IMPLEMENTATION-DATA-TYPE-REF
                      DEST="IMPLEMENTATION-DATA-TYPE">/AUTOSAR_Platform/ImplementationDataTypes/VoidPtr</IMPLEMENTATION-DATA-TYPE-REF>
                  </SW-DATA-DEF-PROPS-CONDITIONAL>
                </SW-DATA-DEF-PROPS-VARIANTS>
              </SW-DATA-DEF-PROPS>
              <TYPE-EMITTER>BSW</TYPE-EMITTER>
            </IMPLEMENTATION-DATA-TYPE>
            <IMPLEMENTATION-DATA-TYPE>
              <SHORT-NAME>CanNm_HsmEventType</SHORT-NAME>
              <CATEGORY>TYPE_REFERENCE</CATEGORY>
              <ADMIN-DATA>
                <SDGS>
                  <SDG GID="EB:DnT">
                    <SD GID="TypeGroup">CanNm_Types</SD>
                  </SDG>
                </SDGS>
              </ADMIN-DATA>
              <SW-DATA-DEF-PROPS>
                <SW-DATA-DEF-PROPS-VARIANTS>
                  <SW-DATA-DEF-PROPS-CONDITIONAL>
                    <IMPLEMENTATION-DATA-TYPE-REF
                      DEST="IMPLEMENTATION-DATA-TYPE">/AUTOSAR_Platform/ImplementationDataTypes/uint8</IMPLEMENTATION-DATA-TYPE-REF>
                  </SW-DATA-DEF-PROPS-CONDITIONAL>
                </SW-DATA-DEF-PROPS-VARIANTS>
              </SW-DATA-DEF-PROPS>
              <TYPE-EMITTER>BSW</TYPE-EMITTER>
            </IMPLEMENTATION-DATA-TYPE>
            <IMPLEMENTATION-DATA-TYPE>
              <SHORT-NAME>CanNm_TimeType</SHORT-NAME>
              <CATEGORY>TYPE_REFERENCE</CATEGORY>
              <ADMIN-DATA>
                <SDGS>
                  <SDG GID="EB:DnT">
                    <SD GID="TypeGroup">CanNm_Types</SD>
                  </SDG>
                </SDGS>
              </ADMIN-DATA>
              <SW-DATA-DEF-PROPS>
                <SW-DATA-DEF-PROPS-VARIANTS>
                  <SW-DATA-DEF-PROPS-CONDITIONAL>
                    <IMPLEMENTATION-DATA-TYPE-REF
                      DEST="IMPLEMENTATION-DATA-TYPE">/AUTOSAR_Platform/ImplementationDataTypes/uint16</IMPLEMENTATION-DATA-TYPE-REF>
                  </SW-DATA-DEF-PROPS-CONDITIONAL>
                </SW-DATA-DEF-PROPS-VARIANTS>
              </SW-DATA-DEF-PROPS>
              <TYPE-EMITTER>BSW</TYPE-EMITTER>
            </IMPLEMENTATION-DATA-TYPE>
            <IMPLEMENTATION-DATA-TYPE>
              <SHORT-NAME>CanNm_HsmStateIdxType</SHORT-NAME>
              <CATEGORY>TYPE_REFERENCE</CATEGORY>
              <ADMIN-DATA>
                <SDGS>
                  <SDG GID="EB:DnT">
                    <SD GID="TypeGroup">CanNm_Types</SD>
                  </SDG>
                </SDGS>
              </ADMIN-DATA>
              <SW-DATA-DEF-PROPS>
                <SW-DATA-DEF-PROPS-VARIANTS>
                  <SW-DATA-DEF-PROPS-CONDITIONAL>
                    <IMPLEMENTATION-DATA-TYPE-REF
                      DEST="IMPLEMENTATION-DATA-TYPE">/AUTOSAR_Platform/ImplementationDataTypes/uint8</IMPLEMENTATION-DATA-TYPE-REF>
                  </SW-DATA-DEF-PROPS-CONDITIONAL>
                </SW-DATA-DEF-PROPS-VARIANTS>
              </SW-DATA-DEF-PROPS>
              <TYPE-EMITTER>BSW</TYPE-EMITTER>
            </IMPLEMENTATION-DATA-TYPE>
          </ELEMENTS>
        </AR-PACKAGE>
      </AR-PACKAGES>
    </AR-PACKAGE>

    <AR-PACKAGE>
      <SHORT-NAME>EB_CanNm</SHORT-NAME>
      <AR-PACKAGES>
        <AR-PACKAGE>
          <SHORT-NAME>Implementations</SHORT-NAME>
          <ELEMENTS>
            <BSW-IMPLEMENTATION>
              <SHORT-NAME>BswImplementation_Main</SHORT-NAME>
              <CODE-DESCRIPTORS>
                <CODE>
                  <SHORT-NAME>Files</SHORT-NAME>
                  <ARTIFACT-DESCRIPTORS>
                    <AUTOSAR-ENGINEERING-OBJECT>
                      <SHORT-LABEL>Autosar::include::CanNm.h</SHORT-LABEL>
                      <CATEGORY>SWHDR</CATEGORY>
                    </AUTOSAR-ENGINEERING-OBJECT>
                    <AUTOSAR-ENGINEERING-OBJECT>
                      <SHORT-LABEL>Autosar::include::CanNm_Api.h</SHORT-LABEL>
                      <CATEGORY>SWHDR</CATEGORY>
                    </AUTOSAR-ENGINEERING-OBJECT>
                    <AUTOSAR-ENGINEERING-OBJECT>
                      <SHORT-LABEL>Autosar::include::CanNm_Cbk.h</SHORT-LABEL>
                      <CATEGORY>SWHDR</CATEGORY>
                    </AUTOSAR-ENGINEERING-OBJECT>
                    <AUTOSAR-ENGINEERING-OBJECT>
                      <SHORT-LABEL>Autosar::include::CanNm_Hsm.h</SHORT-LABEL>
                      <CATEGORY>SWHDR</CATEGORY>
                    </AUTOSAR-ENGINEERING-OBJECT>
                    <AUTOSAR-ENGINEERING-OBJECT>
                      <SHORT-LABEL>Autosar::include::CanNm_HsmCanNm.h</SHORT-LABEL>
                      <CATEGORY>SWHDR</CATEGORY>
                    </AUTOSAR-ENGINEERING-OBJECT>
                    <AUTOSAR-ENGINEERING-OBJECT>
                      <SHORT-LABEL>Autosar::include::CanNm_HsmCanNmInt.h</SHORT-LABEL>
                      <CATEGORY>SWHDR</CATEGORY>
                    </AUTOSAR-ENGINEERING-OBJECT>
                    <AUTOSAR-ENGINEERING-OBJECT>
                      <SHORT-LABEL>Autosar::include::CanNm_HsmCfg.h</SHORT-LABEL>
                      <CATEGORY>SWHDR</CATEGORY>
                    </AUTOSAR-ENGINEERING-OBJECT>
                    <AUTOSAR-ENGINEERING-OBJECT>
                      <SHORT-LABEL>Autosar::include::CanNm_Int.h</SHORT-LABEL>
                      <CATEGORY>SWHDR</CATEGORY>
                    </AUTOSAR-ENGINEERING-OBJECT>
                    <AUTOSAR-ENGINEERING-OBJECT>
                      <SHORT-LABEL>Autosar::include::CanNm_Lcfg_Static.h</SHORT-LABEL>
                      <CATEGORY>SWHDR</CATEGORY>
                    </AUTOSAR-ENGINEERING-OBJECT>
                    <AUTOSAR-ENGINEERING-OBJECT>
                      <SHORT-LABEL>Autosar::include::CanNm_Trace.h</SHORT-LABEL>
                      <CATEGORY>SWHDR</CATEGORY>
                    </AUTOSAR-ENGINEERING-OBJECT>
                    <AUTOSAR-ENGINEERING-OBJECT>
                      <SHORT-LABEL>Autosar::include::CanNm_Trace_Internal.h</SHORT-LABEL>
                      <CATEGORY>SWHDR</CATEGORY>
                    </AUTOSAR-ENGINEERING-OBJECT>
                    <AUTOSAR-ENGINEERING-OBJECT>
                      <SHORT-LABEL>Autosar::include::CanNm_Version.h</SHORT-LABEL>
                      <CATEGORY>SWHDR</CATEGORY>
                    </AUTOSAR-ENGINEERING-OBJECT>
                    <AUTOSAR-ENGINEERING-OBJECT>
                      <SHORT-LABEL>Autosar::src::CanNm.c</SHORT-LABEL>
                      <CATEGORY>SWSRC</CATEGORY>
                    </AUTOSAR-ENGINEERING-OBJECT>
                    <AUTOSAR-ENGINEERING-OBJECT>
                      <SHORT-LABEL>Autosar::src::CanNm_Hsm.c</SHORT-LABEL>
                      <CATEGORY>SWSRC</CATEGORY>
                    </AUTOSAR-ENGINEERING-OBJECT>
                    <AUTOSAR-ENGINEERING-OBJECT>
                      <SHORT-LABEL>Autosar::src::CanNm_HsmCanNmData.c</SHORT-LABEL>
                      <CATEGORY>SWSRC</CATEGORY>
                    </AUTOSAR-ENGINEERING-OBJECT>
                    <AUTOSAR-ENGINEERING-OBJECT>
                      <SHORT-LABEL>Autosar::src::CanNm_HsmCanNmFnct.c</SHORT-LABEL>
                      <CATEGORY>SWSRC</CATEGORY>
                    </AUTOSAR-ENGINEERING-OBJECT>
                    <AUTOSAR-ENGINEERING-OBJECT>
                      <SHORT-LABEL>make::CanNm_defs.mak</SHORT-LABEL>
                      <CATEGORY>SWMAKE</CATEGORY>
                    </AUTOSAR-ENGINEERING-OBJECT>
                    <AUTOSAR-ENGINEERING-OBJECT>
                      <SHORT-LABEL>make::CanNm_rules.mak</SHORT-LABEL>
                      <CATEGORY>SWMAKE</CATEGORY>
                    </AUTOSAR-ENGINEERING-OBJECT>
                  </ARTIFACT-DESCRIPTORS>
                </CODE>
              </CODE-DESCRIPTORS>
              <PROGRAMMING-LANGUAGE>C</PROGRAMMING-LANGUAGE>
              <RESOURCE-CONSUMPTION>
                <SHORT-NAME>ResourceConsumption</SHORT-NAME>
                <MEMORY-SECTIONS>
                  <MEMORY-SECTION>
                    <SHORT-NAME>CONST_8</SHORT-NAME>
                    <ALIGNMENT>8</ALIGNMENT>
                    <SW-ADDRMETHOD-REF DEST="SW-ADDR-METHOD">/AUTOSAR_MemMap/SwAddrMethods/CONST</SW-ADDRMETHOD-REF>
                  </MEMORY-SECTION>
                  <MEMORY-SECTION>
                    <SHORT-NAME>CONST_32</SHORT-NAME>
                    <ALIGNMENT>32</ALIGNMENT>
                    <SW-ADDRMETHOD-REF DEST="SW-ADDR-METHOD">/AUTOSAR_MemMap/SwAddrMethods/CONST</SW-ADDRMETHOD-REF>
                  </MEMORY-SECTION>
                  <MEMORY-SECTION>
                    <SHORT-NAME>VAR_INIT_8</SHORT-NAME>
                    <ALIGNMENT>8</ALIGNMENT>
                    <SW-ADDRMETHOD-REF DEST="SW-ADDR-METHOD">/AUTOSAR_MemMap/SwAddrMethods/VAR</SW-ADDRMETHOD-REF>
                  </MEMORY-SECTION>
                  <MEMORY-SECTION>
                    <SHORT-NAME>CONST_UNSPECIFIED</SHORT-NAME>
                    <ALIGNMENT>UNSPECIFIED</ALIGNMENT>
                    <SW-ADDRMETHOD-REF DEST="SW-ADDR-METHOD">/AUTOSAR_MemMap/SwAddrMethods/CONST</SW-ADDRMETHOD-REF>
                  </MEMORY-SECTION>
                  <MEMORY-SECTION>
                    <SHORT-NAME>CODE</SHORT-NAME>
                    <SW-ADDRMETHOD-REF DEST="SW-ADDR-METHOD">/AUTOSAR_MemMap/SwAddrMethods/CODE</SW-ADDRMETHOD-REF>
                  </MEMORY-SECTION>
                  <MEMORY-SECTION>
                    <SHORT-NAME>VAR_INIT_UNSPECIFIED</SHORT-NAME>
                    <ALIGNMENT>UNSPECIFIED</ALIGNMENT>
                    <SW-ADDRMETHOD-REF DEST="SW-ADDR-METHOD">/AUTOSAR_MemMap/SwAddrMethods/VAR</SW-ADDRMETHOD-REF>
                  </MEMORY-SECTION>
                  <MEMORY-SECTION>
                    <SHORT-NAME>VAR_CLEARED_8</SHORT-NAME>
                    <ALIGNMENT>8</ALIGNMENT>
                    <SW-ADDRMETHOD-REF DEST="SW-ADDR-METHOD">/AUTOSAR_MemMap/SwAddrMethods/VAR_CLEARED</SW-ADDRMETHOD-REF>
                  </MEMORY-SECTION>
                  <MEMORY-SECTION>
                    <SHORT-NAME>VAR_CLEARED_UNSPECIFIED</SHORT-NAME>
                    <ALIGNMENT>UNSPECIFIED</ALIGNMENT>
                    <SW-ADDRMETHOD-REF DEST="SW-ADDR-METHOD">/AUTOSAR_MemMap/SwAddrMethods/VAR_CLEARED</SW-ADDRMETHOD-REF>
                  </MEMORY-SECTION>
                  <MEMORY-SECTION>
                    <SHORT-NAME>VAR_INIT_BOOLEAN</SHORT-NAME>
                    <ALIGNMENT>8</ALIGNMENT>
                    <SW-ADDRMETHOD-REF DEST="SW-ADDR-METHOD">/AUTOSAR_MemMap/SwAddrMethods/VAR</SW-ADDRMETHOD-REF>
                  </MEMORY-SECTION>
                  <MEMORY-SECTION>
                    <SHORT-NAME>CONFIG_DATA_UNSPECIFIED</SHORT-NAME>
                    <ALIGNMENT>UNSPECIFIED</ALIGNMENT>
                    <SW-ADDRMETHOD-REF DEST="SW-ADDR-METHOD">/AUTOSAR_MemMap/SwAddrMethods/CONFIG_DATA</SW-ADDRMETHOD-REF>
                  </MEMORY-SECTION>
                </MEMORY-SECTIONS>
              </RESOURCE-CONSUMPTION>
              <SW-VERSION>6.20.6</SW-VERSION>
              <VENDOR-ID>1</VENDOR-ID>
              <AR-RELEASE-VERSION>4.0.3</AR-RELEASE-VERSION>
              <BEHAVIOR-REF DEST="BSW-INTERNAL-BEHAVIOR">/AUTOSAR_CanNm/BswModuleDescriptions/CanNm/InternalBehavior_Main</BEHAVIOR-REF>
              <VENDOR-SPECIFIC-MODULE-DEF-REFS>
                <VENDOR-SPECIFIC-MODULE-DEF-REF DEST="ECUC-MODULE-DEF">/TS_TxDxM6I20R0/CanNm</VENDOR-SPECIFIC-MODULE-DEF-REF>
              </VENDOR-SPECIFIC-MODULE-DEF-REFS>
            </BSW-IMPLEMENTATION>
[!SELECT "as:modconf('Os')[1]/OsApplication/eb-list::*/OsAppEcucPartitionRef"!][!//
[!VAR "Partition" = "node:value(.)"!][!//
[!VAR "Application" = "node:name(..)"!][!//
[!IF "node:exists(as:modconf('ComM')[1]/ComMConfigSet/eb-list::*[1]/ComMChannel/eb-list::*[($Partition = node:value(ComMChannelPartitionRef)) and (ComMBusType = 'COMM_BUS_TYPE_CAN') and ((ComMNetworkManagement/ComMNmVariant = 'FULL') or (ComMNetworkManagement/ComMNmVariant = 'PASSIVE'))])"!][!//
            <BSW-IMPLEMENTATION>
              <SHORT-NAME>BswImplementation_Ch_OsApplication_[!"$Application"!]</SHORT-NAME>
              <CODE-DESCRIPTORS>
                <CODE>
                  <SHORT-NAME>Files</SHORT-NAME>
                  <ARTIFACT-DESCRIPTORS>
                    <AUTOSAR-ENGINEERING-OBJECT>
                      <SHORT-LABEL>Autosar::include::CanNm.h</SHORT-LABEL>
                      <CATEGORY>SWHDR</CATEGORY>
                    </AUTOSAR-ENGINEERING-OBJECT>
                    <AUTOSAR-ENGINEERING-OBJECT>
                      <SHORT-LABEL>Autosar::include::CanNm_Api.h</SHORT-LABEL>
                      <CATEGORY>SWHDR</CATEGORY>
                    </AUTOSAR-ENGINEERING-OBJECT>
                    <AUTOSAR-ENGINEERING-OBJECT>
                      <SHORT-LABEL>Autosar::include::CanNm_Cbk.h</SHORT-LABEL>
                      <CATEGORY>SWHDR</CATEGORY>
                    </AUTOSAR-ENGINEERING-OBJECT>
                    <AUTOSAR-ENGINEERING-OBJECT>
                      <SHORT-LABEL>Autosar::include::CanNm_Hsm.h</SHORT-LABEL>
                      <CATEGORY>SWHDR</CATEGORY>
                    </AUTOSAR-ENGINEERING-OBJECT>
                    <AUTOSAR-ENGINEERING-OBJECT>
                      <SHORT-LABEL>Autosar::include::CanNm_HsmCanNm.h</SHORT-LABEL>
                      <CATEGORY>SWHDR</CATEGORY>
                    </AUTOSAR-ENGINEERING-OBJECT>
                    <AUTOSAR-ENGINEERING-OBJECT>
                      <SHORT-LABEL>Autosar::include::CanNm_HsmCanNmInt.h</SHORT-LABEL>
                      <CATEGORY>SWHDR</CATEGORY>
                    </AUTOSAR-ENGINEERING-OBJECT>
                    <AUTOSAR-ENGINEERING-OBJECT>
                      <SHORT-LABEL>Autosar::include::CanNm_HsmCfg.h</SHORT-LABEL>
                      <CATEGORY>SWHDR</CATEGORY>
                    </AUTOSAR-ENGINEERING-OBJECT>
                    <AUTOSAR-ENGINEERING-OBJECT>
                      <SHORT-LABEL>Autosar::include::CanNm_Int.h</SHORT-LABEL>
                      <CATEGORY>SWHDR</CATEGORY>
                    </AUTOSAR-ENGINEERING-OBJECT>
                    <AUTOSAR-ENGINEERING-OBJECT>
                      <SHORT-LABEL>Autosar::include::CanNm_Lcfg_Static.h</SHORT-LABEL>
                      <CATEGORY>SWHDR</CATEGORY>
                    </AUTOSAR-ENGINEERING-OBJECT>
                    <AUTOSAR-ENGINEERING-OBJECT>
                      <SHORT-LABEL>Autosar::include::CanNm_Trace.h</SHORT-LABEL>
                      <CATEGORY>SWHDR</CATEGORY>
                    </AUTOSAR-ENGINEERING-OBJECT>
                    <AUTOSAR-ENGINEERING-OBJECT>
                      <SHORT-LABEL>Autosar::include::CanNm_Trace_Internal.h</SHORT-LABEL>
                      <CATEGORY>SWHDR</CATEGORY>
                    </AUTOSAR-ENGINEERING-OBJECT>
                    <AUTOSAR-ENGINEERING-OBJECT>
                      <SHORT-LABEL>Autosar::include::CanNm_Version.h</SHORT-LABEL>
                      <CATEGORY>SWHDR</CATEGORY>
                    </AUTOSAR-ENGINEERING-OBJECT>
                    <AUTOSAR-ENGINEERING-OBJECT>
                      <SHORT-LABEL>Autosar::src::CanNm.c</SHORT-LABEL>
                      <CATEGORY>SWSRC</CATEGORY>
                    </AUTOSAR-ENGINEERING-OBJECT>
                    <AUTOSAR-ENGINEERING-OBJECT>
                      <SHORT-LABEL>Autosar::src::CanNm_Hsm.c</SHORT-LABEL>
                      <CATEGORY>SWSRC</CATEGORY>
                    </AUTOSAR-ENGINEERING-OBJECT>
                    <AUTOSAR-ENGINEERING-OBJECT>
                      <SHORT-LABEL>Autosar::src::CanNm_HsmCanNmData.c</SHORT-LABEL>
                      <CATEGORY>SWSRC</CATEGORY>
                    </AUTOSAR-ENGINEERING-OBJECT>
                    <AUTOSAR-ENGINEERING-OBJECT>
                      <SHORT-LABEL>Autosar::src::CanNm_HsmCanNmFnct.c</SHORT-LABEL>
                      <CATEGORY>SWSRC</CATEGORY>
                    </AUTOSAR-ENGINEERING-OBJECT>
                    <AUTOSAR-ENGINEERING-OBJECT>
                      <SHORT-LABEL>make::CanNm_defs.mak</SHORT-LABEL>
                      <CATEGORY>SWMAKE</CATEGORY>
                    </AUTOSAR-ENGINEERING-OBJECT>
                    <AUTOSAR-ENGINEERING-OBJECT>
                      <SHORT-LABEL>make::CanNm_rules.mak</SHORT-LABEL>
                      <CATEGORY>SWMAKE</CATEGORY>
                    </AUTOSAR-ENGINEERING-OBJECT>
                  </ARTIFACT-DESCRIPTORS>
                </CODE>
              </CODE-DESCRIPTORS>
              <PROGRAMMING-LANGUAGE>C</PROGRAMMING-LANGUAGE>
              <RESOURCE-CONSUMPTION>
                <SHORT-NAME>ResourceConsumption</SHORT-NAME>
                <MEMORY-SECTIONS>
                  <MEMORY-SECTION>
                    <SHORT-NAME>CODE</SHORT-NAME>
                    <SW-ADDRMETHOD-REF DEST="SW-ADDR-METHOD">/AUTOSAR_MemMap/SwAddrMethods/CODE</SW-ADDRMETHOD-REF>
                  </MEMORY-SECTION>
                </MEMORY-SECTIONS>
              </RESOURCE-CONSUMPTION>
              <SW-VERSION>6.20.6</SW-VERSION>
              <VENDOR-ID>1</VENDOR-ID>
              <AR-RELEASE-VERSION>4.0.3</AR-RELEASE-VERSION>
              <BEHAVIOR-REF DEST="BSW-INTERNAL-BEHAVIOR">/AUTOSAR_CanNm/BswModuleDescriptions/CanNm/InternalBehavior_Ch_OsApplication_[!"$Application"!]</BEHAVIOR-REF>
              <VENDOR-API-INFIX>ChOsApp_[!"$Application"!]</VENDOR-API-INFIX>
              <VENDOR-SPECIFIC-MODULE-DEF-REFS>
                <VENDOR-SPECIFIC-MODULE-DEF-REF DEST="ECUC-MODULE-DEF">/TS_TxDxM6I20R0/CanNm</VENDOR-SPECIFIC-MODULE-DEF-REF>
              </VENDOR-SPECIFIC-MODULE-DEF-REFS>
            </BSW-IMPLEMENTATION>
[!ENDIF!][!//
[!ENDSELECT!][!//
          </ELEMENTS>
        </AR-PACKAGE>
      </AR-PACKAGES>
    </AR-PACKAGE>
  </AR-PACKAGES>
[!ELSE!][!/* "$MulticorePerChannelSupport = 'true'" */!]
  <AR-PACKAGES>
    <AR-PACKAGE>
      <SHORT-NAME>AUTOSAR_CanNm</SHORT-NAME>
      <AR-PACKAGES>
        <AR-PACKAGE>
          <SHORT-NAME>BswModuleDescriptions</SHORT-NAME>
          <ELEMENTS>
            <BSW-MODULE-DESCRIPTION>
              <SHORT-NAME>CanNm</SHORT-NAME>
              <MODULE-ID>31</MODULE-ID>
              <PROVIDED-ENTRYS>
                <BSW-MODULE-ENTRY-REF-CONDITIONAL>
                  <BSW-MODULE-ENTRY-REF DEST="BSW-MODULE-ENTRY">/AUTOSAR_CanNm/BswModuleEntrys/CanNm_MainFunction</BSW-MODULE-ENTRY-REF>
                </BSW-MODULE-ENTRY-REF-CONDITIONAL>

[!IF "node:existsAndTrue(CanNmGeneral/CanNmMultiCoreSupport)"!]

                <BSW-MODULE-ENTRY-REF-CONDITIONAL>
                  <BSW-MODULE-ENTRY-REF DEST="BSW-MODULE-ENTRY">/AUTOSAR_CanNm/BswModuleEntrys/CanNm_Dummy_RxIndication</BSW-MODULE-ENTRY-REF>
                </BSW-MODULE-ENTRY-REF-CONDITIONAL>

[!IF "node:existsAndFalse(as:modconf('CanNm')[1]/CanNmGeneral/CanNmMultiCoreUseSingleCS)"!]
[!IF "node:existsAndFalse(as:modconf('CanNm')[1]/CanNmGlobalConfig/eb-list::*[1]/CanNmPassiveModeEnabled)"!]
                <BSW-MODULE-ENTRY-REF-CONDITIONAL>
                  <BSW-MODULE-ENTRY-REF DEST="BSW-MODULE-ENTRY">/AUTOSAR_CanNm/BswModuleEntrys/CanNm_NetworkRequest</BSW-MODULE-ENTRY-REF>
                </BSW-MODULE-ENTRY-REF-CONDITIONAL>
[!ENDIF!]
[!ENDIF!]

[!IF "node:existsAndFalse(as:modconf('CanNm')[1]/CanNmGeneral/CanNmMultiCoreUseSingleCS)"!]
[!IF "node:existsAndFalse(as:modconf('CanNm')[1]/CanNmGlobalConfig/eb-list::*[1]/CanNmPassiveModeEnabled)"!]
                <BSW-MODULE-ENTRY-REF-CONDITIONAL>
                  <BSW-MODULE-ENTRY-REF DEST="BSW-MODULE-ENTRY">/AUTOSAR_CanNm/BswModuleEntrys/CanNm_NetworkGwEraRequest</BSW-MODULE-ENTRY-REF>
                </BSW-MODULE-ENTRY-REF-CONDITIONAL>
[!ENDIF!]
[!ENDIF!]
[!IF "node:existsAndFalse(as:modconf('CanNm')[1]/CanNmGeneral/CanNmMultiCoreUseSingleCS)"!]
[!IF "node:existsAndFalse(as:modconf('CanNm')[1]/CanNmGlobalConfig/eb-list::*[1]/CanNmPassiveModeEnabled)"!]
                <BSW-MODULE-ENTRY-REF-CONDITIONAL>
                  <BSW-MODULE-ENTRY-REF DEST="BSW-MODULE-ENTRY">/AUTOSAR_CanNm/BswModuleEntrys/CanNm_NetworkRelease</BSW-MODULE-ENTRY-REF>
                </BSW-MODULE-ENTRY-REF-CONDITIONAL>
[!ENDIF!]
[!ENDIF!]
[!IF "node:existsAndTrue(as:modconf('CanNm')[1]/CanNmGlobalConfig/eb-list::*[1]/CanNmBusSynchronizationEnabled)"!]
                <BSW-MODULE-ENTRY-REF-CONDITIONAL>
                  <BSW-MODULE-ENTRY-REF DEST="BSW-MODULE-ENTRY">/AUTOSAR_CanNm/BswModuleEntrys/CanNm_RequestBusSynchronization</BSW-MODULE-ENTRY-REF>
                </BSW-MODULE-ENTRY-REF-CONDITIONAL>
[!ENDIF!]
[!IF "node:existsAndFalse(as:modconf('CanNm')[1]/CanNmGeneral/CanNmMultiCoreUseSingleCS)"!]
                <BSW-MODULE-ENTRY-REF-CONDITIONAL>
                  <BSW-MODULE-ENTRY-REF DEST="BSW-MODULE-ENTRY">/AUTOSAR_CanNm/BswModuleEntrys/CanNm_PassiveStartUp</BSW-MODULE-ENTRY-REF>
                </BSW-MODULE-ENTRY-REF-CONDITIONAL>
[!ENDIF!]                

[!IF "node:existsAndTrue(as:modconf('CanNm')[1]/CanNmGeneral/CanNmMultiCoreUseSingleCS)"!]
                <BSW-MODULE-ENTRY-REF-CONDITIONAL>
                  <BSW-MODULE-ENTRY-REF DEST="BSW-MODULE-ENTRY">/AUTOSAR_CanNm/BswModuleEntrys/CanNm_MultipleNetworkOperations</BSW-MODULE-ENTRY-REF>
                </BSW-MODULE-ENTRY-REF-CONDITIONAL>
[!ENDIF!]                

[!IF "$SynchronizedPncShutdownEnabled = 'true'"!]
                <BSW-MODULE-ENTRY-REF-CONDITIONAL>
                  <BSW-MODULE-ENTRY-REF DEST="BSW-MODULE-ENTRY">/AUTOSAR_CanNm/BswModuleEntrys/CanNm_RequestSynchronizedPncShutdown_Nm_To_CanNm_RcvFnct</BSW-MODULE-ENTRY-REF>
                </BSW-MODULE-ENTRY-REF-CONDITIONAL>

                <BSW-MODULE-ENTRY-REF-CONDITIONAL>
                  <BSW-MODULE-ENTRY-REF DEST="BSW-MODULE-ENTRY">/AUTOSAR_CanNm/BswModuleEntrys/CanNm_ForwardSynchronizedPncShutdown_CanNm_To_Nm_DataSntFnct</BSW-MODULE-ENTRY-REF>
                </BSW-MODULE-ENTRY-REF-CONDITIONAL>
[!ENDIF!]

[!ENDIF!][!//
              </PROVIDED-ENTRYS>
[!IF "node:existsAndTrue(CanNmGeneral/CanNmMultiCoreSupport)"!]

              <PROVIDED-CLIENT-SERVER-ENTRYS>
[!LOOP "as:modconf('CanNm')[1]/CanNmGlobalConfig/eb-list::*[1]/CanNmChannelConfig/eb-list::*"!]
[!IF "node:existsAndFalse(as:modconf('CanNm')[1]/CanNmGeneral/CanNmMultiCoreUseSingleCS)"!]
                <BSW-MODULE-CLIENT-SERVER-ENTRY>
                  <SHORT-NAME>ProvidedCSEntry_CanNm_PassiveStartUp_[!"node:name(.)"!]</SHORT-NAME>
                  <ENCAPSULATED-ENTRY-REF DEST="BSW-MODULE-ENTRY">/AUTOSAR_CanNm/BswModuleEntrys/CanNm_PassiveStartUp</ENCAPSULATED-ENTRY-REF>
                  <IS-REENTRANT>true</IS-REENTRANT>
                  <IS-SYNCHRONOUS>false</IS-SYNCHRONOUS>
                </BSW-MODULE-CLIENT-SERVER-ENTRY>
[!ENDIF!]

[!IF "node:existsAndTrue(as:modconf('CanNm')[1]/CanNmGeneral/CanNmMultiCoreUseSingleCS)"!]
                <BSW-MODULE-CLIENT-SERVER-ENTRY>
                  <SHORT-NAME>ProvidedCSEntry_CanNm_MultipleNetworkOperations_[!"node:name(.)"!]</SHORT-NAME>
                  <ENCAPSULATED-ENTRY-REF DEST="BSW-MODULE-ENTRY">/AUTOSAR_CanNm/BswModuleEntrys/CanNm_MultipleNetworkOperations</ENCAPSULATED-ENTRY-REF>
                  <IS-REENTRANT>true</IS-REENTRANT>
                  <IS-SYNCHRONOUS>false</IS-SYNCHRONOUS>
                </BSW-MODULE-CLIENT-SERVER-ENTRY>
[!ENDIF!]
[!IF "node:existsAndFalse(as:modconf('CanNm')[1]/CanNmGeneral/CanNmMultiCoreUseSingleCS)"!]
[!IF "node:existsAndFalse(as:modconf('CanNm')[1]/CanNmGlobalConfig/eb-list::*[1]/CanNmPassiveModeEnabled)"!]
                <BSW-MODULE-CLIENT-SERVER-ENTRY>
                  <SHORT-NAME>ProvidedCSEntry_CanNm_NetworkRequest_[!"node:name(.)"!]</SHORT-NAME>
                  <ENCAPSULATED-ENTRY-REF DEST="BSW-MODULE-ENTRY">/AUTOSAR_CanNm/BswModuleEntrys/CanNm_NetworkRequest</ENCAPSULATED-ENTRY-REF>
                  <IS-REENTRANT>true</IS-REENTRANT>
                  <IS-SYNCHRONOUS>false</IS-SYNCHRONOUS>
                </BSW-MODULE-CLIENT-SERVER-ENTRY>
[!ENDIF!]
[!ENDIF!]
[!IF "node:existsAndFalse(as:modconf('CanNm')[1]/CanNmGeneral/CanNmMultiCoreUseSingleCS)"!]
[!IF "node:existsAndFalse(as:modconf('CanNm')[1]/CanNmGlobalConfig/eb-list::*[1]/CanNmPassiveModeEnabled)"!]
                <BSW-MODULE-CLIENT-SERVER-ENTRY>
                  <SHORT-NAME>ProvidedCSEntry_CanNm_NetworkGwEraRequest_[!"node:name(.)"!]</SHORT-NAME>
                  <ENCAPSULATED-ENTRY-REF DEST="BSW-MODULE-ENTRY">/AUTOSAR_CanNm/BswModuleEntrys/CanNm_NetworkGwEraRequest</ENCAPSULATED-ENTRY-REF>
                  <IS-REENTRANT>true</IS-REENTRANT>
                  <IS-SYNCHRONOUS>false</IS-SYNCHRONOUS>
                </BSW-MODULE-CLIENT-SERVER-ENTRY>
[!ENDIF!]
[!ENDIF!]

[!IF "node:existsAndFalse(as:modconf('CanNm')[1]/CanNmGeneral/CanNmMultiCoreUseSingleCS)"!]
[!IF "node:existsAndFalse(as:modconf('CanNm')[1]/CanNmGlobalConfig/eb-list::*[1]/CanNmPassiveModeEnabled)"!]
                <BSW-MODULE-CLIENT-SERVER-ENTRY>
                  <SHORT-NAME>ProvidedCSEntry_CanNm_NetworkRelease_[!"node:name(.)"!]</SHORT-NAME>
                  <ENCAPSULATED-ENTRY-REF DEST="BSW-MODULE-ENTRY">/AUTOSAR_CanNm/BswModuleEntrys/CanNm_NetworkRelease</ENCAPSULATED-ENTRY-REF>
                  <IS-REENTRANT>true</IS-REENTRANT>
                  <IS-SYNCHRONOUS>false</IS-SYNCHRONOUS>
                </BSW-MODULE-CLIENT-SERVER-ENTRY>
[!ENDIF!]
[!ENDIF!]

[!IF "node:existsAndTrue(as:modconf('CanNm')[1]/CanNmGlobalConfig/eb-list::*[1]/CanNmBusSynchronizationEnabled)"!]
                <BSW-MODULE-CLIENT-SERVER-ENTRY>
                  <SHORT-NAME>ProvidedCSEntry_CanNm_RequestBusSynchronization_[!"node:name(.)"!]</SHORT-NAME>
                  <ENCAPSULATED-ENTRY-REF DEST="BSW-MODULE-ENTRY">/AUTOSAR_CanNm/BswModuleEntrys/CanNm_RequestBusSynchronization</ENCAPSULATED-ENTRY-REF>
                  <IS-REENTRANT>false</IS-REENTRANT>
                  <IS-SYNCHRONOUS>true</IS-SYNCHRONOUS>
                </BSW-MODULE-CLIENT-SERVER-ENTRY>
[!ENDIF!]
[!ENDLOOP!]

              </PROVIDED-CLIENT-SERVER-ENTRYS>
[!ENDIF!][!//

[!IF "node:existsAndTrue(CanNmGeneral/CanNmMultiCoreSupport)"!]

              <REQUIRED-CLIENT-SERVER-ENTRYS>
[!LOOP "as:modconf('CanNm')[1]/CanNmGlobalConfig/eb-list::*[1]/CanNmChannelConfig/eb-list::*"!]
                <BSW-MODULE-CLIENT-SERVER-ENTRY>
                  <SHORT-NAME>RequiredCSEntry_Nm_NetworkStartIndication_[!"node:name(.)"!]</SHORT-NAME>
                  <ENCAPSULATED-ENTRY-REF DEST="BSW-MODULE-ENTRY">/AUTOSAR_CanNm/BswModuleEntrys/CanNm_MainFunction</ENCAPSULATED-ENTRY-REF>
                  <IS-SYNCHRONOUS>false</IS-SYNCHRONOUS>
                </BSW-MODULE-CLIENT-SERVER-ENTRY>

                <BSW-MODULE-CLIENT-SERVER-ENTRY>
                  <SHORT-NAME>RequiredCSEntry_Nm_NetworkMode_[!"node:name(.)"!]</SHORT-NAME>
                  <ENCAPSULATED-ENTRY-REF DEST="BSW-MODULE-ENTRY">/AUTOSAR_CanNm/BswModuleEntrys/CanNm_MainFunction</ENCAPSULATED-ENTRY-REF>
                  <IS-SYNCHRONOUS>false</IS-SYNCHRONOUS>
                </BSW-MODULE-CLIENT-SERVER-ENTRY>

                <BSW-MODULE-CLIENT-SERVER-ENTRY>
                  <SHORT-NAME>RequiredCSEntry_Nm_BusSleepMode_[!"node:name(.)"!]</SHORT-NAME>
                  <ENCAPSULATED-ENTRY-REF DEST="BSW-MODULE-ENTRY">/AUTOSAR_CanNm/BswModuleEntrys/CanNm_MainFunction</ENCAPSULATED-ENTRY-REF>
                  <IS-SYNCHRONOUS>false</IS-SYNCHRONOUS>
                </BSW-MODULE-CLIENT-SERVER-ENTRY>

                <BSW-MODULE-CLIENT-SERVER-ENTRY>
                  <SHORT-NAME>RequiredCSEntry_Nm_PrepareBusSleepMode_[!"node:name(.)"!]</SHORT-NAME>
                  <ENCAPSULATED-ENTRY-REF DEST="BSW-MODULE-ENTRY">/AUTOSAR_CanNm/BswModuleEntrys/CanNm_MainFunction</ENCAPSULATED-ENTRY-REF>
                  <IS-SYNCHRONOUS>false</IS-SYNCHRONOUS>
                </BSW-MODULE-CLIENT-SERVER-ENTRY>

[!IF "node:existsAndTrue(as:modconf('CanNm')[1]/CanNmGlobalConfig/eb-list::*[1]/CanNmRemoteSleepIndEnabled)"!]
                <BSW-MODULE-CLIENT-SERVER-ENTRY>
                  <SHORT-NAME>RequiredCSEntry_Nm_RemoteSleepIndication_[!"node:name(.)"!]</SHORT-NAME>
                  <ENCAPSULATED-ENTRY-REF DEST="BSW-MODULE-ENTRY">/AUTOSAR_CanNm/BswModuleEntrys/CanNm_MainFunction</ENCAPSULATED-ENTRY-REF>
                  <IS-SYNCHRONOUS>false</IS-SYNCHRONOUS>
                </BSW-MODULE-CLIENT-SERVER-ENTRY>
[!ENDIF!]

[!IF "node:existsAndTrue(as:modconf('CanNm')[1]/CanNmGlobalConfig/eb-list::*[1]/CanNmRemoteSleepIndEnabled)"!]
                <BSW-MODULE-CLIENT-SERVER-ENTRY>
                  <SHORT-NAME>RequiredCSEntry_Nm_RemoteSleepCancellation_[!"node:name(.)"!]</SHORT-NAME>
                  <ENCAPSULATED-ENTRY-REF DEST="BSW-MODULE-ENTRY">/AUTOSAR_CanNm/BswModuleEntrys/CanNm_MainFunction</ENCAPSULATED-ENTRY-REF>
                  <IS-SYNCHRONOUS>false</IS-SYNCHRONOUS>
                </BSW-MODULE-CLIENT-SERVER-ENTRY>
[!ENDIF!]

[!IF "node:existsAndTrue(as:modconf('CanNm')[1]/CanNmGlobalConfig/eb-list::*[1]/CanNmPduRxIndicationEnabled)"!]
                <BSW-MODULE-CLIENT-SERVER-ENTRY>
                  <SHORT-NAME>RequiredCSEntry_Nm_PduRxIndication_[!"node:name(.)"!]</SHORT-NAME>
                  <ENCAPSULATED-ENTRY-REF DEST="BSW-MODULE-ENTRY">/AUTOSAR_CanNm/BswModuleEntrys/CanNm_MainFunction</ENCAPSULATED-ENTRY-REF>
                  <IS-SYNCHRONOUS>false</IS-SYNCHRONOUS>
                </BSW-MODULE-CLIENT-SERVER-ENTRY>
[!ENDIF!]

[!IF "node:existsAndTrue(as:modconf('CanNm')[1]/CanNmGlobalConfig/eb-list::*[1]/CanNmStateChangeIndEnabled)"!]
                <BSW-MODULE-CLIENT-SERVER-ENTRY>
                  <SHORT-NAME>RequiredCSEntry_Nm_StateChangeNotification_[!"node:name(.)"!]</SHORT-NAME>
                  <ENCAPSULATED-ENTRY-REF DEST="BSW-MODULE-ENTRY">/AUTOSAR_CanNm/BswModuleEntrys/CanNm_MainFunction</ENCAPSULATED-ENTRY-REF>
                  <IS-SYNCHRONOUS>false</IS-SYNCHRONOUS>
                </BSW-MODULE-CLIENT-SERVER-ENTRY>
[!ENDIF!]

[!IF "node:existsAndTrue(CanNmRepeatMsgIndEnabled)"!]
                <BSW-MODULE-CLIENT-SERVER-ENTRY>
                  <SHORT-NAME>RequiredCSEntry_Nm_RepeatMessageIndication_[!"node:name(.)"!]</SHORT-NAME>
                  <ENCAPSULATED-ENTRY-REF DEST="BSW-MODULE-ENTRY">/AUTOSAR_CanNm/BswModuleEntrys/CanNm_Dummy_RxIndication</ENCAPSULATED-ENTRY-REF>
                  <IS-SYNCHRONOUS>false</IS-SYNCHRONOUS>
                </BSW-MODULE-CLIENT-SERVER-ENTRY>
[!ENDIF!]

[!IF "(node:existsAndFalse(as:modconf('CanNm')[1]/CanNmGlobalConfig/eb-list::*[1]/CanNmPassiveModeEnabled)) and
      (node:existsAndFalse(as:modconf('CanNm')[1]/CanNmGlobalConfig/eb-list::*[1]/CanNmImmediateTxconfEnabled))"!]
                <BSW-MODULE-CLIENT-SERVER-ENTRY>
                  <SHORT-NAME>RequiredCSEntry_Nm_TxTimeoutException_[!"node:name(.)"!]</SHORT-NAME>
                  <ENCAPSULATED-ENTRY-REF DEST="BSW-MODULE-ENTRY">/AUTOSAR_CanNm/BswModuleEntrys/CanNm_MainFunction</ENCAPSULATED-ENTRY-REF>
                  <IS-SYNCHRONOUS>false</IS-SYNCHRONOUS>
                </BSW-MODULE-CLIENT-SERVER-ENTRY>
[!ENDIF!]

[!IF "node:existsAndTrue(CanNmCarWakeUpRxEnabled)"!]
                <BSW-MODULE-CLIENT-SERVER-ENTRY>
                  <SHORT-NAME>RequiredCSEntry_Nm_CarWakeUpIndication_[!"node:name(.)"!]</SHORT-NAME>
                  <ENCAPSULATED-ENTRY-REF DEST="BSW-MODULE-ENTRY">/AUTOSAR_CanNm/BswModuleEntrys/CanNm_Dummy_RxIndication</ENCAPSULATED-ENTRY-REF>
                  <IS-SYNCHRONOUS>false</IS-SYNCHRONOUS>
                </BSW-MODULE-CLIENT-SERVER-ENTRY>
[!ENDIF!]
[!ENDLOOP!]
              </REQUIRED-CLIENT-SERVER-ENTRYS>

[!IF "$SynchronizedPncShutdownEnabled = 'true'"!][!//
              <PROVIDED-DATAS>
                <VARIABLE-DATA-PROTOTYPE>
                  <SHORT-NAME>CanNm_ForwardSynchronizedPncShutdown_CanNm_To_Nm_DataSet</SHORT-NAME>
                  <TYPE-TREF DEST="IMPLEMENTATION-DATA-TYPE">/AUTOSAR_Nm/ImplementationDataTypes/Nm_PnSyncShutdown_BusNm_To_Nm_DataType</TYPE-TREF>
                </VARIABLE-DATA-PROTOTYPE>
              </PROVIDED-DATAS>

              <REQUIRED-DATAS>
                <VARIABLE-DATA-PROTOTYPE>
                  <SHORT-NAME>CanNm_RequestSynchronizedPncShutdown_Nm_To_CanNm_DataGet</SHORT-NAME>
                  <TYPE-TREF DEST="IMPLEMENTATION-DATA-TYPE">/AUTOSAR_Nm/ImplementationDataTypes/Nm_PnSyncShutdown_Nm_To_BusNm_DataType</TYPE-TREF>
                </VARIABLE-DATA-PROTOTYPE>
              </REQUIRED-DATAS>
[!ENDIF!][!//

[!ENDIF!][!//

              <INTERNAL-BEHAVIORS>
                <BSW-INTERNAL-BEHAVIOR>
                  <SHORT-NAME>InternalBehavior_0</SHORT-NAME>
                  <EXCLUSIVE-AREAS>
                    <EXCLUSIVE-AREA>
                      <!-- !LINKSTO CanNm.EB.BSWMDGeneration.1,1 -->
                      <SHORT-NAME>SCHM_CANNM_EXCLUSIVE_AREA_0</SHORT-NAME>
                    </EXCLUSIVE-AREA>
                  </EXCLUSIVE-AREAS>
                  <STATIC-MEMORYS>
[!FOR "ChannelIndex"="0" TO "num:i($VAR_CANNM_NUMBER_OF_CHANNELS)-1"!][!//
                    <VARIABLE-DATA-PROTOTYPE>
                      <SHORT-NAME>CanNm_HsmInstCanNm_StateId_[!"$ChannelIndex"!]</SHORT-NAME>
                        <ADMIN-DATA>
                          <SDGS>
                            <SDG GID="EB:DnT">
                              <SD GID="StateGroup">CanNm_HsmInstCanNm_StateId</SD>
                              <SD GID="StateId">[!"$ChannelIndex"!]</SD>
                              <SD GID="EnableTracing">true</SD>
                            </SDG>
                          </SDGS>
                        </ADMIN-DATA>
                      <SW-DATA-DEF-PROPS>
                        <SW-DATA-DEF-PROPS-VARIANTS>
                          <SW-DATA-DEF-PROPS-CONDITIONAL>
                            <SW-IMPL-POLICY>STANDARD</SW-IMPL-POLICY>
                          </SW-DATA-DEF-PROPS-CONDITIONAL>
                        </SW-DATA-DEF-PROPS-VARIANTS>
                      </SW-DATA-DEF-PROPS>
                      <TYPE-TREF DEST="IMPLEMENTATION-DATA-TYPE">/AUTOSAR_CanNm/ImplementationDataTypes/CanNm_HsmStateIdxType</TYPE-TREF>
                    </VARIABLE-DATA-PROTOTYPE>
[!ENDFOR!][!//
                  </STATIC-MEMORYS>
[!IF "node:existsAndTrue(CanNmGeneral/CanNmMultiCoreSupport)"!]
                  <INTERNAL-TRIGGERING-POINTS>
[!LOOP "as:modconf('CanNm')[1]/CanNmGlobalConfig/eb-list::*[1]/CanNmChannelConfig/eb-list::*"!]
[!IF "(node:existsAndTrue(CanNmRepeatMsgIndEnabled)) or (node:existsAndTrue(CanNmCarWakeUpRxEnabled))"!]
                    <BSW-INTERNAL-TRIGGERING-POINT>
                      <SHORT-NAME>TriggeringPoint_RxIndication_[!"node:name(.)"!]</SHORT-NAME>
                    </BSW-INTERNAL-TRIGGERING-POINT>
[!ENDIF!]
[!ENDLOOP!]
                  </INTERNAL-TRIGGERING-POINTS>
[!ENDIF!][!//
                  <ENTITYS>
                    <BSW-SCHEDULABLE-ENTITY>
                      <SHORT-NAME>CanNm_MainFunction</SHORT-NAME>
                      <CAN-ENTER-EXCLUSIVE-AREA-REFS>
                        <CAN-ENTER-EXCLUSIVE-AREA-REF DEST="EXCLUSIVE-AREA">/AUTOSAR_CanNm/BswModuleDescriptions/CanNm/InternalBehavior_0/SCHM_CANNM_EXCLUSIVE_AREA_0</CAN-ENTER-EXCLUSIVE-AREA-REF>
                      </CAN-ENTER-EXCLUSIVE-AREA-REFS>
                      <MINIMUM-START-INTERVAL>0.0</MINIMUM-START-INTERVAL>
                      <CALL-POINTS>
[!IF "node:existsAndTrue(CanNmGeneral/CanNmMultiCoreSupport)"!]
[!LOOP "as:modconf('CanNm')[1]/CanNmGlobalConfig/eb-list::*[1]/CanNmChannelConfig/eb-list::*"!]
                        <BSW-ASYNCHRONOUS-SERVER-CALL-POINT>
                          <SHORT-NAME>AsynchCallPoint_Nm_NetworkStartIndication_[!"node:name(.)"!]</SHORT-NAME>
                          <CALLED-ENTRY-REF DEST="BSW-MODULE-CLIENT-SERVER-ENTRY">/AUTOSAR_CanNm/BswModuleDescriptions/CanNm/RequiredCSEntry_Nm_NetworkStartIndication_[!"node:name(.)"!]</CALLED-ENTRY-REF>
                        </BSW-ASYNCHRONOUS-SERVER-CALL-POINT>
                        <BSW-ASYNCHRONOUS-SERVER-CALL-POINT>
                          <SHORT-NAME>AsynchCallPoint_Nm_NetworkMode_[!"node:name(.)"!]</SHORT-NAME>
                          <CALLED-ENTRY-REF DEST="BSW-MODULE-CLIENT-SERVER-ENTRY">/AUTOSAR_CanNm/BswModuleDescriptions/CanNm/RequiredCSEntry_Nm_NetworkMode_[!"node:name(.)"!]</CALLED-ENTRY-REF>
                        </BSW-ASYNCHRONOUS-SERVER-CALL-POINT>
                        <BSW-ASYNCHRONOUS-SERVER-CALL-POINT>
                          <SHORT-NAME>AsynchCallPoint_Nm_BusSleepMode_[!"node:name(.)"!]</SHORT-NAME>
                          <CALLED-ENTRY-REF DEST="BSW-MODULE-CLIENT-SERVER-ENTRY">/AUTOSAR_CanNm/BswModuleDescriptions/CanNm/RequiredCSEntry_Nm_BusSleepMode_[!"node:name(.)"!]</CALLED-ENTRY-REF>
                        </BSW-ASYNCHRONOUS-SERVER-CALL-POINT>
                        <BSW-ASYNCHRONOUS-SERVER-CALL-POINT>
                          <SHORT-NAME>AsynchCallPoint_Nm_PrepareBusSleepMode_[!"node:name(.)"!]</SHORT-NAME>
                          <CALLED-ENTRY-REF DEST="BSW-MODULE-CLIENT-SERVER-ENTRY">/AUTOSAR_CanNm/BswModuleDescriptions/CanNm/RequiredCSEntry_Nm_PrepareBusSleepMode_[!"node:name(.)"!]</CALLED-ENTRY-REF>
                        </BSW-ASYNCHRONOUS-SERVER-CALL-POINT>
[!IF "node:existsAndTrue(as:modconf('CanNm')[1]/CanNmGlobalConfig/eb-list::*[1]/CanNmRemoteSleepIndEnabled)"!]
                        <BSW-ASYNCHRONOUS-SERVER-CALL-POINT>
                          <SHORT-NAME>AsynchCallPoint_Nm_RemoteSleepIndication_[!"node:name(.)"!]</SHORT-NAME>
                          <CALLED-ENTRY-REF DEST="BSW-MODULE-CLIENT-SERVER-ENTRY">/AUTOSAR_CanNm/BswModuleDescriptions/CanNm/RequiredCSEntry_Nm_RemoteSleepIndication_[!"node:name(.)"!]</CALLED-ENTRY-REF>
                        </BSW-ASYNCHRONOUS-SERVER-CALL-POINT>
[!ENDIF!]
[!IF "node:existsAndTrue(as:modconf('CanNm')[1]/CanNmGlobalConfig/eb-list::*[1]/CanNmRemoteSleepIndEnabled)"!]
                        <BSW-ASYNCHRONOUS-SERVER-CALL-POINT>
                          <SHORT-NAME>AsynchCallPoint_Nm_RemoteSleepCancellation_[!"node:name(.)"!]</SHORT-NAME>
                          <CALLED-ENTRY-REF DEST="BSW-MODULE-CLIENT-SERVER-ENTRY">/AUTOSAR_CanNm/BswModuleDescriptions/CanNm/RequiredCSEntry_Nm_RemoteSleepCancellation_[!"node:name(.)"!]</CALLED-ENTRY-REF>
                        </BSW-ASYNCHRONOUS-SERVER-CALL-POINT>
[!ENDIF!]
[!IF "node:existsAndTrue(as:modconf('CanNm')[1]/CanNmGlobalConfig/eb-list::*[1]/CanNmPduRxIndicationEnabled)"!]
                        <BSW-ASYNCHRONOUS-SERVER-CALL-POINT>
                          <SHORT-NAME>AsynchCallPoint_Nm_PduRxIndication_[!"node:name(.)"!]</SHORT-NAME>
                          <CALLED-ENTRY-REF DEST="BSW-MODULE-CLIENT-SERVER-ENTRY">/AUTOSAR_CanNm/BswModuleDescriptions/CanNm/RequiredCSEntry_Nm_PduRxIndication_[!"node:name(.)"!]</CALLED-ENTRY-REF>
                        </BSW-ASYNCHRONOUS-SERVER-CALL-POINT>
[!ENDIF!]
[!IF "(node:existsAndFalse(as:modconf('CanNm')[1]/CanNmGlobalConfig/eb-list::*[1]/CanNmPassiveModeEnabled)) and
      (node:existsAndFalse(as:modconf('CanNm')[1]/CanNmGlobalConfig/eb-list::*[1]/CanNmImmediateTxconfEnabled))"!]
                        <BSW-ASYNCHRONOUS-SERVER-CALL-POINT>
                          <SHORT-NAME>AsynchCallPoint_Nm_TxTimeoutException_[!"node:name(.)"!]</SHORT-NAME>
                          <CALLED-ENTRY-REF DEST="BSW-MODULE-CLIENT-SERVER-ENTRY">/AUTOSAR_CanNm/BswModuleDescriptions/CanNm/RequiredCSEntry_Nm_TxTimeoutException_[!"node:name(.)"!]</CALLED-ENTRY-REF>
                        </BSW-ASYNCHRONOUS-SERVER-CALL-POINT>
[!ENDIF!]
[!IF "node:existsAndTrue(as:modconf('CanNm')[1]/CanNmGlobalConfig/eb-list::*[1]/CanNmStateChangeIndEnabled)"!]
                        <BSW-ASYNCHRONOUS-SERVER-CALL-POINT>
                          <SHORT-NAME>AsynchCallPoint_Nm_StateChangeNotification_[!"node:name(.)"!]</SHORT-NAME>
                          <CALLED-ENTRY-REF DEST="BSW-MODULE-CLIENT-SERVER-ENTRY">/AUTOSAR_CanNm/BswModuleDescriptions/CanNm/RequiredCSEntry_Nm_StateChangeNotification_[!"node:name(.)"!]</CALLED-ENTRY-REF>
                        </BSW-ASYNCHRONOUS-SERVER-CALL-POINT>
[!ENDIF!]
[!ENDLOOP!]
[!ENDIF!][!//
                      </CALL-POINTS>
                      <IMPLEMENTED-ENTRY-REF DEST="BSW-MODULE-ENTRY">/AUTOSAR_CanNm/BswModuleEntrys/CanNm_MainFunction</IMPLEMENTED-ENTRY-REF>
                    </BSW-SCHEDULABLE-ENTITY>

[!IF "node:existsAndTrue(CanNmGeneral/CanNmMultiCoreSupport)"!]
[!LOOP "as:modconf('CanNm')[1]/CanNmGlobalConfig/eb-list::*[1]/CanNmChannelConfig/eb-list::*"!]
[!IF "(node:existsAndTrue(CanNmRepeatMsgIndEnabled)) or (node:existsAndTrue(CanNmCarWakeUpRxEnabled))"!]
                    <!-- dummy context for Rx Indication used-->
                    <BSW-SCHEDULABLE-ENTITY>
                      <SHORT-NAME>Entity_Nm_RxInidcation_[!"node:name(.)"!]</SHORT-NAME>
                      <MINIMUM-START-INTERVAL>0.0</MINIMUM-START-INTERVAL>
                      <CALL-POINTS>
[!IF "node:existsAndTrue(CanNmRepeatMsgIndEnabled)"!]
                        <BSW-ASYNCHRONOUS-SERVER-CALL-POINT>
                          <SHORT-NAME>AsynchCallPoint_Nm_RepeatMessageIndication_[!"node:name(.)"!]</SHORT-NAME>
                          <CALLED-ENTRY-REF DEST="BSW-MODULE-CLIENT-SERVER-ENTRY">/AUTOSAR_CanNm/BswModuleDescriptions/CanNm/RequiredCSEntry_Nm_RepeatMessageIndication_[!"node:name(.)"!]</CALLED-ENTRY-REF>
                        </BSW-ASYNCHRONOUS-SERVER-CALL-POINT>
[!ENDIF!]
[!IF "node:existsAndTrue(CanNmCarWakeUpRxEnabled)"!]
                        <BSW-ASYNCHRONOUS-SERVER-CALL-POINT>
                          <SHORT-NAME>AsynchCallPoint_Nm_CarWakeUpIndication_[!"node:name(.)"!]</SHORT-NAME>
                          <CALLED-ENTRY-REF DEST="BSW-MODULE-CLIENT-SERVER-ENTRY">/AUTOSAR_CanNm/BswModuleDescriptions/CanNm/RequiredCSEntry_Nm_CarWakeUpIndication_[!"node:name(.)"!]</CALLED-ENTRY-REF>
                        </BSW-ASYNCHRONOUS-SERVER-CALL-POINT>
[!ENDIF!]
                      </CALL-POINTS>
                      <IMPLEMENTED-ENTRY-REF DEST="BSW-MODULE-ENTRY">/AUTOSAR_CanNm/BswModuleEntrys/CanNm_Dummy_RxIndication</IMPLEMENTED-ENTRY-REF>
                    </BSW-SCHEDULABLE-ENTITY>
[!ENDIF!]
[!ENDLOOP!]
[!IF "$SynchronizedPncShutdownEnabled = 'true'"!][!//
                    <BSW-SCHEDULABLE-ENTITY>
                      <SHORT-NAME>BswSchEnt_CanNm_RequestSynchronizedPncShutdown_Nm_To_CanNm_RcvFnct</SHORT-NAME>
                      <CAN-ENTER-EXCLUSIVE-AREA-REFS>
                        <CAN-ENTER-EXCLUSIVE-AREA-REF DEST="EXCLUSIVE-AREA">/AUTOSAR_CanNm/BswModuleDescriptions/CanNm/InternalBehavior_0/SCHM_CANNM_EXCLUSIVE_AREA_0</CAN-ENTER-EXCLUSIVE-AREA-REF>
                      </CAN-ENTER-EXCLUSIVE-AREA-REFS>
                      <MINIMUM-START-INTERVAL>0.0</MINIMUM-START-INTERVAL>
                      <DATA-RECEIVE-POINTS>
                        <BSW-VARIABLE-ACCESS>
                          <SHORT-NAME>BswVarAccess_CanNm_RequestSynchronizedPncShutdown_Nm_To_CanNm_DataGet</SHORT-NAME>
                          <ACCESSED-VARIABLE-REF DEST="VARIABLE-DATA-PROTOTYPE">/AUTOSAR_CanNm/BswModuleDescriptions/CanNm/CanNm_RequestSynchronizedPncShutdown_Nm_To_CanNm_DataGet</ACCESSED-VARIABLE-REF>
                        </BSW-VARIABLE-ACCESS>
                      </DATA-RECEIVE-POINTS>
                      <IMPLEMENTED-ENTRY-REF DEST="BSW-MODULE-ENTRY">/AUTOSAR_CanNm/BswModuleEntrys/CanNm_RequestSynchronizedPncShutdown_Nm_To_CanNm_RcvFnct</IMPLEMENTED-ENTRY-REF>
                    </BSW-SCHEDULABLE-ENTITY>
[!ENDIF!][!//
[!ENDIF!][!//
[!IF "node:existsAndTrue(CanNmGeneral/CanNmMultiCoreSupport)"!]
[!LOOP "as:modconf('CanNm')[1]/CanNmGlobalConfig/eb-list::*[1]/CanNmChannelConfig/eb-list::*"!]
[!IF "node:existsAndFalse(as:modconf('CanNm')[1]/CanNmGeneral/CanNmMultiCoreUseSingleCS)"!]
                    <BSW-CALLED-ENTITY>
                      <SHORT-NAME>CanNm_PassiveStartUp_CalledEntity_[!"node:name(.)"!]</SHORT-NAME>
                      <MINIMUM-START-INTERVAL>0.0</MINIMUM-START-INTERVAL>
                      <IMPLEMENTED-ENTRY-REF DEST="BSW-MODULE-ENTRY">/AUTOSAR_CanNm/BswModuleEntrys/CanNm_PassiveStartUp</IMPLEMENTED-ENTRY-REF>
                    </BSW-CALLED-ENTITY>
[!ENDIF!]                    

[!IF "node:existsAndTrue(as:modconf('CanNm')[1]/CanNmGeneral/CanNmMultiCoreUseSingleCS)"!]
                    <BSW-CALLED-ENTITY>
                      <SHORT-NAME>CanNm_MultipleNetworkOperations_CalledEntity_[!"node:name(.)"!]</SHORT-NAME>
                      <MINIMUM-START-INTERVAL>0.0</MINIMUM-START-INTERVAL>
                      <IMPLEMENTED-ENTRY-REF DEST="BSW-MODULE-ENTRY">/AUTOSAR_CanNm/BswModuleEntrys/CanNm_MultipleNetworkOperations</IMPLEMENTED-ENTRY-REF>
                    </BSW-CALLED-ENTITY>
[!ENDIF!]                    

[!IF "node:existsAndFalse(as:modconf('CanNm')[1]/CanNmGeneral/CanNmMultiCoreUseSingleCS)"!]
[!IF "node:existsAndFalse(as:modconf('CanNm')[1]/CanNmGlobalConfig/eb-list::*[1]/CanNmPassiveModeEnabled)"!]
                    <BSW-CALLED-ENTITY>
                      <SHORT-NAME>CanNm_NetworkRequest_CalledEntity_[!"node:name(.)"!]</SHORT-NAME>
                      <MINIMUM-START-INTERVAL>0.0</MINIMUM-START-INTERVAL>
                      <IMPLEMENTED-ENTRY-REF DEST="BSW-MODULE-ENTRY">/AUTOSAR_CanNm/BswModuleEntrys/CanNm_NetworkRequest</IMPLEMENTED-ENTRY-REF>
                    </BSW-CALLED-ENTITY>
[!ENDIF!]
[!ENDIF!]

[!IF "node:existsAndFalse(as:modconf('CanNm')[1]/CanNmGeneral/CanNmMultiCoreUseSingleCS)"!]
[!IF "node:existsAndFalse(as:modconf('CanNm')[1]/CanNmGlobalConfig/eb-list::*[1]/CanNmPassiveModeEnabled)"!]
                    <BSW-CALLED-ENTITY>
                      <SHORT-NAME>CanNm_NetworkGwEraRequest_CalledEntity_[!"node:name(.)"!]</SHORT-NAME>
                      <MINIMUM-START-INTERVAL>0.0</MINIMUM-START-INTERVAL>
                      <IMPLEMENTED-ENTRY-REF DEST="BSW-MODULE-ENTRY">/AUTOSAR_CanNm/BswModuleEntrys/CanNm_NetworkGwEraRequest</IMPLEMENTED-ENTRY-REF>
                    </BSW-CALLED-ENTITY>
[!ENDIF!]
[!ENDIF!]

[!IF "node:existsAndFalse(as:modconf('CanNm')[1]/CanNmGeneral/CanNmMultiCoreUseSingleCS)"!]
[!IF "node:existsAndFalse(as:modconf('CanNm')[1]/CanNmGlobalConfig/eb-list::*[1]/CanNmPassiveModeEnabled)"!]
                    <BSW-CALLED-ENTITY>
                      <SHORT-NAME>CanNm_NetworkRelease_CalledEntity_[!"node:name(.)"!]</SHORT-NAME>
                      <MINIMUM-START-INTERVAL>0.0</MINIMUM-START-INTERVAL>
                      <IMPLEMENTED-ENTRY-REF DEST="BSW-MODULE-ENTRY">/AUTOSAR_CanNm/BswModuleEntrys/CanNm_NetworkRelease</IMPLEMENTED-ENTRY-REF>
                    </BSW-CALLED-ENTITY>
[!ENDIF!]
[!ENDIF!]

[!IF "node:existsAndTrue(as:modconf('CanNm')[1]/CanNmGlobalConfig/eb-list::*[1]/CanNmBusSynchronizationEnabled)"!]
                    <BSW-CALLED-ENTITY>
                      <SHORT-NAME>CanNm_RequestBusSynchronization_CalledEntity_[!"node:name(.)"!]</SHORT-NAME>
                      <MINIMUM-START-INTERVAL>0.0</MINIMUM-START-INTERVAL>
                      <IMPLEMENTED-ENTRY-REF DEST="BSW-MODULE-ENTRY">/AUTOSAR_CanNm/BswModuleEntrys/CanNm_RequestBusSynchronization</IMPLEMENTED-ENTRY-REF>
                    </BSW-CALLED-ENTITY>
[!ENDIF!]
[!ENDLOOP!]

[!IF "$SynchronizedPncShutdownEnabled = 'true'"!][!//
                    <BSW-CALLED-ENTITY>
                      <SHORT-NAME>BswCalledEnt_CanNm_ForwardSynchronizedPncShutdown_CanNm_To_Nm_DataSntFnct</SHORT-NAME>
                      <MINIMUM-START-INTERVAL>0.0</MINIMUM-START-INTERVAL>
                      <DATA-SEND-POINTS>
                        <BSW-VARIABLE-ACCESS>
                          <SHORT-NAME>BswVarAccess_CanNm_ForwardSynchronizedPncShutdown_CanNm_To_Nm_DataSet</SHORT-NAME>
                          <ACCESSED-VARIABLE-REF DEST="VARIABLE-DATA-PROTOTYPE">/AUTOSAR_CanNm/BswModuleDescriptions/CanNm/CanNm_ForwardSynchronizedPncShutdown_CanNm_To_Nm_DataSet</ACCESSED-VARIABLE-REF>
                        </BSW-VARIABLE-ACCESS>
                      </DATA-SEND-POINTS>
                      <IMPLEMENTED-ENTRY-REF DEST="BSW-MODULE-ENTRY">/AUTOSAR_CanNm/BswModuleEntrys/CanNm_ForwardSynchronizedPncShutdown_CanNm_To_Nm_DataSntFnct</IMPLEMENTED-ENTRY-REF>
                    </BSW-CALLED-ENTITY>
[!ENDIF!][!//
[!ENDIF!][!//
                  </ENTITYS>
                  <EVENTS>
                    <BSW-TIMING-EVENT>
                      <SHORT-NAME>TimingEvent_MainFunction</SHORT-NAME>
                      <STARTS-ON-EVENT-REF DEST="BSW-SCHEDULABLE-ENTITY">/AUTOSAR_CanNm/BswModuleDescriptions/CanNm/InternalBehavior_0/CanNm_MainFunction</STARTS-ON-EVENT-REF>
                      <PERIOD>[!"CanNmGlobalConfig/eb-list::*[1]/CanNmMainFunctionPeriod"!]</PERIOD>
                    </BSW-TIMING-EVENT>

[!IF "node:existsAndTrue(CanNmGeneral/CanNmMultiCoreSupport)"!][!//
[!LOOP "as:modconf('CanNm')[1]/CanNmGlobalConfig/eb-list::*[1]/CanNmChannelConfig/eb-list::*"!][!//
[!IF "(node:existsAndTrue(CanNmRepeatMsgIndEnabled)) or (node:existsAndTrue(CanNmCarWakeUpRxEnabled))"!][!//
                    <BSW-INTERNAL-TRIGGER-OCCURRED-EVENT>
                      <SHORT-NAME>IntTrigggering_RxIndication_Event_[!"node:name(.)"!]</SHORT-NAME>
                      <STARTS-ON-EVENT-REF DEST="BSW-SCHEDULABLE-ENTITY">/AUTOSAR_CanNm/BswModuleDescriptions/CanNm/InternalBehavior_0/Entity_Nm_RxInidcation_[!"node:name(.)"!]</STARTS-ON-EVENT-REF>
                      <EVENT-SOURCE-REF DEST="BSW-INTERNAL-TRIGGERING-POINT">/AUTOSAR_CanNm/BswModuleDescriptions/CanNm/InternalBehavior_0/TriggeringPoint_RxIndication_[!"node:name(.)"!]</EVENT-SOURCE-REF>
                    </BSW-INTERNAL-TRIGGER-OCCURRED-EVENT>
[!ENDIF!][!//
[!IF "node:existsAndFalse(as:modconf('CanNm')[1]/CanNmGeneral/CanNmMultiCoreUseSingleCS)"!]
                    <BSW-OPERATION-INVOKED-EVENT>
                      <SHORT-NAME>OpInokedEv_CanNm_PassiveStartUp_[!"node:name(.)"!]</SHORT-NAME>
                      <STARTS-ON-EVENT-REF DEST="BSW-CALLED-ENTITY">/AUTOSAR_CanNm/BswModuleDescriptions/CanNm/InternalBehavior_0/CanNm_PassiveStartUp_CalledEntity_[!"node:name(.)"!]</STARTS-ON-EVENT-REF>
                      <ENTRY-REF DEST="BSW-MODULE-CLIENT-SERVER-ENTRY">/AUTOSAR_CanNm/BswModuleDescriptions/CanNm/ProvidedCSEntry_CanNm_PassiveStartUp_[!"node:name(.)"!]</ENTRY-REF>
                    </BSW-OPERATION-INVOKED-EVENT>
[!ENDIF!]
[!IF "node:existsAndTrue(as:modconf('CanNm')[1]/CanNmGeneral/CanNmMultiCoreUseSingleCS)"!]
                    <BSW-OPERATION-INVOKED-EVENT>
                      <SHORT-NAME>OpInokedEv_CanNm_MultipleNetworkOperations_[!"node:name(.)"!]</SHORT-NAME>
                      <STARTS-ON-EVENT-REF DEST="BSW-CALLED-ENTITY">/AUTOSAR_CanNm/BswModuleDescriptions/CanNm/InternalBehavior_0/CanNm_MultipleNetworkOperations_CalledEntity_[!"node:name(.)"!]</STARTS-ON-EVENT-REF>
                      <ENTRY-REF DEST="BSW-MODULE-CLIENT-SERVER-ENTRY">/AUTOSAR_CanNm/BswModuleDescriptions/CanNm/ProvidedCSEntry_CanNm_MultipleNetworkOperations_[!"node:name(.)"!]</ENTRY-REF>
                    </BSW-OPERATION-INVOKED-EVENT>
[!ENDIF!]
[!IF "node:existsAndFalse(as:modconf('CanNm')[1]/CanNmGeneral/CanNmMultiCoreUseSingleCS)"!]
[!IF "node:existsAndFalse(as:modconf('CanNm')[1]/CanNmGlobalConfig/eb-list::*[1]/CanNmPassiveModeEnabled)"!][!//
                    <BSW-OPERATION-INVOKED-EVENT>
                      <SHORT-NAME>OpInokedEv_CanNm_NetworkRequest_[!"node:name(.)"!]</SHORT-NAME>
                      <STARTS-ON-EVENT-REF DEST="BSW-CALLED-ENTITY">/AUTOSAR_CanNm/BswModuleDescriptions/CanNm/InternalBehavior_0/CanNm_NetworkRequest_CalledEntity_[!"node:name(.)"!]</STARTS-ON-EVENT-REF>
                      <ENTRY-REF DEST="BSW-MODULE-CLIENT-SERVER-ENTRY">/AUTOSAR_CanNm/BswModuleDescriptions/CanNm/ProvidedCSEntry_CanNm_NetworkRequest_[!"node:name(.)"!]</ENTRY-REF>
                    </BSW-OPERATION-INVOKED-EVENT>
[!ENDIF!][!//
[!ENDIF!]

[!IF "node:existsAndFalse(as:modconf('CanNm')[1]/CanNmGeneral/CanNmMultiCoreUseSingleCS)"!]
[!IF "node:existsAndFalse(as:modconf('CanNm')[1]/CanNmGlobalConfig/eb-list::*[1]/CanNmPassiveModeEnabled)"!][!//
                    <BSW-OPERATION-INVOKED-EVENT>
                      <SHORT-NAME>OpInokedEv_CanNm_NetworkGwEraRequest_[!"node:name(.)"!]</SHORT-NAME>
                      <STARTS-ON-EVENT-REF DEST="BSW-CALLED-ENTITY">/AUTOSAR_CanNm/BswModuleDescriptions/CanNm/InternalBehavior_0/CanNm_NetworkGwEraRequest_CalledEntity_[!"node:name(.)"!]</STARTS-ON-EVENT-REF>
                      <ENTRY-REF DEST="BSW-MODULE-CLIENT-SERVER-ENTRY">/AUTOSAR_CanNm/BswModuleDescriptions/CanNm/ProvidedCSEntry_CanNm_NetworkGwEraRequest_[!"node:name(.)"!]</ENTRY-REF>
                    </BSW-OPERATION-INVOKED-EVENT>
[!ENDIF!][!//
[!ENDIF!]

[!IF "node:existsAndFalse(as:modconf('CanNm')[1]/CanNmGeneral/CanNmMultiCoreUseSingleCS)"!]
[!IF "node:existsAndFalse(as:modconf('CanNm')[1]/CanNmGlobalConfig/eb-list::*[1]/CanNmPassiveModeEnabled)"!][!//
                    <BSW-OPERATION-INVOKED-EVENT>
                      <SHORT-NAME>OpInokedEv_CanNm_NetworkRelease_[!"node:name(.)"!]</SHORT-NAME>
                      <STARTS-ON-EVENT-REF DEST="BSW-CALLED-ENTITY">/AUTOSAR_CanNm/BswModuleDescriptions/CanNm/InternalBehavior_0/CanNm_NetworkRelease_CalledEntity_[!"node:name(.)"!]</STARTS-ON-EVENT-REF>
                      <ENTRY-REF DEST="BSW-MODULE-CLIENT-SERVER-ENTRY">/AUTOSAR_CanNm/BswModuleDescriptions/CanNm/ProvidedCSEntry_CanNm_NetworkRelease_[!"node:name(.)"!]</ENTRY-REF>
                    </BSW-OPERATION-INVOKED-EVENT>
[!ENDIF!][!//
[!ENDIF!]

[!IF "node:existsAndTrue(as:modconf('CanNm')[1]/CanNmGlobalConfig/eb-list::*[1]/CanNmBusSynchronizationEnabled)"!][!//
                    <BSW-OPERATION-INVOKED-EVENT>
                      <SHORT-NAME>OpInokedEv_CanNm_RequestBusSynchronization_[!"node:name(.)"!]</SHORT-NAME>
                      <STARTS-ON-EVENT-REF DEST="BSW-CALLED-ENTITY">/AUTOSAR_CanNm/BswModuleDescriptions/CanNm/InternalBehavior_0/CanNm_RequestBusSynchronization_CalledEntity_[!"node:name(.)"!]</STARTS-ON-EVENT-REF>
                      <ENTRY-REF DEST="BSW-MODULE-CLIENT-SERVER-ENTRY">/AUTOSAR_CanNm/BswModuleDescriptions/CanNm/ProvidedCSEntry_CanNm_RequestBusSynchronization_[!"node:name(.)"!]</ENTRY-REF>
                    </BSW-OPERATION-INVOKED-EVENT>
[!ENDIF!][!//

[!ENDLOOP!][!//
[!IF "$SynchronizedPncShutdownEnabled = 'true'"!][!//
                    <BSW-DATA-RECEIVED-EVENT>
                      <SHORT-NAME>CanNm_RequestSynchronizedPncShutdown_Nm_To_CanNm_RecEv</SHORT-NAME>
                      <STARTS-ON-EVENT-REF DEST="BSW-SCHEDULABLE-ENTITY">/AUTOSAR_CanNm/BswModuleDescriptions/CanNm/InternalBehavior_0/BswSchEnt_CanNm_RequestSynchronizedPncShutdown_Nm_To_CanNm_RcvFnct</STARTS-ON-EVENT-REF>
                      <DATA-REF DEST="VARIABLE-DATA-PROTOTYPE">/AUTOSAR_CanNm/BswModuleDescriptions/CanNm/CanNm_RequestSynchronizedPncShutdown_Nm_To_CanNm_DataGet</DATA-REF>
                    </BSW-DATA-RECEIVED-EVENT>
[!ENDIF!][!//
[!ENDIF!][!//
                  </EVENTS>

[!IF "node:existsAndTrue(CanNmGeneral/CanNmMultiCoreSupport)"!][!//
[!IF "$SynchronizedPncShutdownEnabled = 'true'"!][!//
[!CALL "GetPncShutdownChannelsTypeCount"!][!//
                  <RECEPTION-POLICYS>
                    <BSW-QUEUED-DATA-RECEPTION-POLICY>
                      <ENABLE-TAKE-ADDRESS>true</ENABLE-TAKE-ADDRESS>
                      <RECEIVED-DATA-REF DEST="VARIABLE-DATA-PROTOTYPE">/AUTOSAR_CanNm/BswModuleDescriptions/CanNm/CanNm_RequestSynchronizedPncShutdown_Nm_To_CanNm_DataGet</RECEIVED-DATA-REF>
                      <QUEUE-LENGTH>[!"$PncShutdownActiveChannels"!]</QUEUE-LENGTH>
                    </BSW-QUEUED-DATA-RECEPTION-POLICY>
                  </RECEPTION-POLICYS>
[!ENDIF!][!//
[!ENDIF!][!//

                </BSW-INTERNAL-BEHAVIOR>
              </INTERNAL-BEHAVIORS>
            </BSW-MODULE-DESCRIPTION>
          </ELEMENTS>
        </AR-PACKAGE>
        <AR-PACKAGE>
          <SHORT-NAME>BswModuleEntrys</SHORT-NAME>
          <ELEMENTS>
            <BSW-MODULE-ENTRY>
              <!-- !LINKSTO CanNm.EB.BSWMDGeneration.2,1 -->
              <SHORT-NAME>CanNm_MainFunction</SHORT-NAME>
              <SERVICE-ID>0x13</SERVICE-ID>
              <IS-REENTRANT>false</IS-REENTRANT>
              <IS-SYNCHRONOUS>true</IS-SYNCHRONOUS>
              <CALL-TYPE>SCHEDULED</CALL-TYPE>
              <EXECUTION-CONTEXT>TASK</EXECUTION-CONTEXT>
              <SW-SERVICE-IMPL-POLICY>STANDARD</SW-SERVICE-IMPL-POLICY>
              <ARGUMENTS>
              </ARGUMENTS>
            </BSW-MODULE-ENTRY>

[!IF "node:existsAndTrue(CanNmGeneral/CanNmMultiCoreSupport)"!][!//

            <BSW-MODULE-ENTRY>
              <SHORT-NAME>CanNm_Dummy_RxIndication</SHORT-NAME>
              <ADMIN-DATA>
                <SDGS>
                  <SDG GID="EB:DnT">
                    <SD GID="FunctionGroup">Extern</SD>
                    <SD GID="EnableTracing">true</SD>
                  </SDG>
                 </SDGS>
              </ADMIN-DATA>
              <SERVICE-ID>255</SERVICE-ID>
              <IS-REENTRANT>true</IS-REENTRANT>
              <IS-SYNCHRONOUS>false</IS-SYNCHRONOUS>
              <CALL-TYPE>SCHEDULED</CALL-TYPE>
              <EXECUTION-CONTEXT>TASK</EXECUTION-CONTEXT>
              <SW-SERVICE-IMPL-POLICY>STANDARD</SW-SERVICE-IMPL-POLICY>
              <ARGUMENTS>
              </ARGUMENTS>
            </BSW-MODULE-ENTRY>

[!IF "node:existsAndFalse(as:modconf('CanNm')[1]/CanNmGeneral/CanNmMultiCoreUseSingleCS)"!]
            <BSW-MODULE-ENTRY>
              <SHORT-NAME>CanNm_PassiveStartUp</SHORT-NAME>
              <ADMIN-DATA>
                <SDGS>
                  <SDG GID="EB:DnT">
                    <SD GID="FunctionGroup">Extern</SD>
                    <SD GID="EnableTracing">true</SD>
                  </SDG>
                 </SDGS>
              </ADMIN-DATA>
              <SERVICE-ID>1</SERVICE-ID>
              <IS-REENTRANT>false</IS-REENTRANT>
              <IS-SYNCHRONOUS>false</IS-SYNCHRONOUS>
              <CALL-TYPE>REGULAR</CALL-TYPE>
              <EXECUTION-CONTEXT>TASK</EXECUTION-CONTEXT>
              <SW-SERVICE-IMPL-POLICY>STANDARD</SW-SERVICE-IMPL-POLICY>
              <RETURN-TYPE>
                <SHORT-NAME>RetVal</SHORT-NAME>
                <DIRECTION>OUT</DIRECTION>
                <SW-DATA-DEF-PROPS>
                  <SW-DATA-DEF-PROPS-VARIANTS>
                    <SW-DATA-DEF-PROPS-CONDITIONAL>
                      <IMPLEMENTATION-DATA-TYPE-REF DEST="IMPLEMENTATION-DATA-TYPE">/AUTOSAR_Std/ImplementationDataTypes/Std_ReturnType</IMPLEMENTATION-DATA-TYPE-REF>
                    </SW-DATA-DEF-PROPS-CONDITIONAL>
                  </SW-DATA-DEF-PROPS-VARIANTS>
                </SW-DATA-DEF-PROPS>
              </RETURN-TYPE>
              <ARGUMENTS>
                <SW-SERVICE-ARG>
                  <SHORT-NAME>nmNetworkHandle</SHORT-NAME>
                  <DIRECTION>IN</DIRECTION>
                  <SW-DATA-DEF-PROPS>
                    <SW-DATA-DEF-PROPS-VARIANTS>
                      <SW-DATA-DEF-PROPS-CONDITIONAL>
                        <IMPLEMENTATION-DATA-TYPE-REF DEST="IMPLEMENTATION-DATA-TYPE">/AUTOSAR_Platform/ImplementationDataTypes/uint8</IMPLEMENTATION-DATA-TYPE-REF>
                      </SW-DATA-DEF-PROPS-CONDITIONAL>
                    </SW-DATA-DEF-PROPS-VARIANTS>
                  </SW-DATA-DEF-PROPS>
                </SW-SERVICE-ARG>
              </ARGUMENTS>
            </BSW-MODULE-ENTRY>
[!ENDIF!]

[!IF "node:existsAndTrue(as:modconf('CanNm')[1]/CanNmGeneral/CanNmMultiCoreUseSingleCS)"!]           
            <BSW-MODULE-ENTRY>
              <SHORT-NAME>CanNm_MultipleNetworkOperations</SHORT-NAME>
              <ADMIN-DATA>
                <SDGS>
                  <SDG GID="EB:DnT">
                    <SD GID="FunctionGroup">Extern</SD>
                    <SD GID="EnableTracing">true</SD>
                  </SDG>
                 </SDGS>
              </ADMIN-DATA>
              <SERVICE-ID>1</SERVICE-ID>
              <IS-REENTRANT>false</IS-REENTRANT>
              <IS-SYNCHRONOUS>false</IS-SYNCHRONOUS>
              <CALL-TYPE>REGULAR</CALL-TYPE>
              <EXECUTION-CONTEXT>TASK</EXECUTION-CONTEXT>
              <SW-SERVICE-IMPL-POLICY>STANDARD</SW-SERVICE-IMPL-POLICY>
              <RETURN-TYPE>
                <SHORT-NAME>RetVal</SHORT-NAME>
                <DIRECTION>OUT</DIRECTION>
                <SW-DATA-DEF-PROPS>
                  <SW-DATA-DEF-PROPS-VARIANTS>
                    <SW-DATA-DEF-PROPS-CONDITIONAL>
                      <IMPLEMENTATION-DATA-TYPE-REF DEST="IMPLEMENTATION-DATA-TYPE">/AUTOSAR_Std/ImplementationDataTypes/Std_ReturnType</IMPLEMENTATION-DATA-TYPE-REF>
                    </SW-DATA-DEF-PROPS-CONDITIONAL>
                  </SW-DATA-DEF-PROPS-VARIANTS>
                </SW-DATA-DEF-PROPS>
              </RETURN-TYPE>
              <ARGUMENTS>
                <SW-SERVICE-ARG>
                  <SHORT-NAME>nmNetworkHandle</SHORT-NAME>
                  <DIRECTION>IN</DIRECTION>
                  <SW-DATA-DEF-PROPS>
                    <SW-DATA-DEF-PROPS-VARIANTS>
                      <SW-DATA-DEF-PROPS-CONDITIONAL>
                        <IMPLEMENTATION-DATA-TYPE-REF DEST="IMPLEMENTATION-DATA-TYPE">/AUTOSAR_Platform/ImplementationDataTypes/uint8</IMPLEMENTATION-DATA-TYPE-REF>
                      </SW-DATA-DEF-PROPS-CONDITIONAL>
                    </SW-DATA-DEF-PROPS-VARIANTS>
                  </SW-DATA-DEF-PROPS>
                </SW-SERVICE-ARG>
                <SW-SERVICE-ARG>
                  <SHORT-NAME>operation</SHORT-NAME>
                  <DIRECTION>IN</DIRECTION>
                  <SW-DATA-DEF-PROPS>
                    <SW-DATA-DEF-PROPS-VARIANTS>
                      <SW-DATA-DEF-PROPS-CONDITIONAL>
                        <IMPLEMENTATION-DATA-TYPE-REF DEST="IMPLEMENTATION-DATA-TYPE">/AUTOSAR_Platform/ImplementationDataTypes/uint8</IMPLEMENTATION-DATA-TYPE-REF>
                      </SW-DATA-DEF-PROPS-CONDITIONAL>
                    </SW-DATA-DEF-PROPS-VARIANTS>
                  </SW-DATA-DEF-PROPS>
                </SW-SERVICE-ARG>                
              </ARGUMENTS>
            </BSW-MODULE-ENTRY>            
[!ENDIF!]

[!IF "node:existsAndFalse(as:modconf('CanNm')[1]/CanNmGeneral/CanNmMultiCoreUseSingleCS)"!]
[!IF "node:existsAndFalse(as:modconf('CanNm')[1]/CanNmGlobalConfig/eb-list::*[1]/CanNmPassiveModeEnabled)"!][!//
            <BSW-MODULE-ENTRY>
              <SHORT-NAME>CanNm_NetworkRequest</SHORT-NAME>
              <ADMIN-DATA>
                <SDGS>
                  <SDG GID="EB:DnT">
                    <SD GID="FunctionGroup">Extern</SD>
                    <SD GID="EnableTracing">true</SD>
                  </SDG>
                 </SDGS>
              </ADMIN-DATA>
              <SERVICE-ID>2</SERVICE-ID>
              <IS-REENTRANT>false</IS-REENTRANT>
              <IS-SYNCHRONOUS>false</IS-SYNCHRONOUS>
              <CALL-TYPE>REGULAR</CALL-TYPE>
              <EXECUTION-CONTEXT>TASK</EXECUTION-CONTEXT>
              <SW-SERVICE-IMPL-POLICY>STANDARD</SW-SERVICE-IMPL-POLICY>
              <RETURN-TYPE>
                <SHORT-NAME>RetVal</SHORT-NAME>
                <DIRECTION>OUT</DIRECTION>
                <SW-DATA-DEF-PROPS>
                  <SW-DATA-DEF-PROPS-VARIANTS>
                    <SW-DATA-DEF-PROPS-CONDITIONAL>
                      <IMPLEMENTATION-DATA-TYPE-REF DEST="IMPLEMENTATION-DATA-TYPE">/AUTOSAR_Std/ImplementationDataTypes/Std_ReturnType</IMPLEMENTATION-DATA-TYPE-REF>
                    </SW-DATA-DEF-PROPS-CONDITIONAL>
                  </SW-DATA-DEF-PROPS-VARIANTS>
                </SW-DATA-DEF-PROPS>
              </RETURN-TYPE>
              <ARGUMENTS>
                <SW-SERVICE-ARG>
                  <SHORT-NAME>nmNetworkHandle</SHORT-NAME>
                  <DIRECTION>IN</DIRECTION>
                  <SW-DATA-DEF-PROPS>
                    <SW-DATA-DEF-PROPS-VARIANTS>
                      <SW-DATA-DEF-PROPS-CONDITIONAL>
                        <IMPLEMENTATION-DATA-TYPE-REF DEST="IMPLEMENTATION-DATA-TYPE">/AUTOSAR_Platform/ImplementationDataTypes/uint8</IMPLEMENTATION-DATA-TYPE-REF>
                      </SW-DATA-DEF-PROPS-CONDITIONAL>
                    </SW-DATA-DEF-PROPS-VARIANTS>
                  </SW-DATA-DEF-PROPS>
                </SW-SERVICE-ARG>
              </ARGUMENTS>
            </BSW-MODULE-ENTRY>
[!ENDIF!][!//
[!ENDIF!]

[!IF "node:existsAndFalse(as:modconf('CanNm')[1]/CanNmGeneral/CanNmMultiCoreUseSingleCS)"!]
[!IF "node:existsAndFalse(as:modconf('CanNm')[1]/CanNmGlobalConfig/eb-list::*[1]/CanNmPassiveModeEnabled)"!][!//
            <BSW-MODULE-ENTRY>
              <SHORT-NAME>CanNm_NetworkGwEraRequest</SHORT-NAME>
              <ADMIN-DATA>
                <SDGS>
                  <SDG GID="EB:DnT">
                    <SD GID="FunctionGroup">Extern</SD>
                    <SD GID="EnableTracing">true</SD>
                  </SDG>
                 </SDGS>
              </ADMIN-DATA>
              <SERVICE-ID>254</SERVICE-ID>
              <IS-REENTRANT>false</IS-REENTRANT>
              <IS-SYNCHRONOUS>false</IS-SYNCHRONOUS>
              <CALL-TYPE>REGULAR</CALL-TYPE>
              <EXECUTION-CONTEXT>TASK</EXECUTION-CONTEXT>
              <SW-SERVICE-IMPL-POLICY>STANDARD</SW-SERVICE-IMPL-POLICY>
              <RETURN-TYPE>
                <SHORT-NAME>RetVal</SHORT-NAME>
                <DIRECTION>OUT</DIRECTION>
                <SW-DATA-DEF-PROPS>
                  <SW-DATA-DEF-PROPS-VARIANTS>
                    <SW-DATA-DEF-PROPS-CONDITIONAL>
                      <IMPLEMENTATION-DATA-TYPE-REF DEST="IMPLEMENTATION-DATA-TYPE">/AUTOSAR_Std/ImplementationDataTypes/Std_ReturnType</IMPLEMENTATION-DATA-TYPE-REF>
                    </SW-DATA-DEF-PROPS-CONDITIONAL>
                  </SW-DATA-DEF-PROPS-VARIANTS>
                </SW-DATA-DEF-PROPS>
              </RETURN-TYPE>
              <ARGUMENTS>
                <SW-SERVICE-ARG>
                  <SHORT-NAME>nmNetworkHandle</SHORT-NAME>
                  <DIRECTION>IN</DIRECTION>
                  <SW-DATA-DEF-PROPS>
                    <SW-DATA-DEF-PROPS-VARIANTS>
                      <SW-DATA-DEF-PROPS-CONDITIONAL>
                        <IMPLEMENTATION-DATA-TYPE-REF DEST="IMPLEMENTATION-DATA-TYPE">/AUTOSAR_Platform/ImplementationDataTypes/uint8</IMPLEMENTATION-DATA-TYPE-REF>
                      </SW-DATA-DEF-PROPS-CONDITIONAL>
                    </SW-DATA-DEF-PROPS-VARIANTS>
                  </SW-DATA-DEF-PROPS>
                </SW-SERVICE-ARG>
              </ARGUMENTS>
            </BSW-MODULE-ENTRY>
[!ENDIF!][!//
[!ENDIF!]

[!IF "node:existsAndFalse(as:modconf('CanNm')[1]/CanNmGeneral/CanNmMultiCoreUseSingleCS)"!]
[!IF "node:existsAndFalse(as:modconf('CanNm')[1]/CanNmGlobalConfig/eb-list::*[1]/CanNmPassiveModeEnabled)"!][!//
            <BSW-MODULE-ENTRY>
              <SHORT-NAME>CanNm_NetworkRelease</SHORT-NAME>
              <ADMIN-DATA>
                <SDGS>
                  <SDG GID="EB:DnT">
                    <SD GID="FunctionGroup">Extern</SD>
                    <SD GID="EnableTracing">true</SD>
                  </SDG>
                 </SDGS>
              </ADMIN-DATA>
              <SERVICE-ID>3</SERVICE-ID>
              <IS-REENTRANT>false</IS-REENTRANT>
              <IS-SYNCHRONOUS>false</IS-SYNCHRONOUS>
              <CALL-TYPE>REGULAR</CALL-TYPE>
              <EXECUTION-CONTEXT>TASK</EXECUTION-CONTEXT>
              <SW-SERVICE-IMPL-POLICY>STANDARD</SW-SERVICE-IMPL-POLICY>
              <RETURN-TYPE>
                <SHORT-NAME>RetVal</SHORT-NAME>
                <DIRECTION>OUT</DIRECTION>
                <SW-DATA-DEF-PROPS>
                  <SW-DATA-DEF-PROPS-VARIANTS>
                    <SW-DATA-DEF-PROPS-CONDITIONAL>
                      <IMPLEMENTATION-DATA-TYPE-REF DEST="IMPLEMENTATION-DATA-TYPE">/AUTOSAR_Std/ImplementationDataTypes/Std_ReturnType</IMPLEMENTATION-DATA-TYPE-REF>
                    </SW-DATA-DEF-PROPS-CONDITIONAL>
                  </SW-DATA-DEF-PROPS-VARIANTS>
                </SW-DATA-DEF-PROPS>
              </RETURN-TYPE>
              <ARGUMENTS>
                <SW-SERVICE-ARG>
                  <SHORT-NAME>nmNetworkHandle</SHORT-NAME>
                  <DIRECTION>IN</DIRECTION>
                  <SW-DATA-DEF-PROPS>
                    <SW-DATA-DEF-PROPS-VARIANTS>
                      <SW-DATA-DEF-PROPS-CONDITIONAL>
                        <IMPLEMENTATION-DATA-TYPE-REF DEST="IMPLEMENTATION-DATA-TYPE">/AUTOSAR_Platform/ImplementationDataTypes/uint8</IMPLEMENTATION-DATA-TYPE-REF>
                      </SW-DATA-DEF-PROPS-CONDITIONAL>
                    </SW-DATA-DEF-PROPS-VARIANTS>
                  </SW-DATA-DEF-PROPS>
                </SW-SERVICE-ARG>
              </ARGUMENTS>
            </BSW-MODULE-ENTRY>
[!ENDIF!][!//
[!ENDIF!]

[!IF "node:existsAndTrue(as:modconf('CanNm')[1]/CanNmGlobalConfig/eb-list::*[1]/CanNmBusSynchronizationEnabled)"!][!//
            <BSW-MODULE-ENTRY>
              <SHORT-NAME>CanNm_RequestBusSynchronization</SHORT-NAME>
              <ADMIN-DATA>
                <SDGS>
                  <SDG GID="EB:DnT">
                    <SD GID="FunctionGroup">Extern</SD>
                    <SD GID="EnableTracing">true</SD>
                  </SDG>
                 </SDGS>
              </ADMIN-DATA>
              <SERVICE-ID>192</SERVICE-ID>
              <IS-REENTRANT>false</IS-REENTRANT>
              <IS-SYNCHRONOUS>false</IS-SYNCHRONOUS>
              <CALL-TYPE>REGULAR</CALL-TYPE>
              <EXECUTION-CONTEXT>TASK</EXECUTION-CONTEXT>
              <SW-SERVICE-IMPL-POLICY>STANDARD</SW-SERVICE-IMPL-POLICY>
              <RETURN-TYPE>
                <SHORT-NAME>RetVal</SHORT-NAME>
                <DIRECTION>OUT</DIRECTION>
                <SW-DATA-DEF-PROPS>
                  <SW-DATA-DEF-PROPS-VARIANTS>
                    <SW-DATA-DEF-PROPS-CONDITIONAL>
                      <IMPLEMENTATION-DATA-TYPE-REF DEST="IMPLEMENTATION-DATA-TYPE">/AUTOSAR_Std/ImplementationDataTypes/Std_ReturnType</IMPLEMENTATION-DATA-TYPE-REF>
                    </SW-DATA-DEF-PROPS-CONDITIONAL>
                  </SW-DATA-DEF-PROPS-VARIANTS>
                </SW-DATA-DEF-PROPS>
              </RETURN-TYPE>
              <ARGUMENTS>
                <SW-SERVICE-ARG>
                  <SHORT-NAME>nmNetworkHandle</SHORT-NAME>
                  <DIRECTION>IN</DIRECTION>
                  <SW-DATA-DEF-PROPS>
                    <SW-DATA-DEF-PROPS-VARIANTS>
                      <SW-DATA-DEF-PROPS-CONDITIONAL>
                        <IMPLEMENTATION-DATA-TYPE-REF DEST="IMPLEMENTATION-DATA-TYPE">/AUTOSAR_Platform/ImplementationDataTypes/uint8</IMPLEMENTATION-DATA-TYPE-REF>
                      </SW-DATA-DEF-PROPS-CONDITIONAL>
                    </SW-DATA-DEF-PROPS-VARIANTS>
                  </SW-DATA-DEF-PROPS>
                </SW-SERVICE-ARG>
              </ARGUMENTS>
            </BSW-MODULE-ENTRY>
[!ENDIF!][!//

[!IF "$SynchronizedPncShutdownEnabled = 'true'"!][!//
            <BSW-MODULE-ENTRY>
              <SHORT-NAME>CanNm_RequestSynchronizedPncShutdown</SHORT-NAME>
              <ADMIN-DATA>
                <SDGS>
                  <SDG GID="EB:DnT">
                    <SD GID="FunctionGroup">Extern</SD>
                    <SD GID="EnableTracing">true</SD>
                  </SDG>
                 </SDGS>
              </ADMIN-DATA>
              <SERVICE-ID>243</SERVICE-ID>
              <IS-REENTRANT>false</IS-REENTRANT>
              <IS-SYNCHRONOUS>true</IS-SYNCHRONOUS>
              <CALL-TYPE>REGULAR</CALL-TYPE>
              <EXECUTION-CONTEXT>TASK</EXECUTION-CONTEXT>
              <SW-SERVICE-IMPL-POLICY>STANDARD</SW-SERVICE-IMPL-POLICY>
              <RETURN-TYPE>
                <SHORT-NAME>RetVal</SHORT-NAME>
                <DIRECTION>OUT</DIRECTION>
                <SW-DATA-DEF-PROPS>
                  <SW-DATA-DEF-PROPS-VARIANTS>
                    <SW-DATA-DEF-PROPS-CONDITIONAL>
                      <IMPLEMENTATION-DATA-TYPE-REF DEST="IMPLEMENTATION-DATA-TYPE">/AUTOSAR_Std/ImplementationDataTypes/Std_ReturnType</IMPLEMENTATION-DATA-TYPE-REF>
                    </SW-DATA-DEF-PROPS-CONDITIONAL>
                  </SW-DATA-DEF-PROPS-VARIANTS>
                </SW-DATA-DEF-PROPS>
              </RETURN-TYPE>
              <ARGUMENTS>
                <SW-SERVICE-ARG>
                  <SHORT-NAME>nmChannelHandle</SHORT-NAME>
                  <DIRECTION>IN</DIRECTION>
                  <SW-DATA-DEF-PROPS>
                    <SW-DATA-DEF-PROPS-VARIANTS>
                      <SW-DATA-DEF-PROPS-CONDITIONAL>
                        <IMPLEMENTATION-DATA-TYPE-REF DEST="IMPLEMENTATION-DATA-TYPE">/AUTOSAR_Platform/ImplementationDataTypes/uint8</IMPLEMENTATION-DATA-TYPE-REF>
                      </SW-DATA-DEF-PROPS-CONDITIONAL>
                    </SW-DATA-DEF-PROPS-VARIANTS>
                  </SW-DATA-DEF-PROPS>
                </SW-SERVICE-ARG>
                <SW-SERVICE-ARG>
                  <SHORT-NAME>pncId</SHORT-NAME>
                  <DIRECTION>IN</DIRECTION>
                  <SW-DATA-DEF-PROPS>
                    <SW-DATA-DEF-PROPS-VARIANTS>
                      <SW-DATA-DEF-PROPS-CONDITIONAL>
                        <IMPLEMENTATION-DATA-TYPE-REF DEST="IMPLEMENTATION-DATA-TYPE">/AUTOSAR_Platform/ImplementationDataTypes/uint16</IMPLEMENTATION-DATA-TYPE-REF>
                      </SW-DATA-DEF-PROPS-CONDITIONAL>
                    </SW-DATA-DEF-PROPS-VARIANTS>
                  </SW-DATA-DEF-PROPS>
                </SW-SERVICE-ARG>
              </ARGUMENTS>
            </BSW-MODULE-ENTRY>

            <BSW-MODULE-ENTRY>
              <SHORT-NAME>CanNm_ForwardSynchronizedPncShutdown_CanNm_To_Nm_DataSntFnct</SHORT-NAME>
              <ADMIN-DATA>
                <SDGS>
                  <SDG GID="EB:DnT">
                    <SD GID="FunctionGroup">Extern</SD>
                    <SD GID="EnableTracing">true</SD>
                  </SDG>
                 </SDGS>
              </ADMIN-DATA>
              <SERVICE-ID>255</SERVICE-ID>
              <IS-REENTRANT>false</IS-REENTRANT>
              <IS-SYNCHRONOUS>true</IS-SYNCHRONOUS>
              <CALL-TYPE>REGULAR</CALL-TYPE>
              <EXECUTION-CONTEXT>TASK</EXECUTION-CONTEXT>
              <SW-SERVICE-IMPL-POLICY>STANDARD</SW-SERVICE-IMPL-POLICY>
              <ARGUMENTS>
                <SW-SERVICE-ARG>
                  <SHORT-NAME>inData</SHORT-NAME>
                  <DIRECTION>IN</DIRECTION>
                  <SW-DATA-DEF-PROPS>
                    <SW-DATA-DEF-PROPS-VARIANTS>
                      <SW-DATA-DEF-PROPS-CONDITIONAL>
                        <IMPLEMENTATION-DATA-TYPE-REF DEST="IMPLEMENTATION-DATA-TYPE">/AUTOSAR_Nm/ImplementationDataTypes/Nm_PnSyncShutdown_BusNm_To_Nm_DataType</IMPLEMENTATION-DATA-TYPE-REF>
                      </SW-DATA-DEF-PROPS-CONDITIONAL>
                    </SW-DATA-DEF-PROPS-VARIANTS>
                  </SW-DATA-DEF-PROPS>
                </SW-SERVICE-ARG>
              </ARGUMENTS>
            </BSW-MODULE-ENTRY>

            <BSW-MODULE-ENTRY>
              <SHORT-NAME>CanNm_RequestSynchronizedPncShutdown_Nm_To_CanNm_RcvFnct</SHORT-NAME>
              <ADMIN-DATA>
                <SDGS>
                  <SDG GID="EB:DnT">
                    <SD GID="FunctionGroup">Extern</SD>
                    <SD GID="EnableTracing">true</SD>
                  </SDG>
                 </SDGS>
              </ADMIN-DATA>
              <SERVICE-ID>255</SERVICE-ID>
              <IS-REENTRANT>false</IS-REENTRANT>
              <IS-SYNCHRONOUS>true</IS-SYNCHRONOUS>
              <CALL-TYPE>SCHEDULED</CALL-TYPE>
              <EXECUTION-CONTEXT>TASK</EXECUTION-CONTEXT>
              <SW-SERVICE-IMPL-POLICY>STANDARD</SW-SERVICE-IMPL-POLICY>
              <ARGUMENTS>
              </ARGUMENTS>
            </BSW-MODULE-ENTRY>

[!ENDIF!][!//
[!ENDIF!][!//
          </ELEMENTS>
        </AR-PACKAGE>
        <AR-PACKAGE>
          <SHORT-NAME>ImplementationDataTypes</SHORT-NAME>
          <ELEMENTS>
            <IMPLEMENTATION-DATA-TYPE>
              <SHORT-NAME>CanNm_HsmStatechartPtrType</SHORT-NAME>
              <CATEGORY>TYPE_REFERENCE</CATEGORY>
              <ADMIN-DATA>
                <SDGS>
                  <SDG GID="EB:DnT">
                    <SD GID="TypeGroup">CanNm_Types</SD>
                  </SDG>
                </SDGS>
              </ADMIN-DATA>
              <SW-DATA-DEF-PROPS>
                <SW-DATA-DEF-PROPS-VARIANTS>
                  <SW-DATA-DEF-PROPS-CONDITIONAL>
                    <IMPLEMENTATION-DATA-TYPE-REF
                      DEST="IMPLEMENTATION-DATA-TYPE">/AUTOSAR_Platform/ImplementationDataTypes/VoidPtr</IMPLEMENTATION-DATA-TYPE-REF>
                  </SW-DATA-DEF-PROPS-CONDITIONAL>
                </SW-DATA-DEF-PROPS-VARIANTS>
              </SW-DATA-DEF-PROPS>
              <TYPE-EMITTER>BSW</TYPE-EMITTER>
            </IMPLEMENTATION-DATA-TYPE>
            <IMPLEMENTATION-DATA-TYPE>
              <SHORT-NAME>CanNm_HsmEventType</SHORT-NAME>
              <CATEGORY>TYPE_REFERENCE</CATEGORY>
              <ADMIN-DATA>
                <SDGS>
                  <SDG GID="EB:DnT">
                    <SD GID="TypeGroup">CanNm_Types</SD>
                  </SDG>
                </SDGS>
              </ADMIN-DATA>
              <SW-DATA-DEF-PROPS>
                <SW-DATA-DEF-PROPS-VARIANTS>
                  <SW-DATA-DEF-PROPS-CONDITIONAL>
                    <IMPLEMENTATION-DATA-TYPE-REF
                      DEST="IMPLEMENTATION-DATA-TYPE">/AUTOSAR_Platform/ImplementationDataTypes/uint8</IMPLEMENTATION-DATA-TYPE-REF>
                  </SW-DATA-DEF-PROPS-CONDITIONAL>
                </SW-DATA-DEF-PROPS-VARIANTS>
              </SW-DATA-DEF-PROPS>
              <TYPE-EMITTER>BSW</TYPE-EMITTER>
            </IMPLEMENTATION-DATA-TYPE>
            <IMPLEMENTATION-DATA-TYPE>
              <SHORT-NAME>CanNm_TimeType</SHORT-NAME>
              <CATEGORY>TYPE_REFERENCE</CATEGORY>
              <ADMIN-DATA>
                <SDGS>
                  <SDG GID="EB:DnT">
                    <SD GID="TypeGroup">CanNm_Types</SD>
                  </SDG>
                </SDGS>
              </ADMIN-DATA>
              <SW-DATA-DEF-PROPS>
                <SW-DATA-DEF-PROPS-VARIANTS>
                  <SW-DATA-DEF-PROPS-CONDITIONAL>
                    <IMPLEMENTATION-DATA-TYPE-REF
                      DEST="IMPLEMENTATION-DATA-TYPE">/AUTOSAR_Platform/ImplementationDataTypes/uint16</IMPLEMENTATION-DATA-TYPE-REF>
                  </SW-DATA-DEF-PROPS-CONDITIONAL>
                </SW-DATA-DEF-PROPS-VARIANTS>
              </SW-DATA-DEF-PROPS>
              <TYPE-EMITTER>BSW</TYPE-EMITTER>
            </IMPLEMENTATION-DATA-TYPE>
            <IMPLEMENTATION-DATA-TYPE>
              <SHORT-NAME>CanNm_HsmStateIdxType</SHORT-NAME>
              <CATEGORY>TYPE_REFERENCE</CATEGORY>
              <ADMIN-DATA>
                <SDGS>
                  <SDG GID="EB:DnT">
                    <SD GID="TypeGroup">CanNm_Types</SD>
                  </SDG>
                </SDGS>
              </ADMIN-DATA>
              <SW-DATA-DEF-PROPS>
                <SW-DATA-DEF-PROPS-VARIANTS>
                  <SW-DATA-DEF-PROPS-CONDITIONAL>
                    <IMPLEMENTATION-DATA-TYPE-REF
                      DEST="IMPLEMENTATION-DATA-TYPE">/AUTOSAR_Platform/ImplementationDataTypes/uint8</IMPLEMENTATION-DATA-TYPE-REF>
                  </SW-DATA-DEF-PROPS-CONDITIONAL>
                </SW-DATA-DEF-PROPS-VARIANTS>
              </SW-DATA-DEF-PROPS>
              <TYPE-EMITTER>BSW</TYPE-EMITTER>
            </IMPLEMENTATION-DATA-TYPE>
          </ELEMENTS>
        </AR-PACKAGE>
      </AR-PACKAGES>
    </AR-PACKAGE>

    <AR-PACKAGE>
      <SHORT-NAME>EB_CanNm</SHORT-NAME>
      <AR-PACKAGES>
        <AR-PACKAGE>
          <SHORT-NAME>Implementations</SHORT-NAME>
          <ELEMENTS>
            <BSW-IMPLEMENTATION>
              <SHORT-NAME>BswImplementation_0</SHORT-NAME>
              <CODE-DESCRIPTORS>
                <CODE>
                  <SHORT-NAME>Files</SHORT-NAME>
                  <ARTIFACT-DESCRIPTORS>
                    <AUTOSAR-ENGINEERING-OBJECT>
                      <SHORT-LABEL>Autosar::include::CanNm.h</SHORT-LABEL>
                      <CATEGORY>SWHDR</CATEGORY>
                    </AUTOSAR-ENGINEERING-OBJECT>
                    <AUTOSAR-ENGINEERING-OBJECT>
                      <SHORT-LABEL>Autosar::include::CanNm_Api.h</SHORT-LABEL>
                      <CATEGORY>SWHDR</CATEGORY>
                    </AUTOSAR-ENGINEERING-OBJECT>
                    <AUTOSAR-ENGINEERING-OBJECT>
                      <SHORT-LABEL>Autosar::include::CanNm_Cbk.h</SHORT-LABEL>
                      <CATEGORY>SWHDR</CATEGORY>
                    </AUTOSAR-ENGINEERING-OBJECT>
                    <AUTOSAR-ENGINEERING-OBJECT>
                      <SHORT-LABEL>Autosar::include::CanNm_Hsm.h</SHORT-LABEL>
                      <CATEGORY>SWHDR</CATEGORY>
                    </AUTOSAR-ENGINEERING-OBJECT>
                    <AUTOSAR-ENGINEERING-OBJECT>
                      <SHORT-LABEL>Autosar::include::CanNm_HsmCanNm.h</SHORT-LABEL>
                      <CATEGORY>SWHDR</CATEGORY>
                    </AUTOSAR-ENGINEERING-OBJECT>
                    <AUTOSAR-ENGINEERING-OBJECT>
                      <SHORT-LABEL>Autosar::include::CanNm_HsmCanNmInt.h</SHORT-LABEL>
                      <CATEGORY>SWHDR</CATEGORY>
                    </AUTOSAR-ENGINEERING-OBJECT>
                    <AUTOSAR-ENGINEERING-OBJECT>
                      <SHORT-LABEL>Autosar::include::CanNm_HsmCfg.h</SHORT-LABEL>
                      <CATEGORY>SWHDR</CATEGORY>
                    </AUTOSAR-ENGINEERING-OBJECT>
                    <AUTOSAR-ENGINEERING-OBJECT>
                      <SHORT-LABEL>Autosar::include::CanNm_Int.h</SHORT-LABEL>
                      <CATEGORY>SWHDR</CATEGORY>
                    </AUTOSAR-ENGINEERING-OBJECT>
                    <AUTOSAR-ENGINEERING-OBJECT>
                      <SHORT-LABEL>Autosar::include::CanNm_Lcfg_Static.h</SHORT-LABEL>
                      <CATEGORY>SWHDR</CATEGORY>
                    </AUTOSAR-ENGINEERING-OBJECT>
                    <AUTOSAR-ENGINEERING-OBJECT>
                      <SHORT-LABEL>Autosar::include::CanNm_Trace.h</SHORT-LABEL>
                      <CATEGORY>SWHDR</CATEGORY>
                    </AUTOSAR-ENGINEERING-OBJECT>
                    <AUTOSAR-ENGINEERING-OBJECT>
                      <SHORT-LABEL>Autosar::include::CanNm_Trace_Internal.h</SHORT-LABEL>
                      <CATEGORY>SWHDR</CATEGORY>
                    </AUTOSAR-ENGINEERING-OBJECT>
                    <AUTOSAR-ENGINEERING-OBJECT>
                      <SHORT-LABEL>Autosar::include::CanNm_Version.h</SHORT-LABEL>
                      <CATEGORY>SWHDR</CATEGORY>
                    </AUTOSAR-ENGINEERING-OBJECT>
                    <AUTOSAR-ENGINEERING-OBJECT>
                      <SHORT-LABEL>Autosar::src::CanNm.c</SHORT-LABEL>
                      <CATEGORY>SWSRC</CATEGORY>
                    </AUTOSAR-ENGINEERING-OBJECT>
                    <AUTOSAR-ENGINEERING-OBJECT>
                      <SHORT-LABEL>Autosar::src::CanNm_Hsm.c</SHORT-LABEL>
                      <CATEGORY>SWSRC</CATEGORY>
                    </AUTOSAR-ENGINEERING-OBJECT>
                    <AUTOSAR-ENGINEERING-OBJECT>
                      <SHORT-LABEL>Autosar::src::CanNm_HsmCanNmData.c</SHORT-LABEL>
                      <CATEGORY>SWSRC</CATEGORY>
                    </AUTOSAR-ENGINEERING-OBJECT>
                    <AUTOSAR-ENGINEERING-OBJECT>
                      <SHORT-LABEL>Autosar::src::CanNm_HsmCanNmFnct.c</SHORT-LABEL>
                      <CATEGORY>SWSRC</CATEGORY>
                    </AUTOSAR-ENGINEERING-OBJECT>
                    <AUTOSAR-ENGINEERING-OBJECT>
                      <SHORT-LABEL>make::CanNm_defs.mak</SHORT-LABEL>
                      <CATEGORY>SWMAKE</CATEGORY>
                    </AUTOSAR-ENGINEERING-OBJECT>
                    <AUTOSAR-ENGINEERING-OBJECT>
                      <SHORT-LABEL>make::CanNm_rules.mak</SHORT-LABEL>
                      <CATEGORY>SWMAKE</CATEGORY>
                    </AUTOSAR-ENGINEERING-OBJECT>
                  </ARTIFACT-DESCRIPTORS>
                </CODE>
              </CODE-DESCRIPTORS>
              <PROGRAMMING-LANGUAGE>C</PROGRAMMING-LANGUAGE>
              <RESOURCE-CONSUMPTION>
                <SHORT-NAME>ResourceConsumption</SHORT-NAME>
                <MEMORY-SECTIONS>
                  <MEMORY-SECTION>
                    <SHORT-NAME>CONST_8</SHORT-NAME>
                    <ALIGNMENT>8</ALIGNMENT>
                    <SW-ADDRMETHOD-REF DEST="SW-ADDR-METHOD">/AUTOSAR_MemMap/SwAddrMethods/CONST</SW-ADDRMETHOD-REF>
                  </MEMORY-SECTION>
                  <MEMORY-SECTION>
                    <SHORT-NAME>CONST_32</SHORT-NAME>
                    <ALIGNMENT>32</ALIGNMENT>
                    <SW-ADDRMETHOD-REF DEST="SW-ADDR-METHOD">/AUTOSAR_MemMap/SwAddrMethods/CONST</SW-ADDRMETHOD-REF>
                  </MEMORY-SECTION>
                  <MEMORY-SECTION>
                    <SHORT-NAME>VAR_INIT_8</SHORT-NAME>
                    <ALIGNMENT>8</ALIGNMENT>
                    <SW-ADDRMETHOD-REF DEST="SW-ADDR-METHOD">/AUTOSAR_MemMap/SwAddrMethods/VAR</SW-ADDRMETHOD-REF>
                  </MEMORY-SECTION>
                  <MEMORY-SECTION>
                    <SHORT-NAME>CONST_UNSPECIFIED</SHORT-NAME>
                    <ALIGNMENT>UNSPECIFIED</ALIGNMENT>
                    <SW-ADDRMETHOD-REF DEST="SW-ADDR-METHOD">/AUTOSAR_MemMap/SwAddrMethods/CONST</SW-ADDRMETHOD-REF>
                  </MEMORY-SECTION>
                  <MEMORY-SECTION>
                    <SHORT-NAME>CODE</SHORT-NAME>
                    <SW-ADDRMETHOD-REF DEST="SW-ADDR-METHOD">/AUTOSAR_MemMap/SwAddrMethods/CODE</SW-ADDRMETHOD-REF>
                  </MEMORY-SECTION>
                  <MEMORY-SECTION>
                    <SHORT-NAME>VAR_INIT_UNSPECIFIED</SHORT-NAME>
                    <ALIGNMENT>UNSPECIFIED</ALIGNMENT>
                    <SW-ADDRMETHOD-REF DEST="SW-ADDR-METHOD">/AUTOSAR_MemMap/SwAddrMethods/VAR</SW-ADDRMETHOD-REF>
                  </MEMORY-SECTION>
                  <MEMORY-SECTION>
                    <SHORT-NAME>VAR_CLEARED_8</SHORT-NAME>
                    <ALIGNMENT>8</ALIGNMENT>
                    <SW-ADDRMETHOD-REF DEST="SW-ADDR-METHOD">/AUTOSAR_MemMap/SwAddrMethods/VAR_CLEARED</SW-ADDRMETHOD-REF>
                  </MEMORY-SECTION>
                  <MEMORY-SECTION>
                    <SHORT-NAME>VAR_CLEARED_UNSPECIFIED</SHORT-NAME>
                    <ALIGNMENT>UNSPECIFIED</ALIGNMENT>
                    <SW-ADDRMETHOD-REF DEST="SW-ADDR-METHOD">/AUTOSAR_MemMap/SwAddrMethods/VAR_CLEARED</SW-ADDRMETHOD-REF>
                  </MEMORY-SECTION>
                  <MEMORY-SECTION>
                    <SHORT-NAME>VAR_INIT_BOOLEAN</SHORT-NAME>
                    <ALIGNMENT>8</ALIGNMENT>
                    <SW-ADDRMETHOD-REF DEST="SW-ADDR-METHOD">/AUTOSAR_MemMap/SwAddrMethods/VAR</SW-ADDRMETHOD-REF>
                  </MEMORY-SECTION>
                  <MEMORY-SECTION>
                    <SHORT-NAME>CONFIG_DATA_UNSPECIFIED</SHORT-NAME>
                    <ALIGNMENT>UNSPECIFIED</ALIGNMENT>
                    <SW-ADDRMETHOD-REF DEST="SW-ADDR-METHOD">/AUTOSAR_MemMap/SwAddrMethods/CONFIG_DATA</SW-ADDRMETHOD-REF>
                  </MEMORY-SECTION>
                </MEMORY-SECTIONS>
              </RESOURCE-CONSUMPTION>
              <SW-VERSION>6.20.6</SW-VERSION>
              <VENDOR-ID>1</VENDOR-ID>
              <AR-RELEASE-VERSION>4.0.3</AR-RELEASE-VERSION>
              <BEHAVIOR-REF DEST="BSW-INTERNAL-BEHAVIOR">/AUTOSAR_CanNm/BswModuleDescriptions/CanNm/InternalBehavior_0</BEHAVIOR-REF>
              <VENDOR-SPECIFIC-MODULE-DEF-REFS>
                <VENDOR-SPECIFIC-MODULE-DEF-REF DEST="ECUC-MODULE-DEF">/TS_TxDxM6I20R0/CanNm</VENDOR-SPECIFIC-MODULE-DEF-REF>
              </VENDOR-SPECIFIC-MODULE-DEF-REFS>
            </BSW-IMPLEMENTATION>
          </ELEMENTS>
        </AR-PACKAGE>
      </AR-PACKAGES>
    </AR-PACKAGE>
  </AR-PACKAGES>
[!ENDIF!][!/* "$MulticorePerChannelSupport = 'true'" */!]
</AUTOSAR>
