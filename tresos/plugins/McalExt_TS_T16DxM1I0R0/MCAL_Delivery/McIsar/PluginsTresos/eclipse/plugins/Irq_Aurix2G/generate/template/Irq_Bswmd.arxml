<?xml version="1.0" encoding="UTF-8"?>
[!/*<!--
/******************************************************************************
**                                                                           **
** Copyright (C) Infineon Technologies (2020)                                **
**                                                                           **
** All rights reserved.                                                      **
**                                                                           **
** This document contains proprietary information belonging to Infineon      **
** Technologies. Passing on and copying of this document, and communication  **
** of its contents is not permitted without prior written authorization.     **
**                                                                           **
*******************************************************************************
**                                                                           **
**  FILENAME  : Irq_Bswmd.arxml                                              **
**                                                                           **
**  VERSION   : 11.0.0                                                       **
**                                                                           **
**  DATE      : 2020-03-24                                                   **
**                                                                           **
**  VARIANT   : Variant PC                                                   **
**                                                                           **
**  PLATFORM  : Infineon AURIX2G                                             **
**                                                                           **
**  AUTHOR    : DL-AUTOSAR-Engineering                                       **
**                                                                           **
**  VENDOR    : Infineon Technologies                                        **
**                                                                           **
**  TRACEABILITY :  NA                                                       **
**                                                                           **
**  DESCRIPTION  : Basic Software Module Description for Irq driver          **
**                                                                           **
**                                                                           **
**  SPECIFICATION(S) : Specification of IRQ Driver                           **
**                                                                           **
**  MAY BE CHANGED BY USER : no                                              **
**                                                                           **
******************************************************************************/
-->*/!][!//
<!--
/******************************************************************************
**                                                                           **
** Copyright (C) Infineon Technologies (2020)                                **
**                                                                           **
** All rights reserved.                                                      **
**                                                                           **
** This document contains proprietary information belonging to Infineon      **
** Technologies. Passing on and copying of this document, and communication  **
** of its contents is not permitted without prior written authorization.     **
**                                                                           **
*******************************************************************************
**                                                                           **
**  FILENAME  : Irq_Bswmd.arxml                                              **
**                                                                           **
**  VERSION   : 11.0.0                                                       **
**                                                                           **
**  DATE, TIME: [!"$date"!], [!"$time"!]      !!!IGNORE-LINE!!!                   **
**                                                                            **
**  GENERATOR : Build [!"$buildnr"!]        !!!IGNORE-LINE!!!                   **
**                                                                           **
**  VARIANT   : Variant PC                                                   **
**                                                                           **
**  PLATFORM  : Infineon AURIX2G                                             **
**                                                                           **
**  AUTHOR    : DL-AUTOSAR-Engineering                                       **
**                                                                           **
**  VENDOR    : Infineon Technologies                                        **
**                                                                           **
**  TRACEABILITY :  NA                                                       **
**                                                                           **
**  DESCRIPTION  : Basic Software Module Description for Irq driver          **
**                                                                           **
**                                                                           **
**  SPECIFICATION(S) : Specification of IRQ Driver                           **
**                                                                           **
**  MAY BE CHANGED BY USER : no                                              **
**                                                                           **
******************************************************************************/
-->
[!NOCODE!][!//
  [!VAR "MinorVersion" = "text:split($moduleReleaseVer, '.')[position()-1 = 1]"!][!//
[!ENDNOCODE!][!//
[!IF "$MinorVersion = num:i(2)"!][!//
<AUTOSAR xmlns="http://autosar.org/schema/r4.0" xmlns:xsi="http://www.w3.org/2001/XMLSchema-instance" xsi:schemaLocation="http://autosar.org/schema/r4.0 AUTOSAR_4-2-2.xsd">
[!ELSE!][!//
<AUTOSAR xmlns="http://autosar.org/schema/r4.0" xmlns:xsi="http://www.w3.org/2001/XMLSchema-instance" xsi:schemaLocation="http://autosar.org/schema/r4.0 AUTOSAR_00046.xsd">
[!ENDIF!][!//
[!AUTOSPACING!][!//
[!SELECT "as:modconf('Irq')[1]"!][!//
  [!NOCODE!][!//
    [!VAR "LinModAdded" = "'false'"!][!//
    [!SELECT "as:modconf('Lin')[1]"!][!//
      [!VAR "LinModAdded" = "'true'"!][!//
    [!ENDSELECT!][!//
    [!SELECT "as:modconf('Uart')[1]"!][!//
      [!VAR "LinModAdded" = "'true'"!][!//
    [!ENDSELECT!][!//
    [!VAR "AdcModAdded" = "'false'"!][!//
    [!SELECT "as:modconf('Adc')[1]"!][!//
      [!VAR "AdcModAdded" = "'true'"!][!//
    [!ENDSELECT!][!//
    [!VAR "CanModAdded" = "'false'"!][!//
    [!SELECT "as:modconf('Can')[1]"!][!//
      [!VAR "CanModAdded" = "'true'"!][!//
    [!ENDSELECT!][!//
    [!VAR "Ccu6ModAdded" = "'false'"!][!//
    [!SELECT "as:modconf('Icu')[1]"!][!//
      [!VAR "Ccu6ModAdded" = "'true'"!][!//
    [!ENDSELECT!][!//
    [!SELECT "as:modconf('Pwm')[1]"!][!//
      [!VAR "Ccu6ModAdded" = "'true'"!][!//
    [!ENDSELECT!][!//
    [!VAR "DmaModAdded" = "'false'"!][!//
    [!IF "contains( ecu:get('Irq.ModAvailable'), 'IrqDma' )"!][!//
      [!SELECT "as:modconf('Dma')[1]"!][!//
        [!VAR "DmaModAdded" = "'true'"!][!//
      [!ENDSELECT!][!//
    [!ENDIF!][!//
    [!VAR "DmuModAdded" = "'false'"!][!//
    [!SELECT "as:modconf('Fls')[1]"!][!//
      [!VAR "DmuModAdded" = "'true'"!][!//
    [!ENDSELECT!][!//
    [!VAR "DsadcModAdded" = "'false'"!][!//
    [!SELECT "as:modconf('Dsadc')[1]"!][!//
      [!VAR "DsadcModAdded" = "'true'"!][!//
    [!ENDSELECT!][!//
    [!VAR "EthModAdded" = "'false'"!][!//
    [!SELECT "as:modconf('Eth')[1]"!][!//
      [!VAR "EthModAdded" = "'true'"!][!//
    [!ENDSELECT!][!//
    [!VAR "FrModAdded" = "'false'"!][!//
    [!SELECT "as:modconf('Fr')[1]"!][!//
      [!VAR "FrModAdded" = "'true'"!][!//
    [!ENDSELECT!][!//
    [!VAR "I2cModAdded" = "'false'"!][!//
    [!SELECT "as:modconf('I2c')[1]"!][!//
      [!VAR "I2cModAdded" = "'true'"!][!//
    [!ENDSELECT!][!//
    [!VAR "GpsrModAdded" = "'false'"!][!//
    [!IF "contains( ecu:get('Irq.ModAvailable'), 'IrqGpsr' )"!][!//
      [!VAR "GpsrModAdded" = "'true'"!][!//
    [!ENDIF!][!//
    [!VAR "GtmModAdded" = "'false'"!][!//
    [!SELECT "as:modconf('Mcu')[1]"!]
      [!VAR "Count" = "num:i(count(McuModuleConfiguration/GtmGlobalConfiguration/*))"!]
      [!IF "$Count > num:i(0)"!]
        [!VAR "GtmModAdded" = "'true'"!][!//
      [!ENDIF!][!//
    [!ENDSELECT!][!//
    [!VAR "GptModAdded" = "'false'"!][!//
    [!SELECT "as:modconf('Gpt')[1]"!][!//
      [!VAR "GptModAdded" = "'true'"!][!//
    [!ENDSELECT!][!//
    [!VAR "HsslModAdded" = "'false'"!][!//
    [!SELECT "as:modconf('Hssl')[1]"!][!//
      [!VAR "HsslModAdded" = "'true'"!][!//
    [!ENDSELECT!][!//
    [!VAR "ScuModAdded" = "'false'"!][!//
    [!SELECT "as:modconf('Dsadc')[1]"!][!//
      [!VAR "ScuModAdded" = "'true'"!][!//
    [!ENDSELECT!][!//
    [!SELECT "as:modconf('Icu')[1]"!][!//
      [!VAR "ScuModAdded" = "'true'"!][!//
    [!ENDSELECT!][!//
    [!VAR "SentModAdded" = "'false'"!][!//
    [!SELECT "as:modconf('Sent')[1]"!][!//
      [!VAR "SentModAdded" = "'true'"!][!//
    [!ENDSELECT!][!//
    [!VAR "SpiModAdded" = "'false'"!][!//
    [!SELECT "as:modconf('Spi')[1]"!][!//
      [!VAR "SpiModAdded" = "'true'"!][!//
    [!ENDSELECT!][!//
    [!VAR "StmModAdded" = "'false'"!][!//
    [!SELECT "as:modconf('Wdg')[1]"!][!//
      [!VAR "StmModAdded" = "'true'"!][!//
    [!ENDSELECT!][!//
    [!SELECT "as:modconf('Stm')[1]"!][!//
      [!VAR "StmModAdded" = "'true'"!][!//
    [!ENDSELECT!][!//
  [!ENDNOCODE!]
<AR-PACKAGES>
    <AR-PACKAGE>
      <SHORT-NAME>AURIX2G_Irq</SHORT-NAME>
      <AR-PACKAGES>
        <AR-PACKAGE>
          <SHORT-NAME>BswModuleDescriptions</SHORT-NAME>
          <CATEGORY>STANDARD</CATEGORY>
          <ELEMENTS>
            <BSW-MODULE-DESCRIPTION>
              <SHORT-NAME>Irq</SHORT-NAME>
              <LONG-NAME>
                <L-4 L="EN">IRQ Driver</L-4>
              </LONG-NAME>
              <CATEGORY>BSW_MODULE</CATEGORY>
              <MODULE-ID>255</MODULE-ID>
              <PROVIDED-ENTRYS>
              [!IF "$LinModAdded = 'true'"!]
                <BSW-MODULE-ENTRY-REF-CONDITIONAL>
                  <BSW-MODULE-ENTRY-REF DEST="BSW-MODULE-ENTRY">/AURIX2G_Irq/BswModuleEntrys/IrqAsclin_Init</BSW-MODULE-ENTRY-REF>
                </BSW-MODULE-ENTRY-REF-CONDITIONAL>
              [!ENDIF!]
                <BSW-MODULE-ENTRY-REF-CONDITIONAL>
                  <BSW-MODULE-ENTRY-REF DEST="BSW-MODULE-ENTRY">/AURIX2G_Irq/BswModuleEntrys/Irq_ClearAllInterruptFlags</BSW-MODULE-ENTRY-REF>
                </BSW-MODULE-ENTRY-REF-CONDITIONAL>
              [!IF "$AdcModAdded = 'true'"!]
                <BSW-MODULE-ENTRY-REF-CONDITIONAL>
                  <BSW-MODULE-ENTRY-REF DEST="BSW-MODULE-ENTRY">/AURIX2G_Irq/BswModuleEntrys/IrqAdc_Init</BSW-MODULE-ENTRY-REF>
                </BSW-MODULE-ENTRY-REF-CONDITIONAL>
              [!ENDIF!][!//
              [!IF "$CanModAdded = 'true'"!]
                <BSW-MODULE-ENTRY-REF-CONDITIONAL>
                  <BSW-MODULE-ENTRY-REF DEST="BSW-MODULE-ENTRY">/AURIX2G_Irq/BswModuleEntrys/IrqCan_Init</BSW-MODULE-ENTRY-REF>
                </BSW-MODULE-ENTRY-REF-CONDITIONAL>
              [!ENDIF!][!//
              [!IF "$Ccu6ModAdded = 'true'"!]
                <BSW-MODULE-ENTRY-REF-CONDITIONAL>
                  <BSW-MODULE-ENTRY-REF DEST="BSW-MODULE-ENTRY">/AURIX2G_Irq/BswModuleEntrys/IrqCcu6_Init</BSW-MODULE-ENTRY-REF>
                </BSW-MODULE-ENTRY-REF-CONDITIONAL>
              [!ENDIF!][!//
              [!IF "$DmaModAdded = 'true'"!]
                <BSW-MODULE-ENTRY-REF-CONDITIONAL>
                  <BSW-MODULE-ENTRY-REF DEST="BSW-MODULE-ENTRY">/AURIX2G_Irq/BswModuleEntrys/IrqDma_Init</BSW-MODULE-ENTRY-REF>
                </BSW-MODULE-ENTRY-REF-CONDITIONAL>
              [!ENDIF!][!//
              [!IF "$DmuModAdded = 'true'"!]
                <BSW-MODULE-ENTRY-REF-CONDITIONAL>
                  <BSW-MODULE-ENTRY-REF DEST="BSW-MODULE-ENTRY">/AURIX2G_Irq/BswModuleEntrys/IrqDmu_Init</BSW-MODULE-ENTRY-REF>
                </BSW-MODULE-ENTRY-REF-CONDITIONAL>
              [!ENDIF!][!//
              [!IF "$DsadcModAdded = 'true'"!]
                <BSW-MODULE-ENTRY-REF-CONDITIONAL>
                  <BSW-MODULE-ENTRY-REF DEST="BSW-MODULE-ENTRY">/AURIX2G_Irq/BswModuleEntrys/IrqDsadc_Init</BSW-MODULE-ENTRY-REF>
                </BSW-MODULE-ENTRY-REF-CONDITIONAL>
              [!ENDIF!][!//
              [!IF "$EthModAdded = 'true'"!]
                <BSW-MODULE-ENTRY-REF-CONDITIONAL>
                  <BSW-MODULE-ENTRY-REF DEST="BSW-MODULE-ENTRY">/AURIX2G_Irq/BswModuleEntrys/IrqEthernet_Init</BSW-MODULE-ENTRY-REF>
                </BSW-MODULE-ENTRY-REF-CONDITIONAL>
              [!ENDIF!][!//
              [!IF "$FrModAdded = 'true'"!][!//
               <BSW-MODULE-ENTRY-REF-CONDITIONAL>
                  <BSW-MODULE-ENTRY-REF DEST="BSW-MODULE-ENTRY">/AURIX2G_Irq/BswModuleEntrys/IrqFlexray_Init</BSW-MODULE-ENTRY-REF>
                </BSW-MODULE-ENTRY-REF-CONDITIONAL>
              [!ENDIF!][!//
              [!IF "$GpsrModAdded = 'true'"!][!//
                <BSW-MODULE-ENTRY-REF-CONDITIONAL>
                  <BSW-MODULE-ENTRY-REF DEST="BSW-MODULE-ENTRY">/AURIX2G_Irq/BswModuleEntrys/IrqGpsr_Init</BSW-MODULE-ENTRY-REF>
                </BSW-MODULE-ENTRY-REF-CONDITIONAL>
              [!ENDIF!][!//
              [!IF "$GtmModAdded = 'true'"!][!//
                <BSW-MODULE-ENTRY-REF-CONDITIONAL>
                  <BSW-MODULE-ENTRY-REF DEST="BSW-MODULE-ENTRY">/AURIX2G_Irq/BswModuleEntrys/IrqGtm_Init</BSW-MODULE-ENTRY-REF>
                </BSW-MODULE-ENTRY-REF-CONDITIONAL>
              [!ENDIF!][!//
              [!IF "$GptModAdded = 'true'"!][!//
                <BSW-MODULE-ENTRY-REF-CONDITIONAL>
                  <BSW-MODULE-ENTRY-REF DEST="BSW-MODULE-ENTRY">/AURIX2G_Irq/BswModuleEntrys/IrqGpt_Init</BSW-MODULE-ENTRY-REF>
                </BSW-MODULE-ENTRY-REF-CONDITIONAL>
             [!ENDIF!][!//
             [!IF "$HsslModAdded = 'true'"!][!//
                <BSW-MODULE-ENTRY-REF-CONDITIONAL>
                  <BSW-MODULE-ENTRY-REF DEST="BSW-MODULE-ENTRY">/AURIX2G_Irq/BswModuleEntrys/IrqHssl_Init</BSW-MODULE-ENTRY-REF>
                </BSW-MODULE-ENTRY-REF-CONDITIONAL>
             [!ENDIF!][!//
             [!IF "$ScuModAdded = 'true'"!][!//
               <BSW-MODULE-ENTRY-REF-CONDITIONAL>
                  <BSW-MODULE-ENTRY-REF DEST="BSW-MODULE-ENTRY">/AURIX2G_Irq/BswModuleEntrys/IrqScu_Init</BSW-MODULE-ENTRY-REF>
                </BSW-MODULE-ENTRY-REF-CONDITIONAL>
             [!ENDIF!][!//
             [!IF "$SentModAdded = 'true'"!][!//
               <BSW-MODULE-ENTRY-REF-CONDITIONAL>
                  <BSW-MODULE-ENTRY-REF DEST="BSW-MODULE-ENTRY">/AURIX2G_Irq/BswModuleEntrys/IrqSent_Init</BSW-MODULE-ENTRY-REF>
                </BSW-MODULE-ENTRY-REF-CONDITIONAL>
              [!ENDIF!][!//
              [!IF "$SpiModAdded = 'true'"!][!//
                <BSW-MODULE-ENTRY-REF-CONDITIONAL>
                  <BSW-MODULE-ENTRY-REF DEST="BSW-MODULE-ENTRY">/AURIX2G_Irq/BswModuleEntrys/IrqSpi_Init</BSW-MODULE-ENTRY-REF>
                </BSW-MODULE-ENTRY-REF-CONDITIONAL>
              [!ENDIF!][!//
              [!IF "$StmModAdded = 'true'"!][!//
                <BSW-MODULE-ENTRY-REF-CONDITIONAL>
                  <BSW-MODULE-ENTRY-REF DEST="BSW-MODULE-ENTRY">/AURIX2G_Irq/BswModuleEntrys/IrqStm_Init</BSW-MODULE-ENTRY-REF>
                </BSW-MODULE-ENTRY-REF-CONDITIONAL>
              [!ENDIF!][!//
              [!IF "$I2cModAdded = 'true'"!][!//
                <BSW-MODULE-ENTRY-REF-CONDITIONAL>
                  <BSW-MODULE-ENTRY-REF DEST="BSW-MODULE-ENTRY">/AURIX2G_Irq/BswModuleEntrys/IrqI2c_Init</BSW-MODULE-ENTRY-REF>
                </BSW-MODULE-ENTRY-REF-CONDITIONAL>
              [!ENDIF!][!//
              </PROVIDED-ENTRYS>
              <INTERNAL-BEHAVIORS>
                <BSW-INTERNAL-BEHAVIOR>
                  <SHORT-NAME>IrqBehavior</SHORT-NAME>
                  <ENTITYS>
                  [!IF "$Ccu6ModAdded = 'true'"!]
                    <BSW-CALLED-ENTITY>
                      <SHORT-NAME>IrqCcu6_Init</SHORT-NAME>
                      <REENTRANCY-LEVEL>NON-REENTRANT</REENTRANCY-LEVEL>
                      <IMPLEMENTED-ENTRY-REF DEST="BSW-MODULE-ENTRY">/AURIX2G_Irq/BswModuleEntrys/IrqCcu6_Init</IMPLEMENTED-ENTRY-REF>
                    </BSW-CALLED-ENTITY>
                  [!ENDIF!][!//
                  [!IF "$CanModAdded = 'true'"!][!//
                    <BSW-CALLED-ENTITY>
                      <SHORT-NAME>IrqCan_Init</SHORT-NAME>
                      <REENTRANCY-LEVEL>NON-REENTRANT</REENTRANCY-LEVEL>
                      <IMPLEMENTED-ENTRY-REF DEST="BSW-MODULE-ENTRY">/AURIX2G_Irq/BswModuleEntrys/IrqCan_Init</IMPLEMENTED-ENTRY-REF>
                    </BSW-CALLED-ENTITY>
                  [!ENDIF!][!//
                  [!IF "$GptModAdded = 'true'"!][!//
                    <BSW-CALLED-ENTITY>
                      <SHORT-NAME>IrqGpt_Init</SHORT-NAME>
                      <REENTRANCY-LEVEL>NON-REENTRANT</REENTRANCY-LEVEL>
                      <IMPLEMENTED-ENTRY-REF DEST="BSW-MODULE-ENTRY">/AURIX2G_Irq/BswModuleEntrys/IrqGpt_Init</IMPLEMENTED-ENTRY-REF>
                    </BSW-CALLED-ENTITY>
                  [!ENDIF!][!//
                  [!IF "$GtmModAdded = 'true'"!][!//
                    <BSW-CALLED-ENTITY>
                      <SHORT-NAME>IrqGtm_Init</SHORT-NAME>
                      <REENTRANCY-LEVEL>NON-REENTRANT</REENTRANCY-LEVEL>
                      <IMPLEMENTED-ENTRY-REF DEST="BSW-MODULE-ENTRY">/AURIX2G_Irq/BswModuleEntrys/IrqGtm_Init</IMPLEMENTED-ENTRY-REF>
                    </BSW-CALLED-ENTITY>
                  [!ENDIF!][!//
                  [!IF "$GpsrModAdded = 'true'"!][!//
                    <BSW-CALLED-ENTITY>
                      <SHORT-NAME>IrqGpsr_Init</SHORT-NAME>
                      <REENTRANCY-LEVEL>NON-REENTRANT</REENTRANCY-LEVEL>
                      <IMPLEMENTED-ENTRY-REF DEST="BSW-MODULE-ENTRY">/AURIX2G_Irq/BswModuleEntrys/IrqGpsr_Init</IMPLEMENTED-ENTRY-REF>
                    </BSW-CALLED-ENTITY>
                  [!ENDIF!][!//
                  [!IF "$FrModAdded = 'true'"!][!//
                    <BSW-CALLED-ENTITY>
                      <SHORT-NAME>IrqFlexray_Init</SHORT-NAME>
                      <REENTRANCY-LEVEL>NON-REENTRANT</REENTRANCY-LEVEL>
                      <IMPLEMENTED-ENTRY-REF DEST="BSW-MODULE-ENTRY">/AURIX2G_Irq/BswModuleEntrys/IrqFlexray_Init</IMPLEMENTED-ENTRY-REF>
                    </BSW-CALLED-ENTITY>
                  [!ENDIF!][!//
                  [!IF "$SpiModAdded = 'true'"!][!//
                    <BSW-CALLED-ENTITY>
                      <SHORT-NAME>IrqSpi_Init</SHORT-NAME>
                      <REENTRANCY-LEVEL>NON-REENTRANT</REENTRANCY-LEVEL>
                      <IMPLEMENTED-ENTRY-REF DEST="BSW-MODULE-ENTRY">/AURIX2G_Irq/BswModuleEntrys/IrqSpi_Init</IMPLEMENTED-ENTRY-REF>
                    </BSW-CALLED-ENTITY>
                  [!ENDIF!][!//
                  [!IF "$LinModAdded = 'true'"!][!//
                    <BSW-CALLED-ENTITY>
                      <SHORT-NAME>IrqAsclin_Init</SHORT-NAME>
                      <REENTRANCY-LEVEL>NON-REENTRANT</REENTRANCY-LEVEL>
                      <IMPLEMENTED-ENTRY-REF DEST="BSW-MODULE-ENTRY">/AURIX2G_Irq/BswModuleEntrys/IrqAsclin_Init</IMPLEMENTED-ENTRY-REF>
                    </BSW-CALLED-ENTITY>
                  [!ENDIF!][!//
                  [!IF "$AdcModAdded = 'true'"!][!//
                    <BSW-CALLED-ENTITY>
                      <SHORT-NAME>IrqAdc_Init</SHORT-NAME>
                      <REENTRANCY-LEVEL>NON-REENTRANT</REENTRANCY-LEVEL>
                      <IMPLEMENTED-ENTRY-REF DEST="BSW-MODULE-ENTRY">/AURIX2G_Irq/BswModuleEntrys/IrqAdc_Init</IMPLEMENTED-ENTRY-REF>
                    </BSW-CALLED-ENTITY>
                  [!ENDIF!][!//
                  [!IF "$EthModAdded = 'true'"!][!//
                    <BSW-CALLED-ENTITY>
                      <SHORT-NAME>IrqEthernet_Init</SHORT-NAME>
                      <REENTRANCY-LEVEL>NON-REENTRANT</REENTRANCY-LEVEL>
                      <IMPLEMENTED-ENTRY-REF DEST="BSW-MODULE-ENTRY">/AURIX2G_Irq/BswModuleEntrys/IrqEthernet_Init</IMPLEMENTED-ENTRY-REF>
                    </BSW-CALLED-ENTITY>
                  [!ENDIF!][!//
                  [!IF "$DmaModAdded = 'true'"!][!//
                    <BSW-CALLED-ENTITY>
                      <SHORT-NAME>IrqDma_Init</SHORT-NAME>
                      <REENTRANCY-LEVEL>NON-REENTRANT</REENTRANCY-LEVEL>
                      <IMPLEMENTED-ENTRY-REF DEST="BSW-MODULE-ENTRY">/AURIX2G_Irq/BswModuleEntrys/IrqDma_Init</IMPLEMENTED-ENTRY-REF>
                    </BSW-CALLED-ENTITY>
                  [!ENDIF!][!//
                  [!IF "$ScuModAdded = 'true'"!][!//
                    <BSW-CALLED-ENTITY>
                      <SHORT-NAME>IrqScu_Init</SHORT-NAME>
                      <REENTRANCY-LEVEL>NON-REENTRANT</REENTRANCY-LEVEL>
                      <IMPLEMENTED-ENTRY-REF DEST="BSW-MODULE-ENTRY">/AURIX2G_Irq/BswModuleEntrys/IrqScu_Init</IMPLEMENTED-ENTRY-REF>
                    </BSW-CALLED-ENTITY>
                  [!ENDIF!][!//
                  [!IF "$DmuModAdded = 'true'"!][!//
                    <BSW-CALLED-ENTITY>
                      <SHORT-NAME>IrqDmu_Init</SHORT-NAME>
                      <REENTRANCY-LEVEL>NON-REENTRANT</REENTRANCY-LEVEL>
                      <IMPLEMENTED-ENTRY-REF DEST="BSW-MODULE-ENTRY">/AURIX2G_Irq/BswModuleEntrys/IrqDmu_Init</IMPLEMENTED-ENTRY-REF>
                    </BSW-CALLED-ENTITY>
                  [!ENDIF!][!//
                  [!IF "$HsslModAdded = 'true'"!][!//
                    <BSW-CALLED-ENTITY>
                      <SHORT-NAME>IrqHssl_Init</SHORT-NAME>
                      <REENTRANCY-LEVEL>NON-REENTRANT</REENTRANCY-LEVEL>
                      <IMPLEMENTED-ENTRY-REF DEST="BSW-MODULE-ENTRY">/AURIX2G_Irq/BswModuleEntrys/IrqHssl_Init</IMPLEMENTED-ENTRY-REF>
                    </BSW-CALLED-ENTITY>
                  [!ENDIF!][!//
                  [!IF "$SentModAdded = 'true'"!][!//
                    <BSW-CALLED-ENTITY>
                      <SHORT-NAME>IrqSent_Init</SHORT-NAME>
                      <REENTRANCY-LEVEL>NON-REENTRANT</REENTRANCY-LEVEL>
                      <IMPLEMENTED-ENTRY-REF DEST="BSW-MODULE-ENTRY">/AURIX2G_Irq/BswModuleEntrys/IrqSent_Init</IMPLEMENTED-ENTRY-REF>
                    </BSW-CALLED-ENTITY>
                  [!ENDIF!][!//
                  [!IF "$DsadcModAdded = 'true'"!][!//
                    <BSW-CALLED-ENTITY>
                      <SHORT-NAME>IrqDsadc_Init</SHORT-NAME>
                      <REENTRANCY-LEVEL>NON-REENTRANT</REENTRANCY-LEVEL>
                      <IMPLEMENTED-ENTRY-REF DEST="BSW-MODULE-ENTRY">/AURIX2G_Irq/BswModuleEntrys/IrqDsadc_Init</IMPLEMENTED-ENTRY-REF>
                    </BSW-CALLED-ENTITY>
                  [!ENDIF!][!//
                  [!IF "$StmModAdded = 'true'"!][!//
                    <BSW-CALLED-ENTITY>
                      <SHORT-NAME>IrqStm_Init</SHORT-NAME>
                      <REENTRANCY-LEVEL>NON-REENTRANT</REENTRANCY-LEVEL>
                      <IMPLEMENTED-ENTRY-REF DEST="BSW-MODULE-ENTRY">/AURIX2G_Irq/BswModuleEntrys/IrqStm_Init</IMPLEMENTED-ENTRY-REF>
                    </BSW-CALLED-ENTITY>
                  [!ENDIF!][!//
                  [!IF "$I2cModAdded = 'true'"!][!//
                    <BSW-CALLED-ENTITY>
                      <SHORT-NAME>IrqI2c_Init</SHORT-NAME>
                      <REENTRANCY-LEVEL>NON-REENTRANT</REENTRANCY-LEVEL>
                      <IMPLEMENTED-ENTRY-REF DEST="BSW-MODULE-ENTRY">/AURIX2G_Irq/BswModuleEntrys/IrqI2c_Init</IMPLEMENTED-ENTRY-REF>
                    </BSW-CALLED-ENTITY>
                  [!ENDIF!][!//
                    <BSW-CALLED-ENTITY>
                      <SHORT-NAME>Irq_ClearAllInterruptFlags</SHORT-NAME>
                      <REENTRANCY-LEVEL>NON-REENTRANT</REENTRANCY-LEVEL>
                      <IMPLEMENTED-ENTRY-REF DEST="BSW-MODULE-ENTRY">/AURIX2G_Irq/BswModuleEntrys/Irq_ClearAllInterruptFlags</IMPLEMENTED-ENTRY-REF>
                    </BSW-CALLED-ENTITY>
                  </ENTITYS>
                </BSW-INTERNAL-BEHAVIOR>
              </INTERNAL-BEHAVIORS>
            </BSW-MODULE-DESCRIPTION>
          </ELEMENTS>
        </AR-PACKAGE>
        <AR-PACKAGE>
          <SHORT-NAME>BswModuleEntrys</SHORT-NAME>
          <CATEGORY>STANDARD</CATEGORY>
          <ELEMENTS>
         [!IF "$LinModAdded = 'true'"!][!//
            <BSW-MODULE-ENTRY>
              <SHORT-NAME>IrqAsclin_Init</SHORT-NAME>
              <IS-REENTRANT>false</IS-REENTRANT>
              <IS-SYNCHRONOUS>true</IS-SYNCHRONOUS>
              <CALL-TYPE>REGULAR</CALL-TYPE>
              <EXECUTION-CONTEXT>TASK</EXECUTION-CONTEXT>
              <SW-SERVICE-IMPL-POLICY>STANDARD</SW-SERVICE-IMPL-POLICY>
            </BSW-MODULE-ENTRY>
         [!ENDIF!][!//
            <BSW-MODULE-ENTRY>
              <SHORT-NAME>Irq_ClearAllInterruptFlags</SHORT-NAME>
              <IS-REENTRANT>false</IS-REENTRANT>
              <IS-SYNCHRONOUS>true</IS-SYNCHRONOUS>
              <CALL-TYPE>REGULAR</CALL-TYPE>
              <EXECUTION-CONTEXT>TASK</EXECUTION-CONTEXT>
              <SW-SERVICE-IMPL-POLICY>STANDARD</SW-SERVICE-IMPL-POLICY>
            </BSW-MODULE-ENTRY>
         [!IF "$AdcModAdded = 'true'"!][!//
            <BSW-MODULE-ENTRY>
              <SHORT-NAME>IrqAdc_Init</SHORT-NAME>
              <IS-REENTRANT>false</IS-REENTRANT>
              <IS-SYNCHRONOUS>true</IS-SYNCHRONOUS>
              <CALL-TYPE>REGULAR</CALL-TYPE>
              <EXECUTION-CONTEXT>TASK</EXECUTION-CONTEXT>
              <SW-SERVICE-IMPL-POLICY>STANDARD</SW-SERVICE-IMPL-POLICY>
            </BSW-MODULE-ENTRY>
         [!ENDIF!][!//
         [!IF "$CanModAdded = 'true'"!][!//
            <BSW-MODULE-ENTRY>
              <SHORT-NAME>IrqCan_Init</SHORT-NAME>
              <IS-REENTRANT>false</IS-REENTRANT>
              <IS-SYNCHRONOUS>true</IS-SYNCHRONOUS>
              <CALL-TYPE>REGULAR</CALL-TYPE>
              <EXECUTION-CONTEXT>TASK</EXECUTION-CONTEXT>
              <SW-SERVICE-IMPL-POLICY>STANDARD</SW-SERVICE-IMPL-POLICY>
            </BSW-MODULE-ENTRY>
         [!ENDIF!][!//
         [!IF "$Ccu6ModAdded = 'true'"!][!//
            <BSW-MODULE-ENTRY>
              <SHORT-NAME>IrqCcu6_Init</SHORT-NAME>
              <IS-REENTRANT>false</IS-REENTRANT>
              <IS-SYNCHRONOUS>true</IS-SYNCHRONOUS>
              <CALL-TYPE>REGULAR</CALL-TYPE>
              <EXECUTION-CONTEXT>TASK</EXECUTION-CONTEXT>
              <SW-SERVICE-IMPL-POLICY>STANDARD</SW-SERVICE-IMPL-POLICY>
            </BSW-MODULE-ENTRY>
         [!ENDIF!][!//
         [!IF "$DmaModAdded = 'true'"!][!//
            <BSW-MODULE-ENTRY>
              <SHORT-NAME>IrqDma_Init</SHORT-NAME>
              <IS-REENTRANT>false</IS-REENTRANT>
              <IS-SYNCHRONOUS>true</IS-SYNCHRONOUS>
              <CALL-TYPE>REGULAR</CALL-TYPE>
              <EXECUTION-CONTEXT>TASK</EXECUTION-CONTEXT>
              <SW-SERVICE-IMPL-POLICY>STANDARD</SW-SERVICE-IMPL-POLICY>
            </BSW-MODULE-ENTRY>
         [!ENDIF!][!//
         [!IF "$DmuModAdded = 'true'"!][!//
            <BSW-MODULE-ENTRY>
              <SHORT-NAME>IrqDmu_Init</SHORT-NAME>
              <IS-REENTRANT>false</IS-REENTRANT>
              <IS-SYNCHRONOUS>true</IS-SYNCHRONOUS>
              <CALL-TYPE>REGULAR</CALL-TYPE>
              <EXECUTION-CONTEXT>TASK</EXECUTION-CONTEXT>
              <SW-SERVICE-IMPL-POLICY>STANDARD</SW-SERVICE-IMPL-POLICY>
            </BSW-MODULE-ENTRY>
         [!ENDIF!][!//
         [!IF "$DsadcModAdded = 'true'"!][!//
            <BSW-MODULE-ENTRY>
              <SHORT-NAME>IrqDsadc_Init</SHORT-NAME>
              <IS-REENTRANT>false</IS-REENTRANT>
              <IS-SYNCHRONOUS>true</IS-SYNCHRONOUS>
              <CALL-TYPE>REGULAR</CALL-TYPE>
              <EXECUTION-CONTEXT>TASK</EXECUTION-CONTEXT>
              <SW-SERVICE-IMPL-POLICY>STANDARD</SW-SERVICE-IMPL-POLICY>
            </BSW-MODULE-ENTRY>
         [!ENDIF!][!//
         [!IF "$EthModAdded = 'true'"!][!//
            <BSW-MODULE-ENTRY>
              <SHORT-NAME>IrqEthernet_Init</SHORT-NAME>
              <IS-REENTRANT>false</IS-REENTRANT>
              <IS-SYNCHRONOUS>true</IS-SYNCHRONOUS>
              <CALL-TYPE>REGULAR</CALL-TYPE>
              <EXECUTION-CONTEXT>TASK</EXECUTION-CONTEXT>
              <SW-SERVICE-IMPL-POLICY>STANDARD</SW-SERVICE-IMPL-POLICY>
            </BSW-MODULE-ENTRY>
         [!ENDIF!][!//
         [!IF "$FrModAdded = 'true'"!][!//
            <BSW-MODULE-ENTRY>
              <SHORT-NAME>IrqFlexray_Init</SHORT-NAME>
              <SHORT-NAME-PATTERN />
              <IS-REENTRANT>false</IS-REENTRANT>
              <IS-SYNCHRONOUS>true</IS-SYNCHRONOUS>
              <CALL-TYPE>REGULAR</CALL-TYPE>
              <EXECUTION-CONTEXT>TASK</EXECUTION-CONTEXT>
              <SW-SERVICE-IMPL-POLICY>STANDARD</SW-SERVICE-IMPL-POLICY>
            </BSW-MODULE-ENTRY>
         [!ENDIF!][!//
         [!IF "$GpsrModAdded = 'true'"!][!//
            <BSW-MODULE-ENTRY>
              <SHORT-NAME>IrqGpsr_Init</SHORT-NAME>
              <IS-REENTRANT>false</IS-REENTRANT>
              <IS-SYNCHRONOUS>true</IS-SYNCHRONOUS>
              <CALL-TYPE>REGULAR</CALL-TYPE>
              <EXECUTION-CONTEXT>TASK</EXECUTION-CONTEXT>
              <SW-SERVICE-IMPL-POLICY>STANDARD</SW-SERVICE-IMPL-POLICY>
            </BSW-MODULE-ENTRY>
         [!ENDIF!][!//
         [!IF "$GptModAdded = 'true'"!][!//
            <BSW-MODULE-ENTRY>
              <SHORT-NAME>IrqGpt_Init</SHORT-NAME>
              <IS-REENTRANT>false</IS-REENTRANT>
              <IS-SYNCHRONOUS>true</IS-SYNCHRONOUS>
              <CALL-TYPE>REGULAR</CALL-TYPE>
              <EXECUTION-CONTEXT>TASK</EXECUTION-CONTEXT>
              <SW-SERVICE-IMPL-POLICY>STANDARD</SW-SERVICE-IMPL-POLICY>
            </BSW-MODULE-ENTRY>
         [!ENDIF!][!//
         [!IF "$GtmModAdded = 'true'"!][!//
            <BSW-MODULE-ENTRY>
              <SHORT-NAME>IrqGtm_Init</SHORT-NAME>
              <IS-REENTRANT>false</IS-REENTRANT>
              <IS-SYNCHRONOUS>true</IS-SYNCHRONOUS>
              <CALL-TYPE>REGULAR</CALL-TYPE>
              <EXECUTION-CONTEXT>TASK</EXECUTION-CONTEXT>
              <SW-SERVICE-IMPL-POLICY>STANDARD</SW-SERVICE-IMPL-POLICY>
            </BSW-MODULE-ENTRY>
         [!ENDIF!][!//
         [!IF "$HsslModAdded = 'true'"!][!//
            <BSW-MODULE-ENTRY>
              <SHORT-NAME>IrqHssl_Init</SHORT-NAME>
              <IS-REENTRANT>false</IS-REENTRANT>
              <IS-SYNCHRONOUS>true</IS-SYNCHRONOUS>
              <CALL-TYPE>REGULAR</CALL-TYPE>
              <EXECUTION-CONTEXT>TASK</EXECUTION-CONTEXT>
              <SW-SERVICE-IMPL-POLICY>STANDARD</SW-SERVICE-IMPL-POLICY>
            </BSW-MODULE-ENTRY>
         [!ENDIF!][!//
         [!IF "$ScuModAdded = 'true'"!][!//
            <BSW-MODULE-ENTRY>
              <SHORT-NAME>IrqScu_Init</SHORT-NAME>
              <IS-REENTRANT>false</IS-REENTRANT>
              <IS-SYNCHRONOUS>true</IS-SYNCHRONOUS>
              <CALL-TYPE>REGULAR</CALL-TYPE>
              <EXECUTION-CONTEXT>TASK</EXECUTION-CONTEXT>
              <SW-SERVICE-IMPL-POLICY>STANDARD</SW-SERVICE-IMPL-POLICY>
            </BSW-MODULE-ENTRY>
         [!ENDIF!][!//
         [!IF "$SentModAdded = 'true'"!][!//
            <BSW-MODULE-ENTRY>
              <SHORT-NAME>IrqSent_Init</SHORT-NAME>
              <IS-REENTRANT>false</IS-REENTRANT>
              <IS-SYNCHRONOUS>true</IS-SYNCHRONOUS>
              <CALL-TYPE>REGULAR</CALL-TYPE>
              <EXECUTION-CONTEXT>TASK</EXECUTION-CONTEXT>
              <SW-SERVICE-IMPL-POLICY>STANDARD</SW-SERVICE-IMPL-POLICY>
            </BSW-MODULE-ENTRY>
         [!ENDIF!][!//
         [!IF "$SpiModAdded = 'true'"!][!//
            <BSW-MODULE-ENTRY>
              <SHORT-NAME>IrqSpi_Init</SHORT-NAME>
              <IS-REENTRANT>false</IS-REENTRANT>
              <IS-SYNCHRONOUS>true</IS-SYNCHRONOUS>
              <CALL-TYPE>REGULAR</CALL-TYPE>
              <EXECUTION-CONTEXT>TASK</EXECUTION-CONTEXT>
              <SW-SERVICE-IMPL-POLICY>STANDARD</SW-SERVICE-IMPL-POLICY>
            </BSW-MODULE-ENTRY>
         [!ENDIF!][!//
         [!IF "$StmModAdded = 'true'"!][!//
            <BSW-MODULE-ENTRY>
              <SHORT-NAME>IrqStm_Init</SHORT-NAME>
              <IS-REENTRANT>false</IS-REENTRANT>
              <IS-SYNCHRONOUS>true</IS-SYNCHRONOUS>
              <CALL-TYPE>REGULAR</CALL-TYPE>
              <EXECUTION-CONTEXT>TASK</EXECUTION-CONTEXT>
              <SW-SERVICE-IMPL-POLICY>STANDARD</SW-SERVICE-IMPL-POLICY>
            </BSW-MODULE-ENTRY>
         [!ENDIF!][!//
         [!IF "$I2cModAdded = 'true'"!][!//
            <BSW-MODULE-ENTRY>
              <SHORT-NAME>IrqI2c_Init</SHORT-NAME>
              <IS-REENTRANT>false</IS-REENTRANT>
              <IS-SYNCHRONOUS>true</IS-SYNCHRONOUS>
              <CALL-TYPE>REGULAR</CALL-TYPE>
              <EXECUTION-CONTEXT>TASK</EXECUTION-CONTEXT>
              <SW-SERVICE-IMPL-POLICY>STANDARD</SW-SERVICE-IMPL-POLICY>
            </BSW-MODULE-ENTRY>
         [!ENDIF!][!//
          </ELEMENTS>
        </AR-PACKAGE>
        <AR-PACKAGE>
          <SHORT-NAME>Implementations</SHORT-NAME>
          <ELEMENTS>
            <BSW-IMPLEMENTATION>
              <SHORT-NAME>Irq</SHORT-NAME>
              <CODE-DESCRIPTORS>
                <CODE>
                  <SHORT-NAME>Files</SHORT-NAME>
                  <ARTIFACT-DESCRIPTORS>
                    <AUTOSAR-ENGINEERING-OBJECT>
                      <SHORT-LABEL>ssc::src::Irq.c</SHORT-LABEL>
                      <CATEGORY>SWSRC</CATEGORY>
                    </AUTOSAR-ENGINEERING-OBJECT>
                    <AUTOSAR-ENGINEERING-OBJECT>
                      <SHORT-LABEL>ssc::inc::Irq.h</SHORT-LABEL>
                      <CATEGORY>SWHDR</CATEGORY>
                    </AUTOSAR-ENGINEERING-OBJECT>
                  </ARTIFACT-DESCRIPTORS>
                </CODE>
              </CODE-DESCRIPTORS>
              <GENERATED-ARTIFACTS>
                <DEPENDENCY-ON-ARTIFACT>
                  <SHORT-NAME>Irq_Cfg_h</SHORT-NAME>
                  <ARTIFACT-DESCRIPTOR>
                    <SHORT-LABEL>generate::template::inc::Irq_Cfg.h</SHORT-LABEL>
                    <CATEGORY>SWTEMPLATE</CATEGORY>
                  </ARTIFACT-DESCRIPTOR>
                  <USAGES>
                    <USAGE>COMPILE</USAGE>
                  </USAGES>
                </DEPENDENCY-ON-ARTIFACT>
                <DEPENDENCY-ON-ARTIFACT>
                  <SHORT-NAME>Irq_xdm</SHORT-NAME>
                  <ARTIFACT-DESCRIPTOR>
                    <SHORT-LABEL>config::Irq.xdm</SHORT-LABEL>
                    <CATEGORY>SWTOOL</CATEGORY>
                  </ARTIFACT-DESCRIPTOR>
                  <USAGES>
                    <USAGE>CODEGENERATION</USAGE>
                  </USAGES>
                </DEPENDENCY-ON-ARTIFACT>
                <DEPENDENCY-ON-ARTIFACT>
                  <SHORT-NAME>Irq_bmd</SHORT-NAME>
                  <ARTIFACT-DESCRIPTOR>
                    <SHORT-LABEL>autosar::[!"concat(substring(ecu:get('Rel.SubDerivate'),1,4),'x')"!]::[!"ecu:get('Rel.SubDerivate')"!]::irq.bmd</SHORT-LABEL>
                    <CATEGORY>SWTOOL</CATEGORY>
                  </ARTIFACT-DESCRIPTOR>
                  <USAGES>
                    <USAGE>CODEGENERATION</USAGE>
                  </USAGES>
                </DEPENDENCY-ON-ARTIFACT>
              </GENERATED-ARTIFACTS>
              <PROGRAMMING-LANGUAGE>C</PROGRAMMING-LANGUAGE>
              <RESOURCE-CONSUMPTION>
                <SHORT-NAME>ResourceConsumption</SHORT-NAME>
                <MEMORY-SECTIONS>
                  <MEMORY-SECTION>
                    <SHORT-NAME>CODE_QM_GLOBAL</SHORT-NAME>
                    <ALIGNMENT>UNSPECIFIED</ALIGNMENT>
                    <SW-ADDRMETHOD-REF DEST="SW-ADDR-METHOD">/AUTOSAR_MemMap/SwAddrMethods/CODE</SW-ADDRMETHOD-REF>
                  </MEMORY-SECTION>
                </MEMORY-SECTIONS>
                <SECTION-NAME-PREFIXS>
                  <SECTION-NAME-PREFIX>
                    <SHORT-NAME>IRQ</SHORT-NAME>
                    <SYMBOL>IRQ</SYMBOL>
                  </SECTION-NAME-PREFIX>
                </SECTION-NAME-PREFIXS>
              </RESOURCE-CONSUMPTION>
              <SW-VERSION>20.0.0</SW-VERSION>
              <VENDOR-ID>17</VENDOR-ID>
              [!VAR "MinorVersion" = "text:split($moduleReleaseVer, '.')[position()-1 = 1]"!][!//
              [!IF "$MinorVersion = num:i(2)"!][!//
              <AR-RELEASE-VERSION>4.2.2</AR-RELEASE-VERSION>
              [!ELSE!]
              <AR-RELEASE-VERSION>4.4.0</AR-RELEASE-VERSION>
              [!ENDIF!]
              <BEHAVIOR-REF DEST="BSW-INTERNAL-BEHAVIOR">/AURIX2G_Irq/BswModuleDescriptions/Irq/IrqBehavior</BEHAVIOR-REF>
              <VENDOR-SPECIFIC-MODULE-DEF-REFS>
                <VENDOR-SPECIFIC-MODULE-DEF-REF DEST="ECUC-MODULE-DEF">/AURIX2G/EcucDefs/Irq</VENDOR-SPECIFIC-MODULE-DEF-REF>
              </VENDOR-SPECIFIC-MODULE-DEF-REFS>
            </BSW-IMPLEMENTATION>
          </ELEMENTS>
        </AR-PACKAGE>
      </AR-PACKAGES>
    </AR-PACKAGE>
  </AR-PACKAGES>
[!ENDSELECT!][!//
</AUTOSAR>
