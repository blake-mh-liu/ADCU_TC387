<?xml version="1.0" encoding="UTF-8"?>
[!/*<!--
/*******************************************************************************
**                                                                            **
** Copyright (C) Infineon Technologies (2023)                                 **
**                                                                            **
** All rights reserved.                                                       **
**                                                                            **
** This document contains proprietary information belonging to Infineon       **
** Technologies. Passing on and copying of this document, and communication   **
** of its contents is not permitted without prior written authorization.      **
**                                                                            **
********************************************************************************
**                                                                            **
**  FILENAME  : Icu_17_TimerIp_Bswmd.arxml                                    **
**                                                                            **
**  VERSION   : 32.0.0                                                        **
**                                                                            **
**  DATE      : 2023-05-18                                                    **
**                                                                            **
**  VARIANT   : Variant PB                                                    **
**                                                                            **
**  PLATFORM  : Infineon AURIX2G                                              **
**                                                                            **
**  AUTHOR    : DL-AUTOSAR-Engineering                                        **
**                                                                            **
**  VENDOR    : Infineon Technologies                                         **
**                                                                            **
**  TRACEABILITY : [cover parentID= {494217C8-3791-4964-8F02-98817E081697}]   **
**                                                                            **
**  DESCRIPTION  : Basic Software Module Description for ICU                  **
**                                                                            **
**  [/cover]                                                                  **
**                                                                            **
**  SPECIFICATION(S) : Specification of Icu Driver                            **
**                                                                            **
**  MAY BE CHANGED BY USER : no                                               **
**                                                                            **
*******************************************************************************/
-->*/!]
<!--
/*******************************************************************************
**                                                                            **
** Copyright (C) Infineon Technologies (2023)                                 **
**                                                                            **
** All rights reserved.                                                       **
**                                                                            **
** This document contains proprietary information belonging to Infineon       **
** Technologies. Passing on and copying of this document, and communication   **
** of its contents is not permitted without prior written authorization.      **
**                                                                            **
********************************************************************************
**                                                                            **
**  FILENAME  : Icu_17_TimerIp_Bswmd.arxml                                    **
**                                                                            **
**  VERSION   : 32.0.0                                                        **
**                                                                            **
**  DATE, TIME: [!"$date"!], [!"$time"!]          !!!IGNORE-LINE!!!           **
**                                                                            **
**  GENERATOR : Build [!"$buildnr"!]            !!!IGNORE-LINE!!!             **
**                                                                            **
**  VARIANT   : Variant PB                                                    **
**                                                                            **
**  PLATFORM  : Infineon AURIX2G                                              **
**                                                                            **
**  AUTHOR    : DL-AUTOSAR-Engineering                                        **
**                                                                            **
**  VENDOR    : Infineon Technologies                                         **
**                                                                            **
**  DESCRIPTION  : Basic Software Module Description for ICU                  **
**                                                                            **
**  SPECIFICATION(S) : Specification of Icu Driver                            **
**                                                                            **
**  MAY BE CHANGED BY USER : no                                               **
**                                                                            **
*******************************************************************************/
-->
[!/*<!-- [cover parentID={6ED094A1-7DF3-4366-B016-1F909310C766}] 
ICU BSWMD ARXML [/cover] -->*/!]
[!NOCODE!][!//
  [!VAR "MinorVersion" = "text:split($moduleReleaseVer, '.')[position()-1 = 1]"!][!//
  [!INCLUDE "Icu_17_TimerIp.m"!][!//
[!ENDNOCODE!][!//
[!IF "$MinorVersion = num:i(2)"!][!//
  <AUTOSAR xmlns="http://autosar.org/schema/r4.0" xmlns:xsi="http://www.w3.org/2001/XMLSchema-instance" xsi:schemaLocation="http://autosar.org/schema/r4.0 AUTOSAR_4-2-2.xsd">
[!ELSE!]  
  <AUTOSAR xmlns="http://autosar.org/schema/r4.0" xmlns:xsi="http://www.w3.org/2001/XMLSchema-instance" xsi:schemaLocation="http://autosar.org/schema/r4.0 AUTOSAR_00046.xsd">
[!ENDIF!]
[!AUTOSPACING!][!//
[!NOCODE!][!//
  [!SELECT "as:modconf('Icu')[1]"!][!//
    [!VAR "Icu_SafetyEnable_Xpath" = "IcuGeneral/IcuSafetyEnable"!][!//
    [!VAR "MaxChannels"= "num:i(count(./IcuConfigSet/IcuChannel/*))"!][!//
    [!VAR "Icu_GetVersionInfo_Xpath" = "IcuOptionalApis/IcuGetVersionInfoApi"!][!//
    [!VAR "Icu_DeInit_Xpath" = "IcuOptionalApis/IcuDeInitApi"!][!//
    [!VAR "Icu_SetMode_Xpath" = "IcuOptionalApis/IcuSetModeApi"!][!//
    [!VAR "Icu_DisableWakeup_Xpath" = "IcuOptionalApis/IcuDisableWakeupApi"!][!//
    [!VAR "Icu_EnableWakeup_Xpath" = "IcuOptionalApis/IcuEnableWakeupApi"!][!//
    [!VAR "Icu_DisableEdgeDetection_Xpath" = "IcuOptionalApis/IcuEdgeDetectApi"!][!//
    [!VAR "Icu_EnableEdgeDetection_Xpath" = "IcuOptionalApis/IcuEdgeDetectApi"!][!//
    [!VAR "Icu_GetInputState_Xpath" = "IcuOptionalApis/IcuGetInputStateApi"!][!//
    [!VAR "Icu_SetTimeout_Xpath" = "IcuOptionalApis/IcuTimeoutDetectionApi"!][!//
    [!VAR "Icu_StartTimestamp_Xpath" = "IcuOptionalApis/IcuTimestampApi"!][!//
    [!VAR "Icu_StopTimestamp_Xpath" = "IcuOptionalApis/IcuTimestampApi"!][!//
    [!VAR "Icu_GetTimestamp_Xpath" = "IcuOptionalApis/IcuTimestampApi"!][!//
    [!VAR "Icu_ResetEdgeCount_Xpath" = "IcuOptionalApis/IcuEdgeCountApi"!][!//
    [!VAR "Icu_EnableEdgeCount_Xpath" = "IcuOptionalApis/IcuEdgeCountApi"!][!//
    [!VAR "Icu_DisableEdgeCount_Xpath" = "IcuOptionalApis/IcuEdgeCountApi"!][!//
    [!VAR "Icu_GetEdgeNumbers_Xpath" = "IcuOptionalApis/IcuEdgeCountApi"!][!//
    [!VAR "Icu_IncInterface_Xpath" = "IcuOptionalApis/IcuIncrementalInterfaceApi"!][!//
    [!VAR "Icu_StartSignalMeasurement_Xpath" = "IcuOptionalApis/IcuSignalMeasurementApi"!][!//
    [!VAR "Icu_StopSignalMeasurement_Xpath" = "IcuOptionalApis/IcuSignalMeasurementApi"!][!//
    [!VAR "Icu_GetTimeElapsed_Xpath" = "IcuOptionalApis/IcuGetTimeElapsedApi"!][!//
    [!VAR "Icu_GetDutyCycleValues_Xpath" = "IcuOptionalApis/IcuGetDutyCycleValuesApi"!][!//
    [!VAR "Icu_CheckWakeup_Xpath" = "IcuOptionalApis/IcuWakeupFunctionalityApi"!][!//
    [!VAR "Icu_17_TimerIp_EnableMultiEdgeDetection_Xpath" = "IcuOptionalApis/IcuEdgeDetectApi"!][!//
    [!VAR "Icu_17_TimerIp_InitCheck_Xpath" = "IcuOptionalApis/IcuInitCheckApi"!][!//
    [!VAR "ReportWakeupSource" = "IcuGeneral/IcuReportWakeupSource"!][!//
    [!VAR "DevErrorDetect" = "IcuGeneral/IcuDevErrorDetect"!][!//
    [!IF "$MinorVersion = num:i(4)"!][!//
      [!VAR "DevRuntimeErrorDetect" = "IcuGeneral/IcuRunTimeErrorDetect"!][!//
    [!ELSE!]
      [!VAR "DevRuntimeErrorDetect" = "'false'"!][!//
    [!ENDIF!]
    [!CALL "ICU_CG_GenerateModuleMap"!][!//
    [!VAR "ChannelModeMap" = "''"!][!//
    [!SELECT "IcuConfigSet"!][!//
      [!FOR "ChannelId" = "num:i(1)" TO "num:i($MaxChannels)"!][!//
        [!SELECT "IcuChannel/*[IcuChannelId = num:i($ChannelId) - num:i(1)]"!][!//
          [!NOCODE!][!//
            [!CALL "ICU_CG_GetCore", "Channel" = "node:name(node:current())"!][!//
          [!ENDNOCODE!][!//
          [!IF "IcuAssignedHwUnit != 'ERU'"!][!//
            [!VAR "ChannelModeMap" = "text:toupper(concat($ChannelModeMap,'CORE',$CGCoreId_Extract,'_','_UNION',','))"!][!//
          [!ENDIF!][!//
        [!ENDSELECT!][!//
      [!ENDFOR!][!//
    [!ENDSELECT!][!//
  [!ENDSELECT!][!//
  [!VAR "GtmAvailable" = "ecu:get('Gtm.Available')"!][!//
  [!VAR "MaxChannels"= "num:i(count(./IcuConfigSet/IcuChannel/*))"!][!//
  [!VAR "ConfiguredCores"= "num:i(0)"!][!//
  [!VAR "UnallocatedChannels"= "num:i($MaxChannels - num:i(count(text:split($CGCoreMap,','))))"!][!//
  [!FOR "CoreId" = "num:i(1)" TO "num:i(6)"!][!//
    [!IF "contains($CGCoreMap,concat('CORE',num:i($CoreId) - num:i(1)))"!]
      [!VAR "ConfiguredCores"= "bit:bitset($ConfiguredCores,$CoreId)"!][!//
    [!ELSEIF "num:i($CGMasterCoreId_Extract) = (num:i($CoreId) - num:i(1))"!]
      [!IF "$UnallocatedChannels > num:i(0)"!]
        [!VAR "ConfiguredCores"= "bit:bitset($ConfiguredCores,$CoreId)"!][!//
      [!ENDIF!]
    [!ENDIF!]
  [!ENDFOR!]
[!ENDNOCODE!][!//
<AR-PACKAGES>
  <AR-PACKAGE>
    <SHORT-NAME>AUTOSAR_Icu_17_TimerIp</SHORT-NAME>
    <AR-PACKAGES>
      <AR-PACKAGE>
        <SHORT-NAME>BswModuleDescriptions</SHORT-NAME>
        <CATEGORY>STANDARD</CATEGORY>
        <ELEMENTS>
          <BSW-MODULE-DESCRIPTION>
            <SHORT-NAME>Icu</SHORT-NAME>
            <LONG-NAME>
              <L-4 L="EN">ICU Driver</L-4>
            </LONG-NAME>
            <CATEGORY>BSW_MODULE</CATEGORY>
            <MODULE-ID>122</MODULE-ID>
            <PROVIDED-ENTRYS>
[!IF "$Icu_GetVersionInfo_Xpath = 'true'"!][!//
              <BSW-MODULE-ENTRY-REF-CONDITIONAL>
                <BSW-MODULE-ENTRY-REF DEST="BSW-MODULE-ENTRY">/AUTOSAR_Icu_17_TimerIp/BswModuleEntrys/Icu_GetVersionInfo</BSW-MODULE-ENTRY-REF>
              </BSW-MODULE-ENTRY-REF-CONDITIONAL>
[!ENDIF!][!//
              <BSW-MODULE-ENTRY-REF-CONDITIONAL>
                <BSW-MODULE-ENTRY-REF DEST="BSW-MODULE-ENTRY">/AUTOSAR_Icu_17_TimerIp/BswModuleEntrys/Icu_Init</BSW-MODULE-ENTRY-REF>
              </BSW-MODULE-ENTRY-REF-CONDITIONAL>
[!IF "$Icu_DeInit_Xpath = 'true'"!][!//
              <BSW-MODULE-ENTRY-REF-CONDITIONAL>
                <BSW-MODULE-ENTRY-REF DEST="BSW-MODULE-ENTRY">/AUTOSAR_Icu_17_TimerIp/BswModuleEntrys/Icu_DeInit</BSW-MODULE-ENTRY-REF>
              </BSW-MODULE-ENTRY-REF-CONDITIONAL>
[!ENDIF!][!//
[!IF "$Icu_SetMode_Xpath = 'true'"!][!//
              <BSW-MODULE-ENTRY-REF-CONDITIONAL>
                <BSW-MODULE-ENTRY-REF DEST="BSW-MODULE-ENTRY">/AUTOSAR_Icu_17_TimerIp/BswModuleEntrys/Icu_SetMode</BSW-MODULE-ENTRY-REF>
              </BSW-MODULE-ENTRY-REF-CONDITIONAL>
[!ENDIF!][!//
[!IF "$Icu_DisableWakeup_Xpath = 'true'"!][!//
              <BSW-MODULE-ENTRY-REF-CONDITIONAL>
                <BSW-MODULE-ENTRY-REF DEST="BSW-MODULE-ENTRY">/AUTOSAR_Icu_17_TimerIp/BswModuleEntrys/Icu_DisableWakeup</BSW-MODULE-ENTRY-REF>
              </BSW-MODULE-ENTRY-REF-CONDITIONAL>
[!ENDIF!][!//
[!IF "$Icu_EnableWakeup_Xpath = 'true'"!][!//
              <BSW-MODULE-ENTRY-REF-CONDITIONAL>
                <BSW-MODULE-ENTRY-REF DEST="BSW-MODULE-ENTRY">/AUTOSAR_Icu_17_TimerIp/BswModuleEntrys/Icu_EnableWakeup</BSW-MODULE-ENTRY-REF>
              </BSW-MODULE-ENTRY-REF-CONDITIONAL>
[!ENDIF!][!//
              <BSW-MODULE-ENTRY-REF-CONDITIONAL>
                <BSW-MODULE-ENTRY-REF DEST="BSW-MODULE-ENTRY">/AUTOSAR_Icu_17_TimerIp/BswModuleEntrys/Icu_SetActivationCondition</BSW-MODULE-ENTRY-REF>
              </BSW-MODULE-ENTRY-REF-CONDITIONAL>
[!IF "$Icu_DisableEdgeDetection_Xpath = 'true'"!][!//
              <BSW-MODULE-ENTRY-REF-CONDITIONAL>
                <BSW-MODULE-ENTRY-REF DEST="BSW-MODULE-ENTRY">/AUTOSAR_Icu_17_TimerIp/BswModuleEntrys/Icu_DisableEdgeDetection</BSW-MODULE-ENTRY-REF>
              </BSW-MODULE-ENTRY-REF-CONDITIONAL>
[!ENDIF!][!//
[!IF "$Icu_EnableEdgeDetection_Xpath = 'true'"!][!//
              <BSW-MODULE-ENTRY-REF-CONDITIONAL>
                <BSW-MODULE-ENTRY-REF DEST="BSW-MODULE-ENTRY">/AUTOSAR_Icu_17_TimerIp/BswModuleEntrys/Icu_EnableEdgeDetection</BSW-MODULE-ENTRY-REF>
              </BSW-MODULE-ENTRY-REF-CONDITIONAL>
[!ENDIF!][!//
              <BSW-MODULE-ENTRY-REF-CONDITIONAL>
                <BSW-MODULE-ENTRY-REF DEST="BSW-MODULE-ENTRY">/AUTOSAR_Icu_17_TimerIp/BswModuleEntrys/Icu_DisableNotification</BSW-MODULE-ENTRY-REF>
              </BSW-MODULE-ENTRY-REF-CONDITIONAL>
              <BSW-MODULE-ENTRY-REF-CONDITIONAL>
                <BSW-MODULE-ENTRY-REF DEST="BSW-MODULE-ENTRY">/AUTOSAR_Icu_17_TimerIp/BswModuleEntrys/Icu_EnableNotification</BSW-MODULE-ENTRY-REF>
              </BSW-MODULE-ENTRY-REF-CONDITIONAL>
[!IF "$Icu_SetTimeout_Xpath = 'true'"!][!//
              <BSW-MODULE-ENTRY-REF-CONDITIONAL>
                <BSW-MODULE-ENTRY-REF DEST="BSW-MODULE-ENTRY">/AUTOSAR_Icu_17_TimerIp/BswModuleEntrys/Icu_SetTimeoutValue</BSW-MODULE-ENTRY-REF>
              </BSW-MODULE-ENTRY-REF-CONDITIONAL>
[!ENDIF!][!//
[!IF "$Icu_GetInputState_Xpath = 'true'"!][!//
              <BSW-MODULE-ENTRY-REF-CONDITIONAL>
                <BSW-MODULE-ENTRY-REF DEST="BSW-MODULE-ENTRY">/AUTOSAR_Icu_17_TimerIp/BswModuleEntrys/Icu_GetInputState</BSW-MODULE-ENTRY-REF>
              </BSW-MODULE-ENTRY-REF-CONDITIONAL>
[!ENDIF!][!//
[!IF "$Icu_StartTimestamp_Xpath = 'true'"!][!//
              <BSW-MODULE-ENTRY-REF-CONDITIONAL>
                <BSW-MODULE-ENTRY-REF DEST="BSW-MODULE-ENTRY">/AUTOSAR_Icu_17_TimerIp/BswModuleEntrys/Icu_StartTimestamp</BSW-MODULE-ENTRY-REF>
              </BSW-MODULE-ENTRY-REF-CONDITIONAL>
[!ENDIF!][!//
[!IF "$Icu_StopTimestamp_Xpath = 'true'"!][!//
              <BSW-MODULE-ENTRY-REF-CONDITIONAL>
                <BSW-MODULE-ENTRY-REF DEST="BSW-MODULE-ENTRY">/AUTOSAR_Icu_17_TimerIp/BswModuleEntrys/Icu_StopTimestamp</BSW-MODULE-ENTRY-REF>
              </BSW-MODULE-ENTRY-REF-CONDITIONAL>
[!ENDIF!][!//
[!IF "$Icu_GetTimestamp_Xpath = 'true'"!][!//
              <BSW-MODULE-ENTRY-REF-CONDITIONAL>
                <BSW-MODULE-ENTRY-REF DEST="BSW-MODULE-ENTRY">/AUTOSAR_Icu_17_TimerIp/BswModuleEntrys/Icu_GetTimestampIndex</BSW-MODULE-ENTRY-REF>
              </BSW-MODULE-ENTRY-REF-CONDITIONAL>
[!ENDIF!][!//
[!IF "$Icu_ResetEdgeCount_Xpath = 'true'"!][!//
              <BSW-MODULE-ENTRY-REF-CONDITIONAL>
                <BSW-MODULE-ENTRY-REF DEST="BSW-MODULE-ENTRY">/AUTOSAR_Icu_17_TimerIp/BswModuleEntrys/Icu_ResetEdgeCount</BSW-MODULE-ENTRY-REF>
              </BSW-MODULE-ENTRY-REF-CONDITIONAL>
[!ENDIF!][!//
[!IF "$Icu_EnableEdgeCount_Xpath = 'true'"!][!//
              <BSW-MODULE-ENTRY-REF-CONDITIONAL>
                <BSW-MODULE-ENTRY-REF DEST="BSW-MODULE-ENTRY">/AUTOSAR_Icu_17_TimerIp/BswModuleEntrys/Icu_EnableEdgeCount</BSW-MODULE-ENTRY-REF>
              </BSW-MODULE-ENTRY-REF-CONDITIONAL>
[!ENDIF!][!//
[!IF "$Icu_DisableEdgeCount_Xpath = 'true'"!][!//
              <BSW-MODULE-ENTRY-REF-CONDITIONAL>
                <BSW-MODULE-ENTRY-REF DEST="BSW-MODULE-ENTRY">/AUTOSAR_Icu_17_TimerIp/BswModuleEntrys/Icu_DisableEdgeCount</BSW-MODULE-ENTRY-REF>
              </BSW-MODULE-ENTRY-REF-CONDITIONAL>
[!ENDIF!][!//
[!IF "$Icu_GetEdgeNumbers_Xpath = 'true'"!][!//
              <BSW-MODULE-ENTRY-REF-CONDITIONAL>
                <BSW-MODULE-ENTRY-REF DEST="BSW-MODULE-ENTRY">/AUTOSAR_Icu_17_TimerIp/BswModuleEntrys/Icu_GetEdgeNumbers</BSW-MODULE-ENTRY-REF>
              </BSW-MODULE-ENTRY-REF-CONDITIONAL>
[!ENDIF!][!//
[!IF "$Icu_StartSignalMeasurement_Xpath = 'true'"!][!//
              <BSW-MODULE-ENTRY-REF-CONDITIONAL>
                <BSW-MODULE-ENTRY-REF DEST="BSW-MODULE-ENTRY">/AUTOSAR_Icu_17_TimerIp/BswModuleEntrys/Icu_StartSignalMeasurement</BSW-MODULE-ENTRY-REF>
              </BSW-MODULE-ENTRY-REF-CONDITIONAL>
[!ENDIF!][!//
[!IF "$Icu_StopSignalMeasurement_Xpath = 'true'"!][!//
              <BSW-MODULE-ENTRY-REF-CONDITIONAL>
                <BSW-MODULE-ENTRY-REF DEST="BSW-MODULE-ENTRY">/AUTOSAR_Icu_17_TimerIp/BswModuleEntrys/Icu_StopSignalMeasurement</BSW-MODULE-ENTRY-REF>
              </BSW-MODULE-ENTRY-REF-CONDITIONAL>
[!ENDIF!][!//
[!IF "$Icu_GetTimeElapsed_Xpath = 'true'"!][!//
              <BSW-MODULE-ENTRY-REF-CONDITIONAL>
                <BSW-MODULE-ENTRY-REF DEST="BSW-MODULE-ENTRY">/AUTOSAR_Icu_17_TimerIp/BswModuleEntrys/Icu_GetTimeElapsed</BSW-MODULE-ENTRY-REF>
              </BSW-MODULE-ENTRY-REF-CONDITIONAL>
[!ENDIF!][!//
[!IF "$Icu_GetDutyCycleValues_Xpath = 'true'"!][!//
              <BSW-MODULE-ENTRY-REF-CONDITIONAL>
                <BSW-MODULE-ENTRY-REF DEST="BSW-MODULE-ENTRY">/AUTOSAR_Icu_17_TimerIp/BswModuleEntrys/Icu_GetDutyCycleValues</BSW-MODULE-ENTRY-REF>
              </BSW-MODULE-ENTRY-REF-CONDITIONAL>
[!ENDIF!][!//
[!IF "$Icu_CheckWakeup_Xpath = 'true'"!][!//
              <BSW-MODULE-ENTRY-REF-CONDITIONAL>
                <BSW-MODULE-ENTRY-REF DEST="BSW-MODULE-ENTRY">/AUTOSAR_Icu_17_TimerIp/BswModuleEntrys/Icu_CheckWakeup</BSW-MODULE-ENTRY-REF>
              </BSW-MODULE-ENTRY-REF-CONDITIONAL>
[!ENDIF!][!//
              <BSW-MODULE-ENTRY-REF-CONDITIONAL>
                <BSW-MODULE-ENTRY-REF DEST="BSW-MODULE-ENTRY">/AUTOSAR_Icu_17_TimerIp/BswModuleEntrys/Icu_Timer_Isr</BSW-MODULE-ENTRY-REF>
              </BSW-MODULE-ENTRY-REF-CONDITIONAL>
[!IF "$Icu_17_TimerIp_EnableMultiEdgeDetection_Xpath = 'true'"!][!//
              <BSW-MODULE-ENTRY-REF-CONDITIONAL>
                <BSW-MODULE-ENTRY-REF DEST="BSW-MODULE-ENTRY">/AUTOSAR_Icu_17_TimerIp/BswModuleEntrys/Icu_EnableMultiEdgeDetection</BSW-MODULE-ENTRY-REF>
              </BSW-MODULE-ENTRY-REF-CONDITIONAL>
[!ENDIF!][!//
[!IF "$Icu_17_TimerIp_InitCheck_Xpath = 'true'"!][!//
              <BSW-MODULE-ENTRY-REF-CONDITIONAL>
                <BSW-MODULE-ENTRY-REF DEST="BSW-MODULE-ENTRY">/AUTOSAR_Icu_17_TimerIp/BswModuleEntrys/Icu_InitCheck</BSW-MODULE-ENTRY-REF>
              </BSW-MODULE-ENTRY-REF-CONDITIONAL>
[!ENDIF!][!//
[!IF "$Icu_IncInterface_Xpath = 'true'"!][!//
              <BSW-MODULE-ENTRY-REF-CONDITIONAL>
                <BSW-MODULE-ENTRY-REF DEST="BSW-MODULE-ENTRY">/AUTOSAR_Icu_17_TimerIp/BswModuleEntrys/Icu_StartIncInterface</BSW-MODULE-ENTRY-REF>
              </BSW-MODULE-ENTRY-REF-CONDITIONAL>
              <BSW-MODULE-ENTRY-REF-CONDITIONAL>
                <BSW-MODULE-ENTRY-REF DEST="BSW-MODULE-ENTRY">/AUTOSAR_Icu_17_TimerIp/BswModuleEntrys/Icu_StopIncInterface</BSW-MODULE-ENTRY-REF>
              </BSW-MODULE-ENTRY-REF-CONDITIONAL>
              <BSW-MODULE-ENTRY-REF-CONDITIONAL>
                <BSW-MODULE-ENTRY-REF DEST="BSW-MODULE-ENTRY">/AUTOSAR_Icu_17_TimerIp/BswModuleEntrys/Icu_CalibratePos</BSW-MODULE-ENTRY-REF>
              </BSW-MODULE-ENTRY-REF-CONDITIONAL>
              <BSW-MODULE-ENTRY-REF-CONDITIONAL>
                <BSW-MODULE-ENTRY-REF DEST="BSW-MODULE-ENTRY">/AUTOSAR_Icu_17_TimerIp/BswModuleEntrys/Icu_ReadEncCount</BSW-MODULE-ENTRY-REF>
              </BSW-MODULE-ENTRY-REF-CONDITIONAL>
              <BSW-MODULE-ENTRY-REF-CONDITIONAL>
                <BSW-MODULE-ENTRY-REF DEST="BSW-MODULE-ENTRY">/AUTOSAR_Icu_17_TimerIp/BswModuleEntrys/Icu_ReadEncCountDir</BSW-MODULE-ENTRY-REF>
              </BSW-MODULE-ENTRY-REF-CONDITIONAL>
[!ENDIF!][!//
            </PROVIDED-ENTRYS>
            <BSW-MODULE-DEPENDENCYS>
[!IF "$DevErrorDetect = 'true'"!][!//
              <BSW-MODULE-DEPENDENCY>
                <SHORT-NAME>DetDependency</SHORT-NAME>
                <TARGET-MODULE-ID>15</TARGET-MODULE-ID>
                <REQUIRED-ENTRYS>                
                  <BSW-MODULE-ENTRY-REF-CONDITIONAL>
                    <BSW-MODULE-ENTRY-REF DEST="BSW-MODULE-ENTRY">/AUTOSAR_Det/BswModuleEntrys/Det_ReportError</BSW-MODULE-ENTRY-REF>
                  </BSW-MODULE-ENTRY-REF-CONDITIONAL>
                </REQUIRED-ENTRYS>
              </BSW-MODULE-DEPENDENCY>
[!ENDIF!][!//
[!IF "$DevRuntimeErrorDetect = 'true'"!][!//
              <BSW-MODULE-DEPENDENCY>
                <SHORT-NAME>McalWrapperDependency</SHORT-NAME>
                <TARGET-MODULE-ID>255</TARGET-MODULE-ID>
                <REQUIRED-ENTRYS>                 
                  <BSW-MODULE-ENTRY-REF-CONDITIONAL>
                    <BSW-MODULE-ENTRY-REF DEST="BSW-MODULE-ENTRY">/AUTOSAR_Stub/BswModuleEntrys/Mcal_Wrapper_Det_ReportRuntimeError</BSW-MODULE-ENTRY-REF>
                  </BSW-MODULE-ENTRY-REF-CONDITIONAL>
                </REQUIRED-ENTRYS>
              </BSW-MODULE-DEPENDENCY>
[!ENDIF!][!//
[!IF "$ReportWakeupSource = 'true'"!][!//
              <BSW-MODULE-DEPENDENCY>
                <SHORT-NAME>EcuMDependency</SHORT-NAME>
                <TARGET-MODULE-ID>10</TARGET-MODULE-ID>
                <REQUIRED-ENTRYS>
                  <BSW-MODULE-ENTRY-REF-CONDITIONAL>
                    <BSW-MODULE-ENTRY-REF DEST="BSW-MODULE-ENTRY">/AUTOSAR_EcuM/BswModuleEntrys/EcuM_SetWakeupEvent</BSW-MODULE-ENTRY-REF>
                  </BSW-MODULE-ENTRY-REF-CONDITIONAL>
                  <BSW-MODULE-ENTRY-REF-CONDITIONAL>
                    <BSW-MODULE-ENTRY-REF DEST="BSW-MODULE-ENTRY">/AUTOSAR_EcuM/BswModuleEntrys/EcuM_CheckWakeup</BSW-MODULE-ENTRY-REF>
                  </BSW-MODULE-ENTRY-REF-CONDITIONAL>
                </REQUIRED-ENTRYS>
              </BSW-MODULE-DEPENDENCY>
[!ENDIF!][!//
              <BSW-MODULE-DEPENDENCY>
                <SHORT-NAME>McuDependency</SHORT-NAME>
                <TARGET-MODULE-ID>101</TARGET-MODULE-ID>
                <REQUIRED-ENTRYS>
                  <BSW-MODULE-ENTRY-REF-CONDITIONAL>
                    <BSW-MODULE-ENTRY-REF DEST="BSW-MODULE-ENTRY">/AUTOSAR_Mcu/BswModuleEntrys/Mcu_17_Gpt12_TimerClockInit</BSW-MODULE-ENTRY-REF>
                  </BSW-MODULE-ENTRY-REF-CONDITIONAL>
                  [!IF "$GtmAvailable = 'true'"!][!//
                  <BSW-MODULE-ENTRY-REF-CONDITIONAL>
                    <BSW-MODULE-ENTRY-REF DEST="BSW-MODULE-ENTRY">/AUTOSAR_Mcu/BswModuleEntrys/Mcu_17_Gtm_TimChannelDeInit</BSW-MODULE-ENTRY-REF>
                  </BSW-MODULE-ENTRY-REF-CONDITIONAL>
                  [!ENDIF!][!//
                  <BSW-MODULE-ENTRY-REF-CONDITIONAL>
                    <BSW-MODULE-ENTRY-REF DEST="BSW-MODULE-ENTRY">/AUTOSAR_Mcu/BswModuleEntrys/Mcu_17_Ccu6_TimerDeInit</BSW-MODULE-ENTRY-REF>
                  </BSW-MODULE-ENTRY-REF-CONDITIONAL>
                  <BSW-MODULE-ENTRY-REF-CONDITIONAL>
                    <BSW-MODULE-ENTRY-REF DEST="BSW-MODULE-ENTRY">/AUTOSAR_Mcu/BswModuleEntrys/Mcu_17_Gpt12_TimerDeInit</BSW-MODULE-ENTRY-REF>
                  </BSW-MODULE-ENTRY-REF-CONDITIONAL>
                  <BSW-MODULE-ENTRY-REF-CONDITIONAL>
                    <BSW-MODULE-ENTRY-REF DEST="BSW-MODULE-ENTRY">/AUTOSAR_Mcu/BswModuleEntrys/Mcu_17_Ccu6_TimerStop</BSW-MODULE-ENTRY-REF>
                  </BSW-MODULE-ENTRY-REF-CONDITIONAL>
                  [!IF "$GtmAvailable = 'true'"!][!//
                  <BSW-MODULE-ENTRY-REF-CONDITIONAL>
                    <BSW-MODULE-ENTRY-REF DEST="BSW-MODULE-ENTRY">/AUTOSAR_Mcu/BswModuleEntrys/Mcu_17_Gtm_ConnectPortPinToTim</BSW-MODULE-ENTRY-REF>
                  </BSW-MODULE-ENTRY-REF-CONDITIONAL>
                  <BSW-MODULE-ENTRY-REF-CONDITIONAL>
                    <BSW-MODULE-ENTRY-REF DEST="BSW-MODULE-ENTRY">/AUTOSAR_Mcu/BswModuleEntrys/Mcu_17_Gtm_TimChannelInit</BSW-MODULE-ENTRY-REF>
                  </BSW-MODULE-ENTRY-REF-CONDITIONAL>
                  [!ENDIF!][!//
                  <BSW-MODULE-ENTRY-REF-CONDITIONAL>
                    <BSW-MODULE-ENTRY-REF DEST="BSW-MODULE-ENTRY">/AUTOSAR_Mcu/BswModuleEntrys/Mcu_17_Ccu6_TimerInit</BSW-MODULE-ENTRY-REF>
                  </BSW-MODULE-ENTRY-REF-CONDITIONAL>
                  <BSW-MODULE-ENTRY-REF-CONDITIONAL>
                    <BSW-MODULE-ENTRY-REF DEST="BSW-MODULE-ENTRY">/AUTOSAR_Mcu/BswModuleEntrys/Mcu_17_Ccu6_TimerShadowTransfer</BSW-MODULE-ENTRY-REF>
                  </BSW-MODULE-ENTRY-REF-CONDITIONAL>
                  <BSW-MODULE-ENTRY-REF-CONDITIONAL>
                    <BSW-MODULE-ENTRY-REF DEST="BSW-MODULE-ENTRY">/AUTOSAR_Mcu/BswModuleEntrys/Mcu_17_Ccu6_TimerStart</BSW-MODULE-ENTRY-REF>
                  </BSW-MODULE-ENTRY-REF-CONDITIONAL>
                  <BSW-MODULE-ENTRY-REF-CONDITIONAL>
                    <BSW-MODULE-ENTRY-REF DEST="BSW-MODULE-ENTRY">/AUTOSAR_Mcu/BswModuleEntrys/Mcu_17_Gpt12_TimerInit</BSW-MODULE-ENTRY-REF>
                  </BSW-MODULE-ENTRY-REF-CONDITIONAL>
                </REQUIRED-ENTRYS>
              </BSW-MODULE-DEPENDENCY>

              <BSW-MODULE-DEPENDENCY>
                <SHORT-NAME>McalLibDependency</SHORT-NAME>
                <TARGET-MODULE-ID>255</TARGET-MODULE-ID>
                <REQUIRED-ENTRYS>
                  <BSW-MODULE-ENTRY-REF-CONDITIONAL>
                    <BSW-MODULE-ENTRY-REF DEST="BSW-MODULE-ENTRY">/AURIX2G_McalLib/BswModuleEntrys/Mcal_WriteSafetyEndInitProtRegMask</BSW-MODULE-ENTRY-REF>
                  </BSW-MODULE-ENTRY-REF-CONDITIONAL>
                  <BSW-MODULE-ENTRY-REF-CONDITIONAL>
                    <BSW-MODULE-ENTRY-REF DEST="BSW-MODULE-ENTRY">/AURIX2G_McalLib/BswModuleEntrys/Mcal_GetCpuIndex</BSW-MODULE-ENTRY-REF>
                  </BSW-MODULE-ENTRY-REF-CONDITIONAL>
                  <BSW-MODULE-ENTRY-REF-CONDITIONAL>
                    <BSW-MODULE-ENTRY-REF DEST="BSW-MODULE-ENTRY">/AURIX2G_McalLib/BswModuleEntrys/Mcal_GetBitAtomic</BSW-MODULE-ENTRY-REF>
                  </BSW-MODULE-ENTRY-REF-CONDITIONAL>
                  <BSW-MODULE-ENTRY-REF-CONDITIONAL>
                    <BSW-MODULE-ENTRY-REF DEST="BSW-MODULE-ENTRY">/AURIX2G_McalLib/BswModuleEntrys/Mcal_SetBitAtomic</BSW-MODULE-ENTRY-REF>
                  </BSW-MODULE-ENTRY-REF-CONDITIONAL>
                </REQUIRED-ENTRYS>
              </BSW-MODULE-DEPENDENCY>
[!IF "$Icu_SafetyEnable_Xpath = 'true'"!][!//
              <BSW-MODULE-DEPENDENCY>
                <SHORT-NAME>McalSafetyErrorDependency</SHORT-NAME>
                <TARGET-MODULE-ID>255</TARGET-MODULE-ID>
                <REQUIRED-ENTRYS>
                  <BSW-MODULE-ENTRY-REF-CONDITIONAL>
                    <BSW-MODULE-ENTRY-REF DEST="BSW-MODULE-ENTRY">/AUTOSAR_Stub/BswModuleEntrys/Mcal_ReportSafetyError</BSW-MODULE-ENTRY-REF>
                  </BSW-MODULE-ENTRY-REF-CONDITIONAL>
                </REQUIRED-ENTRYS>
              </BSW-MODULE-DEPENDENCY>
[!ENDIF!][!//
            </BSW-MODULE-DEPENDENCYS>
            <INTERNAL-BEHAVIORS>
              <BSW-INTERNAL-BEHAVIOR>
                <SHORT-NAME>IcuBehavior</SHORT-NAME>
                <EXCLUSIVE-AREAS>
[!IF "$Icu_ResetEdgeCount_Xpath = 'true'"!][!//
                  <EXCLUSIVE-AREA>
                    <SHORT-NAME>ResetEdgeCount</SHORT-NAME>
                    <INTRODUCTION>
                      <NOTE SI="User shall implement this exclusive area by Suspend and Resume interrupts to reduce the chance to miss any edge during the reset operation." NOTE-TYPE="HINT"/>
                    </INTRODUCTION>
                  </EXCLUSIVE-AREA>
[!ENDIF!][!//
[!IF "$Icu_GetDutyCycleValues_Xpath = 'true'"!][!//
                  [!IF "$GtmAvailable = 'true'"!][!//
                  <EXCLUSIVE-AREA>
                    <SHORT-NAME>GtmGetDutyCycle</SHORT-NAME>
                    <INTRODUCTION>
                      <NOTE SI="User shall implement this exclusive area by Suspend and Resume interrupts to ensure coherent duty cycle measurement is done." NOTE-TYPE="HINT"/>
                    </INTRODUCTION>
                  </EXCLUSIVE-AREA>
                  [!ENDIF!][!//
[!ENDIF!][!//
                  <EXCLUSIVE-AREA>
                    <SHORT-NAME>SetActivationCondition</SHORT-NAME>
                    <INTRODUCTION>
                      <NOTE SI="User shall implement this exclusive area by Suspend and Resume interrupts to reduce the chance to miss any edge during the Set active condition operation." NOTE-TYPE="HINT"/>
                    </INTRODUCTION>
                  </EXCLUSIVE-AREA>
[!IF "$Icu_EnableEdgeCount_Xpath = 'true'"!][!//
                  [!IF "$GtmAvailable = 'true'"!][!//
                  <EXCLUSIVE-AREA>
                    <SHORT-NAME>GtmEnableEdgeCount</SHORT-NAME>
                    <INTRODUCTION>
                      <NOTE SI="User shall implement this exclusive area by Suspend and Resume interrupts to reduce the chance to miss any edge during the enable edge count operation." NOTE-TYPE="HINT"/>
                    </INTRODUCTION>
                  </EXCLUSIVE-AREA>
                  [!ENDIF!][!//
[!ENDIF!][!//
                </EXCLUSIVE-AREAS>
                <ENTITYS>
[!IF "$Icu_GetVersionInfo_Xpath = 'true'"!][!//
                  <BSW-CALLED-ENTITY>
                    <SHORT-NAME>Icu_GetVersionInfo</SHORT-NAME>
                    <REENTRANCY-LEVEL>MULTICORE-REENTRANT</REENTRANCY-LEVEL>
                    <IMPLEMENTED-ENTRY-REF DEST="BSW-MODULE-ENTRY">/AUTOSAR_Icu_17_TimerIp/BswModuleEntrys/Icu_GetVersionInfo</IMPLEMENTED-ENTRY-REF>
                  </BSW-CALLED-ENTITY>
[!ENDIF!][!//
                  <BSW-CALLED-ENTITY>
                    <SHORT-NAME>Icu_Init</SHORT-NAME>
                    <REENTRANCY-LEVEL>NON-REENTRANT</REENTRANCY-LEVEL>
                    <IMPLEMENTED-ENTRY-REF DEST="BSW-MODULE-ENTRY">/AUTOSAR_Icu_17_TimerIp/BswModuleEntrys/Icu_Init</IMPLEMENTED-ENTRY-REF>
                  </BSW-CALLED-ENTITY>
[!IF "$Icu_17_TimerIp_InitCheck_Xpath = 'true'"!][!//
                  <BSW-CALLED-ENTITY>
                    <SHORT-NAME>Icu_InitCheck</SHORT-NAME>
                    <REENTRANCY-LEVEL>NON-REENTRANT</REENTRANCY-LEVEL>
                    <IMPLEMENTED-ENTRY-REF DEST="BSW-MODULE-ENTRY">/AUTOSAR_Icu_17_TimerIp/BswModuleEntrys/Icu_InitCheck</IMPLEMENTED-ENTRY-REF>
                  </BSW-CALLED-ENTITY>
[!ENDIF!][!//
[!IF "$Icu_DeInit_Xpath = 'true'"!][!//
                  <BSW-CALLED-ENTITY>
                    <SHORT-NAME>Icu_DeInit</SHORT-NAME>
                    <REENTRANCY-LEVEL>NON-REENTRANT</REENTRANCY-LEVEL>
                    <IMPLEMENTED-ENTRY-REF DEST="BSW-MODULE-ENTRY">/AUTOSAR_Icu_17_TimerIp/BswModuleEntrys/Icu_DeInit</IMPLEMENTED-ENTRY-REF>
                  </BSW-CALLED-ENTITY>
[!ENDIF!][!//
[!IF "$Icu_SetMode_Xpath = 'true'"!][!//
                  <BSW-CALLED-ENTITY>
                    <SHORT-NAME>Icu_SetMode</SHORT-NAME>
                    <REENTRANCY-LEVEL>NON-REENTRANT</REENTRANCY-LEVEL>
                    <IMPLEMENTED-ENTRY-REF DEST="BSW-MODULE-ENTRY">/AUTOSAR_Icu_17_TimerIp/BswModuleEntrys/Icu_SetMode</IMPLEMENTED-ENTRY-REF>
                  </BSW-CALLED-ENTITY>
[!ENDIF!][!//
[!IF "$Icu_DisableWakeup_Xpath = 'true'"!][!//
                  <BSW-CALLED-ENTITY>
                    <SHORT-NAME>Icu_DisableWakeup</SHORT-NAME>
                    <REENTRANCY-LEVEL>MULTICORE-REENTRANT</REENTRANCY-LEVEL>
                    <IMPLEMENTED-ENTRY-REF DEST="BSW-MODULE-ENTRY">/AUTOSAR_Icu_17_TimerIp/BswModuleEntrys/Icu_DisableWakeup</IMPLEMENTED-ENTRY-REF>
                  </BSW-CALLED-ENTITY>
[!ENDIF!][!//
[!IF "$Icu_EnableWakeup_Xpath = 'true'"!][!//
                  <BSW-CALLED-ENTITY>
                    <SHORT-NAME>Icu_EnableWakeup</SHORT-NAME>
                    <REENTRANCY-LEVEL>MULTICORE-REENTRANT</REENTRANCY-LEVEL>
                    <IMPLEMENTED-ENTRY-REF DEST="BSW-MODULE-ENTRY">/AUTOSAR_Icu_17_TimerIp/BswModuleEntrys/Icu_EnableWakeup</IMPLEMENTED-ENTRY-REF>
                  </BSW-CALLED-ENTITY>
[!ENDIF!][!//
                  <BSW-CALLED-ENTITY>
                    <SHORT-NAME>Icu_SetActivationCondition</SHORT-NAME>
                    <CAN-ENTER-EXCLUSIVE-AREA-REFS>
                      <CAN-ENTER-EXCLUSIVE-AREA-REF DEST="EXCLUSIVE-AREA">/AUTOSAR_Icu_17_TimerIp/BswModuleDescriptions/Icu/IcuBehavior/SetActivationCondition</CAN-ENTER-EXCLUSIVE-AREA-REF>
                    </CAN-ENTER-EXCLUSIVE-AREA-REFS>
                    <REENTRANCY-LEVEL>MULTICORE-REENTRANT</REENTRANCY-LEVEL>
                    <IMPLEMENTED-ENTRY-REF DEST="BSW-MODULE-ENTRY">/AUTOSAR_Icu_17_TimerIp/BswModuleEntrys/Icu_SetActivationCondition</IMPLEMENTED-ENTRY-REF>
                  </BSW-CALLED-ENTITY>
[!IF "$Icu_DisableEdgeDetection_Xpath = 'true'"!][!//
                  <BSW-CALLED-ENTITY>
                    <SHORT-NAME>Icu_DisableEdgeDetection</SHORT-NAME>
                    <REENTRANCY-LEVEL>MULTICORE-REENTRANT</REENTRANCY-LEVEL>
                    <IMPLEMENTED-ENTRY-REF DEST="BSW-MODULE-ENTRY">/AUTOSAR_Icu_17_TimerIp/BswModuleEntrys/Icu_DisableEdgeDetection</IMPLEMENTED-ENTRY-REF>
                  </BSW-CALLED-ENTITY>
[!ENDIF!][!//
[!IF "$Icu_EnableEdgeDetection_Xpath = 'true'"!][!//
                  <BSW-CALLED-ENTITY>
                    <SHORT-NAME>Icu_EnableEdgeDetection</SHORT-NAME>
                    <REENTRANCY-LEVEL>MULTICORE-REENTRANT</REENTRANCY-LEVEL>
                    <IMPLEMENTED-ENTRY-REF DEST="BSW-MODULE-ENTRY">/AUTOSAR_Icu_17_TimerIp/BswModuleEntrys/Icu_EnableEdgeDetection</IMPLEMENTED-ENTRY-REF>
                  </BSW-CALLED-ENTITY>
[!ENDIF!][!//
                  <BSW-CALLED-ENTITY>
                    <SHORT-NAME>Icu_DisableNotification</SHORT-NAME>
                    <REENTRANCY-LEVEL>MULTICORE-REENTRANT</REENTRANCY-LEVEL>
                    <IMPLEMENTED-ENTRY-REF DEST="BSW-MODULE-ENTRY">/AUTOSAR_Icu_17_TimerIp/BswModuleEntrys/Icu_DisableNotification</IMPLEMENTED-ENTRY-REF>
                  </BSW-CALLED-ENTITY>
                  <BSW-CALLED-ENTITY>
                    <SHORT-NAME>Icu_EnableNotification</SHORT-NAME>
                    <REENTRANCY-LEVEL>MULTICORE-REENTRANT</REENTRANCY-LEVEL>
                    <IMPLEMENTED-ENTRY-REF DEST="BSW-MODULE-ENTRY">/AUTOSAR_Icu_17_TimerIp/BswModuleEntrys/Icu_EnableNotification</IMPLEMENTED-ENTRY-REF>
                  </BSW-CALLED-ENTITY>
[!IF "$Icu_SetTimeout_Xpath = 'true'"!][!//
                  <BSW-CALLED-ENTITY>
                    <SHORT-NAME>Icu_SetTimeoutValue</SHORT-NAME>
                    <REENTRANCY-LEVEL>MULTICORE-REENTRANT</REENTRANCY-LEVEL>
                    <IMPLEMENTED-ENTRY-REF DEST="BSW-MODULE-ENTRY">/AUTOSAR_Icu_17_TimerIp/BswModuleEntrys/Icu_SetTimeoutValue</IMPLEMENTED-ENTRY-REF>
                  </BSW-CALLED-ENTITY>
[!ENDIF!][!//
[!IF "$Icu_GetInputState_Xpath = 'true'"!][!//
                  <BSW-CALLED-ENTITY>
                    <SHORT-NAME>Icu_GetInputState</SHORT-NAME>
                    <REENTRANCY-LEVEL>MULTICORE-REENTRANT</REENTRANCY-LEVEL>
                    <IMPLEMENTED-ENTRY-REF DEST="BSW-MODULE-ENTRY">/AUTOSAR_Icu_17_TimerIp/BswModuleEntrys/Icu_GetInputState</IMPLEMENTED-ENTRY-REF>
                  </BSW-CALLED-ENTITY>
[!ENDIF!][!//
[!IF "$Icu_StartTimestamp_Xpath = 'true'"!][!//
                  <BSW-CALLED-ENTITY>
                    <SHORT-NAME>Icu_StartTimestamp</SHORT-NAME>
                    <REENTRANCY-LEVEL>MULTICORE-REENTRANT</REENTRANCY-LEVEL>
                    <IMPLEMENTED-ENTRY-REF DEST="BSW-MODULE-ENTRY">/AUTOSAR_Icu_17_TimerIp/BswModuleEntrys/Icu_StartTimestamp</IMPLEMENTED-ENTRY-REF>
                  </BSW-CALLED-ENTITY>
[!ENDIF!][!//
[!IF "$Icu_StopTimestamp_Xpath = 'true'"!][!//
                  <BSW-CALLED-ENTITY>
                    <SHORT-NAME>Icu_StopTimestamp</SHORT-NAME>
                    <REENTRANCY-LEVEL>MULTICORE-REENTRANT</REENTRANCY-LEVEL>
                    <IMPLEMENTED-ENTRY-REF DEST="BSW-MODULE-ENTRY">/AUTOSAR_Icu_17_TimerIp/BswModuleEntrys/Icu_StopTimestamp</IMPLEMENTED-ENTRY-REF>
                  </BSW-CALLED-ENTITY>
[!ENDIF!][!//
[!IF "$Icu_GetTimestamp_Xpath = 'true'"!][!//
                  <BSW-CALLED-ENTITY>
                    <SHORT-NAME>Icu_GetTimestampIndex</SHORT-NAME>
                    <REENTRANCY-LEVEL>MULTICORE-REENTRANT</REENTRANCY-LEVEL>
                    <IMPLEMENTED-ENTRY-REF DEST="BSW-MODULE-ENTRY">/AUTOSAR_Icu_17_TimerIp/BswModuleEntrys/Icu_GetTimestampIndex</IMPLEMENTED-ENTRY-REF>
                  </BSW-CALLED-ENTITY>
[!ENDIF!][!//
[!IF "$Icu_ResetEdgeCount_Xpath = 'true'"!][!//
                  <BSW-CALLED-ENTITY>
                    <SHORT-NAME>Icu_ResetEdgeCount</SHORT-NAME>
                    <CAN-ENTER-EXCLUSIVE-AREA-REFS>
                      <CAN-ENTER-EXCLUSIVE-AREA-REF DEST="EXCLUSIVE-AREA">/AUTOSAR_Icu_17_TimerIp/BswModuleDescriptions/Icu/IcuBehavior/ResetEdgeCount</CAN-ENTER-EXCLUSIVE-AREA-REF>
                    </CAN-ENTER-EXCLUSIVE-AREA-REFS>
                    <REENTRANCY-LEVEL>MULTICORE-REENTRANT</REENTRANCY-LEVEL>
                    <IMPLEMENTED-ENTRY-REF DEST="BSW-MODULE-ENTRY">/AUTOSAR_Icu_17_TimerIp/BswModuleEntrys/Icu_ResetEdgeCount</IMPLEMENTED-ENTRY-REF>
                  </BSW-CALLED-ENTITY>
[!ENDIF!][!//
[!IF "$Icu_EnableEdgeCount_Xpath = 'true'"!][!//
                  <BSW-CALLED-ENTITY>
                    <SHORT-NAME>Icu_EnableEdgeCount</SHORT-NAME>
                    [!IF "$GtmAvailable = 'true'"!][!//
                    <CAN-ENTER-EXCLUSIVE-AREA-REFS>
                      <CAN-ENTER-EXCLUSIVE-AREA-REF DEST="EXCLUSIVE-AREA">/AUTOSAR_Icu_17_TimerIp/BswModuleDescriptions/Icu/IcuBehavior/GtmEnableEdgeCount</CAN-ENTER-EXCLUSIVE-AREA-REF>
                    </CAN-ENTER-EXCLUSIVE-AREA-REFS>
                    [!ENDIF!][!//
                    <REENTRANCY-LEVEL>MULTICORE-REENTRANT</REENTRANCY-LEVEL>
                    <IMPLEMENTED-ENTRY-REF DEST="BSW-MODULE-ENTRY">/AUTOSAR_Icu_17_TimerIp/BswModuleEntrys/Icu_EnableEdgeCount</IMPLEMENTED-ENTRY-REF>
                  </BSW-CALLED-ENTITY>
[!ENDIF!][!//
[!IF "$Icu_DisableEdgeCount_Xpath = 'true'"!][!//
                  <BSW-CALLED-ENTITY>
                    <SHORT-NAME>Icu_DisableEdgeCount</SHORT-NAME>
                    <REENTRANCY-LEVEL>MULTICORE-REENTRANT</REENTRANCY-LEVEL>
                    <IMPLEMENTED-ENTRY-REF DEST="BSW-MODULE-ENTRY">/AUTOSAR_Icu_17_TimerIp/BswModuleEntrys/Icu_DisableEdgeCount</IMPLEMENTED-ENTRY-REF>
                  </BSW-CALLED-ENTITY>
[!ENDIF!][!//
[!IF "$Icu_GetEdgeNumbers_Xpath = 'true'"!][!//
                  <BSW-CALLED-ENTITY>
                    <SHORT-NAME>Icu_GetEdgeNumbers</SHORT-NAME>
                    <REENTRANCY-LEVEL>MULTICORE-REENTRANT</REENTRANCY-LEVEL>
                    <IMPLEMENTED-ENTRY-REF DEST="BSW-MODULE-ENTRY">/AUTOSAR_Icu_17_TimerIp/BswModuleEntrys/Icu_GetEdgeNumbers</IMPLEMENTED-ENTRY-REF>
                  </BSW-CALLED-ENTITY>
[!ENDIF!][!//
[!IF "$Icu_StartSignalMeasurement_Xpath = 'true'"!][!//
                  <BSW-CALLED-ENTITY>
                    <SHORT-NAME>Icu_StartSignalMeasurement</SHORT-NAME>
                    <REENTRANCY-LEVEL>MULTICORE-REENTRANT</REENTRANCY-LEVEL>
                    <IMPLEMENTED-ENTRY-REF DEST="BSW-MODULE-ENTRY">/AUTOSAR_Icu_17_TimerIp/BswModuleEntrys/Icu_StartSignalMeasurement</IMPLEMENTED-ENTRY-REF>
                  </BSW-CALLED-ENTITY>
[!ENDIF!][!//
[!IF "$Icu_StopSignalMeasurement_Xpath = 'true'"!][!//
                  <BSW-CALLED-ENTITY>
                    <SHORT-NAME>Icu_StopSignalMeasurement</SHORT-NAME>
                    <REENTRANCY-LEVEL>MULTICORE-REENTRANT</REENTRANCY-LEVEL>
                    <IMPLEMENTED-ENTRY-REF DEST="BSW-MODULE-ENTRY">/AUTOSAR_Icu_17_TimerIp/BswModuleEntrys/Icu_StopSignalMeasurement</IMPLEMENTED-ENTRY-REF>
                  </BSW-CALLED-ENTITY>
[!ENDIF!][!//
[!IF "$Icu_GetTimeElapsed_Xpath = 'true'"!][!//
                  <BSW-CALLED-ENTITY>
                    <SHORT-NAME>Icu_GetTimeElapsed</SHORT-NAME>
                    <REENTRANCY-LEVEL>MULTICORE-REENTRANT</REENTRANCY-LEVEL>
                    <IMPLEMENTED-ENTRY-REF DEST="BSW-MODULE-ENTRY">/AUTOSAR_Icu_17_TimerIp/BswModuleEntrys/Icu_GetTimeElapsed</IMPLEMENTED-ENTRY-REF>
                  </BSW-CALLED-ENTITY>
[!ENDIF!][!//
[!IF "$Icu_GetDutyCycleValues_Xpath = 'true'"!][!//
                  <BSW-CALLED-ENTITY>
                    <SHORT-NAME>Icu_GetDutyCycleValues</SHORT-NAME>
                    [!IF "$GtmAvailable = 'true'"!][!//
                    <CAN-ENTER-EXCLUSIVE-AREA-REFS>
                      <CAN-ENTER-EXCLUSIVE-AREA-REF DEST="EXCLUSIVE-AREA">/AUTOSAR_Icu_17_TimerIp/BswModuleDescriptions/Icu/IcuBehavior/GtmGetDutyCycle</CAN-ENTER-EXCLUSIVE-AREA-REF>
                    </CAN-ENTER-EXCLUSIVE-AREA-REFS>
                    [!ENDIF!][!//
                    <REENTRANCY-LEVEL>MULTICORE-REENTRANT</REENTRANCY-LEVEL>
                    <IMPLEMENTED-ENTRY-REF DEST="BSW-MODULE-ENTRY">/AUTOSAR_Icu_17_TimerIp/BswModuleEntrys/Icu_GetDutyCycleValues</IMPLEMENTED-ENTRY-REF>
                  </BSW-CALLED-ENTITY>
[!ENDIF!][!//
[!IF "$Icu_CheckWakeup_Xpath = 'true'"!][!//
                  <BSW-CALLED-ENTITY>
                    <SHORT-NAME>Icu_CheckWakeup</SHORT-NAME>
                    <REENTRANCY-LEVEL>MULTICORE-REENTRANT</REENTRANCY-LEVEL>
                    <IMPLEMENTED-ENTRY-REF DEST="BSW-MODULE-ENTRY">/AUTOSAR_Icu_17_TimerIp/BswModuleEntrys/Icu_CheckWakeup</IMPLEMENTED-ENTRY-REF>
                  </BSW-CALLED-ENTITY>
[!ENDIF!][!//
[!IF "$Icu_17_TimerIp_EnableMultiEdgeDetection_Xpath = 'true'"!][!//
                  <BSW-CALLED-ENTITY>
                    <SHORT-NAME>Icu_EnableMultiEdgeDetection</SHORT-NAME>
                    <REENTRANCY-LEVEL>MULTICORE-REENTRANT</REENTRANCY-LEVEL>
                    <IMPLEMENTED-ENTRY-REF DEST="BSW-MODULE-ENTRY">/AUTOSAR_Icu_17_TimerIp/BswModuleEntrys/Icu_EnableMultiEdgeDetection</IMPLEMENTED-ENTRY-REF>
                  </BSW-CALLED-ENTITY>
[!ENDIF!][!//
[!IF "$Icu_IncInterface_Xpath = 'true'"!][!//
                  <BSW-CALLED-ENTITY>
                    <SHORT-NAME>Icu_StartIncInterface</SHORT-NAME>
                    <REENTRANCY-LEVEL>MULTICORE-REENTRANT</REENTRANCY-LEVEL>
                    <IMPLEMENTED-ENTRY-REF DEST="BSW-MODULE-ENTRY">/AUTOSAR_Icu_17_TimerIp/BswModuleEntrys/Icu_StartIncInterface</IMPLEMENTED-ENTRY-REF>
                  </BSW-CALLED-ENTITY>
                  <BSW-CALLED-ENTITY>
                    <SHORT-NAME>Icu_StopIncInterface</SHORT-NAME>
                    <REENTRANCY-LEVEL>MULTICORE-REENTRANT</REENTRANCY-LEVEL>
                    <IMPLEMENTED-ENTRY-REF DEST="BSW-MODULE-ENTRY">/AUTOSAR_Icu_17_TimerIp/BswModuleEntrys/Icu_StopIncInterface</IMPLEMENTED-ENTRY-REF>
                  </BSW-CALLED-ENTITY>
                  <BSW-CALLED-ENTITY>
                    <SHORT-NAME>Icu_CalibratePos</SHORT-NAME>
                    <REENTRANCY-LEVEL>MULTICORE-REENTRANT</REENTRANCY-LEVEL>
                    <IMPLEMENTED-ENTRY-REF DEST="BSW-MODULE-ENTRY">/AUTOSAR_Icu_17_TimerIp/BswModuleEntrys/Icu_CalibratePos</IMPLEMENTED-ENTRY-REF>
                  </BSW-CALLED-ENTITY>
                  <BSW-CALLED-ENTITY>
                    <SHORT-NAME>Icu_ReadEncCount</SHORT-NAME>
                    <REENTRANCY-LEVEL>MULTICORE-REENTRANT</REENTRANCY-LEVEL>
                    <IMPLEMENTED-ENTRY-REF DEST="BSW-MODULE-ENTRY">/AUTOSAR_Icu_17_TimerIp/BswModuleEntrys/Icu_ReadEncCount</IMPLEMENTED-ENTRY-REF>
                  </BSW-CALLED-ENTITY>
                  <BSW-CALLED-ENTITY>
                    <SHORT-NAME>Icu_ReadEncCountDir</SHORT-NAME>
                    <REENTRANCY-LEVEL>MULTICORE-REENTRANT</REENTRANCY-LEVEL>
                    <IMPLEMENTED-ENTRY-REF DEST="BSW-MODULE-ENTRY">/AUTOSAR_Icu_17_TimerIp/BswModuleEntrys/Icu_ReadEncCountDir</IMPLEMENTED-ENTRY-REF>
                  </BSW-CALLED-ENTITY>
[!ENDIF!][!//
                  <BSW-INTERRUPT-ENTITY>
                    <SHORT-NAME>Icu_Timer_Isr</SHORT-NAME>
                    <REENTRANCY-LEVEL>MULTICORE-REENTRANT</REENTRANCY-LEVEL>
                    <IMPLEMENTED-ENTRY-REF DEST="BSW-MODULE-ENTRY">/AUTOSAR_Icu_17_TimerIp/BswModuleEntrys/Icu_Timer_Isr</IMPLEMENTED-ENTRY-REF>
                  </BSW-INTERRUPT-ENTITY>
                </ENTITYS>
              </BSW-INTERNAL-BEHAVIOR>
            </INTERNAL-BEHAVIORS>
          </BSW-MODULE-DESCRIPTION>
        </ELEMENTS>
      </AR-PACKAGE>
      <AR-PACKAGE>
        <SHORT-NAME>BswModuleEntrys</SHORT-NAME>
        <CATEGORY>STANDARD</CATEGORY>
        <ELEMENTS>
[!IF "$Icu_GetVersionInfo_Xpath = 'true'"!][!//
          <BSW-MODULE-ENTRY>
            <SHORT-NAME>Icu_GetVersionInfo</SHORT-NAME>
            <SERVICE-ID>18</SERVICE-ID>
            <IS-REENTRANT>true</IS-REENTRANT>
            <IS-SYNCHRONOUS>true</IS-SYNCHRONOUS>
            <CALL-TYPE>REGULAR</CALL-TYPE>
            <EXECUTION-CONTEXT>TASK</EXECUTION-CONTEXT>
            <SW-SERVICE-IMPL-POLICY>STANDARD</SW-SERVICE-IMPL-POLICY>
            <ARGUMENTS>
              <SW-SERVICE-ARG>
                <SHORT-NAME>VersionInfoPtr</SHORT-NAME>
                <CATEGORY>DATA_REFERENCE</CATEGORY>
                <SW-DATA-DEF-PROPS>
                  <SW-DATA-DEF-PROPS-VARIANTS>
                    <SW-DATA-DEF-PROPS-CONDITIONAL>
                      <SW-POINTER-TARGET-PROPS>
                        <TARGET-CATEGORY>TYPE_REFERENCE</TARGET-CATEGORY>
                        <SW-DATA-DEF-PROPS>
                          <SW-DATA-DEF-PROPS-VARIANTS>
                            <SW-DATA-DEF-PROPS-CONDITIONAL>
                              <IMPLEMENTATION-DATA-TYPE-REF DEST = "IMPLEMENTATION-DATA-TYPE">/AUTOSAR_Std/ImplementationDataTypes/Std_VersionInfoType</IMPLEMENTATION-DATA-TYPE-REF>
                            </SW-DATA-DEF-PROPS-CONDITIONAL>
                          </SW-DATA-DEF-PROPS-VARIANTS>
                        </SW-DATA-DEF-PROPS>
                      </SW-POINTER-TARGET-PROPS>
                    </SW-DATA-DEF-PROPS-CONDITIONAL>
                  </SW-DATA-DEF-PROPS-VARIANTS>
                </SW-DATA-DEF-PROPS>
              </SW-SERVICE-ARG>
            </ARGUMENTS>
          </BSW-MODULE-ENTRY>
[!ENDIF!][!//
          <BSW-MODULE-ENTRY>
            <SHORT-NAME>Icu_Init</SHORT-NAME>
            <SERVICE-ID>0</SERVICE-ID>
            <IS-REENTRANT>false</IS-REENTRANT>
            <IS-SYNCHRONOUS>true</IS-SYNCHRONOUS>
            <CALL-TYPE>REGULAR</CALL-TYPE>
            <EXECUTION-CONTEXT>TASK</EXECUTION-CONTEXT>
            <SW-SERVICE-IMPL-POLICY>STANDARD</SW-SERVICE-IMPL-POLICY>
            <ARGUMENTS>
              <SW-SERVICE-ARG>
                <SHORT-NAME>ConfigPtr</SHORT-NAME>
                <CATEGORY>DATA_REFERENCE</CATEGORY>
                <SW-DATA-DEF-PROPS>
                  <SW-DATA-DEF-PROPS-VARIANTS>
                    <SW-DATA-DEF-PROPS-CONDITIONAL>
                      <SW-POINTER-TARGET-PROPS>
                        <TARGET-CATEGORY>TYPE_REFERENCE</TARGET-CATEGORY>
                        <SW-DATA-DEF-PROPS>
                          <SW-DATA-DEF-PROPS-VARIANTS>
                            <SW-DATA-DEF-PROPS-CONDITIONAL>
                              <IMPLEMENTATION-DATA-TYPE-REF DEST = "IMPLEMENTATION-DATA-TYPE">/AUTOSAR_Icu_17_TimerIp/ImplementationDataTypes/Icu_17_TimerIp_ConfigType</IMPLEMENTATION-DATA-TYPE-REF>
                            </SW-DATA-DEF-PROPS-CONDITIONAL>
                          </SW-DATA-DEF-PROPS-VARIANTS>
                        </SW-DATA-DEF-PROPS>
                      </SW-POINTER-TARGET-PROPS>
                    </SW-DATA-DEF-PROPS-CONDITIONAL>
                  </SW-DATA-DEF-PROPS-VARIANTS>
                </SW-DATA-DEF-PROPS>
              </SW-SERVICE-ARG>
            </ARGUMENTS>
          </BSW-MODULE-ENTRY>
[!IF "$Icu_17_TimerIp_InitCheck_Xpath = 'true'"!][!//
          <BSW-MODULE-ENTRY>
            <SHORT-NAME>Icu_InitCheck</SHORT-NAME>
            <SERVICE-ID>48</SERVICE-ID>
            <IS-REENTRANT>false</IS-REENTRANT>
            <IS-SYNCHRONOUS>true</IS-SYNCHRONOUS>
            <CALL-TYPE>REGULAR</CALL-TYPE>
            <EXECUTION-CONTEXT>TASK</EXECUTION-CONTEXT>
            <SW-SERVICE-IMPL-POLICY>STANDARD</SW-SERVICE-IMPL-POLICY>
            <RETURN-TYPE>
              <SHORT-NAME>Return</SHORT-NAME>
              <CATEGORY>TYPE_REFERENCE</CATEGORY>
              <SW-DATA-DEF-PROPS>
                <SW-DATA-DEF-PROPS-VARIANTS>
                  <SW-DATA-DEF-PROPS-CONDITIONAL>
                    <IMPLEMENTATION-DATA-TYPE-REF DEST = "IMPLEMENTATION-DATA-TYPE">/AUTOSAR_Std/ImplementationDataTypes/Std_ReturnType</IMPLEMENTATION-DATA-TYPE-REF>
                  </SW-DATA-DEF-PROPS-CONDITIONAL>
                </SW-DATA-DEF-PROPS-VARIANTS>
              </SW-DATA-DEF-PROPS>
            </RETURN-TYPE>
            <ARGUMENTS>
              <SW-SERVICE-ARG>
                <SHORT-NAME>ConfigPtr</SHORT-NAME>
                <CATEGORY>DATA_REFERENCE</CATEGORY>
                <SW-DATA-DEF-PROPS>
                  <SW-DATA-DEF-PROPS-VARIANTS>
                    <SW-DATA-DEF-PROPS-CONDITIONAL>
                      <SW-POINTER-TARGET-PROPS>
                        <TARGET-CATEGORY>TYPE_REFERENCE</TARGET-CATEGORY>
                        <SW-DATA-DEF-PROPS>
                          <SW-DATA-DEF-PROPS-VARIANTS>
                            <SW-DATA-DEF-PROPS-CONDITIONAL>
                              <IMPLEMENTATION-DATA-TYPE-REF DEST = "IMPLEMENTATION-DATA-TYPE">/AUTOSAR_Icu_17_TimerIp/ImplementationDataTypes/Icu_17_TimerIp_ConfigType</IMPLEMENTATION-DATA-TYPE-REF>
                            </SW-DATA-DEF-PROPS-CONDITIONAL>
                          </SW-DATA-DEF-PROPS-VARIANTS>
                        </SW-DATA-DEF-PROPS>
                      </SW-POINTER-TARGET-PROPS>
                    </SW-DATA-DEF-PROPS-CONDITIONAL>
                  </SW-DATA-DEF-PROPS-VARIANTS>
                </SW-DATA-DEF-PROPS>
              </SW-SERVICE-ARG>
            </ARGUMENTS>
          </BSW-MODULE-ENTRY>
[!ENDIF!][!//
[!IF "$Icu_DeInit_Xpath = 'true'"!][!//
          <BSW-MODULE-ENTRY>
            <SHORT-NAME>Icu_DeInit</SHORT-NAME>
            <SERVICE-ID>1</SERVICE-ID>
            <IS-REENTRANT>false</IS-REENTRANT>
            <IS-SYNCHRONOUS>true</IS-SYNCHRONOUS>
            <CALL-TYPE>REGULAR</CALL-TYPE>
            <EXECUTION-CONTEXT>TASK</EXECUTION-CONTEXT>
            <SW-SERVICE-IMPL-POLICY>STANDARD</SW-SERVICE-IMPL-POLICY>
          </BSW-MODULE-ENTRY>
[!ENDIF!][!//
[!IF "$Icu_SetMode_Xpath = 'true'"!][!//
          <BSW-MODULE-ENTRY>
            <SHORT-NAME>Icu_SetMode</SHORT-NAME>
            <SERVICE-ID>2</SERVICE-ID>
            <IS-REENTRANT>false</IS-REENTRANT>
            <IS-SYNCHRONOUS>true</IS-SYNCHRONOUS>
            <CALL-TYPE>REGULAR</CALL-TYPE>
            <EXECUTION-CONTEXT>TASK</EXECUTION-CONTEXT>
            <SW-SERVICE-IMPL-POLICY>STANDARD</SW-SERVICE-IMPL-POLICY>
            <ARGUMENTS>
              <SW-SERVICE-ARG>
                <SHORT-NAME>Mode</SHORT-NAME>
                <CATEGORY>TYPE_REFERENCE</CATEGORY>
                <SW-DATA-DEF-PROPS>
                  <SW-DATA-DEF-PROPS-VARIANTS>
                    <SW-DATA-DEF-PROPS-CONDITIONAL>
                      <IMPLEMENTATION-DATA-TYPE-REF DEST = "IMPLEMENTATION-DATA-TYPE">/AUTOSAR_Icu_17_TimerIp/ImplementationDataTypes/Icu_17_TimerIp_ModeType</IMPLEMENTATION-DATA-TYPE-REF>
                    </SW-DATA-DEF-PROPS-CONDITIONAL>
                  </SW-DATA-DEF-PROPS-VARIANTS>
                </SW-DATA-DEF-PROPS>
              </SW-SERVICE-ARG>
            </ARGUMENTS>
          </BSW-MODULE-ENTRY>
[!ENDIF!][!//
[!IF "$Icu_IncInterface_Xpath = 'true'"!][!//
          <BSW-MODULE-ENTRY>
            <SHORT-NAME>Icu_StartIncInterface</SHORT-NAME>
            <INTRODUCTION>
              <NOTE SI="Icu_StartIncInterface is reentrant but for different channels." NOTE-TYPE="HINT" />
            </INTRODUCTION>
            <SERVICE-ID>33</SERVICE-ID>
            <IS-REENTRANT>true</IS-REENTRANT>
            <IS-SYNCHRONOUS>true</IS-SYNCHRONOUS>
            <CALL-TYPE>REGULAR</CALL-TYPE>
            <EXECUTION-CONTEXT>TASK</EXECUTION-CONTEXT>
            <SW-SERVICE-IMPL-POLICY>STANDARD</SW-SERVICE-IMPL-POLICY>
            <ARGUMENTS>
              <SW-SERVICE-ARG>
                <SHORT-NAME>Channel</SHORT-NAME>
                <CATEGORY>TYPE_REFERENCE</CATEGORY>
                <SW-DATA-DEF-PROPS>
                  <SW-DATA-DEF-PROPS-VARIANTS>
                    <SW-DATA-DEF-PROPS-CONDITIONAL>
                      <IMPLEMENTATION-DATA-TYPE-REF DEST = "IMPLEMENTATION-DATA-TYPE">/AUTOSAR_Icu_17_TimerIp/ImplementationDataTypes/Icu_17_TimerIp_ChannelType</IMPLEMENTATION-DATA-TYPE-REF>
                    </SW-DATA-DEF-PROPS-CONDITIONAL>
                  </SW-DATA-DEF-PROPS-VARIANTS>
                </SW-DATA-DEF-PROPS>
              </SW-SERVICE-ARG>
            </ARGUMENTS>
          </BSW-MODULE-ENTRY>
[!ENDIF!][!//
[!IF "$Icu_IncInterface_Xpath = 'true'"!][!//
          <BSW-MODULE-ENTRY>
            <SHORT-NAME>Icu_StopIncInterface</SHORT-NAME>
            <INTRODUCTION>
              <NOTE SI="Icu_StopIncInterface is reentrant but for different channels." NOTE-TYPE="HINT" />
            </INTRODUCTION>
            <SERVICE-ID>34</SERVICE-ID>
            <IS-REENTRANT>true</IS-REENTRANT>
            <IS-SYNCHRONOUS>true</IS-SYNCHRONOUS>
            <CALL-TYPE>REGULAR</CALL-TYPE>
            <EXECUTION-CONTEXT>TASK</EXECUTION-CONTEXT>
            <SW-SERVICE-IMPL-POLICY>STANDARD</SW-SERVICE-IMPL-POLICY>
            <ARGUMENTS>
              <SW-SERVICE-ARG>
                <SHORT-NAME>Channel</SHORT-NAME>
                <CATEGORY>TYPE_REFERENCE</CATEGORY>
                <SW-DATA-DEF-PROPS>
                  <SW-DATA-DEF-PROPS-VARIANTS>
                    <SW-DATA-DEF-PROPS-CONDITIONAL>
                      <IMPLEMENTATION-DATA-TYPE-REF DEST = "IMPLEMENTATION-DATA-TYPE">/AUTOSAR_Icu_17_TimerIp/ImplementationDataTypes/Icu_17_TimerIp_ChannelType</IMPLEMENTATION-DATA-TYPE-REF>
                    </SW-DATA-DEF-PROPS-CONDITIONAL>
                  </SW-DATA-DEF-PROPS-VARIANTS>
                </SW-DATA-DEF-PROPS>
              </SW-SERVICE-ARG>
            </ARGUMENTS>
          </BSW-MODULE-ENTRY>
[!ENDIF!][!//
[!IF "$Icu_IncInterface_Xpath = 'true'"!][!//
          <BSW-MODULE-ENTRY>
            <SHORT-NAME>Icu_CalibratePos</SHORT-NAME>
            <INTRODUCTION>
              <NOTE SI="Icu_CalibratePos is reentrant but for different channels." NOTE-TYPE="HINT" />
            </INTRODUCTION>
            <SERVICE-ID>35</SERVICE-ID>
            <IS-REENTRANT>true</IS-REENTRANT>
            <IS-SYNCHRONOUS>true</IS-SYNCHRONOUS>
            <CALL-TYPE>REGULAR</CALL-TYPE>
            <EXECUTION-CONTEXT>TASK</EXECUTION-CONTEXT>
            <SW-SERVICE-IMPL-POLICY>STANDARD</SW-SERVICE-IMPL-POLICY>
            <ARGUMENTS>
              <SW-SERVICE-ARG>
                <SHORT-NAME>Channel</SHORT-NAME>
                <CATEGORY>TYPE_REFERENCE</CATEGORY>
                <SW-DATA-DEF-PROPS>
                  <SW-DATA-DEF-PROPS-VARIANTS>
                    <SW-DATA-DEF-PROPS-CONDITIONAL>
                      <IMPLEMENTATION-DATA-TYPE-REF DEST = "IMPLEMENTATION-DATA-TYPE">/AUTOSAR_Icu_17_TimerIp/ImplementationDataTypes/Icu_17_TimerIp_ChannelType</IMPLEMENTATION-DATA-TYPE-REF>
                    </SW-DATA-DEF-PROPS-CONDITIONAL>
                  </SW-DATA-DEF-PROPS-VARIANTS>
                </SW-DATA-DEF-PROPS>
              </SW-SERVICE-ARG>
              <SW-SERVICE-ARG>
                <SHORT-NAME>Position</SHORT-NAME>
                <CATEGORY>TYPE_REFERENCE</CATEGORY>
                <SW-DATA-DEF-PROPS>
                  <SW-DATA-DEF-PROPS-VARIANTS>
                    <SW-DATA-DEF-PROPS-CONDITIONAL>
                      <IMPLEMENTATION-DATA-TYPE-REF DEST = "IMPLEMENTATION-DATA-TYPE">/AUTOSAR_Platform/ImplementationDataTypes/uint16</IMPLEMENTATION-DATA-TYPE-REF>
                    </SW-DATA-DEF-PROPS-CONDITIONAL>
                  </SW-DATA-DEF-PROPS-VARIANTS>
                </SW-DATA-DEF-PROPS>
              </SW-SERVICE-ARG>
            </ARGUMENTS>
          </BSW-MODULE-ENTRY>
[!ENDIF!][!//
[!IF "$Icu_IncInterface_Xpath = 'true'"!][!//
          <BSW-MODULE-ENTRY>
            <SHORT-NAME>Icu_ReadEncCount</SHORT-NAME>
            <INTRODUCTION>
              <NOTE SI="Icu_ReadEncCount is reentrant but for different channels." NOTE-TYPE="HINT" />
            </INTRODUCTION>
            <SERVICE-ID>36</SERVICE-ID>
            <IS-REENTRANT>true</IS-REENTRANT>
            <IS-SYNCHRONOUS>true</IS-SYNCHRONOUS>
            <CALL-TYPE>REGULAR</CALL-TYPE>
            <EXECUTION-CONTEXT>TASK</EXECUTION-CONTEXT>
            <SW-SERVICE-IMPL-POLICY>STANDARD</SW-SERVICE-IMPL-POLICY>
            <RETURN-TYPE>
              <SHORT-NAME>Return</SHORT-NAME>
              <CATEGORY>TYPE_REFERENCE</CATEGORY>
              <SW-DATA-DEF-PROPS>
                <SW-DATA-DEF-PROPS-VARIANTS>
                  <SW-DATA-DEF-PROPS-CONDITIONAL>
                    <IMPLEMENTATION-DATA-TYPE-REF DEST = "IMPLEMENTATION-DATA-TYPE">/AUTOSAR_Platform/ImplementationDataTypes/uint16</IMPLEMENTATION-DATA-TYPE-REF>
                  </SW-DATA-DEF-PROPS-CONDITIONAL>
                </SW-DATA-DEF-PROPS-VARIANTS>
              </SW-DATA-DEF-PROPS>
            </RETURN-TYPE>
            <ARGUMENTS>
              <SW-SERVICE-ARG>
                <SHORT-NAME>Channel</SHORT-NAME>
                <CATEGORY>TYPE_REFERENCE</CATEGORY>
                <SW-DATA-DEF-PROPS>
                  <SW-DATA-DEF-PROPS-VARIANTS>
                    <SW-DATA-DEF-PROPS-CONDITIONAL>
                      <IMPLEMENTATION-DATA-TYPE-REF DEST = "IMPLEMENTATION-DATA-TYPE">/AUTOSAR_Icu_17_TimerIp/ImplementationDataTypes/Icu_17_TimerIp_ChannelType</IMPLEMENTATION-DATA-TYPE-REF>
                    </SW-DATA-DEF-PROPS-CONDITIONAL>
                  </SW-DATA-DEF-PROPS-VARIANTS>
                </SW-DATA-DEF-PROPS>
              </SW-SERVICE-ARG>
            </ARGUMENTS>
          </BSW-MODULE-ENTRY>
[!ENDIF!][!//
[!IF "$Icu_IncInterface_Xpath = 'true'"!][!//
          <BSW-MODULE-ENTRY>
            <SHORT-NAME>Icu_ReadEncCountDir</SHORT-NAME>
            <INTRODUCTION>
              <NOTE SI="Icu_ReadEncCountDir is reentrant but for different channels." NOTE-TYPE="HINT" />
            </INTRODUCTION>
            <SERVICE-ID>37</SERVICE-ID>
            <IS-REENTRANT>true</IS-REENTRANT>
            <IS-SYNCHRONOUS>true</IS-SYNCHRONOUS>
            <CALL-TYPE>REGULAR</CALL-TYPE>
            <EXECUTION-CONTEXT>TASK</EXECUTION-CONTEXT>
            <SW-SERVICE-IMPL-POLICY>STANDARD</SW-SERVICE-IMPL-POLICY>
            <RETURN-TYPE>
              <SHORT-NAME>Return</SHORT-NAME>
              <CATEGORY>TYPE_REFERENCE</CATEGORY>
              <SW-DATA-DEF-PROPS>
                <SW-DATA-DEF-PROPS-VARIANTS>
                  <SW-DATA-DEF-PROPS-CONDITIONAL>
                    <IMPLEMENTATION-DATA-TYPE-REF DEST = "IMPLEMENTATION-DATA-TYPE">/AUTOSAR_Icu_17_TimerIp/ImplementationDataTypes/Icu_17_TimerIp_EncCountDirType</IMPLEMENTATION-DATA-TYPE-REF>
                  </SW-DATA-DEF-PROPS-CONDITIONAL>
                </SW-DATA-DEF-PROPS-VARIANTS>
              </SW-DATA-DEF-PROPS>
            </RETURN-TYPE>
            <ARGUMENTS>
              <SW-SERVICE-ARG>
                <SHORT-NAME>Channel</SHORT-NAME>
                <CATEGORY>TYPE_REFERENCE</CATEGORY>
                <SW-DATA-DEF-PROPS>
                  <SW-DATA-DEF-PROPS-VARIANTS>
                    <SW-DATA-DEF-PROPS-CONDITIONAL>
                      <IMPLEMENTATION-DATA-TYPE-REF DEST = "IMPLEMENTATION-DATA-TYPE">/AUTOSAR_Icu_17_TimerIp/ImplementationDataTypes/Icu_17_TimerIp_ChannelType</IMPLEMENTATION-DATA-TYPE-REF>
                    </SW-DATA-DEF-PROPS-CONDITIONAL>
                  </SW-DATA-DEF-PROPS-VARIANTS>
                </SW-DATA-DEF-PROPS>
              </SW-SERVICE-ARG>
            </ARGUMENTS>
          </BSW-MODULE-ENTRY>
[!ENDIF!][!//
[!IF "$Icu_DisableWakeup_Xpath = 'true'"!][!//
          <BSW-MODULE-ENTRY>
            <SHORT-NAME>Icu_DisableWakeup</SHORT-NAME>
            <INTRODUCTION>
              <NOTE SI="Icu_DisableWakeup is reentrant but for different channels." NOTE-TYPE="HINT" />
            </INTRODUCTION>
            <SERVICE-ID>3</SERVICE-ID>
            <IS-REENTRANT>true</IS-REENTRANT>
            <IS-SYNCHRONOUS>true</IS-SYNCHRONOUS>
            <CALL-TYPE>REGULAR</CALL-TYPE>
            <EXECUTION-CONTEXT>TASK</EXECUTION-CONTEXT>
            <SW-SERVICE-IMPL-POLICY>STANDARD</SW-SERVICE-IMPL-POLICY>
            <ARGUMENTS>
              <SW-SERVICE-ARG>
                <SHORT-NAME>Channel</SHORT-NAME>
                <CATEGORY>TYPE_REFERENCE</CATEGORY>
                <SW-DATA-DEF-PROPS>
                  <SW-DATA-DEF-PROPS-VARIANTS>
                    <SW-DATA-DEF-PROPS-CONDITIONAL>
                      <IMPLEMENTATION-DATA-TYPE-REF DEST = "IMPLEMENTATION-DATA-TYPE">/AUTOSAR_Icu_17_TimerIp/ImplementationDataTypes/Icu_17_TimerIp_ChannelType</IMPLEMENTATION-DATA-TYPE-REF>
                    </SW-DATA-DEF-PROPS-CONDITIONAL>
                  </SW-DATA-DEF-PROPS-VARIANTS>
                </SW-DATA-DEF-PROPS>
              </SW-SERVICE-ARG>
            </ARGUMENTS>
          </BSW-MODULE-ENTRY>
[!ENDIF!][!//
[!IF "$Icu_EnableWakeup_Xpath = 'true'"!][!//
          <BSW-MODULE-ENTRY>
            <SHORT-NAME>Icu_EnableWakeup</SHORT-NAME>
            <INTRODUCTION>
              <NOTE SI="Icu_EnableWakeup is reentrant but for different channels." NOTE-TYPE="HINT" />
            </INTRODUCTION>
            <SERVICE-ID>4</SERVICE-ID>
            <IS-REENTRANT>true</IS-REENTRANT>
            <IS-SYNCHRONOUS>true</IS-SYNCHRONOUS>
            <CALL-TYPE>REGULAR</CALL-TYPE>
            <EXECUTION-CONTEXT>TASK</EXECUTION-CONTEXT>
            <SW-SERVICE-IMPL-POLICY>STANDARD</SW-SERVICE-IMPL-POLICY>
            <ARGUMENTS>
              <SW-SERVICE-ARG>
                <SHORT-NAME>Channel</SHORT-NAME>
                <CATEGORY>TYPE_REFERENCE</CATEGORY>
                <SW-DATA-DEF-PROPS>
                  <SW-DATA-DEF-PROPS-VARIANTS>
                    <SW-DATA-DEF-PROPS-CONDITIONAL>
                      <IMPLEMENTATION-DATA-TYPE-REF DEST = "IMPLEMENTATION-DATA-TYPE">/AUTOSAR_Icu_17_TimerIp/ImplementationDataTypes/Icu_17_TimerIp_ChannelType</IMPLEMENTATION-DATA-TYPE-REF>
                    </SW-DATA-DEF-PROPS-CONDITIONAL>
                  </SW-DATA-DEF-PROPS-VARIANTS>
                </SW-DATA-DEF-PROPS>
              </SW-SERVICE-ARG>
            </ARGUMENTS>
          </BSW-MODULE-ENTRY>
[!ENDIF!][!//
          <BSW-MODULE-ENTRY>
            <SHORT-NAME>Icu_SetActivationCondition</SHORT-NAME>
            <INTRODUCTION>
              <NOTE SI="Icu_SetActivationCondition is reentrant but for different channels." NOTE-TYPE="HINT" />
            </INTRODUCTION>
            <SERVICE-ID>5</SERVICE-ID>
            <IS-REENTRANT>true</IS-REENTRANT>
            <IS-SYNCHRONOUS>true</IS-SYNCHRONOUS>
            <CALL-TYPE>REGULAR</CALL-TYPE>
            <EXECUTION-CONTEXT>TASK</EXECUTION-CONTEXT>
            <SW-SERVICE-IMPL-POLICY>STANDARD</SW-SERVICE-IMPL-POLICY>
            <ARGUMENTS>
              <SW-SERVICE-ARG>
                <SHORT-NAME>Channel</SHORT-NAME>
                <CATEGORY>TYPE_REFERENCE</CATEGORY>
                <SW-DATA-DEF-PROPS>
                  <SW-DATA-DEF-PROPS-VARIANTS>
                    <SW-DATA-DEF-PROPS-CONDITIONAL>
                      <IMPLEMENTATION-DATA-TYPE-REF DEST = "IMPLEMENTATION-DATA-TYPE">/AUTOSAR_Icu_17_TimerIp/ImplementationDataTypes/Icu_17_TimerIp_ChannelType</IMPLEMENTATION-DATA-TYPE-REF>
                    </SW-DATA-DEF-PROPS-CONDITIONAL>
                  </SW-DATA-DEF-PROPS-VARIANTS>
                </SW-DATA-DEF-PROPS>
              </SW-SERVICE-ARG>
              <SW-SERVICE-ARG>
                <SHORT-NAME>Activation</SHORT-NAME>
                <CATEGORY>TYPE_REFERENCE</CATEGORY>
                <SW-DATA-DEF-PROPS>
                  <SW-DATA-DEF-PROPS-VARIANTS>
                    <SW-DATA-DEF-PROPS-CONDITIONAL>
                      <IMPLEMENTATION-DATA-TYPE-REF DEST = "IMPLEMENTATION-DATA-TYPE">/AUTOSAR_Icu_17_TimerIp/ImplementationDataTypes/Icu_17_TimerIp_ActivationType</IMPLEMENTATION-DATA-TYPE-REF>
                    </SW-DATA-DEF-PROPS-CONDITIONAL>
                  </SW-DATA-DEF-PROPS-VARIANTS>
                </SW-DATA-DEF-PROPS>
              </SW-SERVICE-ARG>
            </ARGUMENTS>
          </BSW-MODULE-ENTRY>
[!IF "$Icu_DisableEdgeDetection_Xpath = 'true'"!][!//
          <BSW-MODULE-ENTRY>
            <SHORT-NAME>Icu_DisableEdgeDetection</SHORT-NAME>
            <INTRODUCTION>
              <NOTE SI="Icu_DisableEdgeDetection is reentrant but for different channels." NOTE-TYPE="HINT" />
            </INTRODUCTION>
            <SERVICE-ID>23</SERVICE-ID>
            <IS-REENTRANT>true</IS-REENTRANT>
            <IS-SYNCHRONOUS>true</IS-SYNCHRONOUS>
            <CALL-TYPE>REGULAR</CALL-TYPE>
            <EXECUTION-CONTEXT>TASK</EXECUTION-CONTEXT>
            <SW-SERVICE-IMPL-POLICY>STANDARD</SW-SERVICE-IMPL-POLICY>
            <ARGUMENTS>
              <SW-SERVICE-ARG>
                <SHORT-NAME>Channel</SHORT-NAME>
                <CATEGORY>TYPE_REFERENCE</CATEGORY>
                <SW-DATA-DEF-PROPS>
                  <SW-DATA-DEF-PROPS-VARIANTS>
                    <SW-DATA-DEF-PROPS-CONDITIONAL>
                      <IMPLEMENTATION-DATA-TYPE-REF DEST = "IMPLEMENTATION-DATA-TYPE">/AUTOSAR_Icu_17_TimerIp/ImplementationDataTypes/Icu_17_TimerIp_ChannelType</IMPLEMENTATION-DATA-TYPE-REF>
                    </SW-DATA-DEF-PROPS-CONDITIONAL>
                  </SW-DATA-DEF-PROPS-VARIANTS>
                </SW-DATA-DEF-PROPS>
              </SW-SERVICE-ARG>
            </ARGUMENTS>
          </BSW-MODULE-ENTRY>
[!ENDIF!][!//
[!IF "$Icu_EnableEdgeDetection_Xpath = 'true'"!][!//
          <BSW-MODULE-ENTRY>
            <SHORT-NAME>Icu_EnableEdgeDetection</SHORT-NAME>
            <INTRODUCTION>
              <NOTE SI="Icu_EnableEdgeDetection is reentrant but for different channels." NOTE-TYPE="HINT" />
            </INTRODUCTION>
            <SERVICE-ID>22</SERVICE-ID>
            <IS-REENTRANT>true</IS-REENTRANT>
            <IS-SYNCHRONOUS>true</IS-SYNCHRONOUS>
            <CALL-TYPE>REGULAR</CALL-TYPE>
            <EXECUTION-CONTEXT>TASK</EXECUTION-CONTEXT>
            <SW-SERVICE-IMPL-POLICY>STANDARD</SW-SERVICE-IMPL-POLICY>
            <ARGUMENTS>
              <SW-SERVICE-ARG>
                <SHORT-NAME>Channel</SHORT-NAME>
                <CATEGORY>TYPE_REFERENCE</CATEGORY>
                <SW-DATA-DEF-PROPS>
                  <SW-DATA-DEF-PROPS-VARIANTS>
                    <SW-DATA-DEF-PROPS-CONDITIONAL>
                      <IMPLEMENTATION-DATA-TYPE-REF DEST = "IMPLEMENTATION-DATA-TYPE">/AUTOSAR_Icu_17_TimerIp/ImplementationDataTypes/Icu_17_TimerIp_ChannelType</IMPLEMENTATION-DATA-TYPE-REF>
                    </SW-DATA-DEF-PROPS-CONDITIONAL>
                  </SW-DATA-DEF-PROPS-VARIANTS>
                </SW-DATA-DEF-PROPS>
              </SW-SERVICE-ARG>
            </ARGUMENTS>
          </BSW-MODULE-ENTRY>
[!ENDIF!][!//
          <BSW-MODULE-ENTRY>
            <SHORT-NAME>Icu_DisableNotification</SHORT-NAME>
            <INTRODUCTION>
              <NOTE SI="Icu_DisableNotification is reentrant but for different channels." NOTE-TYPE="HINT" />
            </INTRODUCTION>
            <SERVICE-ID>6</SERVICE-ID>
            <IS-REENTRANT>true</IS-REENTRANT>
            <IS-SYNCHRONOUS>true</IS-SYNCHRONOUS>
            <CALL-TYPE>REGULAR</CALL-TYPE>
            <EXECUTION-CONTEXT>TASK</EXECUTION-CONTEXT>
            <SW-SERVICE-IMPL-POLICY>STANDARD</SW-SERVICE-IMPL-POLICY>
            <ARGUMENTS>
              <SW-SERVICE-ARG>
                <SHORT-NAME>Channel</SHORT-NAME>
                <CATEGORY>TYPE_REFERENCE</CATEGORY>
                <SW-DATA-DEF-PROPS>
                  <SW-DATA-DEF-PROPS-VARIANTS>
                    <SW-DATA-DEF-PROPS-CONDITIONAL>
                      <IMPLEMENTATION-DATA-TYPE-REF DEST = "IMPLEMENTATION-DATA-TYPE">/AUTOSAR_Icu_17_TimerIp/ImplementationDataTypes/Icu_17_TimerIp_ChannelType</IMPLEMENTATION-DATA-TYPE-REF>
                    </SW-DATA-DEF-PROPS-CONDITIONAL>
                  </SW-DATA-DEF-PROPS-VARIANTS>
                </SW-DATA-DEF-PROPS>
              </SW-SERVICE-ARG>
            </ARGUMENTS>
          </BSW-MODULE-ENTRY>
          <BSW-MODULE-ENTRY>
            <SHORT-NAME>Icu_EnableNotification</SHORT-NAME>
            <INTRODUCTION>
              <NOTE SI="Icu_EnableNotification is reentrant but for different channels." NOTE-TYPE="HINT" />
            </INTRODUCTION>
            <SERVICE-ID>7</SERVICE-ID>
            <IS-REENTRANT>true</IS-REENTRANT>
            <IS-SYNCHRONOUS>true</IS-SYNCHRONOUS>
            <CALL-TYPE>REGULAR</CALL-TYPE>
            <EXECUTION-CONTEXT>TASK</EXECUTION-CONTEXT>
            <SW-SERVICE-IMPL-POLICY>STANDARD</SW-SERVICE-IMPL-POLICY>
            <ARGUMENTS>
              <SW-SERVICE-ARG>
                <SHORT-NAME>Channel</SHORT-NAME>
                <CATEGORY>TYPE_REFERENCE</CATEGORY>
                <SW-DATA-DEF-PROPS>
                  <SW-DATA-DEF-PROPS-VARIANTS>
                    <SW-DATA-DEF-PROPS-CONDITIONAL>
                      <IMPLEMENTATION-DATA-TYPE-REF DEST = "IMPLEMENTATION-DATA-TYPE">/AUTOSAR_Icu_17_TimerIp/ImplementationDataTypes/Icu_17_TimerIp_ChannelType</IMPLEMENTATION-DATA-TYPE-REF>
                    </SW-DATA-DEF-PROPS-CONDITIONAL>
                  </SW-DATA-DEF-PROPS-VARIANTS>
                </SW-DATA-DEF-PROPS>
              </SW-SERVICE-ARG>
            </ARGUMENTS>
          </BSW-MODULE-ENTRY>
[!IF "$Icu_SetTimeout_Xpath = 'true'"!][!//
          <BSW-MODULE-ENTRY>
            <SHORT-NAME>Icu_SetTimeoutValue</SHORT-NAME>
            <INTRODUCTION>
              <NOTE SI="Icu_SetTimeoutValue is reentrant but for different channels." NOTE-TYPE="HINT" />
            </INTRODUCTION>
            <SERVICE-ID>38</SERVICE-ID>
            <IS-REENTRANT>true</IS-REENTRANT>
            <IS-SYNCHRONOUS>true</IS-SYNCHRONOUS>
            <CALL-TYPE>REGULAR</CALL-TYPE>
            <EXECUTION-CONTEXT>TASK</EXECUTION-CONTEXT>
            <SW-SERVICE-IMPL-POLICY>STANDARD</SW-SERVICE-IMPL-POLICY>
            <ARGUMENTS>
              <SW-SERVICE-ARG>
                <SHORT-NAME>Channel</SHORT-NAME>
                <CATEGORY>TYPE_REFERENCE</CATEGORY>
                <SW-DATA-DEF-PROPS>
                  <SW-DATA-DEF-PROPS-VARIANTS>
                    <SW-DATA-DEF-PROPS-CONDITIONAL>
                      <IMPLEMENTATION-DATA-TYPE-REF DEST = "IMPLEMENTATION-DATA-TYPE">/AUTOSAR_Icu_17_TimerIp/ImplementationDataTypes/Icu_17_TimerIp_ChannelType</IMPLEMENTATION-DATA-TYPE-REF>
                    </SW-DATA-DEF-PROPS-CONDITIONAL>
                  </SW-DATA-DEF-PROPS-VARIANTS>
                </SW-DATA-DEF-PROPS>
              </SW-SERVICE-ARG>
              <SW-SERVICE-ARG>
                <SHORT-NAME>TimeoutValue</SHORT-NAME>
                <CATEGORY>TYPE_REFERENCE</CATEGORY>
                <SW-DATA-DEF-PROPS>
                  <SW-DATA-DEF-PROPS-VARIANTS>
                    <SW-DATA-DEF-PROPS-CONDITIONAL>
                      <IMPLEMENTATION-DATA-TYPE-REF DEST = "IMPLEMENTATION-DATA-TYPE">/AUTOSAR_Platform/ImplementationDataTypes/uint32</IMPLEMENTATION-DATA-TYPE-REF>
                    </SW-DATA-DEF-PROPS-CONDITIONAL>
                  </SW-DATA-DEF-PROPS-VARIANTS>
                </SW-DATA-DEF-PROPS>
              </SW-SERVICE-ARG>
            </ARGUMENTS>
          </BSW-MODULE-ENTRY>
[!ENDIF!][!//
[!IF "$Icu_GetInputState_Xpath = 'true'"!][!//
          <BSW-MODULE-ENTRY>
            <SHORT-NAME>Icu_GetInputState</SHORT-NAME>
            <INTRODUCTION>
              <NOTE SI="Icu_GetInputState is reentrant but for different channels." NOTE-TYPE="HINT" />
            </INTRODUCTION>
            <SERVICE-ID>8</SERVICE-ID>
            <IS-REENTRANT>true</IS-REENTRANT>
            <IS-SYNCHRONOUS>true</IS-SYNCHRONOUS>
            <CALL-TYPE>REGULAR</CALL-TYPE>
            <EXECUTION-CONTEXT>TASK</EXECUTION-CONTEXT>
            <SW-SERVICE-IMPL-POLICY>STANDARD</SW-SERVICE-IMPL-POLICY>
            <RETURN-TYPE>
              <SHORT-NAME>Return</SHORT-NAME>
              <CATEGORY>TYPE_REFERENCE</CATEGORY>
              <SW-DATA-DEF-PROPS>
                <SW-DATA-DEF-PROPS-VARIANTS>
                  <SW-DATA-DEF-PROPS-CONDITIONAL>
                    <IMPLEMENTATION-DATA-TYPE-REF DEST = "IMPLEMENTATION-DATA-TYPE">/AUTOSAR_Icu_17_TimerIp/ImplementationDataTypes/Icu_17_TimerIp_InputStateType</IMPLEMENTATION-DATA-TYPE-REF>
                  </SW-DATA-DEF-PROPS-CONDITIONAL>
                </SW-DATA-DEF-PROPS-VARIANTS>
              </SW-DATA-DEF-PROPS>
            </RETURN-TYPE>
            <ARGUMENTS>
              <SW-SERVICE-ARG>
                <SHORT-NAME>Channel</SHORT-NAME>
                <CATEGORY>TYPE_REFERENCE</CATEGORY>
                <SW-DATA-DEF-PROPS>
                  <SW-DATA-DEF-PROPS-VARIANTS>
                    <SW-DATA-DEF-PROPS-CONDITIONAL>
                      <IMPLEMENTATION-DATA-TYPE-REF DEST = "IMPLEMENTATION-DATA-TYPE">/AUTOSAR_Icu_17_TimerIp/ImplementationDataTypes/Icu_17_TimerIp_ChannelType</IMPLEMENTATION-DATA-TYPE-REF>
                    </SW-DATA-DEF-PROPS-CONDITIONAL>
                  </SW-DATA-DEF-PROPS-VARIANTS>
                </SW-DATA-DEF-PROPS>
              </SW-SERVICE-ARG>
            </ARGUMENTS>
          </BSW-MODULE-ENTRY>
[!ENDIF!][!//
[!IF "$Icu_StartTimestamp_Xpath = 'true'"!][!//
          <BSW-MODULE-ENTRY>
            <SHORT-NAME>Icu_StartTimestamp</SHORT-NAME>
            <INTRODUCTION>
              <NOTE SI="Icu_StartTimestamp is reentrant but for different channels." NOTE-TYPE="HINT" />
            </INTRODUCTION>
            <SERVICE-ID>9</SERVICE-ID>
            <IS-REENTRANT>true</IS-REENTRANT>
            <IS-SYNCHRONOUS>false</IS-SYNCHRONOUS>
            <CALL-TYPE>REGULAR</CALL-TYPE>
            <EXECUTION-CONTEXT>TASK</EXECUTION-CONTEXT>
            <SW-SERVICE-IMPL-POLICY>STANDARD</SW-SERVICE-IMPL-POLICY>
            <ARGUMENTS>
              <SW-SERVICE-ARG>
                <SHORT-NAME>Channel</SHORT-NAME>
                <CATEGORY>TYPE_REFERENCE</CATEGORY>
                <SW-DATA-DEF-PROPS>
                  <SW-DATA-DEF-PROPS-VARIANTS>
                    <SW-DATA-DEF-PROPS-CONDITIONAL>
                      <IMPLEMENTATION-DATA-TYPE-REF DEST = "IMPLEMENTATION-DATA-TYPE">/AUTOSAR_Icu_17_TimerIp/ImplementationDataTypes/Icu_17_TimerIp_ChannelType</IMPLEMENTATION-DATA-TYPE-REF>
                    </SW-DATA-DEF-PROPS-CONDITIONAL>
                  </SW-DATA-DEF-PROPS-VARIANTS>
                </SW-DATA-DEF-PROPS>
              </SW-SERVICE-ARG>
              <SW-SERVICE-ARG>
                <SHORT-NAME>BufferPtr</SHORT-NAME>
                <CATEGORY>DATA_REFERENCE</CATEGORY>
                <SW-DATA-DEF-PROPS>
                  <SW-DATA-DEF-PROPS-VARIANTS>
                    <SW-DATA-DEF-PROPS-CONDITIONAL>
                      <SW-POINTER-TARGET-PROPS>
                        <TARGET-CATEGORY>TYPE_REFERENCE</TARGET-CATEGORY>
                        <SW-DATA-DEF-PROPS>
                          <SW-DATA-DEF-PROPS-VARIANTS>
                            <SW-DATA-DEF-PROPS-CONDITIONAL>
                              <IMPLEMENTATION-DATA-TYPE-REF DEST = "IMPLEMENTATION-DATA-TYPE">/AUTOSAR_Icu_17_TimerIp/ImplementationDataTypes/Icu_17_TimerIp_ValueType</IMPLEMENTATION-DATA-TYPE-REF>
                            </SW-DATA-DEF-PROPS-CONDITIONAL>
                          </SW-DATA-DEF-PROPS-VARIANTS>
                        </SW-DATA-DEF-PROPS>
                      </SW-POINTER-TARGET-PROPS>
                    </SW-DATA-DEF-PROPS-CONDITIONAL>
                  </SW-DATA-DEF-PROPS-VARIANTS>
                </SW-DATA-DEF-PROPS>
              </SW-SERVICE-ARG>
              <SW-SERVICE-ARG>
                <SHORT-NAME>BufferSize</SHORT-NAME>
                <CATEGORY>TYPE_REFERENCE</CATEGORY>
                <SW-DATA-DEF-PROPS>
                  <SW-DATA-DEF-PROPS-VARIANTS>
                    <SW-DATA-DEF-PROPS-CONDITIONAL>
                      <IMPLEMENTATION-DATA-TYPE-REF DEST = "IMPLEMENTATION-DATA-TYPE">/AUTOSAR_Platform/ImplementationDataTypes/uint16</IMPLEMENTATION-DATA-TYPE-REF>
                    </SW-DATA-DEF-PROPS-CONDITIONAL>
                  </SW-DATA-DEF-PROPS-VARIANTS>
                </SW-DATA-DEF-PROPS>
              </SW-SERVICE-ARG>
              <SW-SERVICE-ARG>
                <SHORT-NAME>NotifyInterval</SHORT-NAME>
                <CATEGORY>TYPE_REFERENCE</CATEGORY>
                <SW-DATA-DEF-PROPS>
                  <SW-DATA-DEF-PROPS-VARIANTS>
                    <SW-DATA-DEF-PROPS-CONDITIONAL>
                      <IMPLEMENTATION-DATA-TYPE-REF DEST = "IMPLEMENTATION-DATA-TYPE">/AUTOSAR_Platform/ImplementationDataTypes/uint16</IMPLEMENTATION-DATA-TYPE-REF>
                    </SW-DATA-DEF-PROPS-CONDITIONAL>
                  </SW-DATA-DEF-PROPS-VARIANTS>
                </SW-DATA-DEF-PROPS>
              </SW-SERVICE-ARG>
            </ARGUMENTS>
          </BSW-MODULE-ENTRY>
[!ENDIF!][!//
[!IF "$Icu_StopTimestamp_Xpath = 'true'"!][!//
          <BSW-MODULE-ENTRY>
            <SHORT-NAME>Icu_StopTimestamp</SHORT-NAME>
            <INTRODUCTION>
              <NOTE SI="Icu_StopTimestamp is reentrant but for different channels." NOTE-TYPE="HINT" />
            </INTRODUCTION>
            <SERVICE-ID>10</SERVICE-ID>
            <IS-REENTRANT>true</IS-REENTRANT>
            <IS-SYNCHRONOUS>true</IS-SYNCHRONOUS>
            <CALL-TYPE>REGULAR</CALL-TYPE>
            <EXECUTION-CONTEXT>TASK</EXECUTION-CONTEXT>
            <SW-SERVICE-IMPL-POLICY>STANDARD</SW-SERVICE-IMPL-POLICY>
            <ARGUMENTS>
              <SW-SERVICE-ARG>
                <SHORT-NAME>Channel</SHORT-NAME>
                <CATEGORY>TYPE_REFERENCE</CATEGORY>
                <SW-DATA-DEF-PROPS>
                  <SW-DATA-DEF-PROPS-VARIANTS>
                    <SW-DATA-DEF-PROPS-CONDITIONAL>
                      <IMPLEMENTATION-DATA-TYPE-REF DEST = "IMPLEMENTATION-DATA-TYPE">/AUTOSAR_Icu_17_TimerIp/ImplementationDataTypes/Icu_17_TimerIp_ChannelType</IMPLEMENTATION-DATA-TYPE-REF>
                    </SW-DATA-DEF-PROPS-CONDITIONAL>
                  </SW-DATA-DEF-PROPS-VARIANTS>
                </SW-DATA-DEF-PROPS>
              </SW-SERVICE-ARG>
            </ARGUMENTS>
          </BSW-MODULE-ENTRY>
[!ENDIF!][!//
[!IF "$Icu_GetTimestamp_Xpath = 'true'"!][!//
          <BSW-MODULE-ENTRY>
            <SHORT-NAME>Icu_GetTimestampIndex</SHORT-NAME>
            <INTRODUCTION>
              <NOTE SI="Icu_GetTimestampIndex is reentrant but for different channels." NOTE-TYPE="HINT" />
            </INTRODUCTION>
            <SERVICE-ID>11</SERVICE-ID>
            <IS-REENTRANT>true</IS-REENTRANT>
            <IS-SYNCHRONOUS>true</IS-SYNCHRONOUS>
            <CALL-TYPE>REGULAR</CALL-TYPE>
            <EXECUTION-CONTEXT>TASK</EXECUTION-CONTEXT>
            <SW-SERVICE-IMPL-POLICY>STANDARD</SW-SERVICE-IMPL-POLICY>
            <RETURN-TYPE>
              <SHORT-NAME>Return</SHORT-NAME>
              <CATEGORY>TYPE_REFERENCE</CATEGORY>
              <SW-DATA-DEF-PROPS>
                <SW-DATA-DEF-PROPS-VARIANTS>
                  <SW-DATA-DEF-PROPS-CONDITIONAL>
                    <IMPLEMENTATION-DATA-TYPE-REF DEST = "IMPLEMENTATION-DATA-TYPE">/AUTOSAR_Icu_17_TimerIp/ImplementationDataTypes/Icu_17_TimerIp_IndexType</IMPLEMENTATION-DATA-TYPE-REF>
                  </SW-DATA-DEF-PROPS-CONDITIONAL>
                </SW-DATA-DEF-PROPS-VARIANTS>
              </SW-DATA-DEF-PROPS>
            </RETURN-TYPE>
            <ARGUMENTS>
              <SW-SERVICE-ARG>
                <SHORT-NAME>Channel</SHORT-NAME>
                <CATEGORY>TYPE_REFERENCE</CATEGORY>
                <SW-DATA-DEF-PROPS>
                  <SW-DATA-DEF-PROPS-VARIANTS>
                    <SW-DATA-DEF-PROPS-CONDITIONAL>
                      <IMPLEMENTATION-DATA-TYPE-REF DEST = "IMPLEMENTATION-DATA-TYPE">/AUTOSAR_Icu_17_TimerIp/ImplementationDataTypes/Icu_17_TimerIp_ChannelType</IMPLEMENTATION-DATA-TYPE-REF>
                    </SW-DATA-DEF-PROPS-CONDITIONAL>
                  </SW-DATA-DEF-PROPS-VARIANTS>
                </SW-DATA-DEF-PROPS>
              </SW-SERVICE-ARG>
            </ARGUMENTS>
          </BSW-MODULE-ENTRY>
[!ENDIF!][!//
[!IF "$Icu_ResetEdgeCount_Xpath = 'true'"!][!//
          <BSW-MODULE-ENTRY>
            <SHORT-NAME>Icu_ResetEdgeCount</SHORT-NAME>
            <INTRODUCTION>
              <NOTE SI="Icu_ResetEdgeCount is reentrant but for different channels." NOTE-TYPE="HINT" />
            </INTRODUCTION>
            <SERVICE-ID>12</SERVICE-ID>
            <IS-REENTRANT>true</IS-REENTRANT>
            <IS-SYNCHRONOUS>true</IS-SYNCHRONOUS>
            <CALL-TYPE>REGULAR</CALL-TYPE>
            <EXECUTION-CONTEXT>TASK</EXECUTION-CONTEXT>
            <SW-SERVICE-IMPL-POLICY>STANDARD</SW-SERVICE-IMPL-POLICY>
            <ARGUMENTS>
              <SW-SERVICE-ARG>
                <SHORT-NAME>Channel</SHORT-NAME>
                <CATEGORY>TYPE_REFERENCE</CATEGORY>
                <SW-DATA-DEF-PROPS>
                  <SW-DATA-DEF-PROPS-VARIANTS>
                    <SW-DATA-DEF-PROPS-CONDITIONAL>
                      <IMPLEMENTATION-DATA-TYPE-REF DEST = "IMPLEMENTATION-DATA-TYPE">/AUTOSAR_Icu_17_TimerIp/ImplementationDataTypes/Icu_17_TimerIp_ChannelType</IMPLEMENTATION-DATA-TYPE-REF>
                    </SW-DATA-DEF-PROPS-CONDITIONAL>
                  </SW-DATA-DEF-PROPS-VARIANTS>
                </SW-DATA-DEF-PROPS>
              </SW-SERVICE-ARG>
            </ARGUMENTS>
          </BSW-MODULE-ENTRY>
[!ENDIF!][!//
[!IF "$Icu_EnableEdgeCount_Xpath = 'true'"!][!//
          <BSW-MODULE-ENTRY>
            <SHORT-NAME>Icu_EnableEdgeCount</SHORT-NAME>
            <INTRODUCTION>
              <NOTE SI="Icu_EnableEdgeCount is reentrant but for different channels." NOTE-TYPE="HINT" />
            </INTRODUCTION>
            <SERVICE-ID>13</SERVICE-ID>
            <IS-REENTRANT>true</IS-REENTRANT>
            <IS-SYNCHRONOUS>true</IS-SYNCHRONOUS>
            <CALL-TYPE>REGULAR</CALL-TYPE>
            <EXECUTION-CONTEXT>TASK</EXECUTION-CONTEXT>
            <SW-SERVICE-IMPL-POLICY>STANDARD</SW-SERVICE-IMPL-POLICY>
            <ARGUMENTS>
              <SW-SERVICE-ARG>
                <SHORT-NAME>Channel</SHORT-NAME>
                <CATEGORY>TYPE_REFERENCE</CATEGORY>
                <SW-DATA-DEF-PROPS>
                  <SW-DATA-DEF-PROPS-VARIANTS>
                    <SW-DATA-DEF-PROPS-CONDITIONAL>
                      <IMPLEMENTATION-DATA-TYPE-REF DEST = "IMPLEMENTATION-DATA-TYPE">/AUTOSAR_Icu_17_TimerIp/ImplementationDataTypes/Icu_17_TimerIp_ChannelType</IMPLEMENTATION-DATA-TYPE-REF>
                    </SW-DATA-DEF-PROPS-CONDITIONAL>
                  </SW-DATA-DEF-PROPS-VARIANTS>
                </SW-DATA-DEF-PROPS>
              </SW-SERVICE-ARG>
            </ARGUMENTS>
          </BSW-MODULE-ENTRY>
[!ENDIF!][!//
[!IF "$Icu_DisableEdgeCount_Xpath = 'true'"!][!//
          <BSW-MODULE-ENTRY>
            <SHORT-NAME>Icu_DisableEdgeCount</SHORT-NAME>
            <INTRODUCTION>
              <NOTE SI="Icu_DisableEdgeCount is reentrant but for different channels." NOTE-TYPE="HINT" />
            </INTRODUCTION>
            <SERVICE-ID>14</SERVICE-ID>
            <IS-REENTRANT>true</IS-REENTRANT>
            <IS-SYNCHRONOUS>true</IS-SYNCHRONOUS>
            <CALL-TYPE>REGULAR</CALL-TYPE>
            <EXECUTION-CONTEXT>TASK</EXECUTION-CONTEXT>
            <SW-SERVICE-IMPL-POLICY>STANDARD</SW-SERVICE-IMPL-POLICY>
            <ARGUMENTS>
              <SW-SERVICE-ARG>
                <SHORT-NAME>Channel</SHORT-NAME>
                <CATEGORY>TYPE_REFERENCE</CATEGORY>
                <SW-DATA-DEF-PROPS>
                  <SW-DATA-DEF-PROPS-VARIANTS>
                    <SW-DATA-DEF-PROPS-CONDITIONAL>
                      <IMPLEMENTATION-DATA-TYPE-REF DEST = "IMPLEMENTATION-DATA-TYPE">/AUTOSAR_Icu_17_TimerIp/ImplementationDataTypes/Icu_17_TimerIp_ChannelType</IMPLEMENTATION-DATA-TYPE-REF>
                    </SW-DATA-DEF-PROPS-CONDITIONAL>
                  </SW-DATA-DEF-PROPS-VARIANTS>
                </SW-DATA-DEF-PROPS>
              </SW-SERVICE-ARG>
            </ARGUMENTS>
          </BSW-MODULE-ENTRY>
[!ENDIF!][!//
[!IF "$Icu_GetEdgeNumbers_Xpath = 'true'"!][!//
          <BSW-MODULE-ENTRY>
            <SHORT-NAME>Icu_GetEdgeNumbers</SHORT-NAME>
            <INTRODUCTION>
              <NOTE SI="Icu_GetEdgeNumbers is reentrant but for different channels." NOTE-TYPE="HINT" />
            </INTRODUCTION>
            <SERVICE-ID>15</SERVICE-ID>
            <IS-REENTRANT>true</IS-REENTRANT>
            <IS-SYNCHRONOUS>true</IS-SYNCHRONOUS>
            <CALL-TYPE>REGULAR</CALL-TYPE>
            <EXECUTION-CONTEXT>TASK</EXECUTION-CONTEXT>
            <SW-SERVICE-IMPL-POLICY>STANDARD</SW-SERVICE-IMPL-POLICY>
            <RETURN-TYPE>
              <SHORT-NAME>Return</SHORT-NAME>
              <CATEGORY>TYPE_REFERENCE</CATEGORY>
              <SW-DATA-DEF-PROPS>
                <SW-DATA-DEF-PROPS-VARIANTS>
                  <SW-DATA-DEF-PROPS-CONDITIONAL>
                    <IMPLEMENTATION-DATA-TYPE-REF DEST = "IMPLEMENTATION-DATA-TYPE">/AUTOSAR_Icu_17_TimerIp/ImplementationDataTypes/Icu_17_TimerIp_EdgeNumberType</IMPLEMENTATION-DATA-TYPE-REF>
                  </SW-DATA-DEF-PROPS-CONDITIONAL>
                </SW-DATA-DEF-PROPS-VARIANTS>
              </SW-DATA-DEF-PROPS>
            </RETURN-TYPE>
            <ARGUMENTS>
              <SW-SERVICE-ARG>
                <SHORT-NAME>Channel</SHORT-NAME>
                <CATEGORY>TYPE_REFERENCE</CATEGORY>
                <SW-DATA-DEF-PROPS>
                  <SW-DATA-DEF-PROPS-VARIANTS>
                    <SW-DATA-DEF-PROPS-CONDITIONAL>
                      <IMPLEMENTATION-DATA-TYPE-REF DEST = "IMPLEMENTATION-DATA-TYPE">/AUTOSAR_Icu_17_TimerIp/ImplementationDataTypes/Icu_17_TimerIp_ChannelType</IMPLEMENTATION-DATA-TYPE-REF>
                    </SW-DATA-DEF-PROPS-CONDITIONAL>
                  </SW-DATA-DEF-PROPS-VARIANTS>
                </SW-DATA-DEF-PROPS>
              </SW-SERVICE-ARG>
            </ARGUMENTS>
          </BSW-MODULE-ENTRY>
[!ENDIF!][!//
[!IF "$Icu_StartSignalMeasurement_Xpath = 'true'"!][!//
          <BSW-MODULE-ENTRY>
            <SHORT-NAME>Icu_StartSignalMeasurement</SHORT-NAME>
            <INTRODUCTION>
              <NOTE SI="Icu_StartSignalMeasurement is reentrant but for different channels." NOTE-TYPE="HINT" />
            </INTRODUCTION>
            <SERVICE-ID>19</SERVICE-ID>
            <IS-REENTRANT>true</IS-REENTRANT>
            <IS-SYNCHRONOUS>false</IS-SYNCHRONOUS>
            <CALL-TYPE>REGULAR</CALL-TYPE>
            <EXECUTION-CONTEXT>TASK</EXECUTION-CONTEXT>
            <SW-SERVICE-IMPL-POLICY>STANDARD</SW-SERVICE-IMPL-POLICY>
            <ARGUMENTS>
              <SW-SERVICE-ARG>
                <SHORT-NAME>Channel</SHORT-NAME>
                <CATEGORY>TYPE_REFERENCE</CATEGORY>
                <SW-DATA-DEF-PROPS>
                  <SW-DATA-DEF-PROPS-VARIANTS>
                    <SW-DATA-DEF-PROPS-CONDITIONAL>
                      <IMPLEMENTATION-DATA-TYPE-REF DEST = "IMPLEMENTATION-DATA-TYPE">/AUTOSAR_Icu_17_TimerIp/ImplementationDataTypes/Icu_17_TimerIp_ChannelType</IMPLEMENTATION-DATA-TYPE-REF>
                    </SW-DATA-DEF-PROPS-CONDITIONAL>
                  </SW-DATA-DEF-PROPS-VARIANTS>
                </SW-DATA-DEF-PROPS>
              </SW-SERVICE-ARG>
            </ARGUMENTS>
          </BSW-MODULE-ENTRY>
[!ENDIF!][!//
[!IF "$Icu_StopSignalMeasurement_Xpath = 'true'"!][!//
          <BSW-MODULE-ENTRY>
            <SHORT-NAME>Icu_StopSignalMeasurement</SHORT-NAME>
            <INTRODUCTION>
              <NOTE SI="Icu_StopSignalMeasurement is reentrant but for different channels." NOTE-TYPE="HINT" />
            </INTRODUCTION>
            <SERVICE-ID>20</SERVICE-ID>
            <IS-REENTRANT>true</IS-REENTRANT>
            <IS-SYNCHRONOUS>true</IS-SYNCHRONOUS>
            <CALL-TYPE>REGULAR</CALL-TYPE>
            <EXECUTION-CONTEXT>TASK</EXECUTION-CONTEXT>
            <SW-SERVICE-IMPL-POLICY>STANDARD</SW-SERVICE-IMPL-POLICY>
            <ARGUMENTS>
              <SW-SERVICE-ARG>
                <SHORT-NAME>Channel</SHORT-NAME>
                <CATEGORY>TYPE_REFERENCE</CATEGORY>
                <SW-DATA-DEF-PROPS>
                  <SW-DATA-DEF-PROPS-VARIANTS>
                    <SW-DATA-DEF-PROPS-CONDITIONAL>
                      <IMPLEMENTATION-DATA-TYPE-REF DEST = "IMPLEMENTATION-DATA-TYPE">/AUTOSAR_Icu_17_TimerIp/ImplementationDataTypes/Icu_17_TimerIp_ChannelType</IMPLEMENTATION-DATA-TYPE-REF>
                    </SW-DATA-DEF-PROPS-CONDITIONAL>
                  </SW-DATA-DEF-PROPS-VARIANTS>
                </SW-DATA-DEF-PROPS>
              </SW-SERVICE-ARG>
            </ARGUMENTS>
          </BSW-MODULE-ENTRY>
[!ENDIF!][!//
[!IF "$Icu_GetTimeElapsed_Xpath = 'true'"!][!//
          <BSW-MODULE-ENTRY>
            <SHORT-NAME>Icu_GetTimeElapsed</SHORT-NAME>
            <INTRODUCTION>
              <NOTE SI="Icu_GetTimeElapsed is reentrant but for different channels." NOTE-TYPE="HINT" />
            </INTRODUCTION>
            <SERVICE-ID>16</SERVICE-ID>
            <IS-REENTRANT>true</IS-REENTRANT>
            <IS-SYNCHRONOUS>true</IS-SYNCHRONOUS>
            <CALL-TYPE>REGULAR</CALL-TYPE>
            <EXECUTION-CONTEXT>TASK</EXECUTION-CONTEXT>
            <SW-SERVICE-IMPL-POLICY>STANDARD</SW-SERVICE-IMPL-POLICY>
            <RETURN-TYPE>
              <SHORT-NAME>Return</SHORT-NAME>
              <CATEGORY>TYPE_REFERENCE</CATEGORY>
              <SW-DATA-DEF-PROPS>
                <SW-DATA-DEF-PROPS-VARIANTS>
                  <SW-DATA-DEF-PROPS-CONDITIONAL>
                    <IMPLEMENTATION-DATA-TYPE-REF DEST = "IMPLEMENTATION-DATA-TYPE">/AUTOSAR_Icu_17_TimerIp/ImplementationDataTypes/Icu_17_TimerIp_ValueType</IMPLEMENTATION-DATA-TYPE-REF>
                  </SW-DATA-DEF-PROPS-CONDITIONAL>
                </SW-DATA-DEF-PROPS-VARIANTS>
              </SW-DATA-DEF-PROPS>
            </RETURN-TYPE>
            <ARGUMENTS>
              <SW-SERVICE-ARG>
                <SHORT-NAME>Channel</SHORT-NAME>
                <CATEGORY>TYPE_REFERENCE</CATEGORY>
                <SW-DATA-DEF-PROPS>
                  <SW-DATA-DEF-PROPS-VARIANTS>
                    <SW-DATA-DEF-PROPS-CONDITIONAL>
                      <IMPLEMENTATION-DATA-TYPE-REF DEST = "IMPLEMENTATION-DATA-TYPE">/AUTOSAR_Icu_17_TimerIp/ImplementationDataTypes/Icu_17_TimerIp_ChannelType</IMPLEMENTATION-DATA-TYPE-REF>
                    </SW-DATA-DEF-PROPS-CONDITIONAL>
                  </SW-DATA-DEF-PROPS-VARIANTS>
                </SW-DATA-DEF-PROPS>
              </SW-SERVICE-ARG>
            </ARGUMENTS>
          </BSW-MODULE-ENTRY>
[!ENDIF!][!//
[!IF "$Icu_GetDutyCycleValues_Xpath = 'true'"!][!//
          <BSW-MODULE-ENTRY>
            <SHORT-NAME>Icu_GetDutyCycleValues</SHORT-NAME>
            <INTRODUCTION>
              <NOTE SI="Icu_GetDutyCycleValues is reentrant but for different channels." NOTE-TYPE="HINT" />
            </INTRODUCTION>
            <SERVICE-ID>17</SERVICE-ID>
            <IS-REENTRANT>true</IS-REENTRANT>
            <IS-SYNCHRONOUS>true</IS-SYNCHRONOUS>
            <CALL-TYPE>REGULAR</CALL-TYPE>
            <EXECUTION-CONTEXT>TASK</EXECUTION-CONTEXT>
            <SW-SERVICE-IMPL-POLICY>STANDARD</SW-SERVICE-IMPL-POLICY>
            <ARGUMENTS>
              <SW-SERVICE-ARG>
                <SHORT-NAME>Channel</SHORT-NAME>
                <CATEGORY>TYPE_REFERENCE</CATEGORY>
                <SW-DATA-DEF-PROPS>
                  <SW-DATA-DEF-PROPS-VARIANTS>
                    <SW-DATA-DEF-PROPS-CONDITIONAL>
                      <IMPLEMENTATION-DATA-TYPE-REF DEST = "IMPLEMENTATION-DATA-TYPE">/AUTOSAR_Icu_17_TimerIp/ImplementationDataTypes/Icu_17_TimerIp_ChannelType</IMPLEMENTATION-DATA-TYPE-REF>
                    </SW-DATA-DEF-PROPS-CONDITIONAL>
                  </SW-DATA-DEF-PROPS-VARIANTS>
                </SW-DATA-DEF-PROPS>
              </SW-SERVICE-ARG>
              <SW-SERVICE-ARG>
                <SHORT-NAME>DutyCycleValues</SHORT-NAME>
                <CATEGORY>DATA_REFERENCE</CATEGORY>
                <SW-DATA-DEF-PROPS>
                  <SW-DATA-DEF-PROPS-VARIANTS>
                    <SW-DATA-DEF-PROPS-CONDITIONAL>
                      <SW-POINTER-TARGET-PROPS>
                        <TARGET-CATEGORY>TYPE_REFERENCE</TARGET-CATEGORY>
                        <SW-DATA-DEF-PROPS>
                          <SW-DATA-DEF-PROPS-VARIANTS>
                            <SW-DATA-DEF-PROPS-CONDITIONAL>
                              <IMPLEMENTATION-DATA-TYPE-REF DEST = "IMPLEMENTATION-DATA-TYPE">/AUTOSAR_Icu_17_TimerIp/ImplementationDataTypes/Icu_17_TimerIp_DutyCycleType</IMPLEMENTATION-DATA-TYPE-REF>
                            </SW-DATA-DEF-PROPS-CONDITIONAL>
                          </SW-DATA-DEF-PROPS-VARIANTS>
                        </SW-DATA-DEF-PROPS>
                      </SW-POINTER-TARGET-PROPS>
                    </SW-DATA-DEF-PROPS-CONDITIONAL>
                  </SW-DATA-DEF-PROPS-VARIANTS>
                </SW-DATA-DEF-PROPS>
              </SW-SERVICE-ARG>
            </ARGUMENTS>
          </BSW-MODULE-ENTRY>
[!ENDIF!][!//
[!IF "$Icu_CheckWakeup_Xpath = 'true'"!][!//
          <BSW-MODULE-ENTRY>
            <SHORT-NAME>Icu_CheckWakeup</SHORT-NAME>
            <INTRODUCTION>
              <NOTE SI="Icu_CheckWakeup is reentrant but for different channels." NOTE-TYPE="HINT" />
            </INTRODUCTION>
            <SERVICE-ID>21</SERVICE-ID>
            <IS-REENTRANT>true</IS-REENTRANT>
            <IS-SYNCHRONOUS>true</IS-SYNCHRONOUS>
            <CALL-TYPE>REGULAR</CALL-TYPE>
            <EXECUTION-CONTEXT>TASK</EXECUTION-CONTEXT>
            <SW-SERVICE-IMPL-POLICY>STANDARD</SW-SERVICE-IMPL-POLICY>
            <ARGUMENTS>
              <SW-SERVICE-ARG>
                <SHORT-NAME>WakeupSource</SHORT-NAME>
                <CATEGORY>TYPE_REFERENCE</CATEGORY>
                <SW-DATA-DEF-PROPS>
                  <SW-DATA-DEF-PROPS-VARIANTS>
                    <SW-DATA-DEF-PROPS-CONDITIONAL>
                      <IMPLEMENTATION-DATA-TYPE-REF DEST = "IMPLEMENTATION-DATA-TYPE">/AUTOSAR_EcuM/ImplementationDataTypes/EcuM_WakeupSourceType</IMPLEMENTATION-DATA-TYPE-REF>
                    </SW-DATA-DEF-PROPS-CONDITIONAL>
                  </SW-DATA-DEF-PROPS-VARIANTS>
                </SW-DATA-DEF-PROPS>
              </SW-SERVICE-ARG>
            </ARGUMENTS>
          </BSW-MODULE-ENTRY>
[!ENDIF!][!//
          <BSW-MODULE-ENTRY>
            <SHORT-NAME>Icu_Timer_Isr</SHORT-NAME>
            <INTRODUCTION>
              <NOTE SI="Icu_Timer_Isr is reentrant but for different channels." NOTE-TYPE="HINT" />
            </INTRODUCTION>
            <SERVICE-ID>32</SERVICE-ID>
            <IS-REENTRANT>true</IS-REENTRANT>
            <IS-SYNCHRONOUS>true</IS-SYNCHRONOUS>
            <CALL-TYPE>CALLBACK</CALL-TYPE>
            <EXECUTION-CONTEXT>INTERRUPT-CAT-1</EXECUTION-CONTEXT>
            <SW-SERVICE-IMPL-POLICY>STANDARD</SW-SERVICE-IMPL-POLICY>
            <ARGUMENTS>
              <SW-SERVICE-ARG>
                <SHORT-NAME>Channel</SHORT-NAME>
                <CATEGORY>TYPE_REFERENCE</CATEGORY>
                <SW-DATA-DEF-PROPS>
                  <SW-DATA-DEF-PROPS-VARIANTS>
                    <SW-DATA-DEF-PROPS-CONDITIONAL>
                      <IMPLEMENTATION-DATA-TYPE-REF DEST = "IMPLEMENTATION-DATA-TYPE">/AUTOSAR_Platform/ImplementationDataTypes/uint8</IMPLEMENTATION-DATA-TYPE-REF>
                    </SW-DATA-DEF-PROPS-CONDITIONAL>
                  </SW-DATA-DEF-PROPS-VARIANTS>
                </SW-DATA-DEF-PROPS>
              </SW-SERVICE-ARG>
            </ARGUMENTS>
          </BSW-MODULE-ENTRY>
[!IF "$Icu_17_TimerIp_EnableMultiEdgeDetection_Xpath = 'true'"!][!//
          <BSW-MODULE-ENTRY>
            <SHORT-NAME>Icu_EnableMultiEdgeDetection</SHORT-NAME>
            <INTRODUCTION>
              <NOTE SI="Icu_EnableMultiEdgeDetection is reentrant but for different channels." NOTE-TYPE="HINT" />
            </INTRODUCTION>
            <SERVICE-ID>25</SERVICE-ID>
            <IS-REENTRANT>true</IS-REENTRANT>
            <IS-SYNCHRONOUS>true</IS-SYNCHRONOUS>
            <CALL-TYPE>REGULAR</CALL-TYPE>
            <EXECUTION-CONTEXT>TASK</EXECUTION-CONTEXT>
            <SW-SERVICE-IMPL-POLICY>STANDARD</SW-SERVICE-IMPL-POLICY>
            <ARGUMENTS>
              <SW-SERVICE-ARG>
                <SHORT-NAME>Channel</SHORT-NAME>
                <CATEGORY>TYPE_REFERENCE</CATEGORY>
                <SW-DATA-DEF-PROPS>
                  <SW-DATA-DEF-PROPS-VARIANTS>
                    <SW-DATA-DEF-PROPS-CONDITIONAL>
                      <IMPLEMENTATION-DATA-TYPE-REF DEST = "IMPLEMENTATION-DATA-TYPE">/AUTOSAR_Icu_17_TimerIp/ImplementationDataTypes/Icu_17_TimerIp_ChannelType</IMPLEMENTATION-DATA-TYPE-REF>
                    </SW-DATA-DEF-PROPS-CONDITIONAL>
                  </SW-DATA-DEF-PROPS-VARIANTS>
                </SW-DATA-DEF-PROPS>
              </SW-SERVICE-ARG>
              <SW-SERVICE-ARG>
                <SHORT-NAME>EdgeCount</SHORT-NAME>
                <CATEGORY>TYPE_REFERENCE</CATEGORY>
                <SW-DATA-DEF-PROPS>
                  <SW-DATA-DEF-PROPS-VARIANTS>
                    <SW-DATA-DEF-PROPS-CONDITIONAL>
                      <IMPLEMENTATION-DATA-TYPE-REF DEST = "IMPLEMENTATION-DATA-TYPE">/AUTOSAR_Platform/ImplementationDataTypes/uint32</IMPLEMENTATION-DATA-TYPE-REF>
                    </SW-DATA-DEF-PROPS-CONDITIONAL>
                  </SW-DATA-DEF-PROPS-VARIANTS>
                </SW-DATA-DEF-PROPS>
              </SW-SERVICE-ARG>
            </ARGUMENTS>
          </BSW-MODULE-ENTRY>
[!ENDIF!][!//
        </ELEMENTS>
      </AR-PACKAGE>
      <AR-PACKAGE>
        <SHORT-NAME>Implementations</SHORT-NAME>
        <ELEMENTS>
          <BSW-IMPLEMENTATION>
            <SHORT-NAME>Icu</SHORT-NAME>
            <CODE-DESCRIPTORS>
              <CODE>
                <SHORT-NAME>Files</SHORT-NAME>
                <ARTIFACT-DESCRIPTORS>
                  <AUTOSAR-ENGINEERING-OBJECT>
                    <SHORT-LABEL>ssc::src::Icu_17_TimerIp.c</SHORT-LABEL>
                    <CATEGORY>SWSRC</CATEGORY>
                  </AUTOSAR-ENGINEERING-OBJECT>
                  <AUTOSAR-ENGINEERING-OBJECT>
                    <SHORT-LABEL>ssc::inc::Icu_17_TimerIp.h</SHORT-LABEL>
                    <CATEGORY>SWHDR</CATEGORY>
                  </AUTOSAR-ENGINEERING-OBJECT>
                  <AUTOSAR-ENGINEERING-OBJECT>
                    <SHORT-LABEL>ssc::inc::Icu_17_TimerIp_Local.h</SHORT-LABEL>
                    <CATEGORY>SWHDR</CATEGORY>
                  </AUTOSAR-ENGINEERING-OBJECT>
                  <AUTOSAR-ENGINEERING-OBJECT>
                    <SHORT-LABEL>ssc::inc::Icu_17_TimerIp_Cbk.h</SHORT-LABEL>
                    <CATEGORY>SWHDR</CATEGORY>
                  </AUTOSAR-ENGINEERING-OBJECT>
                </ARTIFACT-DESCRIPTORS>
              </CODE>
            </CODE-DESCRIPTORS>
            <GENERATED-ARTIFACTS>
              <DEPENDENCY-ON-ARTIFACT>
                <SHORT-NAME>Icu_PBcfg_c</SHORT-NAME>
                <ARTIFACT-DESCRIPTOR>
                  <SHORT-LABEL>generate::template::src::Icu_17_TimerIp_PBcfg.c</SHORT-LABEL>
                  <CATEGORY>SWTEMPLATE</CATEGORY>
                </ARTIFACT-DESCRIPTOR>
                <USAGES>
                  <USAGE>EXECUTE</USAGE>
                </USAGES>
              </DEPENDENCY-ON-ARTIFACT>
              <DEPENDENCY-ON-ARTIFACT>
                <SHORT-NAME>Icu_PBcfg_h</SHORT-NAME>
                <ARTIFACT-DESCRIPTOR>
                  <SHORT-LABEL>generate::template::inc::Icu_17_TimerIp_PBcfg.h</SHORT-LABEL>
                  <CATEGORY>SWTEMPLATE</CATEGORY>
                </ARTIFACT-DESCRIPTOR>
                <USAGES>
                  <USAGE>EXECUTE</USAGE>
                </USAGES>
              </DEPENDENCY-ON-ARTIFACT>
              <DEPENDENCY-ON-ARTIFACT>
                <SHORT-NAME>Icu_Cfg_h</SHORT-NAME>
                <ARTIFACT-DESCRIPTOR>
                  <SHORT-LABEL>generate::template::inc::Icu_17_TimerIp_Cfg.h</SHORT-LABEL>
                  <CATEGORY>SWTEMPLATE</CATEGORY>
                </ARTIFACT-DESCRIPTOR>
                <USAGES>
                  <USAGE>COMPILE</USAGE>
                </USAGES>
              </DEPENDENCY-ON-ARTIFACT>
              <DEPENDENCY-ON-ARTIFACT>
                <SHORT-NAME>Icu_xdm</SHORT-NAME>
                <ARTIFACT-DESCRIPTOR>
                  <SHORT-LABEL>config::Icu_17_TimerIp.xdm</SHORT-LABEL>
                  <CATEGORY>SWTOOL</CATEGORY>
                </ARTIFACT-DESCRIPTOR>
                <USAGES>
                  <USAGE>CODEGENERATION</USAGE>
                </USAGES>
              </DEPENDENCY-ON-ARTIFACT>
              [!/*<!--[cover parentID={5A503F54-2B4D-4df8-82E7-D96D1CCBE203}]
              BMD files
              [/cover]-->*/!]
              <DEPENDENCY-ON-ARTIFACT>
                <SHORT-NAME>Icu_bmd</SHORT-NAME>
                <ARTIFACT-DESCRIPTOR>
                  <SHORT-LABEL>autosar::[!"concat(substring(ecu:get('Rel.SubDerivate'),1,4),'x')"!]::[!"ecu:get('Rel.SubDerivate')"!]::Icu_17_TimerIp.bmd</SHORT-LABEL>
                  <CATEGORY>SWTOOL</CATEGORY>
                </ARTIFACT-DESCRIPTOR>
                <USAGES>
                  <USAGE>CODEGENERATION</USAGE>
                </USAGES>
              </DEPENDENCY-ON-ARTIFACT>
            </GENERATED-ARTIFACTS>
            <PROGRAMMING-LANGUAGE>C</PROGRAMMING-LANGUAGE>
            <RESOURCE-CONSUMPTION>
              <SHORT-NAME>ResourceConsumption</SHORT-NAME>
              <MEMORY-SECTIONS>
[!FOR "CoreId" = "num:i(1)" TO "num:i(6)"!][!//
  [!IF "bit:getbit($ConfiguredCores,$CoreId)"!]
                <MEMORY-SECTION>
                  <SHORT-NAME>VAR_CLEARED_ASIL_B_CORE[!"num:i(($CoreId) - num:i(1))"!]_32</SHORT-NAME>
                  <ALIGNMENT>32</ALIGNMENT>
                  <SW-ADDRMETHOD-REF DEST="SW-ADDR-METHOD">/AUTOSAR_MemMap/SwAddrMethods/VAR_CLEARED</SW-ADDRMETHOD-REF>
                </MEMORY-SECTION>
                <MEMORY-SECTION>
                  <SHORT-NAME>CONFIG_DATA_ASIL_B_CORE[!"num:i(($CoreId) - num:i(1))"!]_UNSPECIFIED</SHORT-NAME>
                  <ALIGNMENT>UNSPECIFIED</ALIGNMENT>
                  <SW-ADDRMETHOD-REF DEST="SW-ADDR-METHOD">/AUTOSAR_MemMap/SwAddrMethods/CONFIG_DATA</SW-ADDRMETHOD-REF>
                </MEMORY-SECTION>
                <MEMORY-SECTION>
                  <SHORT-NAME>VAR_INIT_ASIL_B_CORE[!"num:i(($CoreId) - num:i(1))"!]_32</SHORT-NAME>
                  <ALIGNMENT>32</ALIGNMENT>
                  <SW-ADDRMETHOD-REF DEST="SW-ADDR-METHOD">/AUTOSAR_MemMap/SwAddrMethods/VAR_INIT</SW-ADDRMETHOD-REF>
                </MEMORY-SECTION>
  [!ENDIF!]
[!ENDFOR!]
                <MEMORY-SECTION>
                  <SHORT-NAME>CONST_ASIL_B_GLOBAL_32</SHORT-NAME>
                  <ALIGNMENT>32</ALIGNMENT>
                  <SW-ADDRMETHOD-REF DEST="SW-ADDR-METHOD">/AUTOSAR_MemMap/SwAddrMethods/CONST</SW-ADDRMETHOD-REF>
                </MEMORY-SECTION>
                <MEMORY-SECTION>
                  <SHORT-NAME>VAR_CLEARED_ASIL_B_GLOBAL_32</SHORT-NAME>
                  <ALIGNMENT>32</ALIGNMENT>
                  <SW-ADDRMETHOD-REF DEST="SW-ADDR-METHOD">/AUTOSAR_MemMap/SwAddrMethods/VAR_CLEARED</SW-ADDRMETHOD-REF>
                </MEMORY-SECTION>
                <MEMORY-SECTION>
                  <SHORT-NAME>CONFIG_DATA_ASIL_B_GLOBAL_UNSPECIFIED</SHORT-NAME>
                  <ALIGNMENT>UNSPECIFIED</ALIGNMENT>
                  <SW-ADDRMETHOD-REF DEST="SW-ADDR-METHOD">/AUTOSAR_MemMap/SwAddrMethods/CONFIG_DATA</SW-ADDRMETHOD-REF>
                </MEMORY-SECTION>
                <MEMORY-SECTION>
                  <SHORT-NAME>CODE_ASIL_B_GLOBAL</SHORT-NAME>
                  <ALIGNMENT>UNSPECIFIED</ALIGNMENT>
                  <SW-ADDRMETHOD-REF DEST="SW-ADDR-METHOD">/AUTOSAR_MemMap/SwAddrMethods/CODE</SW-ADDRMETHOD-REF>
                </MEMORY-SECTION>
              </MEMORY-SECTIONS>
              <SECTION-NAME-PREFIXS>
                <SECTION-NAME-PREFIX>
                  <SHORT-NAME>ICU_17_TIMERIP</SHORT-NAME>
                  <SYMBOL>ICU_17_TIMERIP</SYMBOL>
                </SECTION-NAME-PREFIX>
              </SECTION-NAME-PREFIXS>
            </RESOURCE-CONSUMPTION>
            <SW-VERSION>20.25.0</SW-VERSION>
            <VENDOR-ID>17</VENDOR-ID>
            [!IF "$MinorVersion = num:i(2)"!][!//
            <AR-RELEASE-VERSION>4.2.2</AR-RELEASE-VERSION>
            [!ELSE!]
            <AR-RELEASE-VERSION>4.4.0</AR-RELEASE-VERSION>
            [!ENDIF!]
            <BEHAVIOR-REF DEST="BSW-INTERNAL-BEHAVIOR">/AUTOSAR_Icu_17_TimerIp/BswModuleDescriptions/Icu/IcuBehavior</BEHAVIOR-REF>
            <VENDOR-API-INFIX>TimerIp</VENDOR-API-INFIX>
            <VENDOR-SPECIFIC-MODULE-DEF-REFS>
              <VENDOR-SPECIFIC-MODULE-DEF-REF DEST="ECUC-MODULE-DEF">/AURIX2G/EcucDefs/Icu</VENDOR-SPECIFIC-MODULE-DEF-REF>
            </VENDOR-SPECIFIC-MODULE-DEF-REFS>
          </BSW-IMPLEMENTATION>
        </ELEMENTS>
      </AR-PACKAGE>
      <AR-PACKAGE>
        <SHORT-NAME>ImplementationDataTypes</SHORT-NAME>
        <CATEGORY>STANDARD</CATEGORY>
        <ELEMENTS>
          <IMPLEMENTATION-DATA-TYPE>
            <SHORT-NAME>Icu_17_TimerIp_NotifiPtrType</SHORT-NAME>
            <CATEGORY>FUNCTION_REFERENCE</CATEGORY>
            <INTRODUCTION>
              <NOTE SI="This data type is for a function pointer type pointing to the callback-notification function. The referred function should be implemented by user of the driver" NOTE-TYPE="HINT"/>
            </INTRODUCTION>
            <SW-DATA-DEF-PROPS>
              <SW-DATA-DEF-PROPS-VARIANTS>
                <SW-DATA-DEF-PROPS-CONDITIONAL>
                  <SW-POINTER-TARGET-PROPS>
                    <FUNCTION-POINTER-SIGNATURE-REF DEST="BSW-MODULE-ENTRY">/AUTOSAR_Stub/BswModuleEntrys/IoHwAb_IcuNotification</FUNCTION-POINTER-SIGNATURE-REF>
                  </SW-POINTER-TARGET-PROPS>
                </SW-DATA-DEF-PROPS-CONDITIONAL>
              </SW-DATA-DEF-PROPS-VARIANTS>
            </SW-DATA-DEF-PROPS>
            <TYPE-EMITTER>BSW</TYPE-EMITTER>
          </IMPLEMENTATION-DATA-TYPE>
[!IF "$Icu_SetMode_Xpath = 'true'"!][!//
          <IMPLEMENTATION-DATA-TYPE>
            <SHORT-NAME>Icu_17_TimerIp_ModeType</SHORT-NAME>
            <CATEGORY>TYPE_REFERENCE</CATEGORY>
            <SW-DATA-DEF-PROPS>
              <SW-DATA-DEF-PROPS-VARIANTS>
                <SW-DATA-DEF-PROPS-CONDITIONAL>
                  <COMPU-METHOD-REF DEST="COMPU-METHOD">/AUTOSAR_Icu_17_TimerIp/CompuMethods/Icu_17_TimerIp_ModeType</COMPU-METHOD-REF>
                  <IMPLEMENTATION-DATA-TYPE-REF DEST="IMPLEMENTATION-DATA-TYPE">/AUTOSAR_Platform/ImplementationDataTypes/sint32</IMPLEMENTATION-DATA-TYPE-REF>
                  <SW-IMPL-POLICY>STANDARD</SW-IMPL-POLICY>
                  <ADDITIONAL-NATIVE-TYPE-QUALIFIER>enum</ADDITIONAL-NATIVE-TYPE-QUALIFIER>
                </SW-DATA-DEF-PROPS-CONDITIONAL>
              </SW-DATA-DEF-PROPS-VARIANTS>
            </SW-DATA-DEF-PROPS>
            <TYPE-EMITTER>BSW</TYPE-EMITTER>
          </IMPLEMENTATION-DATA-TYPE>
[!ENDIF!][!//
[!IF "$Icu_IncInterface_Xpath = 'true'"!][!//
          <IMPLEMENTATION-DATA-TYPE>
            <SHORT-NAME>Icu_17_TimerIp_EncCountDirType</SHORT-NAME>
            <CATEGORY>TYPE_REFERENCE</CATEGORY>
            <SW-DATA-DEF-PROPS>
              <SW-DATA-DEF-PROPS-VARIANTS>
                <SW-DATA-DEF-PROPS-CONDITIONAL>
                  <COMPU-METHOD-REF DEST="COMPU-METHOD">/AUTOSAR_Icu_17_TimerIp/CompuMethods/Icu_17_TimerIp_EncCountDirType</COMPU-METHOD-REF>
                  <IMPLEMENTATION-DATA-TYPE-REF DEST="IMPLEMENTATION-DATA-TYPE">/AUTOSAR_Platform/ImplementationDataTypes/sint32</IMPLEMENTATION-DATA-TYPE-REF>
                  <SW-IMPL-POLICY>STANDARD</SW-IMPL-POLICY>
                  <ADDITIONAL-NATIVE-TYPE-QUALIFIER>enum</ADDITIONAL-NATIVE-TYPE-QUALIFIER>
                </SW-DATA-DEF-PROPS-CONDITIONAL>
              </SW-DATA-DEF-PROPS-VARIANTS>
            </SW-DATA-DEF-PROPS>
            <TYPE-EMITTER>BSW</TYPE-EMITTER>
          </IMPLEMENTATION-DATA-TYPE>
[!ENDIF!][!//
          <IMPLEMENTATION-DATA-TYPE>
            <SHORT-NAME>Icu_17_TimerIp_ChannelType</SHORT-NAME>
            <CATEGORY>TYPE_REFERENCE</CATEGORY>
            <SW-DATA-DEF-PROPS>
              <SW-DATA-DEF-PROPS-VARIANTS>
                <SW-DATA-DEF-PROPS-CONDITIONAL>
                  <IMPLEMENTATION-DATA-TYPE-REF DEST="IMPLEMENTATION-DATA-TYPE">/AUTOSAR_Platform/ImplementationDataTypes/uint8</IMPLEMENTATION-DATA-TYPE-REF>
                  <SW-IMPL-POLICY>STANDARD</SW-IMPL-POLICY>
                </SW-DATA-DEF-PROPS-CONDITIONAL>
              </SW-DATA-DEF-PROPS-VARIANTS>
            </SW-DATA-DEF-PROPS>
            <TYPE-EMITTER>BSW</TYPE-EMITTER>
          </IMPLEMENTATION-DATA-TYPE>
[!IF "$Icu_GetInputState_Xpath = 'true'"!][!//
          <IMPLEMENTATION-DATA-TYPE>
            <SHORT-NAME>Icu_17_TimerIp_InputStateType</SHORT-NAME>
            <CATEGORY>TYPE_REFERENCE</CATEGORY>
            <SW-DATA-DEF-PROPS>
              <SW-DATA-DEF-PROPS-VARIANTS>
                <SW-DATA-DEF-PROPS-CONDITIONAL>
                  <COMPU-METHOD-REF DEST="COMPU-METHOD">/AUTOSAR_Icu_17_TimerIp/CompuMethods/Icu_17_TimerIp_InputStateType</COMPU-METHOD-REF>
                  <IMPLEMENTATION-DATA-TYPE-REF DEST="IMPLEMENTATION-DATA-TYPE">/AUTOSAR_Platform/ImplementationDataTypes/sint32</IMPLEMENTATION-DATA-TYPE-REF>
                  <SW-IMPL-POLICY>STANDARD</SW-IMPL-POLICY>
                  <ADDITIONAL-NATIVE-TYPE-QUALIFIER>enum</ADDITIONAL-NATIVE-TYPE-QUALIFIER>
                </SW-DATA-DEF-PROPS-CONDITIONAL>
              </SW-DATA-DEF-PROPS-VARIANTS>
            </SW-DATA-DEF-PROPS>
            <TYPE-EMITTER>BSW</TYPE-EMITTER>
          </IMPLEMENTATION-DATA-TYPE>
[!ENDIF!][!//
          <IMPLEMENTATION-DATA-TYPE>
            <SHORT-NAME>Icu_17_TimerIp_ActivationType</SHORT-NAME>
            <CATEGORY>TYPE_REFERENCE</CATEGORY>
            <SW-DATA-DEF-PROPS>
              <SW-DATA-DEF-PROPS-VARIANTS>
                <SW-DATA-DEF-PROPS-CONDITIONAL>
                  <COMPU-METHOD-REF DEST="COMPU-METHOD">/AUTOSAR_Icu_17_TimerIp/CompuMethods/Icu_17_TimerIp_ActivationType</COMPU-METHOD-REF>
                  <IMPLEMENTATION-DATA-TYPE-REF DEST="IMPLEMENTATION-DATA-TYPE">/AUTOSAR_Platform/ImplementationDataTypes/sint32</IMPLEMENTATION-DATA-TYPE-REF>
                  <SW-IMPL-POLICY>STANDARD</SW-IMPL-POLICY>
                  <ADDITIONAL-NATIVE-TYPE-QUALIFIER>enum</ADDITIONAL-NATIVE-TYPE-QUALIFIER>
                </SW-DATA-DEF-PROPS-CONDITIONAL>
              </SW-DATA-DEF-PROPS-VARIANTS>
            </SW-DATA-DEF-PROPS>
            <TYPE-EMITTER>BSW</TYPE-EMITTER>
          </IMPLEMENTATION-DATA-TYPE>
[!IF "($Icu_GetDutyCycleValues_Xpath = 'true') or ($Icu_StartTimestamp_Xpath = 'true') or ($Icu_GetTimeElapsed_Xpath = 'true')"!][!//
          <IMPLEMENTATION-DATA-TYPE>
            <SHORT-NAME>Icu_17_TimerIp_ValueType</SHORT-NAME>
            <CATEGORY>TYPE_REFERENCE</CATEGORY>
            <SW-DATA-DEF-PROPS>
              <SW-DATA-DEF-PROPS-VARIANTS>
                <SW-DATA-DEF-PROPS-CONDITIONAL>
                  <IMPLEMENTATION-DATA-TYPE-REF DEST="IMPLEMENTATION-DATA-TYPE">/AUTOSAR_Platform/ImplementationDataTypes/uint32</IMPLEMENTATION-DATA-TYPE-REF>
                  <SW-IMPL-POLICY>STANDARD</SW-IMPL-POLICY>
                </SW-DATA-DEF-PROPS-CONDITIONAL>
              </SW-DATA-DEF-PROPS-VARIANTS>
            </SW-DATA-DEF-PROPS>
            <TYPE-EMITTER>BSW</TYPE-EMITTER>
          </IMPLEMENTATION-DATA-TYPE>
[!ENDIF!][!//
[!IF "$Icu_GetDutyCycleValues_Xpath = 'true'"!][!//
          <IMPLEMENTATION-DATA-TYPE>
            <SHORT-NAME>Icu_17_TimerIp_DutyCycleType</SHORT-NAME>
            <CATEGORY>STRUCTURE</CATEGORY>
            <SUB-ELEMENTS>
              <IMPLEMENTATION-DATA-TYPE-ELEMENT>
                <SHORT-NAME>ActiveTime</SHORT-NAME>
                <CATEGORY>TYPE_REFERENCE</CATEGORY>
                <SW-DATA-DEF-PROPS>
                  <SW-DATA-DEF-PROPS-VARIANTS>
                    <SW-DATA-DEF-PROPS-CONDITIONAL>
                      <IMPLEMENTATION-DATA-TYPE-REF DEST="IMPLEMENTATION-DATA-TYPE">/AUTOSAR_Icu_17_TimerIp/ImplementationDataTypes/Icu_17_TimerIp_ValueType</IMPLEMENTATION-DATA-TYPE-REF>
                    </SW-DATA-DEF-PROPS-CONDITIONAL>
                  </SW-DATA-DEF-PROPS-VARIANTS>
                </SW-DATA-DEF-PROPS>
              </IMPLEMENTATION-DATA-TYPE-ELEMENT>
              <IMPLEMENTATION-DATA-TYPE-ELEMENT>
                <SHORT-NAME>PeriodTime</SHORT-NAME>
                <CATEGORY>TYPE_REFERENCE</CATEGORY>
                <SW-DATA-DEF-PROPS>
                  <SW-DATA-DEF-PROPS-VARIANTS>
                    <SW-DATA-DEF-PROPS-CONDITIONAL>
                      <IMPLEMENTATION-DATA-TYPE-REF DEST="IMPLEMENTATION-DATA-TYPE">/AUTOSAR_Icu_17_TimerIp/ImplementationDataTypes/Icu_17_TimerIp_ValueType</IMPLEMENTATION-DATA-TYPE-REF>
                    </SW-DATA-DEF-PROPS-CONDITIONAL>
                  </SW-DATA-DEF-PROPS-VARIANTS>
                </SW-DATA-DEF-PROPS>
              </IMPLEMENTATION-DATA-TYPE-ELEMENT>
            </SUB-ELEMENTS>
            <TYPE-EMITTER>BSW</TYPE-EMITTER>
          </IMPLEMENTATION-DATA-TYPE>
[!ENDIF!][!//
[!IF "$Icu_GetTimestamp_Xpath = 'true'"!][!//
          <IMPLEMENTATION-DATA-TYPE>
            <SHORT-NAME>Icu_17_TimerIp_IndexType</SHORT-NAME>
            <CATEGORY>TYPE_REFERENCE</CATEGORY>
            <SW-DATA-DEF-PROPS>
              <SW-DATA-DEF-PROPS-VARIANTS>
                <SW-DATA-DEF-PROPS-CONDITIONAL>
                  <IMPLEMENTATION-DATA-TYPE-REF DEST="IMPLEMENTATION-DATA-TYPE">/AUTOSAR_Platform/ImplementationDataTypes/uint16</IMPLEMENTATION-DATA-TYPE-REF>
                  <SW-IMPL-POLICY>STANDARD</SW-IMPL-POLICY>
                </SW-DATA-DEF-PROPS-CONDITIONAL>
              </SW-DATA-DEF-PROPS-VARIANTS>
            </SW-DATA-DEF-PROPS>
            <TYPE-EMITTER>BSW</TYPE-EMITTER>
          </IMPLEMENTATION-DATA-TYPE>
[!ENDIF!][!//
[!IF "$Icu_GetEdgeNumbers_Xpath = 'true'"!][!//
          <IMPLEMENTATION-DATA-TYPE>
            <SHORT-NAME>Icu_17_TimerIp_EdgeNumberType</SHORT-NAME>
            <CATEGORY>TYPE_REFERENCE</CATEGORY>
            <SW-DATA-DEF-PROPS>
              <SW-DATA-DEF-PROPS-VARIANTS>
                <SW-DATA-DEF-PROPS-CONDITIONAL>
                  <IMPLEMENTATION-DATA-TYPE-REF DEST="IMPLEMENTATION-DATA-TYPE">/AUTOSAR_Platform/ImplementationDataTypes/uint32</IMPLEMENTATION-DATA-TYPE-REF>
                  <SW-IMPL-POLICY>STANDARD</SW-IMPL-POLICY>
                </SW-DATA-DEF-PROPS-CONDITIONAL>
              </SW-DATA-DEF-PROPS-VARIANTS>
            </SW-DATA-DEF-PROPS>
            <TYPE-EMITTER>BSW</TYPE-EMITTER>
          </IMPLEMENTATION-DATA-TYPE>
[!ENDIF!][!//
          <IMPLEMENTATION-DATA-TYPE>
            <SHORT-NAME>Icu_17_TimerIp_ConfigType</SHORT-NAME>
            <CATEGORY>STRUCTURE</CATEGORY>
            <SUB-ELEMENTS>
              <IMPLEMENTATION-DATA-TYPE-ELEMENT>
                <SHORT-NAME>EruChannelMap</SHORT-NAME>
                <CATEGORY>TYPE_REFERENCE</CATEGORY>
                <ARRAY-SIZE>8</ARRAY-SIZE>
                <ARRAY-SIZE-SEMANTICS>FIXED-SIZE</ARRAY-SIZE-SEMANTICS>
                <SW-DATA-DEF-PROPS>
                  <SW-DATA-DEF-PROPS-VARIANTS>
                    <SW-DATA-DEF-PROPS-CONDITIONAL>
                      <IMPLEMENTATION-DATA-TYPE-REF DEST="IMPLEMENTATION-DATA-TYPE">/AUTOSAR_Platform/ImplementationDataTypes/uint16</IMPLEMENTATION-DATA-TYPE-REF>
                    </SW-DATA-DEF-PROPS-CONDITIONAL>
                  </SW-DATA-DEF-PROPS-VARIANTS>
                </SW-DATA-DEF-PROPS>
              </IMPLEMENTATION-DATA-TYPE-ELEMENT>
              <IMPLEMENTATION-DATA-TYPE-ELEMENT>
                <SHORT-NAME>CoreConfig</SHORT-NAME>
                <CATEGORY>DATA_REFERENCE</CATEGORY>
                <ARRAY-SIZE>6</ARRAY-SIZE>
                <ARRAY-SIZE-SEMANTICS>FIXED-SIZE</ARRAY-SIZE-SEMANTICS>
                <SW-DATA-DEF-PROPS>
                  <SW-DATA-DEF-PROPS-VARIANTS>
                    <SW-DATA-DEF-PROPS-CONDITIONAL>
                      <SW-POINTER-TARGET-PROPS>
                        <TARGET-CATEGORY>TYPE_REFERENCE</TARGET-CATEGORY>
                        <SW-DATA-DEF-PROPS>
                          <SW-DATA-DEF-PROPS-VARIANTS>
                            <SW-DATA-DEF-PROPS-CONDITIONAL>
                              <IMPLEMENTATION-DATA-TYPE-REF DEST="IMPLEMENTATION-DATA-TYPE">/AUTOSAR_Icu_17_TimerIp/ImplementationDataTypes/Icu_17_TimerIp_CoreConfigType</IMPLEMENTATION-DATA-TYPE-REF>
                            </SW-DATA-DEF-PROPS-CONDITIONAL>
                          </SW-DATA-DEF-PROPS-VARIANTS>
                        </SW-DATA-DEF-PROPS>
                      </SW-POINTER-TARGET-PROPS>
                    </SW-DATA-DEF-PROPS-CONDITIONAL>
                  </SW-DATA-DEF-PROPS-VARIANTS>
                </SW-DATA-DEF-PROPS>
              </IMPLEMENTATION-DATA-TYPE-ELEMENT>
              <IMPLEMENTATION-DATA-TYPE-ELEMENT>
                <SHORT-NAME>ChannelMapping</SHORT-NAME>
                <CATEGORY>TYPE_REFERENCE</CATEGORY>
                <ARRAY-SIZE>[!"num:i($MaxChannels)"!]</ARRAY-SIZE>
                <ARRAY-SIZE-SEMANTICS>FIXED-SIZE</ARRAY-SIZE-SEMANTICS>
                <SW-DATA-DEF-PROPS>
                  <SW-DATA-DEF-PROPS-VARIANTS>
                    <SW-DATA-DEF-PROPS-CONDITIONAL>
                      <IMPLEMENTATION-DATA-TYPE-REF DEST="IMPLEMENTATION-DATA-TYPE">/AUTOSAR_Platform/ImplementationDataTypes/uint16</IMPLEMENTATION-DATA-TYPE-REF>
                    </SW-DATA-DEF-PROPS-CONDITIONAL>
                  </SW-DATA-DEF-PROPS-VARIANTS>
                </SW-DATA-DEF-PROPS>
              </IMPLEMENTATION-DATA-TYPE-ELEMENT>
            </SUB-ELEMENTS>
            <TYPE-EMITTER>BSW</TYPE-EMITTER>
          </IMPLEMENTATION-DATA-TYPE>
          <IMPLEMENTATION-DATA-TYPE>
            <SHORT-NAME>Icu_17_TimerIp_ChannelConfigType</SHORT-NAME>
            <CATEGORY>STRUCTURE</CATEGORY>
            <SUB-ELEMENTS>
              <IMPLEMENTATION-DATA-TYPE-ELEMENT>
                <SHORT-NAME>NotificationPointer</SHORT-NAME>
                <CATEGORY>TYPE_REFERENCE</CATEGORY>
                <SW-DATA-DEF-PROPS>
                  <SW-DATA-DEF-PROPS-VARIANTS>
                    <SW-DATA-DEF-PROPS-CONDITIONAL>
                      <IMPLEMENTATION-DATA-TYPE-REF DEST="IMPLEMENTATION-DATA-TYPE">/AUTOSAR_Icu_17_TimerIp/ImplementationDataTypes/Icu_17_TimerIp_NotifiPtrType</IMPLEMENTATION-DATA-TYPE-REF>
                    </SW-DATA-DEF-PROPS-CONDITIONAL>
                  </SW-DATA-DEF-PROPS-VARIANTS>
                </SW-DATA-DEF-PROPS>
              </IMPLEMENTATION-DATA-TYPE-ELEMENT>
              <IMPLEMENTATION-DATA-TYPE-ELEMENT>
                <SHORT-NAME>MeasurementMode</SHORT-NAME>
                <CATEGORY>TYPE_REFERENCE</CATEGORY>
                <SW-DATA-DEF-PROPS>
                  <SW-DATA-DEF-PROPS-VARIANTS>
                    <SW-DATA-DEF-PROPS-CONDITIONAL>
                      <SW-BIT-REPRESENTATION>
                        <NUMBER-OF-BITS>3</NUMBER-OF-BITS>
                      </SW-BIT-REPRESENTATION>
                      <IMPLEMENTATION-DATA-TYPE-REF DEST="IMPLEMENTATION-DATA-TYPE">/AURIX2G_McalLib/ImplementationDataTypes/unsigned_int</IMPLEMENTATION-DATA-TYPE-REF>
                    </SW-DATA-DEF-PROPS-CONDITIONAL>
                  </SW-DATA-DEF-PROPS-VARIANTS>
                </SW-DATA-DEF-PROPS>
              </IMPLEMENTATION-DATA-TYPE-ELEMENT>
              <IMPLEMENTATION-DATA-TYPE-ELEMENT>
                <SHORT-NAME>DefaultStartEdge</SHORT-NAME>
                <CATEGORY>TYPE_REFERENCE</CATEGORY>
                <SW-DATA-DEF-PROPS>
                  <SW-DATA-DEF-PROPS-VARIANTS>
                    <SW-DATA-DEF-PROPS-CONDITIONAL>
                      <SW-BIT-REPRESENTATION>
                        <NUMBER-OF-BITS>2</NUMBER-OF-BITS>
                      </SW-BIT-REPRESENTATION>
                      <IMPLEMENTATION-DATA-TYPE-REF DEST="IMPLEMENTATION-DATA-TYPE">/AURIX2G_McalLib/ImplementationDataTypes/unsigned_int</IMPLEMENTATION-DATA-TYPE-REF>
                    </SW-DATA-DEF-PROPS-CONDITIONAL>
                  </SW-DATA-DEF-PROPS-VARIANTS>
                </SW-DATA-DEF-PROPS>
              </IMPLEMENTATION-DATA-TYPE-ELEMENT>
              <IMPLEMENTATION-DATA-TYPE-ELEMENT>
                <SHORT-NAME>MeasurementProperty</SHORT-NAME>
                <CATEGORY>TYPE_REFERENCE</CATEGORY>
                <SW-DATA-DEF-PROPS>
                  <SW-DATA-DEF-PROPS-VARIANTS>
                    <SW-DATA-DEF-PROPS-CONDITIONAL>
                      <SW-BIT-REPRESENTATION>
                        <NUMBER-OF-BITS>2</NUMBER-OF-BITS>
                      </SW-BIT-REPRESENTATION>
                      <IMPLEMENTATION-DATA-TYPE-REF DEST="IMPLEMENTATION-DATA-TYPE">/AURIX2G_McalLib/ImplementationDataTypes/unsigned_int</IMPLEMENTATION-DATA-TYPE-REF>
                    </SW-DATA-DEF-PROPS-CONDITIONAL>
                  </SW-DATA-DEF-PROPS-VARIANTS>
                </SW-DATA-DEF-PROPS>
              </IMPLEMENTATION-DATA-TYPE-ELEMENT>
              <IMPLEMENTATION-DATA-TYPE-ELEMENT>
                <SHORT-NAME>WakeupCapability</SHORT-NAME>
                <CATEGORY>TYPE_REFERENCE</CATEGORY>
                <SW-DATA-DEF-PROPS>
                  <SW-DATA-DEF-PROPS-VARIANTS>
                    <SW-DATA-DEF-PROPS-CONDITIONAL>
                      <SW-BIT-REPRESENTATION>
                        <NUMBER-OF-BITS>2</NUMBER-OF-BITS>
                      </SW-BIT-REPRESENTATION>
                      <IMPLEMENTATION-DATA-TYPE-REF DEST="IMPLEMENTATION-DATA-TYPE">/AURIX2G_McalLib/ImplementationDataTypes/unsigned_int</IMPLEMENTATION-DATA-TYPE-REF>
                    </SW-DATA-DEF-PROPS-CONDITIONAL>
                  </SW-DATA-DEF-PROPS-VARIANTS>
                </SW-DATA-DEF-PROPS>
              </IMPLEMENTATION-DATA-TYPE-ELEMENT>
              <IMPLEMENTATION-DATA-TYPE-ELEMENT>
                <SHORT-NAME>AssignedHwUnitNumber</SHORT-NAME>
                <CATEGORY>TYPE_REFERENCE</CATEGORY>
                <SW-DATA-DEF-PROPS>
                  <SW-DATA-DEF-PROPS-VARIANTS>
                    <SW-DATA-DEF-PROPS-CONDITIONAL>
                      <SW-BIT-REPRESENTATION>
                        <NUMBER-OF-BITS>16</NUMBER-OF-BITS>
                      </SW-BIT-REPRESENTATION>
                      <IMPLEMENTATION-DATA-TYPE-REF DEST="IMPLEMENTATION-DATA-TYPE">/AURIX2G_McalLib/ImplementationDataTypes/unsigned_int</IMPLEMENTATION-DATA-TYPE-REF>
                    </SW-DATA-DEF-PROPS-CONDITIONAL>
                  </SW-DATA-DEF-PROPS-VARIANTS>
                </SW-DATA-DEF-PROPS>
              </IMPLEMENTATION-DATA-TYPE-ELEMENT>
              <IMPLEMENTATION-DATA-TYPE-ELEMENT>
                <SHORT-NAME>AssignedHwUnit</SHORT-NAME>
                <CATEGORY>TYPE_REFERENCE</CATEGORY>
                <SW-DATA-DEF-PROPS>
                  <SW-DATA-DEF-PROPS-VARIANTS>
                    <SW-DATA-DEF-PROPS-CONDITIONAL>
                      <SW-BIT-REPRESENTATION>
                        <NUMBER-OF-BITS>2</NUMBER-OF-BITS>
                      </SW-BIT-REPRESENTATION>
                      <IMPLEMENTATION-DATA-TYPE-REF DEST="IMPLEMENTATION-DATA-TYPE">/AURIX2G_McalLib/ImplementationDataTypes/unsigned_int</IMPLEMENTATION-DATA-TYPE-REF>
                    </SW-DATA-DEF-PROPS-CONDITIONAL>
                  </SW-DATA-DEF-PROPS-VARIANTS>
                </SW-DATA-DEF-PROPS>
              </IMPLEMENTATION-DATA-TYPE-ELEMENT>
              <IMPLEMENTATION-DATA-TYPE-ELEMENT>
                <SHORT-NAME>PinSelection</SHORT-NAME>
                <CATEGORY>TYPE_REFERENCE</CATEGORY>
                <SW-DATA-DEF-PROPS>
                  <SW-DATA-DEF-PROPS-VARIANTS>
                    <SW-DATA-DEF-PROPS-CONDITIONAL>
                      <SW-BIT-REPRESENTATION>
                        <NUMBER-OF-BITS>4</NUMBER-OF-BITS>
                      </SW-BIT-REPRESENTATION>
                      <IMPLEMENTATION-DATA-TYPE-REF DEST="IMPLEMENTATION-DATA-TYPE">/AURIX2G_McalLib/ImplementationDataTypes/unsigned_int</IMPLEMENTATION-DATA-TYPE-REF>
                    </SW-DATA-DEF-PROPS-CONDITIONAL>
                  </SW-DATA-DEF-PROPS-VARIANTS>
                </SW-DATA-DEF-PROPS>
              </IMPLEMENTATION-DATA-TYPE-ELEMENT>
              <IMPLEMENTATION-DATA-TYPE-ELEMENT>
                <SHORT-NAME>Reserved</SHORT-NAME>
                <CATEGORY>TYPE_REFERENCE</CATEGORY>
                <SW-DATA-DEF-PROPS>
                  <SW-DATA-DEF-PROPS-VARIANTS>
                    <SW-DATA-DEF-PROPS-CONDITIONAL>
                      <SW-BIT-REPRESENTATION>
                        <NUMBER-OF-BITS>1</NUMBER-OF-BITS>
                      </SW-BIT-REPRESENTATION>
                      <IMPLEMENTATION-DATA-TYPE-REF DEST="IMPLEMENTATION-DATA-TYPE">/AURIX2G_McalLib/ImplementationDataTypes/unsigned_int</IMPLEMENTATION-DATA-TYPE-REF>
                    </SW-DATA-DEF-PROPS-CONDITIONAL>
                  </SW-DATA-DEF-PROPS-VARIANTS>
                </SW-DATA-DEF-PROPS>
              </IMPLEMENTATION-DATA-TYPE-ELEMENT>
              <IMPLEMENTATION-DATA-TYPE-ELEMENT>
                <SHORT-NAME>TimChFilterTimeForRisingEdge</SHORT-NAME>
                <CATEGORY>TYPE_REFERENCE</CATEGORY>
                <SW-DATA-DEF-PROPS>
                  <SW-DATA-DEF-PROPS-VARIANTS>
                    <SW-DATA-DEF-PROPS-CONDITIONAL>
                      <IMPLEMENTATION-DATA-TYPE-REF DEST="IMPLEMENTATION-DATA-TYPE">/AUTOSAR_Platform/ImplementationDataTypes/uint32</IMPLEMENTATION-DATA-TYPE-REF>
                    </SW-DATA-DEF-PROPS-CONDITIONAL>
                  </SW-DATA-DEF-PROPS-VARIANTS>
                </SW-DATA-DEF-PROPS>
              </IMPLEMENTATION-DATA-TYPE-ELEMENT>
              <IMPLEMENTATION-DATA-TYPE-ELEMENT>
                <SHORT-NAME>TimChFilterTimeForFallingEdge</SHORT-NAME>
                <CATEGORY>TYPE_REFERENCE</CATEGORY>
                <SW-DATA-DEF-PROPS>
                  <SW-DATA-DEF-PROPS-VARIANTS>
                    <SW-DATA-DEF-PROPS-CONDITIONAL>
                      <IMPLEMENTATION-DATA-TYPE-REF DEST="IMPLEMENTATION-DATA-TYPE">/AUTOSAR_Platform/ImplementationDataTypes/uint32</IMPLEMENTATION-DATA-TYPE-REF>
                    </SW-DATA-DEF-PROPS-CONDITIONAL>
                  </SW-DATA-DEF-PROPS-VARIANTS>
                </SW-DATA-DEF-PROPS>
              </IMPLEMENTATION-DATA-TYPE-ELEMENT>
[!IF "$ReportWakeupSource = 'true'"!][!//
              <IMPLEMENTATION-DATA-TYPE-ELEMENT>
                <SHORT-NAME>ChannelWakeupInfo</SHORT-NAME>
                <CATEGORY>TYPE_REFERENCE</CATEGORY>
                <SW-DATA-DEF-PROPS>
                  <SW-DATA-DEF-PROPS-VARIANTS>
                    <SW-DATA-DEF-PROPS-CONDITIONAL>
                      <IMPLEMENTATION-DATA-TYPE-REF DEST="IMPLEMENTATION-DATA-TYPE">/AUTOSAR_Icu_17_TimerIp/ImplementationDataTypes/Icu_17_TimerIp_ChannelWakeupType</IMPLEMENTATION-DATA-TYPE-REF>
                    </SW-DATA-DEF-PROPS-CONDITIONAL>
                  </SW-DATA-DEF-PROPS-VARIANTS>
                </SW-DATA-DEF-PROPS>
              </IMPLEMENTATION-DATA-TYPE-ELEMENT>
[!ENDIF!][!//
              <IMPLEMENTATION-DATA-TYPE-ELEMENT>
                <SHORT-NAME>InterruptMode</SHORT-NAME>
                <CATEGORY>TYPE_REFERENCE</CATEGORY>
                <SW-DATA-DEF-PROPS>
                  <SW-DATA-DEF-PROPS-VARIANTS>
                    <SW-DATA-DEF-PROPS-CONDITIONAL>
                      <IMPLEMENTATION-DATA-TYPE-REF DEST="IMPLEMENTATION-DATA-TYPE">/AUTOSAR_Platform/ImplementationDataTypes/uint8</IMPLEMENTATION-DATA-TYPE-REF>
                    </SW-DATA-DEF-PROPS-CONDITIONAL>
                  </SW-DATA-DEF-PROPS-VARIANTS>
                </SW-DATA-DEF-PROPS>
              </IMPLEMENTATION-DATA-TYPE-ELEMENT>
              <IMPLEMENTATION-DATA-TYPE-ELEMENT>
                <SHORT-NAME>TimChannelClockSelect</SHORT-NAME>
                <CATEGORY>TYPE_REFERENCE</CATEGORY>
                <SW-DATA-DEF-PROPS>
                  <SW-DATA-DEF-PROPS-VARIANTS>
                    <SW-DATA-DEF-PROPS-CONDITIONAL>
                      <IMPLEMENTATION-DATA-TYPE-REF DEST="IMPLEMENTATION-DATA-TYPE">/AUTOSAR_Platform/ImplementationDataTypes/uint8</IMPLEMENTATION-DATA-TYPE-REF>
                    </SW-DATA-DEF-PROPS-CONDITIONAL>
                  </SW-DATA-DEF-PROPS-VARIANTS>
                </SW-DATA-DEF-PROPS>
              </IMPLEMENTATION-DATA-TYPE-ELEMENT>
              <IMPLEMENTATION-DATA-TYPE-ELEMENT>
                <SHORT-NAME>TimChannelGpr0InputSelect</SHORT-NAME>
                <CATEGORY>TYPE_REFERENCE</CATEGORY>
                <SW-DATA-DEF-PROPS>
                  <SW-DATA-DEF-PROPS-VARIANTS>
                    <SW-DATA-DEF-PROPS-CONDITIONAL>
                      <IMPLEMENTATION-DATA-TYPE-REF DEST="IMPLEMENTATION-DATA-TYPE">/AUTOSAR_Platform/ImplementationDataTypes/uint8</IMPLEMENTATION-DATA-TYPE-REF>
                    </SW-DATA-DEF-PROPS-CONDITIONAL>
                  </SW-DATA-DEF-PROPS-VARIANTS>
                </SW-DATA-DEF-PROPS>
              </IMPLEMENTATION-DATA-TYPE-ELEMENT>
              <IMPLEMENTATION-DATA-TYPE-ELEMENT>
                <SHORT-NAME>TimChannelFilterEnable</SHORT-NAME>
                <CATEGORY>TYPE_REFERENCE</CATEGORY>
                <SW-DATA-DEF-PROPS>
                  <SW-DATA-DEF-PROPS-VARIANTS>
                    <SW-DATA-DEF-PROPS-CONDITIONAL>
                      <IMPLEMENTATION-DATA-TYPE-REF DEST="IMPLEMENTATION-DATA-TYPE">/AUTOSAR_Platform/ImplementationDataTypes/uint8</IMPLEMENTATION-DATA-TYPE-REF>
                    </SW-DATA-DEF-PROPS-CONDITIONAL>
                  </SW-DATA-DEF-PROPS-VARIANTS>
                </SW-DATA-DEF-PROPS>
              </IMPLEMENTATION-DATA-TYPE-ELEMENT>
              <IMPLEMENTATION-DATA-TYPE-ELEMENT>
                <SHORT-NAME>TimChFilterCounterFreqSelect</SHORT-NAME>
                <CATEGORY>TYPE_REFERENCE</CATEGORY>
                <SW-DATA-DEF-PROPS>
                  <SW-DATA-DEF-PROPS-VARIANTS>
                    <SW-DATA-DEF-PROPS-CONDITIONAL>
                      <IMPLEMENTATION-DATA-TYPE-REF DEST="IMPLEMENTATION-DATA-TYPE">/AUTOSAR_Platform/ImplementationDataTypes/uint8</IMPLEMENTATION-DATA-TYPE-REF>
                    </SW-DATA-DEF-PROPS-CONDITIONAL>
                  </SW-DATA-DEF-PROPS-VARIANTS>
                </SW-DATA-DEF-PROPS>
              </IMPLEMENTATION-DATA-TYPE-ELEMENT>
              <IMPLEMENTATION-DATA-TYPE-ELEMENT>
                <SHORT-NAME>TimChFilterModeForRisingEdge</SHORT-NAME>
                <CATEGORY>TYPE_REFERENCE</CATEGORY>
                <SW-DATA-DEF-PROPS>
                  <SW-DATA-DEF-PROPS-VARIANTS>
                    <SW-DATA-DEF-PROPS-CONDITIONAL>
                      <IMPLEMENTATION-DATA-TYPE-REF DEST="IMPLEMENTATION-DATA-TYPE">/AUTOSAR_Platform/ImplementationDataTypes/uint8</IMPLEMENTATION-DATA-TYPE-REF>
                    </SW-DATA-DEF-PROPS-CONDITIONAL>
                  </SW-DATA-DEF-PROPS-VARIANTS>
                </SW-DATA-DEF-PROPS>
              </IMPLEMENTATION-DATA-TYPE-ELEMENT>
              <IMPLEMENTATION-DATA-TYPE-ELEMENT>
                <SHORT-NAME>ModeMappingIndex</SHORT-NAME>
                <CATEGORY>TYPE_REFERENCE</CATEGORY>
                <SW-DATA-DEF-PROPS>
                  <SW-DATA-DEF-PROPS-VARIANTS>
                    <SW-DATA-DEF-PROPS-CONDITIONAL>
                      <IMPLEMENTATION-DATA-TYPE-REF DEST="IMPLEMENTATION-DATA-TYPE">/AUTOSAR_Platform/ImplementationDataTypes/uint8</IMPLEMENTATION-DATA-TYPE-REF>
                    </SW-DATA-DEF-PROPS-CONDITIONAL>
                  </SW-DATA-DEF-PROPS-VARIANTS>
                </SW-DATA-DEF-PROPS>
              </IMPLEMENTATION-DATA-TYPE-ELEMENT>
              <IMPLEMENTATION-DATA-TYPE-ELEMENT>
                <SHORT-NAME>TimChFilterModeForFallingEdge</SHORT-NAME>
                <CATEGORY>TYPE_REFERENCE</CATEGORY>
                <SW-DATA-DEF-PROPS>
                  <SW-DATA-DEF-PROPS-VARIANTS>
                    <SW-DATA-DEF-PROPS-CONDITIONAL>
                      <IMPLEMENTATION-DATA-TYPE-REF DEST="IMPLEMENTATION-DATA-TYPE">/AUTOSAR_Platform/ImplementationDataTypes/uint8</IMPLEMENTATION-DATA-TYPE-REF>
                    </SW-DATA-DEF-PROPS-CONDITIONAL>
                  </SW-DATA-DEF-PROPS-VARIANTS>
                </SW-DATA-DEF-PROPS>
              </IMPLEMENTATION-DATA-TYPE-ELEMENT>
              <IMPLEMENTATION-DATA-TYPE-ELEMENT>
                <SHORT-NAME>OverflowISRThreshold</SHORT-NAME>
                <CATEGORY>TYPE_REFERENCE</CATEGORY>
                <SW-DATA-DEF-PROPS>
                  <SW-DATA-DEF-PROPS-VARIANTS>
                    <SW-DATA-DEF-PROPS-CONDITIONAL>
                      <IMPLEMENTATION-DATA-TYPE-REF DEST="IMPLEMENTATION-DATA-TYPE">/AUTOSAR_Platform/ImplementationDataTypes/uint32</IMPLEMENTATION-DATA-TYPE-REF>
                    </SW-DATA-DEF-PROPS-CONDITIONAL>
                  </SW-DATA-DEF-PROPS-VARIANTS>
                </SW-DATA-DEF-PROPS>
              </IMPLEMENTATION-DATA-TYPE-ELEMENT>
              <IMPLEMENTATION-DATA-TYPE-ELEMENT>
                <SHORT-NAME>TimChannelInputSelect</SHORT-NAME>
                <CATEGORY>TYPE_REFERENCE</CATEGORY>
                <SW-DATA-DEF-PROPS>
                  <SW-DATA-DEF-PROPS-VARIANTS>
                    <SW-DATA-DEF-PROPS-CONDITIONAL>
                      <IMPLEMENTATION-DATA-TYPE-REF DEST="IMPLEMENTATION-DATA-TYPE">/AUTOSAR_Platform/ImplementationDataTypes/uint8</IMPLEMENTATION-DATA-TYPE-REF>
                    </SW-DATA-DEF-PROPS-CONDITIONAL>
                  </SW-DATA-DEF-PROPS-VARIANTS>
                </SW-DATA-DEF-PROPS>
              </IMPLEMENTATION-DATA-TYPE-ELEMENT>
            </SUB-ELEMENTS>
            <TYPE-EMITTER>BSW</TYPE-EMITTER>
          </IMPLEMENTATION-DATA-TYPE>
          <IMPLEMENTATION-DATA-TYPE>
            <SHORT-NAME>Icu_17_TimerIp_CoreConfigType</SHORT-NAME>
            <CATEGORY>STRUCTURE</CATEGORY>
            <SUB-ELEMENTS>
              <IMPLEMENTATION-DATA-TYPE-ELEMENT>
                <SHORT-NAME>MaxChannelCore</SHORT-NAME>
                <CATEGORY>TYPE_REFERENCE</CATEGORY>
                <SW-DATA-DEF-PROPS>
                  <SW-DATA-DEF-PROPS-VARIANTS>
                    <SW-DATA-DEF-PROPS-CONDITIONAL>
                      <IMPLEMENTATION-DATA-TYPE-REF DEST="IMPLEMENTATION-DATA-TYPE">/AUTOSAR_Icu_17_TimerIp/ImplementationDataTypes/Icu_17_TimerIp_ChannelType</IMPLEMENTATION-DATA-TYPE-REF>
                    </SW-DATA-DEF-PROPS-CONDITIONAL>
                  </SW-DATA-DEF-PROPS-VARIANTS>
                </SW-DATA-DEF-PROPS>
              </IMPLEMENTATION-DATA-TYPE-ELEMENT>
              <IMPLEMENTATION-DATA-TYPE-ELEMENT>
                <SHORT-NAME>ChannelConfigPtr</SHORT-NAME>
                <CATEGORY>DATA_REFERENCE</CATEGORY>
                <SW-DATA-DEF-PROPS>
                  <SW-DATA-DEF-PROPS-VARIANTS>
                    <SW-DATA-DEF-PROPS-CONDITIONAL>
                      <SW-POINTER-TARGET-PROPS>
                        <TARGET-CATEGORY>TYPE_REFERENCE</TARGET-CATEGORY>
                        <SW-DATA-DEF-PROPS>
                          <SW-DATA-DEF-PROPS-VARIANTS>
                            <SW-DATA-DEF-PROPS-CONDITIONAL>
                              <IMPLEMENTATION-DATA-TYPE-REF DEST="IMPLEMENTATION-DATA-TYPE">/AUTOSAR_Icu_17_TimerIp/ImplementationDataTypes/Icu_17_TimerIp_ChannelConfigType</IMPLEMENTATION-DATA-TYPE-REF>
                            </SW-DATA-DEF-PROPS-CONDITIONAL>
                          </SW-DATA-DEF-PROPS-VARIANTS>
                        </SW-DATA-DEF-PROPS>
                      </SW-POINTER-TARGET-PROPS>
                    </SW-DATA-DEF-PROPS-CONDITIONAL>
                  </SW-DATA-DEF-PROPS-VARIANTS>
                </SW-DATA-DEF-PROPS>
              </IMPLEMENTATION-DATA-TYPE-ELEMENT>
              <IMPLEMENTATION-DATA-TYPE-ELEMENT>
                <SHORT-NAME>MaxDataChannelCore</SHORT-NAME>
                <CATEGORY>TYPE_REFERENCE</CATEGORY>
                <SW-DATA-DEF-PROPS>
                  <SW-DATA-DEF-PROPS-VARIANTS>
                    <SW-DATA-DEF-PROPS-CONDITIONAL>
                      <IMPLEMENTATION-DATA-TYPE-REF DEST="IMPLEMENTATION-DATA-TYPE">/AUTOSAR_Icu_17_TimerIp/ImplementationDataTypes/Icu_17_TimerIp_ChannelType</IMPLEMENTATION-DATA-TYPE-REF>
                    </SW-DATA-DEF-PROPS-CONDITIONAL>
                  </SW-DATA-DEF-PROPS-VARIANTS>
                </SW-DATA-DEF-PROPS>
              </IMPLEMENTATION-DATA-TYPE-ELEMENT>
            </SUB-ELEMENTS>
            <TYPE-EMITTER>BSW</TYPE-EMITTER>
          </IMPLEMENTATION-DATA-TYPE>
[!IF "$ReportWakeupSource = 'true'"!][!//
          <IMPLEMENTATION-DATA-TYPE>
            <SHORT-NAME>Icu_17_TimerIp_ChannelWakeupType</SHORT-NAME>
            <CATEGORY>STRUCTURE</CATEGORY>
            <SUB-ELEMENTS>
              <IMPLEMENTATION-DATA-TYPE-ELEMENT>
                <SHORT-NAME>EcuMWakeupInfo</SHORT-NAME>
                <CATEGORY>TYPE_REFERENCE</CATEGORY>
                <SW-DATA-DEF-PROPS>
                  <SW-DATA-DEF-PROPS-VARIANTS>
                    <SW-DATA-DEF-PROPS-CONDITIONAL>
                      <IMPLEMENTATION-DATA-TYPE-REF DEST="IMPLEMENTATION-DATA-TYPE">/AUTOSAR_EcuM/ImplementationDataTypes/EcuM_WakeupSourceType</IMPLEMENTATION-DATA-TYPE-REF>
                    </SW-DATA-DEF-PROPS-CONDITIONAL>
                  </SW-DATA-DEF-PROPS-VARIANTS>
                </SW-DATA-DEF-PROPS>
              </IMPLEMENTATION-DATA-TYPE-ELEMENT>
            </SUB-ELEMENTS>
            <TYPE-EMITTER>BSW</TYPE-EMITTER>
          </IMPLEMENTATION-DATA-TYPE>
[!ENDIF!][!//
        </ELEMENTS>
      </AR-PACKAGE>
      <AR-PACKAGE>
        <SHORT-NAME>CompuMethods</SHORT-NAME>
        <CATEGORY>STANDARD</CATEGORY>
        <ELEMENTS>
[!IF "$Icu_SetMode_Xpath = 'true'"!][!//
          <COMPU-METHOD>
            <SHORT-NAME>Icu_17_TimerIp_ModeType</SHORT-NAME>
            <CATEGORY>TEXTTABLE</CATEGORY>
            <COMPU-INTERNAL-TO-PHYS>
              <COMPU-SCALES>
                <COMPU-SCALE>
                  <LOWER-LIMIT INTERVAL-TYPE="CLOSED">0</LOWER-LIMIT>
                  <UPPER-LIMIT INTERVAL-TYPE="CLOSED">0</UPPER-LIMIT>
                  <COMPU-CONST>
                    <VT>ICU_17_TIMERIP_MODE_NORMAL</VT>
                  </COMPU-CONST>
                </COMPU-SCALE>
                <COMPU-SCALE>
                  <LOWER-LIMIT INTERVAL-TYPE="CLOSED">1</LOWER-LIMIT>
                  <UPPER-LIMIT INTERVAL-TYPE="CLOSED">1</UPPER-LIMIT>
                  <COMPU-CONST>
                    <VT>ICU_17_TIMERIP_MODE_SLEEP</VT>
                  </COMPU-CONST>
                </COMPU-SCALE>
              </COMPU-SCALES>
            </COMPU-INTERNAL-TO-PHYS>
          </COMPU-METHOD>
[!ENDIF!][!//
[!IF "$Icu_IncInterface_Xpath = 'true'"!][!//
          <COMPU-METHOD>
            <SHORT-NAME>Icu_17_TimerIp_EncCountDirType</SHORT-NAME>
            <CATEGORY>TEXTTABLE</CATEGORY>
            <COMPU-INTERNAL-TO-PHYS>
              <COMPU-SCALES>
                <COMPU-SCALE>
                  <LOWER-LIMIT INTERVAL-TYPE="CLOSED">0</LOWER-LIMIT>
                  <UPPER-LIMIT INTERVAL-TYPE="CLOSED">0</UPPER-LIMIT>
                  <COMPU-CONST>
                    <VT>ICU_17_TIMERIP_ENC_COUNT_UP</VT>
                  </COMPU-CONST>
                </COMPU-SCALE>
                <COMPU-SCALE>
                  <LOWER-LIMIT INTERVAL-TYPE="CLOSED">1</LOWER-LIMIT>
                  <UPPER-LIMIT INTERVAL-TYPE="CLOSED">1</UPPER-LIMIT>
                  <COMPU-CONST>
                    <VT>ICU_17_TIMERIP_ENC_COUNT_DOWN</VT>
                  </COMPU-CONST>
                </COMPU-SCALE>
              </COMPU-SCALES>
            </COMPU-INTERNAL-TO-PHYS>
          </COMPU-METHOD>
[!ENDIF!][!//
[!IF "$Icu_GetInputState_Xpath = 'true'"!][!//
          <COMPU-METHOD>
            <SHORT-NAME>Icu_17_TimerIp_InputStateType</SHORT-NAME>
            <CATEGORY>TEXTTABLE</CATEGORY>
            <COMPU-INTERNAL-TO-PHYS>
              <COMPU-SCALES>
                <COMPU-SCALE>
                  <LOWER-LIMIT INTERVAL-TYPE="CLOSED">0</LOWER-LIMIT>
                  <UPPER-LIMIT INTERVAL-TYPE="CLOSED">0</UPPER-LIMIT>
                  <COMPU-CONST>
                    <VT>ICU_17_TIMERIP_ACTIVE</VT>
                  </COMPU-CONST>
                </COMPU-SCALE>
                <COMPU-SCALE>
                  <LOWER-LIMIT INTERVAL-TYPE="CLOSED">1</LOWER-LIMIT>
                  <UPPER-LIMIT INTERVAL-TYPE="CLOSED">1</UPPER-LIMIT>
                  <COMPU-CONST>
                    <VT>ICU_17_TIMERIP_IDLE</VT>
                  </COMPU-CONST>
                </COMPU-SCALE>
              </COMPU-SCALES>
            </COMPU-INTERNAL-TO-PHYS>
          </COMPU-METHOD>
[!ENDIF!][!//
          <COMPU-METHOD>
            <SHORT-NAME>Icu_17_TimerIp_ActivationType</SHORT-NAME>
            <CATEGORY>TEXTTABLE</CATEGORY>
            <COMPU-INTERNAL-TO-PHYS>
              <COMPU-SCALES>
                <COMPU-SCALE>
                  <LOWER-LIMIT INTERVAL-TYPE="CLOSED">0</LOWER-LIMIT>
                  <UPPER-LIMIT INTERVAL-TYPE="CLOSED">0</UPPER-LIMIT>
                  <COMPU-CONST>
                    <VT>ICU_17_TIMERIP_RISING_EDGE</VT>
                  </COMPU-CONST>
                </COMPU-SCALE>
                <COMPU-SCALE>
                  <LOWER-LIMIT INTERVAL-TYPE="CLOSED">1</LOWER-LIMIT>
                  <UPPER-LIMIT INTERVAL-TYPE="CLOSED">1</UPPER-LIMIT>
                  <COMPU-CONST>
                    <VT>ICU_17_TIMERIP_FALLING_EDGE</VT>
                  </COMPU-CONST>
                </COMPU-SCALE>
                <COMPU-SCALE>
                  <LOWER-LIMIT INTERVAL-TYPE="CLOSED">2</LOWER-LIMIT>
                  <UPPER-LIMIT INTERVAL-TYPE="CLOSED">2</UPPER-LIMIT>
                  <COMPU-CONST>
                    <VT>ICU_17_TIMERIP_BOTH_EDGES</VT>
                  </COMPU-CONST>
                </COMPU-SCALE>
                <COMPU-SCALE>
                  <LOWER-LIMIT INTERVAL-TYPE="CLOSED">3</LOWER-LIMIT>
                  <UPPER-LIMIT INTERVAL-TYPE="CLOSED">3</UPPER-LIMIT>
                  <COMPU-CONST>
                    <VT>ICU_17_TIMERIP_NO_EDGE</VT>
                  </COMPU-CONST>
                </COMPU-SCALE>
              </COMPU-SCALES>
            </COMPU-INTERNAL-TO-PHYS>
          </COMPU-METHOD>
        </ELEMENTS>
      </AR-PACKAGE>
    </AR-PACKAGES>
  </AR-PACKAGE>
</AR-PACKAGES>
</AUTOSAR>
