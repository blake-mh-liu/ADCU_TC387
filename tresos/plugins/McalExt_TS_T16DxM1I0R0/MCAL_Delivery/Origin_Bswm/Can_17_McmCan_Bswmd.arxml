[part 1 of 2]
<?xml version="1.0" encoding="UTF-8"?>
[!/*<!--
/*******************************************************************************
**                                                                            **
** Copyright (C) Infineon Technologies (2023)                                 **
**                                                                            **
** All rights reserved.                                                       **
**                                                                            **
** This document contains proprietary information belonging to Infineon       **
** Technologies. Passing on and copying of this document, and communication   **
** of its contents is not permitted without prior written authorization.      **
**                                                                            **
********************************************************************************
**                                                                            **
**  FILENAME  : Can_17_McmCan_Bswmd.arxml                                     **
**                                                                            **
**  VERSION   : 25.0.0                                                        **
**                                                                            **
**  DATE      : 2023-05-18                                                    **
**                                                                            **
**  VARIANT   : Variant PB                                                    **
**                                                                            **
**  PLATFORM  : Infineon AURIX2G                                              **
**                                                                            **
**  AUTHOR    : DL-AUTOSAR-Engineering                                        **
**                                                                            **
**  VENDOR    : Infineon Technologies                                         **
**                                                                            **
**  TRACEABILITY : [cover parentID={E4FF14E8-5A83-4c20-BF38-1E18F8125D60}]    **
**                 [cover parentID={8E86D339-7319-415a-B465-628D3764FCC0}]    **
**                                                                            **
**  DESCRIPTION  : Basic Software Module Description for Can driver           **
**                                                                            **
**  [/cover]                                                                  **
**                                                                            **
**  SPECIFICATION(S) : Specification of Can Driver, AUTOSAR Release 4.2.2 and **
**                     4.4.0                                                  **
**                                                                            **
**  MAY BE CHANGED BY USER : no                                               **
**                                                                            **
*******************************************************************************/
-->*/!]
<!--
/*******************************************************************************
**                                                                            **
** Copyright (C) Infineon Technologies (2023)                                 **
**                                                                            **
** All rights reserved.                                                       **
**                                                                            **
** This document contains proprietary information belonging to Infineon       **
** Technologies. Passing on and copying of this document, and communication   **
** of its contents is not permitted without prior written authorization.      **
**                                                                            **
********************************************************************************
**                                                                            **
**  FILENAME  : Can_17_McmCan_Bswmd.arxml                                     **
**                                                                            **
**  VERSION   : 25.0.0                                                        **
**                                                                            **
**  DATE, TIME: [!"$date"!], [!"$time"!]          !!!IGNORE-LINE!!!           **
**                                                                            **
**  GENERATOR : Build [!"$buildnr"!]            !!!IGNORE-LINE!!!             **
**                                                                            **
**  VARIANT   : Variant PB                                                    **
**                                                                            **
**  PLATFORM  : Infineon AURIX2G                                              **
**                                                                            **
**  AUTHOR    : DL-AUTOSAR-Engineering                                        **
**                                                                            **
**  VENDOR    : Infineon Technologies                                         **
**                                                                            **
**  DESCRIPTION  : Basic Software Module Description for Can driver           **
**                                                                            **
**  SPECIFICATION(S) : Specification of Can Driver, AUTOSAR Release 4.2.2 and **
**                     4.4.0                                                  **
**                                                                            **
**  MAY BE CHANGED BY USER : no                                               **
**                                                                            **
*******************************************************************************/
-->
[!NOCODE!][!//
[!ENDNOCODE!][!//
[!NOCODE!][!//
  [!VAR "MinorVersion" = "text:split($moduleReleaseVer, '.')[position()-1 = 1]"!][!//
[!ENDNOCODE!][!//
[!IF "$MinorVersion = num:i(2)"!][!//
<AUTOSAR xmlns="http://autosar.org/schema/r4.0" xmlns:xsi="http://www.w3.org/2001/XMLSchema-instance" xsi:schemaLocation="http://autosar.org/schema/r4.0 AUTOSAR_4-2-2.xsd">
[!ELSE!][!//
<AUTOSAR xmlns="http://autosar.org/schema/r4.0" xmlns:xsi="http://www.w3.org/2001/XMLSchema-instance" xsi:schemaLocation="http://autosar.org/schema/r4.0 AUTOSAR_00046.xsd">
[!ENDIF!][!//
[!AUTOSPACING!][!//
[!NOCODE!][!//
  [!INCLUDE "Can_17_McmCan.m"!][!//
[!ENDNOCODE!][!//
[!/* Select MODULE-CONFIGURATION as context-node */!][!//
[!SELECT "as:modconf('Can')[1]/CanConfigSet"!][!//
[!VAR "MaxKernel" = "num:i(ecu:get('Can.MaxKernels'))"!][!//
[!VAR "MaxController" = "num:i(ecu:get('Can.MaxCtrlKer'))"!][!//
[!VAR "MaxCore" = "num:i(ecu:get('Mcu.NoOfCoreAvailable'))"!][!//
[!/* Can Activated controller identification and allocation */!][!//
[!CALL "CAN_CG_ControllerAllocation"!][!//
[!/* Bring in core specific configuration of the CAN controllers */!][!//
[!CALL "CAN_CG_GenerateModuleMap","Module" = "'CAN'"!][!//
[!VAR "BusOffInterruptStatus" = "num:i(0)"!][!//
[!VAR "RxInterruptStatus" = "num:i(0)"!][!//
[!VAR "TxInterruptStatus" = "num:i(0)"!][!//
[!VAR "BusOffPollingStatus" = "num:i(0)"!][!//
[!VAR "RxPollingStatus" = "num:i(0)"!][!//
[!VAR "TxPollingStatus" = "num:i(0)"!][!//
[!VAR "WUPollingStatus" = "num:i(0)"!][!//
[!VAR "FDNodesPresentVal" = "num:i(0)"!][!//
[!VAR "RxDedInterruptStatus" = "num:i(0)"!][!//
[!VAR "RxMixedPollingStatus" = "num:i(0)"!][!//
[!VAR "RxFifoInterruptStatus" = "num:i(0)"!][!//
[!VAR "TxMixedPollingStatus" = "num:i(0)"!][!//
[!LOOP "./CanHardwareObject/*"!][!//
  [!IF "CanObjectType = 'RECEIVE'"!][!//
    [!IF "node:ref(CanControllerRef)/CanRxProcessing = 'INTERRUPT'"!][!//
      [!IF "CanHwObjectCount = num:i(1)"!][!//
        [!VAR "RxDedInterruptStatus" = "num:i(1)"!][!//
      [!ELSE!][!//
        [!VAR "RxFifoInterruptStatus" = "num:i(1)"!][!//
      [!ENDIF!][!//
    [!ELSEIF "node:ref(CanControllerRef)/CanRxProcessing = 'MIXED'"!][!//
      [!IF "(CanHardwareObjectUsesPolling/*[1]) = 'false'"!][!//
        [!IF "CanHwObjectCount = num:i(1)"!][!//
          [!VAR "RxDedInterruptStatus" = "num:i(1)"!][!//
        [!ELSE!][!//
          [!VAR "RxFifoInterruptStatus" = "num:i(1)"!][!//
        [!ENDIF!][!//
      [!ELSEIF "(CanHardwareObjectUsesPolling/*[1]) = 'true'"!][!//
        [!VAR "RxMixedPollingStatus" = "num:i(1)"!][!//
      [!ENDIF!][!//
    [!ENDIF!][!//
  [!ELSEIF "CanObjectType = 'TRANSMIT'"!][!//
    [!IF "node:ref(CanControllerRef)/CanTxProcessing = 'MIXED'"!][!//
      [!IF "(CanHardwareObjectUsesPolling/*[1]) = 'true'"!][!//
        [!VAR "TxMixedPollingStatus" = "num:i(1)"!][!//
      [!ENDIF!][!//
    [!ENDIF!][!//
  [!ENDIF!][!//
[!ENDLOOP!][!//
[!LOOP "./CanController/*"!][!//
  [!IF "CanControllerActivation = 'true'"!][!//
    [!IF "CanBusoffProcessing = 'INTERRUPT'"!][!//
      [!VAR "BusOffInterruptStatus" = "num:i(1)"!][!//
    [!ELSE!][!//
      [!VAR "BusOffPollingStatus" = "num:i(1)"!][!//
    [!ENDIF!][!//
    [!IF "CanRxProcessing = 'INTERRUPT'"!][!//
      [!VAR "RxInterruptStatus" = "num:i(1)"!][!//
    [!ELSE!][!//
      [!VAR "RxPollingStatus" = "num:i(1)"!][!//
    [!ENDIF!][!//
    [!IF "CanTxProcessing = 'INTERRUPT' or CanTxProcessing = 'MIXED'"!][!//
      [!VAR "TxInterruptStatus" = "num:i(1)"!][!//
    [!ELSE!][!//
      [!VAR "TxPollingStatus" = "num:i(1)"!][!//
    [!ENDIF!][!//
    [!IF "CanWakeupProcessing   = 'POLLING'"!][!//
      [!VAR "WUPollingStatus" = "num:i(1)"!][!//
    [!ENDIF!][!//
  [!ENDIF!][!//
  [!VAR "BaudrateCfgCount" = "num:i(count(./CanControllerBaudrateConfig/*))"!][!//
  [!FOR "BaudrateIndx" = "1" TO "$BaudrateCfgCount"!][!//
    [!IF "(node:exists(CanControllerBaudrateConfig/*[position()=$BaudrateIndx]/CanControllerFdBaudrateConfig/*[1]))"!][!//
      [!/* Set Global switch for FD support */!][!//
      [!VAR "FDNodesPresentVal" = "num:i(1)"!][!//
    [!ENDIF!][!//
  [!ENDFOR!][!//
[!ENDLOOP!][!//
[!VAR "MultiTxPeriod" = "num:i(0)"!][!//
[!VAR "MultiRxPeriod" = "num:i(0)"!][!//
[!/* Maximum number of main function RW periods configured in a ConfigSet */!][!//
[!VAR "MultiperiodsVal" = "num:i(count(../CanGeneral/CanMainFunctionRWPeriods/*))"!][!//
[!IF "$MultiperiodsVal > 1"!][!//
  [!IF "$RxPollingStatus = num:i(1) or $RxMixedPollingStatus = num:i(1)"!][!//
    [!VAR "MultiRxPeriod" = "num:i(1)"!][!//
  [!ENDIF!][!//
[!ENDIF!][!//
[!VAR "MultiperiodsVal" = "num:i(count(../CanGeneral/CanMainFunctionRWPeriods/*))"!][!//
[!IF "$MultiperiodsVal > 1"!][!//
  [!IF "$TxPollingStatus = num:i(1) or $TxMixedPollingStatus = num:i(1)"!][!//
    [!VAR "MultiTxPeriod" = "num:i(1)"!][!//
  [!ENDIF!][!//
[!ENDIF!][!//
<AR-PACKAGES>
  <AR-PACKAGE>
    <SHORT-NAME>AUTOSAR_Can_17_McmCan</SHORT-NAME>
    <AR-PACKAGES>
      <AR-PACKAGE>
        <SHORT-NAME>BswModuleDescriptions</SHORT-NAME>
        <CATEGORY>STANDARD</CATEGORY>
        <ELEMENTS>
          <BSW-MODULE-DESCRIPTION>
            <SHORT-NAME>Can</SHORT-NAME>
            <LONG-NAME>
              <L-4 L="EN">CAN Driver</L-4>
            </LONG-NAME>
            <CATEGORY>BSW_MODULE</CATEGORY>
            <MODULE-ID>80</MODULE-ID>
            <PROVIDED-ENTRYS>
              <BSW-MODULE-ENTRY-REF-CONDITIONAL>
                <BSW-MODULE-ENTRY-REF DEST="BSW-MODULE-ENTRY">/AUTOSAR_Can_17_McmCan/BswModuleEntrys/Can_Init</BSW-MODULE-ENTRY-REF>
              </BSW-MODULE-ENTRY-REF-CONDITIONAL>
[!IF "node:exists(../CanGeneral/CanSetBaudrateApi/*[1]) = 'true'"!][!//
[!IF "$MinorVersion = num:i(2)"!][!//
              <BSW-MODULE-ENTRY-REF-CONDITIONAL>
                <BSW-MODULE-ENTRY-REF DEST="BSW-MODULE-ENTRY">/AUTOSAR_Can_17_McmCan/BswModuleEntrys/Can_CheckBaudrate</BSW-MODULE-ENTRY-REF>
              </BSW-MODULE-ENTRY-REF-CONDITIONAL>
[!ENDIF!][!//
              <BSW-MODULE-ENTRY-REF-CONDITIONAL>
                <BSW-MODULE-ENTRY-REF DEST="BSW-MODULE-ENTRY">/AUTOSAR_Can_17_McmCan/BswModuleEntrys/Can_SetBaudrate</BSW-MODULE-ENTRY-REF>
              </BSW-MODULE-ENTRY-REF-CONDITIONAL>
[!ENDIF!][!//
              <BSW-MODULE-ENTRY-REF-CONDITIONAL>
                <BSW-MODULE-ENTRY-REF DEST="BSW-MODULE-ENTRY">/AUTOSAR_Can_17_McmCan/BswModuleEntrys/Can_SetControllerMode</BSW-MODULE-ENTRY-REF>
              </BSW-MODULE-ENTRY-REF-CONDITIONAL>
              <BSW-MODULE-ENTRY-REF-CONDITIONAL>
                <BSW-MODULE-ENTRY-REF DEST="BSW-MODULE-ENTRY">/AUTOSAR_Can_17_McmCan/BswModuleEntrys/Can_DisableControllerInterrupts</BSW-MODULE-ENTRY-REF>
              </BSW-MODULE-ENTRY-REF-CONDITIONAL>
              <BSW-MODULE-ENTRY-REF-CONDITIONAL>
                <BSW-MODULE-ENTRY-REF DEST="BSW-MODULE-ENTRY">/AUTOSAR_Can_17_McmCan/BswModuleEntrys/Can_EnableControllerInterrupts</BSW-MODULE-ENTRY-REF>
              </BSW-MODULE-ENTRY-REF-CONDITIONAL>
              <BSW-MODULE-ENTRY-REF-CONDITIONAL>
                <BSW-MODULE-ENTRY-REF DEST="BSW-MODULE-ENTRY">/AUTOSAR_Can_17_McmCan/BswModuleEntrys/Can_Write</BSW-MODULE-ENTRY-REF>
              </BSW-MODULE-ENTRY-REF-CONDITIONAL>
[!IF "$MinorVersion = num:i(4)"!][!//
              <BSW-MODULE-ENTRY-REF-CONDITIONAL>
                <BSW-MODULE-ENTRY-REF DEST="BSW-MODULE-ENTRY">/AUTOSAR_Can_17_McmCan/BswModuleEntrys/Can_GetControllerErrorState</BSW-MODULE-ENTRY-REF>
              </BSW-MODULE-ENTRY-REF-CONDITIONAL>
              <BSW-MODULE-ENTRY-REF-CONDITIONAL>
                <BSW-MODULE-ENTRY-REF DEST="BSW-MODULE-ENTRY">/AUTOSAR_Can_17_McmCan/BswModuleEntrys/Can_GetControllerMode</BSW-MODULE-ENTRY-REF>
              </BSW-MODULE-ENTRY-REF-CONDITIONAL>
              <BSW-MODULE-ENTRY-REF-CONDITIONAL>
                <BSW-MODULE-ENTRY-REF DEST="BSW-MODULE-ENTRY">/AUTOSAR_Can_17_McmCan/BswModuleEntrys/Can_GetControllerRxErrorCounter</BSW-MODULE-ENTRY-REF>
              </BSW-MODULE-ENTRY-REF-CONDITIONAL>
              <BSW-MODULE-ENTRY-REF-CONDITIONAL>
                <BSW-MODULE-ENTRY-REF DEST="BSW-MODULE-ENTRY">/AUTOSAR_Can_17_McmCan/BswModuleEntrys/Can_GetControllerTxErrorCounter</BSW-MODULE-ENTRY-REF>
              </BSW-MODULE-ENTRY-REF-CONDITIONAL>
[!ENDIF!][!//
[!IF "$MultiTxPeriod = num:i(0)"!][!//
              <BSW-MODULE-ENTRY-REF-CONDITIONAL>
                <BSW-MODULE-ENTRY-REF DEST="BSW-MODULE-ENTRY">/AUTOSAR_Can_17_McmCan/BswModuleEntrys/Can_MainFunction_Write</BSW-MODULE-ENTRY-REF>
              </BSW-MODULE-ENTRY-REF-CONDITIONAL>
[!ELSE!][!//
[!FOR "HwObjindx" = "0" TO "$MultiperiodsVal - 1"!][!//
              <BSW-MODULE-ENTRY-REF-CONDITIONAL>
                <BSW-MODULE-ENTRY-REF DEST="BSW-MODULE-ENTRY">/AUTOSAR_Can_17_McmCan/BswModuleEntrys/Can_MainFunction_Write_[!"$HwObjindx"!]</BSW-MODULE-ENTRY-REF>
              </BSW-MODULE-ENTRY-REF-CONDITIONAL>
[!ENDFOR!][!//
[!ENDIF!][!//
[!IF "$RxPollingStatus = num:i(1)"!][!//
              <BSW-MODULE-ENTRY-REF-CONDITIONAL>
                <BSW-MODULE-ENTRY-REF DEST="BSW-MODULE-ENTRY">/AUTOSAR_Can_17_McmCan/BswModuleEntrys/Can_MainFunction_Mode</BSW-MODULE-ENTRY-REF>
              </BSW-MODULE-ENTRY-REF-CONDITIONAL>
[!ENDIF!][!//
[!IF "$MultiRxPeriod = num:i(0)"!][!//
              <BSW-MODULE-ENTRY-REF-CONDITIONAL>
                <BSW-MODULE-ENTRY-REF DEST="BSW-MODULE-ENTRY">/AUTOSAR_Can_17_McmCan/BswModuleEntrys/Can_MainFunction_Read</BSW-MODULE-ENTRY-REF>
              </BSW-MODULE-ENTRY-REF-CONDITIONAL>
[!ELSE!][!//
[!FOR "HwObjindx" = "0" TO "$MultiperiodsVal - 1"!][!//
              <BSW-MODULE-ENTRY-REF-CONDITIONAL>
                <BSW-MODULE-ENTRY-REF DEST="BSW-MODULE-ENTRY">/AUTOSAR_Can_17_McmCan/BswModuleEntrys/Can_MainFunction_Read_[!"$HwObjindx"!]</BSW-MODULE-ENTRY-REF>
              </BSW-MODULE-ENTRY-REF-CONDITIONAL>
[!ENDFOR!][!//
[!ENDIF!][!//

[!IF "$BusOffPollingStatus = num:i(1)"!][!//
              <BSW-MODULE-ENTRY-REF-CONDITIONAL>
                <BSW-MODULE-ENTRY-REF DEST="BSW-MODULE-ENTRY">/AUTOSAR_Can_17_McmCan/BswModuleEntrys/Can_MainFunction_BusOff</BSW-MODULE-ENTRY-REF>
              </BSW-MODULE-ENTRY-REF-CONDITIONAL>
[!ENDIF!][!//
[!IF "$WUPollingStatus = num:i(1)"!][!//
              <BSW-MODULE-ENTRY-REF-CONDITIONAL>
                <BSW-MODULE-ENTRY-REF DEST="BSW-MODULE-ENTRY">/AUTOSAR_Can_17_McmCan/BswModuleEntrys/Can_MainFunction_Wakeup</BSW-MODULE-ENTRY-REF>
              </BSW-MODULE-ENTRY-REF-CONDITIONAL>
[!ENDIF!][!//
[!IF "../CanGeneral/CanPublicIcomSupport = 'true'"!][!//
              <BSW-MODULE-ENTRY-REF-CONDITIONAL>
                <BSW-MODULE-ENTRY-REF DEST="BSW-MODULE-ENTRY">/AUTOSAR_Can_17_McmCan/BswModuleEntrys/Can_SetIcomConfiguration</BSW-MODULE-ENTRY-REF>
              </BSW-MODULE-ENTRY-REF-CONDITIONAL>
[!ENDIF!][!//
[!IF "../CanGeneral/CanDeInitApi = 'true'"!][!//
              <BSW-MODULE-ENTRY-REF-CONDITIONAL>
                <BSW-MODULE-ENTRY-REF DEST="BSW-MODULE-ENTRY">/AUTOSAR_Can_17_McmCan/BswModuleEntrys/Can_DeInit</BSW-MODULE-ENTRY-REF>
              </BSW-MODULE-ENTRY-REF-CONDITIONAL>
[!ENDIF!][!//
[!IF "../CanGeneral/CanVersionInfoApi = 'true'"!][!//
              <BSW-MODULE-ENTRY-REF-CONDITIONAL>
                <BSW-MODULE-ENTRY-REF DEST="BSW-MODULE-ENTRY">/AUTOSAR_Can_17_McmCan/BswModuleEntrys/Can_GetVersionInfo</BSW-MODULE-ENTRY-REF>
              </BSW-MODULE-ENTRY-REF-CONDITIONAL>
[!ENDIF!][!//
[!IF "$TxInterruptStatus = num:i(1)"!][!//
              <BSW-MODULE-ENTRY-REF-CONDITIONAL>
                <BSW-MODULE-ENTRY-REF DEST="BSW-MODULE-ENTRY">/AUTOSAR_Can_17_McmCan/BswModuleEntrys/Can_IsrTransmitHandler</BSW-MODULE-ENTRY-REF>
              </BSW-MODULE-ENTRY-REF-CONDITIONAL>
[!ENDIF!][!//
[!IF "$RxDedInterruptStatus = num:i(1)"!][!//
              <BSW-MODULE-ENTRY-REF-CONDITIONAL>
                <BSW-MODULE-ENTRY-REF DEST="BSW-MODULE-ENTRY">/AUTOSAR_Can_17_McmCan/BswModuleEntrys/Can_IsrReceiveHandler</BSW-MODULE-ENTRY-REF>
              </BSW-MODULE-ENTRY-REF-CONDITIONAL>
[!ENDIF!][!//
[!IF "$RxFifoInterruptStatus = num:i(1)"!][!//
              <BSW-MODULE-ENTRY-REF-CONDITIONAL>
                <BSW-MODULE-ENTRY-REF DEST="BSW-MODULE-ENTRY">/AUTOSAR_Can_17_McmCan/BswModuleEntrys/Can_IsrRxFIFOHandler</BSW-MODULE-ENTRY-REF>
              </BSW-MODULE-ENTRY-REF-CONDITIONAL>
[!ENDIF!][!//
[!IF "$BusOffInterruptStatus = num:i(1)"!][!//
              <BSW-MODULE-ENTRY-REF-CONDITIONAL>
                <BSW-MODULE-ENTRY-REF DEST="BSW-MODULE-ENTRY">/AUTOSAR_Can_17_McmCan/BswModuleEntrys/Can_IsrBusOffHandler</BSW-MODULE-ENTRY-REF>
              </BSW-MODULE-ENTRY-REF-CONDITIONAL>
[!ENDIF!][!//
            </PROVIDED-ENTRYS>
            <BSW-MODULE-DEPENDENCYS>
[!IF "(../CanGeneral/CanDevErrorDetect = 'true')"!][!//
              <BSW-MODULE-DEPENDENCY>
                <SHORT-NAME>DetDependency</SHORT-NAME>
                <TARGET-MODULE-ID>15</TARGET-MODULE-ID>
                <REQUIRED-ENTRYS>
                  <BSW-MODULE-ENTRY-REF-CONDITIONAL>
                    <BSW-MODULE-ENTRY-REF DEST="BSW-MODULE-ENTRY">/AUTOSAR_Det/BswModuleEntrys/Det_ReportError</BSW-MODULE-ENTRY-REF>
                  </BSW-MODULE-ENTRY-REF-CONDITIONAL>
                </REQUIRED-ENTRYS>
              </BSW-MODULE-DEPENDENCY>
[!ENDIF!][!//
[!IF "(../CanGeneral/CanRunTimeErrorDetect = 'true')"!][!//
              <BSW-MODULE-DEPENDENCY>
                <SHORT-NAME>McalWrapperDependency</SHORT-NAME>
                <TARGET-MODULE-ID>255</TARGET-MODULE-ID>
                <REQUIRED-ENTRYS>
                  <BSW-MODULE-ENTRY-REF-CONDITIONAL>
                    <BSW-MODULE-ENTRY-REF DEST="BSW-MODULE-ENTRY">/AUTOSAR_Stub/BswModuleEntrys/Mcal_Wrapper_Det_ReportRuntimeError</BSW-MODULE-ENTRY-REF>
                  </BSW-MODULE-ENTRY-REF-CONDITIONAL>
                </REQUIRED-ENTRYS>
              </BSW-MODULE-DEPENDENCY>
[!ENDIF!][!//
              <BSW-MODULE-DEPENDENCY>
                <SHORT-NAME>CanIfDependency</SHORT-NAME>
                <TARGET-MODULE-ID>60</TARGET-MODULE-ID>
                <REQUIRED-ENTRYS>
                  <BSW-MODULE-ENTRY-REF-CONDITIONAL>
                    <BSW-MODULE-ENTRY-REF DEST="BSW-MODULE-ENTRY">/AUTOSAR_CanIf/BswModuleEntrys/CanIf_RxIndication</BSW-MODULE-ENTRY-REF>
                  </BSW-MODULE-ENTRY-REF-CONDITIONAL>
                  <BSW-MODULE-ENTRY-REF-CONDITIONAL>
                    <BSW-MODULE-ENTRY-REF DEST="BSW-MODULE-ENTRY">/AUTOSAR_CanIf/BswModuleEntrys/CanIf_ControllerBusOff</BSW-MODULE-ENTRY-REF>
                  </BSW-MODULE-ENTRY-REF-CONDITIONAL>
                  <BSW-MODULE-ENTRY-REF-CONDITIONAL>
                    <BSW-MODULE-ENTRY-REF DEST="BSW-MODULE-ENTRY">/AUTOSAR_CanIf/BswModuleEntrys/CanIf_TxConfirmation</BSW-MODULE-ENTRY-REF>
                  </BSW-MODULE-ENTRY-REF-CONDITIONAL>
                  <BSW-MODULE-ENTRY-REF-CONDITIONAL>
                    <BSW-MODULE-ENTRY-REF DEST="BSW-MODULE-ENTRY">/AUTOSAR_CanIf/BswModuleEntrys/CanIf_CurrentIcomConfiguration</BSW-MODULE-ENTRY-REF>
                  </BSW-MODULE-ENTRY-REF-CONDITIONAL>
                  <BSW-MODULE-ENTRY-REF-CONDITIONAL>
                    <BSW-MODULE-ENTRY-REF DEST="BSW-MODULE-ENTRY">/AUTOSAR_CanIf/BswModuleEntrys/CanIf_ControllerModeIndication</BSW-MODULE-ENTRY-REF>
                  </BSW-MODULE-ENTRY-REF-CONDITIONAL>
[!VAR "TrigTransmit" = "num:i(0)"!][!//
[!VAR "CanHwObjectCount" = "num:i(count(./CanHardwareObject/*))"!][!//
[!FOR "HwObjIndx" = "1" TO "num:i($CanHwObjectCount)"!][!//
  [!IF "node:exists(./CanHardwareObject/*[position()=$HwObjIndx]/CanTriggerTransmitEnable/*[1]) = 'true'"!][!//
    [!IF "node:value(./CanHardwareObject/*[position()=$HwObjIndx]/CanTriggerTransmitEnable/*[1]) = 'true'"!][!//
      [!VAR "TrigTransmit" = "num:i(1)"!][!//
    [!ENDIF!][!//
  [!ENDIF!][!//
[!ENDFOR!][!//
[!IF "$TrigTransmit = num:i(1)"!][!//
                  <BSW-MODULE-ENTRY-REF-CONDITIONAL>
                    <BSW-MODULE-ENTRY-REF DEST="BSW-MODULE-ENTRY">/AUTOSAR_CanIf/BswModuleEntrys/CanIf_TriggerTransmit</BSW-MODULE-ENTRY-REF>
                  </BSW-MODULE-ENTRY-REF-CONDITIONAL>
[!ENDIF!][!//
                </REQUIRED-ENTRYS>
              </BSW-MODULE-DEPENDENCY>
              <BSW-MODULE-DEPENDENCY>
                <SHORT-NAME>McalLibDependency</SHORT-NAME>
                <TARGET-MODULE-ID>255</TARGET-MODULE-ID>
                <REQUIRED-ENTRYS>
                  <BSW-MODULE-ENTRY-REF-CONDITIONAL>
                    <BSW-MODULE-ENTRY-REF DEST="BSW-MODULE-ENTRY">/AURIX2G_McalLib/BswModuleEntrys/Mcal_GetCpuIndex</BSW-MODULE-ENTRY-REF>
                  </BSW-MODULE-ENTRY-REF-CONDITIONAL>
                  <BSW-MODULE-ENTRY-REF-CONDITIONAL>
                    <BSW-MODULE-ENTRY-REF DEST="BSW-MODULE-ENTRY">/AURIX2G_McalLib/BswModuleEntrys/Mcal_WritePeripEndInitProtReg</BSW-MODULE-ENTRY-REF>
                  </BSW-MODULE-ENTRY-REF-CONDITIONAL>
                  <BSW-MODULE-ENTRY-REF-CONDITIONAL>
                    <BSW-MODULE-ENTRY-REF DEST="BSW-MODULE-ENTRY">/AURIX2G_McalLib/BswModuleEntrys/Mcal_SetBitAtomic</BSW-MODULE-ENTRY-REF>
                  </BSW-MODULE-ENTRY-REF-CONDITIONAL>
                  <BSW-MODULE-ENTRY-REF-CONDITIONAL>
                    <BSW-MODULE-ENTRY-REF DEST="BSW-MODULE-ENTRY">/AURIX2G_McalLib/BswModuleEntrys/Mcal_DelayTickResolution</BSW-MODULE-ENTRY-REF>
                  </BSW-MODULE-ENTRY-REF-CONDITIONAL>
                  <BSW-MODULE-ENTRY-REF-CONDITIONAL>
                    <BSW-MODULE-ENTRY-REF DEST="BSW-MODULE-ENTRY">/AURIX2G_McalLib/BswModuleEntrys/Mcal_DelayGetTick</BSW-MODULE-ENTRY-REF>
                  </BSW-MODULE-ENTRY-REF-CONDITIONAL>
                </REQUIRED-ENTRYS>
              </BSW-MODULE-DEPENDENCY>
            </BSW-MODULE-DEPENDENCYS>
            <INTERNAL-BEHAVIORS>
              <BSW-INTERNAL-BEHAVIOR>
                <SHORT-NAME>CanBehavior</SHORT-NAME>
                <EXCLUSIVE-AREAS>
                  <EXCLUSIVE-AREA>
                    <SHORT-NAME>IcomMsgCntrVal</SHORT-NAME>
                    <INTRODUCTION>
                      <NOTE SI="User of CAN pretended networking functionality shall ensure that the critical section protection provided by CAN for protecting the ICOM message counter value is implemented by using suspend and resume of interrupts" NOTE-TYPE="HINT"/>
                    </INTRODUCTION>
                  </EXCLUSIVE-AREA>
                  <EXCLUSIVE-AREA>
                    <SHORT-NAME>CanWrMO</SHORT-NAME>
                    <INTRODUCTION>
                      <NOTE SI="User of CAN write operation shall ensure that the critical section protection provided by CAN for protecting the write operation sequence is implemented by using suspend and resume of interrupts" NOTE-TYPE="HINT"/>
                    </INTRODUCTION>
                  </EXCLUSIVE-AREA>
                </EXCLUSIVE-AREAS>
                <ENTITYS>

                [!IF "$MinorVersion = num:i(4)"!][!//
                  <BSW-CALLED-ENTITY>
                    <SHORT-NAME>Can_GetControllerErrorState</SHORT-NAME>
                    <REENTRANCY-LEVEL>MULTICORE-REENTRANT</REENTRANCY-LEVEL>
                    <IMPLEMENTED-ENTRY-REF DEST="BSW-MODULE-ENTRY">/AUTOSAR_Can_17_McmCan/BswModuleEntrys/Can_GetControllerErrorState</IMPLEMENTED-ENTRY-REF>
                  </BSW-CALLED-ENTITY>
                   <BSW-CALLED-ENTITY>
                    <SHORT-NAME>Can_GetControllerMode</SHORT-NAME>
                    <REENTRANCY-LEVEL>NON-REENTRANT</REENTRANCY-LEVEL>
                    <IMPLEMENTED-ENTRY-REF DEST="BSW-MODULE-ENTRY">/AUTOSAR_Can_17_McmCan/BswModuleEntrys/Can_GetControllerMode</IMPLEMENTED-ENTRY-REF>
                  </BSW-CALLED-ENTITY>
                  <BSW-CALLED-ENTITY>
                    <SHORT-NAME>Can_GetControllerRxErrorCounter</SHORT-NAME>
                    <REENTRANCY-LEVEL>MULTICORE-REENTRANT</REENTRANCY-LEVEL>
                    <IMPLEMENTED-ENTRY-REF DEST="BSW-MODULE-ENTRY">/AUTOSAR_Can_17_McmCan/BswModuleEntrys/Can_GetControllerRxErrorCounter</IMPLEMENTED-ENTRY-REF>
                  </BSW-CALLED-ENTITY>
                  <BSW-CALLED-ENTITY>
                    <SHORT-NAME>Can_GetControllerTxErrorCounter</SHORT-NAME>
                    <REENTRANCY-LEVEL>MULTICORE-REENTRANT</REENTRANCY-LEVEL>
                    <IMPLEMENTED-ENTRY-REF DEST="BSW-MODULE-ENTRY">/AUTOSAR_Can_17_McmCan/BswModuleEntrys/Can_GetControllerTxErrorCounter</IMPLEMENTED-ENTRY-REF>
                  </BSW-CALLED-ENTITY>
                [!ENDIF!][!//

                  <BSW-CALLED-ENTITY>
                    <SHORT-NAME>Can_Init</SHORT-NAME>
                    <REENTRANCY-LEVEL>NON-REENTRANT</REENTRANCY-LEVEL>
                    <IMPLEMENTED-ENTRY-REF DEST="BSW-MODULE-ENTRY">/AUTOSAR_Can_17_McmCan/BswModuleEntrys/Can_Init</IMPLEMENTED-ENTRY-REF>
                  </BSW-CALLED-ENTITY>
[!IF "node:exists(../CanGeneral/CanSetBaudrateApi/*[1]) = 'true'"!][!//
[!IF "$MinorVersion = num:i(2)"!][!//
                  <BSW-CALLED-ENTITY>
                    <SHORT-NAME>Can_CheckBaudrate</SHORT-NAME>
                    <REENTRANCY-LEVEL>MULTICORE-REENTRANT</REENTRANCY-LEVEL>
                    <IMPLEMENTED-ENTRY-REF DEST="BSW-MODULE-ENTRY">/AUTOSAR_Can_17_McmCan/BswModuleEntrys/Can_CheckBaudrate</IMPLEMENTED-ENTRY-REF>
                  </BSW-CALLED-ENTITY>
[!ENDIF!][!//
                  <BSW-CALLED-ENTITY>
                    <SHORT-NAME>Can_SetBaudrate</SHORT-NAME>
                    <REENTRANCY-LEVEL>MULTICORE-REENTRANT</REENTRANCY-LEVEL>
                    <IMPLEMENTED-ENTRY-REF DEST="BSW-MODULE-ENTRY">/AUTOSAR_Can_17_McmCan/BswModuleEntrys/Can_SetBaudrate</IMPLEMENTED-ENTRY-REF>
                  </BSW-CALLED-ENTITY>
[!ENDIF!][!//
                  <BSW-CALLED-ENTITY>
                    <SHORT-NAME>Can_DisableControllerInterrupts</SHORT-NAME>
                    <REENTRANCY-LEVEL>MULTICORE-REENTRANT</REENTRANCY-LEVEL>
                    <IMPLEMENTED-ENTRY-REF DEST="BSW-MODULE-ENTRY">/AUTOSAR_Can_17_McmCan/BswModuleEntrys/Can_DisableControllerInterrupts</IMPLEMENTED-ENTRY-REF>
                  </BSW-CALLED-ENTITY>
                  <BSW-CALLED-ENTITY>
                    <SHORT-NAME>Can_EnableControllerInterrupts</SHORT-NAME>
                    <REENTRANCY-LEVEL>MULTICORE-REENTRANT</REENTRANCY-LEVEL>
                    <IMPLEMENTED-ENTRY-REF DEST="BSW-MODULE-ENTRY">/AUTOSAR_Can_17_McmCan/BswModuleEntrys/Can_EnableControllerInterrupts</IMPLEMENTED-ENTRY-REF>
                  </BSW-CALLED-ENTITY>
                  <BSW-CALLED-ENTITY>
                    <SHORT-NAME>Can_Write</SHORT-NAME>
                    <CAN-ENTER-EXCLUSIVE-AREA-REFS>
                      <CAN-ENTER-EXCLUSIVE-AREA-REF DEST="EXCLUSIVE-AREA">/AUTOSAR_Can_17_McmCan/BswModuleDescriptions/Can/CanBehavior/CanWrMO</CAN-ENTER-EXCLUSIVE-AREA-REF>
                    </CAN-ENTER-EXCLUSIVE-AREA-REFS>
                    <REENTRANCY-LEVEL>MULTICORE-REENTRANT</REENTRANCY-LEVEL>
                    <RUNS-INSIDE-EXCLUSIVE-AREA-REFS>
                      <RUNS-INSIDE-EXCLUSIVE-AREA-REF DEST="EXCLUSIVE-AREA">/AUTOSAR_Can_17_McmCan/BswModuleDescriptions/Can/CanBehavior/CanWrMO</RUNS-INSIDE-EXCLUSIVE-AREA-REF>
                    </RUNS-INSIDE-EXCLUSIVE-AREA-REFS>
                    <IMPLEMENTED-ENTRY-REF DEST="BSW-MODULE-ENTRY">/AUTOSAR_Can_17_McmCan/BswModuleEntrys/Can_Write</IMPLEMENTED-ENTRY-REF>
                  </BSW-CALLED-ENTITY>
                  <BSW-CALLED-ENTITY>
                    <SHORT-NAME>Can_SetControllerMode</SHORT-NAME>
                    <REENTRANCY-LEVEL>NON-REENTRANT</REENTRANCY-LEVEL>
                    <IMPLEMENTED-ENTRY-REF DEST="BSW-MODULE-ENTRY">/AUTOSAR_Can_17_McmCan/BswModuleEntrys/Can_SetControllerMode</IMPLEMENTED-ENTRY-REF>
                  </BSW-CALLED-ENTITY>
[!IF "../CanGeneral/CanPublicIcomSupport = 'true'"!][!//
                  <BSW-CALLED-ENTITY>
                    <SHORT-NAME>Can_SetIcomConfiguration</SHORT-NAME>
                    <CAN-ENTER-EXCLUSIVE-AREA-REFS>
                      <CAN-ENTER-EXCLUSIVE-AREA-REF DEST="EXCLUSIVE-AREA">/AUTOSAR_Can_17_McmCan/BswModuleDescriptions/Can/CanBehavior/IcomMsgCntrVal</CAN-ENTER-EXCLUSIVE-AREA-REF>
                    </CAN-ENTER-EXCLUSIVE-AREA-REFS>
                    <REENTRANCY-LEVEL>MULTICORE-REENTRANT</REENTRANCY-LEVEL>
                    <IMPLEMENTED-ENTRY-REF DEST="BSW-MODULE-ENTRY">/AUTOSAR_Can_17_McmCan/BswModuleEntrys/Can_SetIcomConfiguration</IMPLEMENTED-ENTRY-REF>
                  </BSW-CALLED-ENTITY>
[!ENDIF!][!//

[!IF "../CanGeneral/CanDeInitApi = 'true'"!][!//
                  <BSW-CALLED-ENTITY>
                    <SHORT-NAME>Can_DeInit</SHORT-NAME>
                    <REENTRANCY-LEVEL>NON-REENTRANT</REENTRANCY-LEVEL>
                    <IMPLEMENTED-ENTRY-REF DEST="BSW-MODULE-ENTRY">/AUTOSAR_Can_17_McmCan/BswModuleEntrys/Can_DeInit</IMPLEMENTED-ENTRY-REF>
                  </BSW-CALLED-ENTITY>
[!ENDIF!][!//
[!IF "../CanGeneral/CanVersionInfoApi = 'true'"!][!//
                  <BSW-CALLED-ENTITY>
                    <SHORT-NAME>Can_GetVersionInfo</SHORT-NAME>
                    <REENTRANCY-LEVEL>MULTICORE-REENTRANT</REENTRANCY-LEVEL>
                    <IMPLEMENTED-ENTRY-REF DEST="BSW-MODULE-ENTRY">/AUTOSAR_Can_17_McmCan/BswModuleEntrys/Can_GetVersionInfo</IMPLEMENTED-ENTRY-REF>
                  </BSW-CALLED-ENTITY>
[!ENDIF!][!//
[!IF "../CanGeneral/CanLPduReceiveCalloutFunction = 'true'"!][!//
                  <BSW-CALLED-ENTITY>
                    <SHORT-NAME>Can_LpduCallout</SHORT-NAME>
                    <REENTRANCY-LEVEL>NON-REENTRANT</REENTRANCY-LEVEL>
                    <IMPLEMENTED-ENTRY-REF DEST="BSW-MODULE-ENTRY">/AUTOSAR_Can_17_McmCan/BswModuleEntrys/Can_LpduCallout</IMPLEMENTED-ENTRY-REF>
                  </BSW-CALLED-ENTITY>
[!ENDIF!][!//
[!IF "$MultiTxPeriod = num:i(0)"!][!//
                  <BSW-SCHEDULABLE-ENTITY>
                    <SHORT-NAME>Can_MainFunction_Write</SHORT-NAME>
                    <MINIMUM-START-INTERVAL>0.005</MINIMUM-START-INTERVAL>
                    <REENTRANCY-LEVEL>NON-REENTRANT</REENTRANCY-LEVEL>
                    <IMPLEMENTED-ENTRY-REF DEST="BSW-MODULE-ENTRY">/AUTOSAR_Can_17_McmCan/BswModuleEntrys/Can_MainFunction_Write</IMPLEMENTED-ENTRY-REF>
                  </BSW-SCHEDULABLE-ENTITY>
[!ELSE!][!//
[!FOR "HwObjindx" = "0" TO "$MultiperiodsVal - 1"!][!//
                  <BSW-SCHEDULABLE-ENTITY>
                    <SHORT-NAME>Can_MainFunction_Write_[!"$HwObjindx"!]</SHORT-NAME>
                    <MINIMUM-START-INTERVAL>0.005</MINIMUM-START-INTERVAL>
                    <REENTRANCY-LEVEL>NON-REENTRANT</REENTRANCY-LEVEL>
                    <IMPLEMENTED-ENTRY-REF DEST="BSW-MODULE-ENTRY">/AUTOSAR_Can_17_McmCan/BswModuleEntrys/Can_MainFunction_Write_[!"$HwObjindx"!]</IMPLEMENTED-ENTRY-REF>
                  </BSW-SCHEDULABLE-ENTITY>
[!ENDFOR!][!//
[!ENDIF!][!//
[!IF "$TxInterruptStatus = num:i(1)"!][!//
                  <BSW-INTERRUPT-ENTITY>
                    <SHORT-NAME>Can_IsrTransmitHandler</SHORT-NAME>
                    <REENTRANCY-LEVEL>MULTICORE-REENTRANT</REENTRANCY-LEVEL>
                    <IMPLEMENTED-ENTRY-REF DEST="BSW-MODULE-ENTRY">/AUTOSAR_Can_17_McmCan/BswModuleEntrys/Can_IsrTransmitHandler</IMPLEMENTED-ENTRY-REF>
                  </BSW-INTERRUPT-ENTITY>
[!ENDIF!][!//
[!IF "$RxDedInterruptStatus = num:i(1)"!][!//
                  <BSW-INTERRUPT-ENTITY>
                    <SHORT-NAME>Can_IsrReceiveHandler</SHORT-NAME>
                    <CAN-ENTER-EXCLUSIVE-AREA-REFS>
                      <CAN-ENTER-EXCLUSIVE-AREA-REF DEST="EXCLUSIVE-AREA">/AUTOSAR_Can_17_McmCan/BswModuleDescriptions/Can/CanBehavior/IcomMsgCntrVal</CAN-ENTER-EXCLUSIVE-AREA-REF>
                    </CAN-ENTER-EXCLUSIVE-AREA-REFS>
                    <REENTRANCY-LEVEL>MULTICORE-REENTRANT</REENTRANCY-LEVEL>
                    <IMPLEMENTED-ENTRY-REF DEST="BSW-MODULE-ENTRY">/AUTOSAR_Can_17_McmCan/BswModuleEntrys/Can_IsrReceiveHandler</IMPLEMENTED-ENTRY-REF>
                  </BSW-INTERRUPT-ENTITY>
[!ENDIF!][!//
[!IF "$RxFifoInterruptStatus = num:i(1)"!][!//
                  <BSW-INTERRUPT-ENTITY>
                    <SHORT-NAME>Can_IsrRxFIFOHandler</SHORT-NAME>
                    <CAN-ENTER-EXCLUSIVE-AREA-REFS>
                      <CAN-ENTER-EXCLUSIVE-AREA-REF DEST="EXCLUSIVE-AREA">/AUTOSAR_Can_17_McmCan/BswModuleDescriptions/Can/CanBehavior/IcomMsgCntrVal</CAN-ENTER-EXCLUSIVE-AREA-REF>
                    </CAN-ENTER-EXCLUSIVE-AREA-REFS>
                    <REENTRANCY-LEVEL>MULTICORE-REENTRANT</REENTRANCY-LEVEL>
                    <IMPLEMENTED-ENTRY-REF DEST="BSW-MODULE-ENTRY">/AUTOSAR_Can_17_McmCan/BswModuleEntrys/Can_IsrRxFIFOHandler</IMPLEMENTED-ENTRY-REF>
                  </BSW-INTERRUPT-ENTITY>
[!ENDIF!][!//
[!IF "$BusOffInterruptStatus = num:i(1)"!][!//
                  <BSW-INTERRUPT-ENTITY>
                    <SHORT-NAME>Can_IsrBusOffHandler</SHORT-NAME>
                    <REENTRANCY-LEVEL>MULTICORE-REENTRANT</REENTRANCY-LEVEL>
                    <IMPLEMENTED-ENTRY-REF DEST="BSW-MODULE-ENTRY">/AUTOSAR_Can_17_McmCan/BswModuleEntrys/Can_IsrBusOffHandler</IMPLEMENTED-ENTRY-REF>
                  </BSW-INTERRUPT-ENTITY>
[!ENDIF!][!//
[!IF "$MultiRxPeriod = num:i(0)"!][!//
                  <BSW-SCHEDULABLE-ENTITY>
                    <SHORT-NAME>Can_MainFunction_Read</SHORT-NAME>
                    <CAN-ENTER-EXCLUSIVE-AREA-REFS>
                      <CAN-ENTER-EXCLUSIVE-AREA-REF DEST="EXCLUSIVE-AREA">/AUTOSAR_Can_17_McmCan/BswModuleDescriptions/Can/CanBehavior/IcomMsgCntrVal</CAN-ENTER-EXCLUSIVE-AREA-REF>
                    </CAN-ENTER-EXCLUSIVE-AREA-REFS>
                    <MINIMUM-START-INTERVAL>0.005</MINIMUM-START-INTERVAL>
                    <REENTRANCY-LEVEL>NON-REENTRANT</REENTRANCY-LEVEL>
                    <IMPLEMENTED-ENTRY-REF DEST="BSW-MODULE-ENTRY">/AUTOSAR_Can_17_McmCan/BswModuleEntrys/Can_MainFunction_Read</IMPLEMENTED-ENTRY-REF>
                  </BSW-SCHEDULABLE-ENTITY>
[!ELSE!][!//
[!FOR "HwObjindx" = "0" TO "$MultiperiodsVal - 1"!][!//
                  <BSW-SCHEDULABLE-ENTITY>
                    <SHORT-NAME>Can_MainFunction_Read_[!"$HwObjindx"!]</SHORT-NAME>
                    <CAN-ENTER-EXCLUSIVE-AREA-REFS>
                      <CAN-ENTER-EXCLUSIVE-AREA-REF DEST="EXCLUSIVE-AREA">/AUTOSAR_Can_17_McmCan/BswModuleDescriptions/Can/CanBehavior/IcomMsgCntrVal</CAN-ENTER-EXCLUSIVE-AREA-REF>
                    </CAN-ENTER-EXCLUSIVE-AREA-REFS>
                    <MINIMUM-START-INTERVAL>0.005</MINIMUM-START-INTERVAL>
                    <REENTRANCY-LEVEL>NON-REENTRANT</REENTRANCY-LEVEL>
                    <IMPLEMENTED-ENTRY-REF DEST="BSW-MODULE-ENTRY">/AUTOSAR_Can_17_McmCan/BswModuleEntrys/Can_MainFunction_Read_[!"$HwObjindx"!]</IMPLEMENTED-ENTRY-REF>
                  </BSW-SCHEDULABLE-ENTITY>
[!ENDFOR!][!//
[!ENDIF!][!//
[!IF "$BusOffPollingStatus = num:i(1)"!][!//
                  <BSW-SCHEDULABLE-ENTITY>
                    <SHORT-NAME>Can_MainFunction_BusOff</SHORT-NAME>
                    <MINIMUM-START-INTERVAL>0.005</MINIMUM-START-INTERVAL>
                    <REENTRANCY-LEVEL>NON-REENTRANT</REENTRANCY-LEVEL>
                    <IMPLEMENTED-ENTRY-REF DEST="BSW-MODULE-ENTRY">/AUTOSAR_Can_17_McmCan/BswModuleEntrys/Can_MainFunction_BusOff</IMPLEMENTED-ENTRY-REF>
                  </BSW-SCHEDULABLE-ENTITY>
[!ENDIF!][!//
[!IF "$WUPollingStatus = num:i(1)"!][!//
                  <BSW-SCHEDULABLE-ENTITY>
                    <SHORT-NAME>Can_MainFunction_Wakeup</SHORT-NAME>
                    <CAN-ENTER-EXCLUSIVE-AREA-REFS>
                      <CAN-ENTER-EXCLUSIVE-AREA-REF DEST="EXCLUSIVE-AREA">/AUTOSAR_Can_17_McmCan/BswModuleDescriptions/Can/CanBehavior/IcomMsgCntrVal</CAN-ENTER-EXCLUSIVE-AREA-REF>
                    </CAN-ENTER-EXCLUSIVE-AREA-REFS>
                    <MINIMUM-START-INTERVAL>0.005</MINIMUM-START-INTERVAL>
                    <REENTRANCY-LEVEL>NON-REENTRANT</REENTRANCY-LEVEL>
                    <IMPLEMENTED-ENTRY-REF DEST="BSW-MODULE-ENTRY">/AUTOSAR_Can_17_McmCan/BswModuleEntrys/Can_MainFunction_Wakeup</IMPLEMENTED-ENTRY-REF>
                  </BSW-SCHEDULABLE-ENTITY>
[!ENDIF!][!//
[!IF "$RxPollingStatus = num:i(1)"!][!//
                  <BSW-SCHEDULABLE-ENTITY>
                    <SHORT-NAME>Can_MainFunction_Mode</SHORT-NAME>
                    <MINIMUM-START-INTERVAL>0.005</MINIMUM-START-INTERVAL>
                    <REENTRANCY-LEVEL>NON-REENTRANT</REENTRANCY-LEVEL>
                    <IMPLEMENTED-ENTRY-REF DEST="BSW-MODULE-ENTRY">/AUTOSAR_Can_17_McmCan/BswModuleEntrys/Can_MainFunction_Mode</IMPLEMENTED-ENTRY-REF>
                  </BSW-SCHEDULABLE-ENTITY>
[!ENDIF!][!//
                </ENTITYS>
                <EVENTS>
[!IF "$RxPollingStatus = num:i(1)"!][!//
                  <BSW-TIMING-EVENT>
                    <SHORT-NAME>TimingEvent_Can_17_McmCan_MainFunction_Mode</SHORT-NAME>
                    <STARTS-ON-EVENT-REF DEST="BSW-SCHEDULABLE-ENTITY">/AUTOSAR_Can_17_McmCan/BswModuleDescriptions/Can/CanBehavior/Can_MainFunction_Mode</STARTS-ON-EVENT-REF>
                    <PERIOD>[!"node:value(../CanGeneral/CanMainFunctionModePeriod)"!]</PERIOD>
                  </BSW-TIMING-EVENT>
[!ENDIF!][!//
[!IF "$BusOffPollingStatus = num:i(1)"!][!//
                  <BSW-TIMING-EVENT>
                    <SHORT-NAME>TimingEvent_Can_17_McmCan_MainFunction_BusOff</SHORT-NAME>
                    <STARTS-ON-EVENT-REF DEST="BSW-SCHEDULABLE-ENTITY">/AUTOSAR_Can_17_McmCan/BswModuleDescriptions/Can/CanBehavior/Can_MainFunction_BusOff</STARTS-ON-EVENT-REF>
                    <PERIOD>[!IF "node:exists(../CanGeneral/CanMainFunctionBusoffPeriod/*[1])"!][!"node:value(../CanGeneral/CanMainFunctionBusoffPeriod/*[1])"!][!ELSE!]0.005[!ENDIF!]</PERIOD>
                  </BSW-TIMING-EVENT>
[!ENDIF!][!//
[!IF "$WUPollingStatus = num:i(1)"!][!//
                  <BSW-TIMING-EVENT>
                    <SHORT-NAME>TimingEvent_Can_17_McmCan_MainFunction_Wakeup</SHORT-NAME>
                    <STARTS-ON-EVENT-REF DEST="BSW-SCHEDULABLE-ENTITY">/AUTOSAR_Can_17_McmCan/BswModuleDescriptions/Can/CanBehavior/Can_MainFunction_Wakeup</STARTS-ON-EVENT-REF>
                    <PERIOD>[!IF "node:exists(../CanGeneral/CanMainFunctionWakeupPeriod/*[1])"!][!"node:value(../CanGeneral/CanMainFunctionWakeupPeriod/*[1])"!][!ELSE!]0.005[!ENDIF!]</PERIOD>
                  </BSW-TIMING-EVENT>
[!ENDIF!][!//
[!IF "$MultiRxPeriod = num:i(0)"!][!//
                  <BSW-TIMING-EVENT>
                    <SHORT-NAME>TimingEvent_Can_17_McmCan_MainFunction_Read</SHORT-NAME>
                    <STARTS-ON-EVENT-REF DEST="BSW-SCHEDULABLE-ENTITY">/AUTOSAR_Can_17_McmCan/BswModuleDescriptions/Can/CanBehavior/Can_MainFunction_Read</STARTS-ON-EVENT-REF>
                    <PERIOD>[!IF "node:exists(../CanGeneral/CanMainFunctionRWPeriods/*[1])"!][!"node:value(../CanGeneral/CanMainFunctionRWPeriods/*[1]/CanMainFunctionPeriod)"!][!ELSE!]0.005[!ENDIF!]</PERIOD>
                  </BSW-TIMING-EVENT>
[!ELSE!][!//
[!FOR "HwObjindx" = "0" TO "$MultiperiodsVal - 1"!][!//
                  <BSW-TIMING-EVENT>
                    <SHORT-NAME>TimingEvent_Can_17_McmCan_MainFunction_Read_[!"$HwObjindx"!]</SHORT-NAME>
                    <STARTS-ON-EVENT-REF DEST="BSW-SCHEDULABLE-ENTITY">/AUTOSAR_Can_17_McmCan/BswModuleDescriptions/Can/CanBehavior/Can_MainFunction_Read_[!"$HwObjindx"!]</STARTS-ON-EVENT-REF>
                    <PERIOD>[!"node:value(../CanGeneral/CanMainFunctionRWPeriods/*[position()=$HwObjindx + num:i(1)]/CanMainFunctionPeriod)"!]</PERIOD>
                  </BSW-TIMING-EVENT>
[!ENDFOR!][!//
[!ENDIF!][!//
[!IF "$MultiTxPeriod = num:i(0)"!][!//
                  <BSW-TIMING-EVENT>
                    <SHORT-NAME>TimingEvent_Can_17_McmCan_MainFunction_Write</SHORT-NAME>
                    <STARTS-ON-EVENT-REF DEST="BSW-SCHEDULABLE-ENTITY">/AUTOSAR_Can_17_McmCan/BswModuleDescriptions/Can/CanBehavior/Can_MainFunction_Write</STARTS-ON-EVENT-REF>
                    <PERIOD>[!IF "node:exists(../CanGeneral/CanMainFunctionRWPeriods/*[1])"!][!"node:value(../CanGeneral/CanMainFunctionRWPeriods/*[1]/CanMainFunctionPeriod)"!][!ELSE!]0.005[!ENDIF!]</PERIOD>
                  </BSW-TIMING-EVENT>
[!ELSE!][!//
[!FOR "HwObjindx" = "0" TO "$MultiperiodsVal - 1"!][!//
                  <BSW-TIMING-EVENT>
                    <SHORT-NAME>TimingEvent_Can_17_McmCan_MainFunction_Write_[!"$HwObjindx"!]</SHORT-NAME>
                    <STARTS-ON-EVENT-REF DEST="BSW-SCHEDULABLE-ENTITY">/AUTOSAR_Can_17_McmCan/BswModuleDescriptions/Can/CanBehavior/Can_MainFunction_Write_[!"$HwObjindx"!]</STARTS-ON-EVENT-REF>
                    <PERIOD>[!"node:value(../CanGeneral/CanMainFunctionRWPeriods/*[position()=$HwObjindx + num:i(1)]/CanMainFunctionPeriod)"!]</PERIOD>
                  </BSW-TIMING-EVENT>
[!ENDFOR!][!//
[!ENDIF!][!//
                </EVENTS>
              </BSW-INTERNAL-BEHAVIOR>
            </INTERNAL-BEHAVIORS>
          </BSW-MODULE-DESCRIPTION>
        </ELEMENTS>
      </AR-PACKAGE>
      <AR-PACKAGE>
        <SHORT-NAME>BswModuleEntrys</SHORT-NAME>
        <CATEGORY>STANDARD</CATEGORY>
        <ELEMENTS>
          <BSW-MODULE-ENTRY>
            <SHORT-NAME>Can_Init</SHORT-NAME>
            <SERVICE-ID>0</SERVICE-ID>
            <IS-REENTRANT>false</IS-REENTRANT>
            <IS-SYNCHRONOUS>true</IS-SYNCHRONOUS>
            <CALL-TYPE>REGULAR</CALL-TYPE>
            <EXECUTION-CONTEXT>TASK</EXECUTION-CONTEXT>
            <SW-SERVICE-IMPL-POLICY>STANDARD</SW-SERVICE-IMPL-POLICY>
            <ARGUMENTS>
              <SW-SERVICE-ARG>
                <SHORT-NAME>Config</SHORT-NAME>
                <CATEGORY>DATA_REFERENCE</CATEGORY>
                <SW-DATA-DEF-PROPS>
                  <SW-DATA-DEF-PROPS-VARIANTS>
                    <SW-DATA-DEF-PROPS-CONDITIONAL>
                      <SW-POINTER-TARGET-PROPS>
                        <TARGET-CATEGORY>TYPE_REFERENCE</TARGET-CATEGORY>
                        <SW-DATA-DEF-PROPS>
                          <SW-DATA-DEF-PROPS-VARIANTS>
                            <SW-DATA-DEF-PROPS-CONDITIONAL>
                              <IMPLEMENTATION-DATA-TYPE-REF DEST="IMPLEMENTATION-DATA-TYPE">/AUTOSAR_Can_17_McmCan/ImplementationDataTypes/Can_17_McmCan_ConfigType</IMPLEMENTATION-DATA-TYPE-REF>
                            </SW-DATA-DEF-PROPS-CONDITIONAL>
                          </SW-DATA-DEF-PROPS-VARIANTS>
                        </SW-DATA-DEF-PROPS>
                      </SW-POINTER-TARGET-PROPS>
                    </SW-DATA-DEF-PROPS-CONDITIONAL>
                  </SW-DATA-DEF-PROPS-VARIANTS>
                </SW-DATA-DEF-PROPS>
              </SW-SERVICE-ARG>
            </ARGUMENTS>
          </BSW-MODULE-ENTRY>
          <BSW-MODULE-ENTRY>
            <SHORT-NAME>Can_SetControllerMode</SHORT-NAME>
            <SERVICE-ID>3</SERVICE-ID>
            <IS-REENTRANT>false</IS-REENTRANT>
            <IS-SYNCHRONOUS>true</IS-SYNCHRONOUS>
            <CALL-TYPE>REGULAR</CALL-TYPE>
            <EXECUTION-CONTEXT>TASK</EXECUTION-CONTEXT>
            <SW-SERVICE-IMPL-POLICY>STANDARD</SW-SERVICE-IMPL-POLICY>
            <RETURN-TYPE>
              <SHORT-NAME>Return</SHORT-NAME>
              <CATEGORY>TYPE_REFERENCE</CATEGORY>
              <SW-DATA-DEF-PROPS>
                <SW-DATA-DEF-PROPS-VARIANTS>
                  <SW-DATA-DEF-PROPS-CONDITIONAL>
                    [!IF "$MinorVersion = num:i(2)"!][!//
                    <IMPLEMENTATION-DATA-TYPE-REF DEST="IMPLEMENTATION-DATA-TYPE">/AUTOSAR_Can_GeneralTypes/ImplementationDataTypes/Can_ReturnType</IMPLEMENTATION-DATA-TYPE-REF>
                    [!ELSE!][!//
                    <IMPLEMENTATION-DATA-TYPE-REF DEST="IMPLEMENTATION-DATA-TYPE">/AUTOSAR_Std/ImplementationDataTypes/Std_ReturnType</IMPLEMENTATION-DATA-TYPE-REF>
                    [!ENDIF!][!//
                  </SW-DATA-DEF-PROPS-CONDITIONAL>
                </SW-DATA-DEF-PROPS-VARIANTS>
              </SW-DATA-DEF-PROPS>
            </RETURN-TYPE>
            <ARGUMENTS>
              <SW-SERVICE-ARG>
                <SHORT-NAME>Controller</SHORT-NAME>
                <CATEGORY>TYPE_REFERENCE</CATEGORY>
                <SW-DATA-DEF-PROPS>
                  <SW-DATA-DEF-PROPS-VARIANTS>
                    <SW-DATA-DEF-PROPS-CONDITIONAL>
                      <IMPLEMENTATION-DATA-TYPE-REF DEST="IMPLEMENTATION-DATA-TYPE">/AUTOSAR_Platform/ImplementationDataTypes/uint8</IMPLEMENTATION-DATA-TYPE-REF>
                    </SW-DATA-DEF-PROPS-CONDITIONAL>
                  </SW-DATA-DEF-PROPS-VARIANTS>
                </SW-DATA-DEF-PROPS>
              </SW-SERVICE-ARG>
              <SW-SERVICE-ARG>
                <SHORT-NAME>Transition</SHORT-NAME>
                <CATEGORY>TYPE_REFERENCE</CATEGORY>
                <SW-DATA-DEF-PROPS>
                  <SW-DATA-DEF-PROPS-VARIANTS>
                    <SW-DATA-DEF-PROPS-CONDITIONAL>
                      [!IF "$MinorVersion = num:i(2)"!][!//
                      <IMPLEMENTATION-DATA-TYPE-REF DEST="IMPLEMENTATION-DATA-TYPE">/AUTOSAR_Can_GeneralTypes/ImplementationDataTypes/Can_StateTransitionType</IMPLEMENTATION-DATA-TYPE-REF>
                      [!ELSE!][!//
                      <IMPLEMENTATION-DATA-TYPE-REF DEST="IMPLEMENTATION-DATA-TYPE">/AUTOSAR_Can_GeneralTypes/ImplementationDataTypes/Can_ControllerStateType</IMPLEMENTATION-DATA-TYPE-REF>
                      [!ENDIF!][!//
                    </SW-DATA-DEF-PROPS-CONDITIONAL>
                  </SW-DATA-DEF-PROPS-VARIANTS>
                </SW-DATA-DEF-PROPS>
              </SW-SERVICE-ARG>
            </ARGUMENTS>
          </BSW-MODULE-ENTRY>
          <BSW-MODULE-ENTRY>
            <SHORT-NAME>Can_DisableControllerInterrupts</SHORT-NAME>
            <INTRODUCTION>
              <NOTE SI="Can_DisableControllerInterrupts is Reentrant for different controllers." NOTE-TYPE="HINT" />
            </INTRODUCTION>
            <SERVICE-ID>4</SERVICE-ID>
            <IS-REENTRANT>true</IS-REENTRANT>
            <IS-SYNCHRONOUS>true</IS-SYNCHRONOUS>
            <CALL-TYPE>REGULAR</CALL-TYPE>
            <EXECUTION-CONTEXT>TASK</EXECUTION-CONTEXT>
            <SW-SERVICE-IMPL-POLICY>STANDARD</SW-SERVICE-IMPL-POLICY>
            <ARGUMENTS>
              <SW-SERVICE-ARG>
                <SHORT-NAME>Controller</SHORT-NAME>
                <CATEGORY>TYPE_REFERENCE</CATEGORY>
                <SW-DATA-DEF-PROPS>
                  <SW-DATA-DEF-PROPS-VARIANTS>
                    <SW-DATA-DEF-PROPS-CONDITIONAL>
                      <IMPLEMENTATION-DATA-TYPE-REF DEST="IMPLEMENTATION-DATA-TYPE">/AUTOSAR_Platform/ImplementationDataTypes/uint8</IMPLEMENTATION-DATA-TYPE-REF>
                    </SW-DATA-DEF-PROPS-CONDITIONAL>
                  </SW-DATA-DEF-PROPS-VARIANTS>
                </SW-DATA-DEF-PROPS>
              </SW-SERVICE-ARG>
            </ARGUMENTS>
          </BSW-MODULE-ENTRY>
          <BSW-MODULE-ENTRY>
            <SHORT-NAME>Can_EnableControllerInterrupts</SHORT-NAME>
            <INTRODUCTION>
              <NOTE SI="Can_EnableControllerInterrupts is Reentrant for different controllers." NOTE-TYPE="HINT" />
            </INTRODUCTION>
            <SERVICE-ID>5</SERVICE-ID>
            <IS-REENTRANT>true</IS-REENTRANT>
            <IS-SYNCHRONOUS>true</IS-SYNCHRONOUS>
            <CALL-TYPE>REGULAR</CALL-TYPE>
            <EXECUTION-CONTEXT>TASK</EXECUTION-CONTEXT>
            <SW-SERVICE-IMPL-POLICY>STANDARD</SW-SERVICE-IMPL-POLICY>
            <ARGUMENTS>
              <SW-SERVICE-ARG>
                <SHORT-NAME>Controller</SHORT-NAME>
                <CATEGORY>TYPE_REFERENCE</CATEGORY>
                <SW-DATA-DEF-PROPS>
                  <SW-DATA-DEF-PROPS-VARIANTS>
                    <SW-DATA-DEF-PROPS-CONDITIONAL>
                      <IMPLEMENTATION-DATA-TYPE-REF DEST="IMPLEMENTATION-DATA-TYPE">/AUTOSAR_Platform/ImplementationDataTypes/uint8</IMPLEMENTATION-DATA-TYPE-REF>
                    </SW-DATA-DEF-PROPS-CONDITIONAL>
                  </SW-DATA-DEF-PROPS-VARIANTS>
                </SW-DATA-DEF-PROPS>
              </SW-SERVICE-ARG>
            </ARGUMENTS>
          </BSW-MODULE-ENTRY>
[!IF "node:exists(../CanGeneral/CanSetBaudrateApi/*[1]) = 'true'"!][!//
[!IF "$MinorVersion = num:i(2)"!][!//
          <BSW-MODULE-ENTRY>
            <SHORT-NAME>Can_CheckBaudrate</SHORT-NAME>
            <INTRODUCTION>
              <NOTE SI="Can_SetBaudrate is Reentrant for different controllers." NOTE-TYPE="HINT" />
            </INTRODUCTION>
            <SERVICE-ID>14</SERVICE-ID>
            <IS-REENTRANT>true</IS-REENTRANT>
            <IS-SYNCHRONOUS>true</IS-SYNCHRONOUS>
            <CALL-TYPE>REGULAR</CALL-TYPE>
            <EXECUTION-CONTEXT>TASK</EXECUTION-CONTEXT>
            <SW-SERVICE-IMPL-POLICY>STANDARD</SW-SERVICE-IMPL-POLICY>
            <ARGUMENTS>
              <SW-SERVICE-ARG>
                <SHORT-NAME>Controller</SHORT-NAME>
                <CATEGORY>TYPE_REFERENCE</CATEGORY>
                <SW-DATA-DEF-PROPS>
                  <SW-DATA-DEF-PROPS-VARIANTS>
                    <SW-DATA-DEF-PROPS-CONDITIONAL>
                      <IMPLEMENTATION-DATA-TYPE-REF DEST="IMPLEMENTATION-DATA-TYPE">/AUTOSAR_Platform/ImplementationDataTypes/uint8</IMPLEMENTATION-DATA-TYPE-REF>
                    </SW-DATA-DEF-PROPS-CONDITIONAL>
                  </SW-DATA-DEF-PROPS-VARIANTS>
                </SW-DATA-DEF-PROPS>
              </SW-SERVICE-ARG>
              <SW-SERVICE-ARG>
                <SHORT-NAME>Baudrate</SHORT-NAME>
                <CATEGORY>TYPE_REFERENCE</CATEGORY>
                <SW-DATA-DEF-PROPS>
                  <SW-DATA-DEF-PROPS-VARIANTS>
                    <SW-DATA-DEF-PROPS-CONDITIONAL>
                      <IMPLEMENTATION-DATA-TYPE-REF DEST="IMPLEMENTATION-DATA-TYPE">/AUTOSAR_Platform/ImplementationDataTypes/uint16</IMPLEMENTATION-DATA-TYPE-REF>
                    </SW-DATA-DEF-PROPS-CONDITIONAL>
                  </SW-DATA-DEF-PROPS-VARIANTS>
                </SW-DATA-DEF-PROPS>
              </SW-SERVICE-ARG>
            </ARGUMENTS>
          </BSW-MODULE-ENTRY>
[!ENDIF!][!//
          <BSW-MODULE-ENTRY>
            <SHORT-NAME>Can_SetBaudrate</SHORT-NAME>
            <INTRODUCTION>
              <NOTE SI="Can_SetBaudrate is Reentrant for different controllers." NOTE-TYPE="HINT" />
            </INTRODUCTION>
            <SERVICE-ID>15</SERVICE-ID>
            <IS-REENTRANT>true</IS-REENTRANT>
            <IS-SYNCHRONOUS>true</IS-SYNCHRONOUS>
            <CALL-TYPE>REGULAR</CALL-TYPE>
            <EXECUTION-CONTEXT>TASK</EXECUTION-CONTEXT>
            <SW-SERVICE-IMPL-POLICY>STANDARD</SW-SERVICE-IMPL-POLICY>
            <ARGUMENTS>
              <SW-SERVICE-ARG>
                <SHORT-NAME>Controller</SHORT-NAME>
                <CATEGORY>TYPE_REFERENCE</CATEGORY>
                <SW-DATA-DEF-PROPS>
                  <SW-DATA-DEF-PROPS-VARIANTS>
                    <SW-DATA-DEF-PROPS-CONDITIONAL>
                      <IMPLEMENTATION-DATA-TYPE-REF DEST="IMPLEMENTATION-DATA-TYPE">/AUTOSAR_Platform/ImplementationDataTypes/uint8</IMPLEMENTATION-DATA-TYPE-REF>
                    </SW-DATA-DEF-PROPS-CONDITIONAL>
                  </SW-DATA-DEF-PROPS-VARIANTS>
                </SW-DATA-DEF-PROPS>
              </SW-SERVICE-ARG>
              <SW-SERVICE-ARG>
                <SHORT-NAME>BaudRateConfigID</SHORT-NAME>
                <CATEGORY>TYPE_REFERENCE</CATEGORY>
                <SW-DATA-DEF-PROPS>
                  <SW-DATA-DEF-PROPS-VARIANTS>
                    <SW-DATA-DEF-PROPS-CONDITIONAL>
                      <IMPLEMENTATION-DATA-TYPE-REF DEST="IMPLEMENTATION-DATA-TYPE">/AUTOSAR_Platform/ImplementationDataTypes/uint16</IMPLEMENTATION-DATA-TYPE-REF>
                    </SW-DATA-DEF-PROPS-CONDITIONAL>
                  </SW-DATA-DEF-PROPS-VARIANTS>
                </SW-DATA-DEF-PROPS>
              </SW-SERVICE-ARG>
            </ARGUMENTS>
          </BSW-MODULE-ENTRY>
[!ENDIF!][!//
[!IF "../CanGeneral/CanDeInitApi = 'true'"!][!//
          <BSW-MODULE-ENTRY>
            <SHORT-NAME>Can_DeInit</SHORT-NAME>
            <SERVICE-ID>16</SERVICE-ID>
            <IS-REENTRANT>false</IS-REENTRANT>
            <IS-SYNCHRONOUS>true</IS-SYNCHRONOUS>
            <CALL-TYPE>REGULAR</CALL-TYPE>
            <EXECUTION-CONTEXT>TASK</EXECUTION-CONTEXT>
            <SW-SERVICE-IMPL-POLICY>STANDARD</SW-SERVICE-IMPL-POLICY>
          </BSW-MODULE-ENTRY>
[!ENDIF!][!//
[!IF "../CanGeneral/CanVersionInfoApi = 'true'"!][!//
          <BSW-MODULE-ENTRY>
            <SHORT-NAME>Can_GetVersionInfo</SHORT-NAME>
            <SERVICE-ID>7</SERVICE-ID>
            <IS-REENTRANT>true</IS-REENTRANT>
            <IS-SYNCHRONOUS>true</IS-SYNCHRONOUS>
            <CALL-TYPE>REGULAR</CALL-TYPE>
            <EXECUTION-CONTEXT>TASK</EXECUTION-CONTEXT>
            <SW-SERVICE-IMPL-POLICY>STANDARD</SW-SERVICE-IMPL-POLICY>
            <ARGUMENTS>
              <SW-SERVICE-ARG>
                <SHORT-NAME>versioninfo</SHORT-NAME>
                <CATEGORY>DATA_REFERENCE</CATEGORY>
                <SW-DATA-DEF-PROPS>
                  <SW-DATA-DEF-PROPS-VARIANTS>
                    <SW-DATA-DEF-PROPS-CONDITIONAL>
                      <SW-POINTER-TARGET-PROPS>
                        <TARGET-CATEGORY>TYPE_REFERENCE</TARGET-CATEGORY>
                        <SW-DATA-DEF-PROPS>
                          <SW-DATA-DEF-PROPS-VARIANTS>
                            <SW-DATA-DEF-PROPS-CONDITIONAL>
                              <IMPLEMENTATION-DATA-TYPE-REF DEST="IMPLEMENTATION-DATA-TYPE">/AUTOSAR_Std/ImplementationDataTypes/Std_VersionInfoType</IMPLEMENTATION-DATA-TYPE-REF>
                            </SW-DATA-DEF-PROPS-CONDITIONAL>
                          </SW-DATA-DEF-PROPS-VARIANTS>
                        </SW-DATA-DEF-PROPS>
                      </SW-POINTER-TARGET-PROPS>
                    </SW-DATA-DEF-PROPS-CONDITIONAL>
                  </SW-DATA-DEF-PROPS-VARIANTS>
                </SW-DATA-DEF-PROPS>
              </SW-SERVICE-ARG>
            </ARGUMENTS>
          </BSW-MODULE-ENTRY>
[!ENDIF!][!//
[!IF "../CanGeneral/CanLPduReceiveCalloutFunction = 'true'"!][!//
          <BSW-MODULE-ENTRY>
            <SHORT-NAME>Can_LpduCallout</SHORT-NAME>
            <SERVICE-ID>32</SERVICE-ID>
            <IS-REENTRANT>false</IS-REENTRANT>
            <IS-SYNCHRONOUS>false</IS-SYNCHRONOUS>
            <CALL-TYPE>REGULAR</CALL-TYPE>
            <EXECUTION-CONTEXT>TASK</EXECUTION-CONTEXT>
            <SW-SERVICE-IMPL-POLICY>STANDARD</SW-SERVICE-IMPL-POLICY>
            <ARGUMENTS>
              <SW-SERVICE-ARG>
                <SHORT-NAME>Hrh</SHORT-NAME>
                <CATEGORY>TYPE_REFERENCE</CATEGORY>
                <SW-DATA-DEF-PROPS>
                  <SW-DATA-DEF-PROPS-VARIANTS>
                    <SW-DATA-DEF-PROPS-CONDITIONAL>
                      <IMPLEMENTATION-DATA-TYPE-REF DEST="IMPLEMENTATION-DATA-TYPE">/AUTOSAR_Platform/ImplementationDataTypes/uint8</IMPLEMENTATION-DATA-TYPE-REF>
                    </SW-DATA-DEF-PROPS-CONDITIONAL>
                  </SW-DATA-DEF-PROPS-VARIANTS>
                </SW-DATA-DEF-PROPS>
              </SW-SERVICE-ARG>
              <SW-SERVICE-ARG>
                <SHORT-NAME>CanId</SHORT-NAME>
                <CATEGORY>TYPE_REFERENCE</CATEGORY>
                <SW-DATA-DEF-PROPS>
                  <SW-DATA-DEF-PROPS-VARIANTS>
                    <SW-DATA-DEF-PROPS-CONDITIONAL>
                      <IMPLEMENTATION-DATA-TYPE-REF DEST="IMPLEMENTATION-DATA-TYPE">/AUTOSAR_Can_GeneralTypes/ImplementationDataTypes/Can_IdType</IMPLEMENTATION-DATA-TYPE-REF>
                    </SW-DATA-DEF-PROPS-CONDITIONAL>
                  </SW-DATA-DEF-PROPS-VARIANTS>
                </SW-DATA-DEF-PROPS>
              </SW-SERVICE-ARG>
              <SW-SERVICE-ARG>
                <SHORT-NAME>CanDataLength</SHORT-NAME>
                <CATEGORY>TYPE_REFERENCE</CATEGORY>
                <SW-DATA-DEF-PROPS>
                  <SW-DATA-DEF-PROPS-VARIANTS>
                    <SW-DATA-DEF-PROPS-CONDITIONAL>
                      <IMPLEMENTATION-DATA-TYPE-REF DEST="IMPLEMENTATION-DATA-TYPE">/AUTOSAR_Platform/ImplementationDataTypes/uint8</IMPLEMENTATION-DATA-TYPE-REF>
                    </SW-DATA-DEF-PROPS-CONDITIONAL>
                  </SW-DATA-DEF-PROPS-VARIANTS>
                </SW-DATA-DEF-PROPS>
              </SW-SERVICE-ARG>
              <SW-SERVICE-ARG>
                <SHORT-NAME>CanSduPtr</SHORT-NAME>
                <CATEGORY>DATA_REFERENCE</CATEGORY>
                <SW-DATA-DEF-PROPS>
                  <SW-DATA-DEF-PROPS-VARIANTS>
                    <SW-DATA-DEF-PROPS-CONDITIONAL>
                      <SW-POINTER-TARGET-PROPS>
                        <TARGET-CATEGORY>TYPE_REFERENCE</TARGET-CATEGORY>
                        <SW-DATA-DEF-PROPS>
                          <SW-DATA-DEF-PROPS-VARIANTS>
                            <SW-DATA-DEF-PROPS-CONDITIONAL>
                              <IMPLEMENTATION-DATA-TYPE-REF DEST="IMPLEMENTATION-DATA-TYPE">/AUTOSAR_Platform/ImplementationDataTypes/uint8</IMPLEMENTATION-DATA-TYPE-REF>
                            </SW-DATA-DEF-PROPS-CONDITIONAL>
                          </SW-DATA-DEF-PROPS-VARIANTS>
                        </SW-DATA-DEF-PROPS>
                      </SW-POINTER-TARGET-PROPS>
                    </SW-DATA-DEF-PROPS-CONDITIONAL>
                  </SW-DATA-DEF-PROPS-VARIANTS>
                </SW-DATA-DEF-PROPS>
              </SW-SERVICE-ARG>
            </ARGUMENTS>
          </BSW-MODULE-ENTRY>
[!ENDIF!][!//
[!IF "../CanGeneral/CanPublicIcomSupport = 'true'"!][!//
          <BSW-MODULE-ENTRY>
            <SHORT-NAME>Can_SetIcomConfiguration</SHORT-NAME>
            <INTRODUCTION>
              <NOTE SI="Can_SetIcomConfiguration is Reentrant for different controllers." NOTE-TYPE="HINT" />
            </INTRODUCTION>
            <SERVICE-ID>33</SERVICE-ID>
            <IS-REENTRANT>true</IS-REENTRANT>
            <IS-SYNCHRONOUS>true</IS-SYNCHRONOUS>
            <CALL-TYPE>REGULAR</CALL-TYPE>
            <EXECUTION-CONTEXT>TASK</EXECUTION-CONTEXT>
            <SW-SERVICE-IMPL-POLICY>STANDARD</SW-SERVICE-IMPL-POLICY>
            <ARGUMENTS>
              <SW-SERVICE-ARG>
                <SHORT-NAME>Controller</SHORT-NAME>
                <CATEGORY>TYPE_REFERENCE</CATEGORY>
                <SW-DATA-DEF-PROPS>
                  <SW-DATA-DEF-PROPS-VARIANTS>
                    <SW-DATA-DEF-PROPS-CONDITIONAL>
                      <IMPLEMENTATION-DATA-TYPE-REF DEST="IMPLEMENTATION-DATA-TYPE">/AUTOSAR_Platform/ImplementationDataTypes/uint8</IMPLEMENTATION-DATA-TYPE-REF>
                    </SW-DATA-DEF-PROPS-CONDITIONAL>
                  </SW-DATA-DEF-PROPS-VARIANTS>
                </SW-DATA-DEF-PROPS>
              </SW-SERVICE-ARG>
              <SW-SERVICE-ARG>
                <SHORT-NAME>ConfigurationId</SHORT-NAME>
                <CATEGORY>TYPE_REFERENCE</CATEGORY>
                <INTRODUCTION>
                  <NOTE SI="IcomConfigIdType type is to be defined in ComStack_Types.h to be resolved by the user." NOTE-TYPE="HINT" />
                </INTRODUCTION>
                <SW-DATA-DEF-PROPS>
                  <SW-DATA-DEF-PROPS-VARIANTS>
                    <SW-DATA-DEF-PROPS-CONDITIONAL>
                      <IMPLEMENTATION-DATA-TYPE-REF DEST="IMPLEMENTATION-DATA-TYPE">/AUTOSAR_Stub/ImplementationDataTypes/IcomConfigIdType</IMPLEMENTATION-DATA-TYPE-REF>
                    </SW-DATA-DEF-PROPS-CONDITIONAL>
                  </SW-DATA-DEF-PROPS-VARIANTS>
                </SW-DATA-DEF-PROPS>
              </SW-SERVICE-ARG>
            </ARGUMENTS>
          </BSW-MODULE-ENTRY>
[!ENDIF!][!//
          <BSW-MODULE-ENTRY>
            <SHORT-NAME>Can_Write</SHORT-NAME>
            <INTRODUCTION>
              <NOTE SI="Can_Write is Reentrant and thread safe." NOTE-TYPE="HINT" />
            </INTRODUCTION>
            <SERVICE-ID>6</SERVICE-ID>
            <IS-REENTRANT>true</IS-REENTRANT>
            <IS-SYNCHRONOUS>true</IS-SYNCHRONOUS>
            <CALL-TYPE>REGULAR</CALL-TYPE>
            <EXECUTION-CONTEXT>TASK</EXECUTION-CONTEXT>
            <SW-SERVICE-IMPL-POLICY>STANDARD</SW-SERVICE-IMPL-POLICY>
            <RETURN-TYPE>
              <SHORT-NAME>Return</SHORT-NAME>
              <CATEGORY>TYPE_REFERENCE</CATEGORY>
              <SW-DATA-DEF-PROPS>
                <SW-DATA-DEF-PROPS-VARIANTS>
                  <SW-DATA-DEF-PROPS-CONDITIONAL>
                    [!IF "$MinorVersion = num:i(2)"!][!//
                    <IMPLEMENTATION-DATA-TYPE-REF DEST="IMPLEMENTATION-DATA-TYPE">/AUTOSAR_Can_GeneralTypes/ImplementationDataTypes/Can_ReturnType</IMPLEMENTATION-DATA-TYPE-REF>
                    [!ELSE!][!//
                    <IMPLEMENTATION-DATA-TYPE-REF DEST="IMPLEMENTATION-DATA-TYPE">/AUTOSAR_Std/ImplementationDataTypes/Std_ReturnType</IMPLEMENTATION-DATA-TYPE-REF>
                    [!ENDIF!][!//
                  </SW-DATA-DEF-PROPS-CONDITIONAL>
                </SW-DATA-DEF-PROPS-VARIANTS>
              </SW-DATA-DEF-PROPS>
            </RETURN-TYPE>
            <ARGUMENTS>
              <SW-SERVICE-ARG>
                <SHORT-NAME>Hth</SHORT-NAME>
                <CATEGORY>TYPE_REFERENCE</CATEGORY>
                <SW-DATA-DEF-PROPS>
                  <SW-DATA-DEF-PROPS-VARIANTS>
                    <SW-DATA-DEF-PROPS-CONDITIONAL>
                      <IMPLEMENTATION-DATA-TYPE-REF DEST="IMPLEMENTATION-DATA-TYPE">/AUTOSAR_Can_GeneralTypes/ImplementationDataTypes/Can_HwHandleType</IMPLEMENTATION-DATA-TYPE-REF>
                    </SW-DATA-DEF-PROPS-CONDITIONAL>
                  </SW-DATA-DEF-PROPS-VARIANTS>
                </SW-DATA-DEF-PROPS>
              </SW-SERVICE-ARG>
              <SW-SERVICE-ARG>
                <SHORT-NAME>PduInfo</SHORT-NAME>
                <CATEGORY>DATA_REFERENCE</CATEGORY>
                <SW-DATA-DEF-PROPS>
                  <SW-DATA-DEF-PROPS-VARIANTS>
                    <SW-DATA-DEF-PROPS-CONDITIONAL>
                      <SW-POINTER-TARGET-PROPS>
                        <TARGET-CATEGORY>TYPE_REFERENCE</TARGET-CATEGORY>
                        <SW-DATA-DEF-PROPS>
                          <SW-DATA-DEF-PROPS-VARIANTS>
                            <SW-DATA-DEF-PROPS-CONDITIONAL>
                              <IMPLEMENTATION-DATA-TYPE-REF DEST="IMPLEMENTATION-DATA-TYPE">/AUTOSAR_Can_GeneralTypes/ImplementationDataTypes/Can_PduType</IMPLEMENTATION-DATA-TYPE-REF>
                            </SW-DATA-DEF-PROPS-CONDITIONAL>
                          </SW-DATA-DEF-PROPS-VARIANTS>
                        </SW-DATA-DEF-PROPS>
                      </SW-POINTER-TARGET-PROPS>
                    </SW-DATA-DEF-PROPS-CONDITIONAL>
                  </SW-DATA-DEF-PROPS-VARIANTS>
                </SW-DATA-DEF-PROPS>
              </SW-SERVICE-ARG>
            </ARGUMENTS>
          </BSW-MODULE-ENTRY>
  [!IF "$MinorVersion = num:i(4)"!][!//
  <BSW-MODULE-ENTRY>
            <SHORT-NAME>Can_GetControllerMode</SHORT-NAME>
            <SERVICE-ID>18</SERVICE-ID>
            <IS-REENTRANT>false</IS-REENTRANT>
            <IS-SYNCHRONOUS>true</IS-SYNCHRONOUS>
            <CALL-TYPE>REGULAR</CALL-TYPE>
            <EXECUTION-CONTEXT>TASK</EXECUTION-CONTEXT>
            <SW-SERVICE-IMPL-POLICY>STANDARD</SW-SERVICE-IMPL-POLICY>
            <RETURN-TYPE>
              <SHORT-NAME>Return</SHORT-NAME>
              <CATEGORY>TYPE_REFERENCE</CATEGORY>
              <SW-DATA-DEF-PROPS>
                <SW-DATA-DEF-PROPS-VARIANTS>
                  <SW-DATA-DEF-PROPS-CONDITIONAL>
                    <IMPLEMENTATION-DATA-TYPE-REF DEST="IMPLEMENTATION-DATA-TYPE">/AUTOSAR_Std/ImplementationDataTypes/Std_ReturnType</IMPLEMENTATION-DATA-TYPE-REF>
                  </SW-DATA-DEF-PROPS-CONDITIONAL>
                </SW-DATA-DEF-PROPS-VARIANTS>
              </SW-DATA-DEF-PROPS>
            </RETURN-TYPE>
            <ARGUMENTS>
              <SW-SERVICE-ARG>
                <SHORT-NAME>Controller</SHORT-NAME>
                <CATEGORY>TYPE_REFERENCE</CATEGORY>
                <SW-DATA-DEF-PROPS>
                  <SW-DATA-DEF-PROPS-VARIANTS>
                    <SW-DATA-DEF-PROPS-CONDITIONAL>
                      <IMPLEMENTATION-DATA-TYPE-REF DEST="IMPLEMENTATION-DATA-TYPE">/AUTOSAR_Platform/ImplementationDataTypes/uint8</IMPLEMENTATION-DATA-TYPE-REF>
                    </SW-DATA-DEF-PROPS-CONDITIONAL>
                  </SW-DATA-DEF-PROPS-VARIANTS>
                </SW-DATA-DEF-PROPS>
              </SW-SERVICE-ARG>
              <SW-SERVICE-ARG>
                  <SHORT-NAME>ControllerModePtr</SHORT-NAME>
                  <CATEGORY>DATA_REFERENCE</CATEGORY>
                  <SW-DATA-DEF-PROPS>
                    <SW-DATA-DEF-PROPS-VARIANTS>
                      <SW-DATA-DEF-PROPS-CONDITIONAL>
                        <SW-POINTER-TARGET-PROPS>
                          <TARGET-CATEGORY>TYPE_REFERENCE</TARGET-CATEGORY>
                          <SW-DATA-DEF-PROPS>
                            <SW-DATA-DEF-PROPS-VARIANTS>
                              <SW-DATA-DEF-PROPS-CONDITIONAL>
                                <IMPLEMENTATION-DATA-TYPE-REF DEST="IMPLEMENTATION-DATA-TYPE">/AUTOSAR_Can_GeneralTypes/ImplementationDataTypes/Can_ControllerStateType</IMPLEMENTATION-DATA-TYPE-REF>
                              </SW-DATA-DEF-PROPS-CONDITIONAL>
                            </SW-DATA-DEF-PROPS-VARIANTS>
                          </SW-DATA-DEF-PROPS>
                        </SW-POINTER-TARGET-PROPS>
                      </SW-DATA-DEF-PROPS-CONDITIONAL>
                    </SW-DATA-DEF-PROPS-VARIANTS>
                  </SW-DATA-DEF-PROPS>
                </SW-SERVICE-ARG>
            </ARGUMENTS>
          </BSW-MODULE-ENTRY>
          <BSW-MODULE-ENTRY>
            <SHORT-NAME>Can_GetControllerErrorState</SHORT-NAME>
            <SERVICE-ID>17</SERVICE-ID>
            <IS-REENTRANT>true</IS-REENTRANT>
            <IS-SYNCHRONOUS>true</IS-SYNCHRONOUS>
            <CALL-TYPE>REGULAR</CALL-TYPE>
            <EXECUTION-CONTEXT>TASK</EXECUTION-CONTEXT>
            <SW-SERVICE-IMPL-POLICY>STANDARD</SW-SERVICE-IMPL-POLICY>
            <RETURN-TYPE>
              <SHORT-NAME>Return</SHORT-NAME>
              <CATEGORY>TYPE_REFERENCE</CATEGORY>
              <SW-DATA-DEF-PROPS>
                <SW-DATA-DEF-PROPS-VARIANTS>
                  <SW-DATA-DEF-PROPS-CONDITIONAL>
                    <IMPLEMENTATION-DATA-TYPE-REF DEST="IMPLEMENTATION-DATA-TYPE">/AUTOSAR_Std/ImplementationDataTypes/Std_ReturnType</IMPLEMENTATION-DATA-TYPE-REF>
                  </SW-DATA-DEF-PROPS-CONDITIONAL>
                </SW-DATA-DEF-PROPS-VARIANTS>
              </SW-DATA-DEF-PROPS>
            </RETURN-TYPE>
            <ARGUMENTS>
              <SW-SERVICE-ARG>
                <SHORT-NAME>Controller</SHORT-NAME>
                <CATEGORY>TYPE_REFERENCE</CATEGORY>
                <SW-DATA-DEF-PROPS>
                  <SW-DATA-DEF-PROPS-VARIANTS>
                    <SW-DATA-DEF-PROPS-CONDITIONAL>
                      <IMPLEMENTATION-DATA-TYPE-REF DEST="IMPLEMENTATION-DATA-TYPE">/AUTOSAR_Platform/ImplementationDataTypes/uint8</IMPLEMENTATION-DATA-TYPE-REF>
                    </SW-DATA-DEF-PROPS-CONDITIONAL>
                  </SW-DATA-DEF-PROPS-VARIANTS>
                </SW-DATA-DEF-PROPS>
              </SW-SERVICE-ARG>
              <SW-SERVICE-ARG>
                  <SHORT-NAME>ErrorStatePtr</SHORT-NAME>
                  <CATEGORY>DATA_REFERENCE</CATEGORY>
                  <SW-DATA-DEF-PROPS>
                    <SW-DATA-DEF-PROPS-VARIANTS>
                      <SW-DATA-DEF-PROPS-CONDITIONAL>
                        <SW-POINTER-TARGET-PROPS>
                          <TARGET-CATEGORY>TYPE_REFERENCE</TARGET-CATEGORY>
                          <SW-DATA-DEF-PROPS>
                            <SW-DATA-DEF-PROPS-VARIANTS>
                              <SW-DATA-DEF-PROPS-CONDITIONAL>
                         <IMPLEMENTATION-DATA-TYPE-REF DEST="IMPLEMENTATION-DATA-TYPE">/AUTOSAR_Can_GeneralTypes/ImplementationDataTypes/Can_ErrorStateType</IMPLEMENTATION-DATA-TYPE-REF>
                              </SW-DATA-DEF-PROPS-CONDITIONAL>
                            </SW-DATA-DEF-PROPS-VARIANTS>
                          </SW-DATA-DEF-PROPS>
                        </SW-POINTER-TARGET-PROPS>
                      </SW-DATA-DEF-PROPS-CONDITIONAL>
                    </SW-DATA-DEF-PROPS-VARIANTS>
                  </SW-DATA-DEF-PROPS>
                </SW-SERVICE-ARG>
            </ARGUMENTS>
          </BSW-MODULE-ENTRY>
          <BSW-MODULE-ENTRY>
            <SHORT-NAME>Can_GetControllerRxErrorCounter</SHORT-NAME>
            <SERVICE-ID>48</SERVICE-ID>
            <IS-REENTRANT>true</IS-REENTRANT>
            <IS-SYNCHRONOUS>true</IS-SYNCHRONOUS>
            <CALL-TYPE>REGULAR</CALL-TYPE>
            <EXECUTION-CONTEXT>TASK</EXECUTION-CONTEXT>
            <SW-SERVICE-IMPL-POLICY>STANDARD</SW-SERVICE-IMPL-POLICY>
            <RETURN-TYPE>
              <SHORT-NAME>Return</SHORT-NAME>
              <CATEGORY>TYPE_REFERENCE</CATEGORY>
              <SW-DATA-DEF-PROPS>
                <SW-DATA-DEF-PROPS-VARIANTS>
                  <SW-DATA-DEF-PROPS-CONDITIONAL>
                    <IMPLEMENTATION-DATA-TYPE-REF DEST="IMPLEMENTATION-DATA-TYPE">/AUTOSAR_Std/ImplementationDataTypes/Std_ReturnType</IMPLEMENTATION-DATA-TYPE-REF>
                  </SW-DATA-DEF-PROPS-CONDITIONAL>
                </SW-DATA-DEF-PROPS-VARIANTS>
              </SW-DATA-DEF-PROPS>
            </RETURN-TYPE>
            <ARGUMENTS>
              <SW-SERVICE-ARG>
                <SHORT-NAME>Controller</SHORT-NAME>
                <CATEGORY>TYPE_REFERENCE</CATEGORY>
                <SW-DATA-DEF-PROPS>
                  <SW-DATA-DEF-PROPS-VARIANTS>
                    <SW-DATA-DEF-PROPS-CONDITIONAL>
                      <IMPLEMENTATION-DATA-TYPE-REF DEST="IMPLEMENTATION-DATA-TYPE">/AUTOSAR_Platform/ImplementationDataTypes/uint8</IMPLEMENTATION-DATA-TYPE-REF>
                    </SW-DATA-DEF-PROPS-CONDITIONAL>
                  </SW-DATA-DEF-PROPS-VARIANTS>
                </SW-DATA-DEF-PROPS>
              </SW-SERVICE-ARG>
              <SW-SERVICE-ARG>
                  <SHORT-NAME>RxErrorCounterPtr</SHORT-NAME>
                  <CATEGORY>DATA_REFERENCE</CATEGORY>
                  <SW-DATA-DEF-PROPS>
                    <SW-DATA-DEF-PROPS-VARIANTS>
                      <SW-DATA-DEF-PROPS-CONDITIONAL>
                        <SW-POINTER-TARGET-PROPS>
                          <TARGET-CATEGORY>TYPE_REFERENCE</TARGET-CATEGORY>
                          <SW-DATA-DEF-PROPS>
                            <SW-DATA-DEF-PROPS-VARIANTS>
                              <SW-DATA-DEF-PROPS-CONDITIONAL>
                                <IMPLEMENTATION-DATA-TYPE-REF DEST="IMPLEMENTATION-DATA-TYPE">/AUTOSAR_Platform/ImplementationDataTypes/uint8</IMPLEMENTATION-DATA-TYPE-REF>
                              </SW-DATA-DEF-PROPS-CONDITIONAL>
                            </SW-DATA-DEF-PROPS-VARIANTS>
                          </SW-DATA-DEF-PROPS>
                        </SW-POINTER-TARGET-PROPS>
                      </SW-DATA-DEF-PROPS-CONDITIONAL>
                    </SW-DATA-DEF-PROPS-VARIANTS>
                  </SW-DATA-DEF-PROPS>
                </SW-SERVICE-ARG>
            </ARGUMENTS>
          </BSW-MODULE-ENTRY>
          <BSW-MODULE-ENTRY>
            <SHORT-NAME>Can_GetControllerTxErrorCounter</SHORT-NAME>
            <SERVICE-ID>49</SERVICE-ID>
            <IS-REENTRANT>true</IS-REENTRANT>
            <IS-SYNCHRONOUS>true</IS-SYNCHRONOUS>
            <CALL-TYPE>REGULAR</CALL-TYPE>
            <EXECUTION-CONTEXT>TASK</EXECUTION-CONTEXT>
            <SW-SERVICE-IMPL-POLICY>STANDARD</SW-SERVICE-IMPL-POLICY>
            <RETURN-TYPE>
              <SHORT-NAME>Return</SHORT-NAME>
              <CATEGORY>TYPE_REFERENCE</CATEGORY>
              <SW-DATA-DEF-PROPS>
                <SW-DATA-DEF-PROPS-VARIANTS>
                  <SW-DATA-DEF-PROPS-CONDITIONAL>
                    <IMPLEMENTATION-DATA-TYPE-REF DEST="IMPLEMENTATION-DATA-TYPE">/AUTOSAR_Std/ImplementationDataTypes/Std_ReturnType</IMPLEMENTATION-DATA-TYPE-REF>
                  </SW-DATA-DEF-PROPS-CONDITIONAL>
                </SW-DATA-DEF-PROPS-VARIANTS>
              </SW-DATA-DEF-PROPS>
            </RETURN-TYPE>
            <ARGUMENTS>
              <SW-SERVICE-ARG>
                <SHORT-NAME>Controller</SHORT-NAME>
                <CATEGORY>TYPE_REFERENCE</CATEGORY>
                <SW-DATA-DEF-PROPS>
                  <SW-DATA-DEF-PROPS-VARIANTS>
                    <SW-DATA-DEF-PROPS-CONDITIONAL>
                      <IMPLEMENTATION-DATA-TYPE-REF DEST="IMPLEMENTATION-DATA-TYPE">/AUTOSAR_Platform/ImplementationDataTypes/uint8</IMPLEMENTATION-DATA-TYPE-REF>
                    </SW-DATA-DEF-PROPS-CONDITIONAL>
                  </SW-DATA-DEF-PROPS-VARIANTS>
                </SW-DATA-DEF-PROPS>
              </SW-SERVICE-ARG>
              <SW-SERVICE-ARG>
                  <SHORT-NAME>TxErrorCounterPtr</SHORT-NAME>
                  <CATEGORY>DATA_REFERENCE</CATEGORY>
                  <SW-DATA-DEF-PROPS>
                    <SW-DATA-DEF-PROPS-VARIANTS>
                      <SW-DATA-DEF-PROPS-CONDITIONAL>
                        <SW-POINTER-TARGET-PROPS>
                          <TARGET-CATEGORY>TYPE_REFERENCE</TARGET-CATEGORY>
                          <SW-DATA-DEF-PROPS>
                            <SW-DATA-DEF-PROPS-VARIANTS>
                              <SW-DATA-DEF-PROPS-CONDITIONAL>
                                <IMPLEMENTATION-DATA-TYPE-REF DEST="IMPLEMENTATION-DATA-TYPE">/AUTOSAR_Platform/ImplementationDataTypes/uint8</IMPLEMENTATION-DATA-TYPE-REF>
                              </SW-DATA-DEF-PROPS-CONDITIONAL>
                            </SW-DATA-DEF-PROPS-VARIANTS>
                          </SW-DATA-DEF-PROPS>
                        </SW-POINTER-TARGET-PROPS>
                      </SW-DATA-DEF-PROPS-CONDITIONAL>
                    </SW-DATA-DEF-PROPS-VARIANTS>
                  </SW-DATA-DEF-PROPS>
                </SW-SERVICE-ARG>
            </ARGUMENTS>
          </BSW-MODULE-ENTRY>
[!ENDIF!][!//
[!IF "$WUPollingStatus = num:i(1)"!][!//
          <BSW-MODULE-ENTRY>
            <SHORT-NAME>Can_MainFunction_Wakeup</SHORT-NAME>
            <SERVICE-ID>10</SERVICE-ID>
            <IS-REENTRANT>false</IS-REENTRANT>
            <IS-SYNCHRONOUS>true</IS-SYNCHRONOUS>
            <CALL-TYPE>SCHEDULED</CALL-TYPE>
            <EXECUTION-CONTEXT>TASK</EXECUTION-CONTEXT>
            <SW-SERVICE-IMPL-POLICY>STANDARD</SW-SERVICE-IMPL-POLICY>
          </BSW-MODULE-ENTRY>
[!ENDIF!][!//
[!IF "$BusOffPollingStatus = num:i(1)"!][!//
          <BSW-MODULE-ENTRY>
            <SHORT-NAME>Can_MainFunction_BusOff</SHORT-NAME>
            <SERVICE-ID>9</SERVICE-ID>
            <IS-REENTRANT>false</IS-REENTRANT>
            <IS-SYNCHRONOUS>true</IS-SYNCHRONOUS>
            <CALL-TYPE>SCHEDULED</CALL-TYPE>
            <EXECUTION-CONTEXT>TASK</EXECUTION-CONTEXT>
            <SW-SERVICE-IMPL-POLICY>STANDARD</SW-SERVICE-IMPL-POLICY>
          </BSW-MODULE-ENTRY>
[!ENDIF!][!//
[!IF "$RxPollingStatus = num:i(1)"!][!//
          <BSW-MODULE-ENTRY>
            <SHORT-NAME>Can_MainFunction_Mode</SHORT-NAME>
            <SERVICE-ID>12</SERVICE-ID>
            <IS-REENTRANT>false</IS-REENTRANT>
            <IS-SYNCHRONOUS>true</IS-SYNCHRONOUS>
            <CALL-TYPE>SCHEDULED</CALL-TYPE>
            <EXECUTION-CONTEXT>TASK</EXECUTION-CONTEXT>
            <SW-SERVICE-IMPL-POLICY>STANDARD</SW-SERVICE-IMPL-POLICY>
          </BSW-MODULE-ENTRY>
[!ENDIF!][!//
[!IF "$MultiRxPeriod = num:i(0)"!][!//
          <BSW-MODULE-ENTRY>
            <SHORT-NAME>Can_MainFunction_Read</SHORT-NAME>
            <SERVICE-ID>8</SERVICE-ID>
            <IS-REENTRANT>false</IS-REENTRANT>
            <IS-SYNCHRONOUS>true</IS-SYNCHRONOUS>
            <CALL-TYPE>SCHEDULED</CALL-TYPE>
            <EXECUTION-CONTEXT>TASK</EXECUTION-CONTEXT>
            <SW-SERVICE-IMPL-POLICY>STANDARD</SW-SERVICE-IMPL-POLICY>
          </BSW-MODULE-ENTRY>
[!ELSE!][!//
[!FOR "HwObjindx" = "0" TO "$MultiperiodsVal - 1"!][!//
          <BSW-MODULE-ENTRY>
            <SHORT-NAME>Can_MainFunction_Read_[!"$HwObjindx"!]</SHORT-NAME>
            <ROLE>Can_MainFunction_Read_[!"$HwObjindx"!]</ROLE>
            <IS-REENTRANT>false</IS-REENTRANT>
            <IS-SYNCHRONOUS>true</IS-SYNCHRONOUS>
            <CALL-TYPE>SCHEDULED</CALL-TYPE>
            <EXECUTION-CONTEXT>TASK</EXECUTION-CONTEXT>
            <SW-SERVICE-IMPL-POLICY>STANDARD</SW-SERVICE-IMPL-POLICY>
          </BSW-MODULE-ENTRY>
[!ENDFOR!][!//
[!ENDIF!][!//
[!IF "$MultiTxPeriod = num:i(0)"!][!//
          <BSW-MODULE-ENTRY>
            <SHORT-NAME>Can_MainFunction_Write</SHORT-NAME>
            <SERVICE-ID>1</SERVICE-ID>
            <IS-REENTRANT>false</IS-REENTRANT>
            <IS-SYNCHRONOUS>true</IS-SYNCHRONOUS>
            <CALL-TYPE>SCHEDULED</CALL-TYPE>
            <EXECUTION-CONTEXT>TASK</EXECUTION-CONTEXT>
            <SW-SERVICE-IMPL-POLICY>STANDARD</SW-SERVICE-IMPL-POLICY>
          </BSW-MODULE-ENTRY>
[!ELSE!][!//
[!FOR "HwObjindx" = "0" TO "$MultiperiodsVal - 1"!][!//
          <BSW-MODULE-ENTRY>
            <SHORT-NAME>Can_MainFunction_Write_[!"$HwObjindx"!]</SHORT-NAME>
            <ROLE>Can_MainFunction_Write_[!"$HwObjindx"!]</ROLE>
            <IS-REENTRANT>false</IS-REENTRANT>
            <IS-SYNCHRONOUS>true</IS-SYNCHRONOUS>
            <CALL-TYPE>SCHEDULED</CALL-TYPE>
            <EXECUTION-CONTEXT>TASK</EXECUTION-CONTEXT>
            <SW-SERVICE-IMPL-POLICY>STANDARD</SW-SERVICE-IMPL-POLICY>
          </BSW-MODULE-ENTRY>
[!ENDFOR!][!//
[!ENDIF!][!//
[!IF "$TxInterruptStatus = num:i(1)"!][!//
          <BSW-MODULE-ENTRY>
            <SHORT-NAME>Can_IsrTransmitHandler</SHORT-NAME>
            <ROLE>Can_IsrTransmitHandler</ROLE>
            <IS-REENTRANT>true</IS-REENTRANT>
            <IS-SYNCHRONOUS>true</IS-SYNCHRONOUS>
            <CALL-TYPE>INTERRUPT</CALL-TYPE>
            <EXECUTION-CONTEXT>INTERRUPT-CAT-1</EXECUTION-CONTEXT>
            <SW-SERVICE-IMPL-POLICY>STANDARD</SW-SERVICE-IMPL-POLICY>
            <ARGUMENTS>
              <SW-SERVICE-ARG>
                <SHORT-NAME>HwKernelId</SHORT-NAME>
                <CATEGORY>TYPE_REFERENCE</CATEGORY>
                <SW-DATA-DEF-PROPS>
                  <SW-DATA-DEF-PROPS-VARIANTS>
                    <SW-DATA-DEF-PROPS-CONDITIONAL>
                      <IMPLEMENTATION-DATA-TYPE-REF DEST="IMPLEMENTATION-DATA-TYPE">/AUTOSAR_Platform/ImplementationDataTypes/uint8</IMPLEMENTATION-DATA-TYPE-REF>
                    </SW-DATA-DEF-PROPS-CONDITIONAL>
                  </SW-DATA-DEF-PROPS-VARIANTS>
                </SW-DATA-DEF-PROPS>
              </SW-SERVICE-ARG>
              <SW-SERVICE-ARG>
                <SHORT-NAME>NodeIdIndex</SHORT-NAME>
                <CATEGORY>TYPE_REFERENCE</CATEGORY>
                <SW-DATA-DEF-PROPS>
                  <SW-DATA-DEF-PROPS-VARIANTS>
                    <SW-DATA-DEF-PROPS-CONDITIONAL>
                      <IMPLEMENTATION-DATA-TYPE-REF DEST="IMPLEMENTATION-DATA-TYPE">/AUTOSAR_Platform/ImplementationDataTypes/uint8</IMPLEMENTATION-DATA-TYPE-REF>
                    </SW-DATA-DEF-PROPS-CONDITIONAL>
                  </SW-DATA-DEF-PROPS-VARIANTS>
                </SW-DATA-DEF-PROPS>
              </SW-SERVICE-ARG>
            </ARGUMENTS>
          </BSW-MODULE-ENTRY>
[!ENDIF!][!//
[!IF "$RxDedInterruptStatus = num:i(1)"!][!//
          <BSW-MODULE-ENTRY>
            <SHORT-NAME>Can_IsrReceiveHandler</SHORT-NAME>
            <ROLE>Can_IsrReceiveHandler</ROLE>
            <IS-REENTRANT>true</IS-REENTRANT>
            <IS-SYNCHRONOUS>true</IS-SYNCHRONOUS>
            <CALL-TYPE>INTERRUPT</CALL-TYPE>
            <EXECUTION-CONTEXT>INTERRUPT-CAT-1</EXECUTION-CONTEXT>
            <SW-SERVICE-IMPL-POLICY>STANDARD</SW-SERVICE-IMPL-POLICY>
            <ARGUMENTS>
              <SW-SERVICE-ARG>
                <SHORT-NAME>HwKernelId</SHORT-NAME>
                <CATEGORY>TYPE_REFERENCE</CATEGORY>
                <SW-DATA-DEF-PROPS>
                  <SW-DATA-DEF-PROPS-VARIANTS>
                    <SW-DATA-DEF-PROPS-CONDITIONAL>
                      <IMPLEMENTATION-DATA-TYPE-REF DEST="IMPLEMENTATION-DATA-TYPE">/AUTOSAR_Platform/ImplementationDataTypes/uint8</IMPLEMENTATION-DATA-TYPE-REF>
                    </SW-DATA-DEF-PROPS-CONDITIONAL>
                  </SW-DATA-DEF-PROPS-VARIANTS>
                </SW-DATA-DEF-PROPS>
              </SW-SERVICE-ARG>
              <SW-SERVICE-ARG>
                <SHORT-NAME>NodeIdIndex</SHORT-NAME>
                <CATEGORY>TYPE_REFERENCE</CATEGORY>
                <SW-DATA-DEF-PROPS>
                  <SW-DATA-DEF-PROPS-VARIANTS>
                    <SW-DATA-DEF-PROPS-CONDITIONAL>
                      <IMPLEMENTATION-DATA-TYPE-REF DEST="IMPLEMENTATION-DATA-TYPE">/AUTOSAR_Platform/ImplementationDataTypes/uint8</IMPLEMENTATION-DATA-TYPE-REF>
                    </SW-DATA-DEF-PROPS-CONDITIONAL>
                  </SW-DATA-DEF-PROPS-VARIANTS>
                </SW-DATA-DEF-PROPS>
              </SW-SERVICE-ARG>
            </ARGUMENTS>
          </BSW-MODULE-ENTRY>
[!ENDIF!][!//
[!IF "$RxFifoInterruptStatus = num:i(1)"!][!//
          <BSW-MODULE-ENTRY>
            <SHORT-NAME>Can_IsrRxFIFOHandler</SHORT-NAME>
            <ROLE>Can_IsrRxFIFOHandler</ROLE>
            <IS-REENTRANT>true</IS-REENTRANT>
            <IS-SYNCHRONOUS>true</IS-SYNCHRONOUS>
            <CALL-TYPE>INTERRUPT</CALL-TYPE>
            <EXECUTION-CONTEXT>INTERRUPT-CAT-1</EXECUTION-CONTEXT>
            <SW-SERVICE-IMPL-POLICY>STANDARD</SW-SERVICE-IMPL-POLICY>
            <ARGUMENTS>
              <SW-SERVICE-ARG>
                <SHORT-NAME>HwKernelId</SHORT-NAME>
                <CATEGORY>TYPE_REFERENCE</CATEGORY>
                <SW-DATA-DEF-PROPS>
                  <SW-DATA-DEF-PROPS-VARIANTS>
                    <SW-DATA-DEF-PROPS-CONDITIONAL>
                      <IMPLEMENTATION-DATA-TYPE-REF DEST="IMPLEMENTATION-DATA-TYPE">/AUTOSAR_Platform/ImplementationDataTypes/uint8</IMPLEMENTATION-DATA-TYPE-REF>
                    </SW-DATA-DEF-PROPS-CONDITIONAL>
                  </SW-DATA-DEF-PROPS-VARIANTS>
                </SW-DATA-DEF-PROPS>
              </SW-SERVICE-ARG>
              <SW-SERVICE-ARG>
                <SHORT-NAME>NodeIdIndex</SHORT-NAME>
                <CATEGORY>TYPE_REFERENCE</CATEGORY>
                <SW-DATA-DEF-PROPS>
                  <SW-DATA-DEF-PROPS-VARIANTS>
                    <SW-DATA-DEF-PROPS-CONDITIONAL>
                      <IMPLEMENTATION-DATA-TYPE-REF DEST="IMPLEMENTATION-DATA-TYPE">/AUTOSAR_Platform/ImplementationDataTypes/uint8</IMPLEMENTATION-DATA-TYPE-REF>
                    </SW-DATA-DEF-PROPS-CONDITIONAL>
                  </SW-DATA-DEF-PROPS-VARIANTS>
                </SW-DATA-DEF-PROPS>
              </SW-SERVICE-ARG>
            </ARGUMENTS>
          </BSW-MODULE-ENTRY>
[!ENDIF!][!//
[!IF "$BusOffInterruptStatus = num:i(1)"!][!//
          <BSW-MODULE-ENTRY>
            <SHORT-NAME>Can_IsrBusOffHandler</SHORT-NAME>
            <ROLE>Can_IsrBusOffHandler</ROLE>
            <IS-REENTRANT>true</IS-REENTRANT>
            <IS-SYNCHRONOUS>true</IS-SYNCHRONOUS>
            <CALL-TYPE>INTERRUPT</CALL-TYPE>
            <EXECUTION-CONTEXT>INTERRUPT-CAT-1</EXECUTION-CONTEXT>
            <SW-SERVICE-IMPL-POLICY>STANDARD</SW-SERVICE-IMPL-POLICY>
            <ARGUMENTS>
              <SW-SERVICE-ARG>
                <SHORT-NAME>HwKernelId</SHORT-NAME>
                <CATEGORY>TYPE_REFERENCE</CATEGORY>
                <SW-DATA-DEF-PROPS>
                  <SW-DATA-DEF-PROPS-VARIANTS>
                    <SW-DATA-DEF-PROPS-CONDITIONAL>
                      <IMPLEMENTATION-DATA-TYPE-REF DEST="IMPLEMENTATION-DATA-TYPE">/AUTOSAR_Platform/ImplementationDataTypes/uint8</IMPLEMENTATION-DATA-TYPE-REF>
                    </SW-DATA-DEF-PROPS-CONDITIONAL>
                  </SW-DATA-DEF-PROPS-VARIANTS>
                </SW-DATA-DEF-PROPS>
              </SW-SERVICE-ARG>
              <SW-SERVICE-ARG>
                <SHORT-NAME>NodeIdIndex</SHORT-NAME>
                <CATEGORY>TYPE_REFERENCE</CATEGORY>
                <SW-DATA-DEF-PROPS>
                  <SW-DATA-DEF-PROPS-VARIANTS>
                    <SW-DATA-DEF-PROPS-CONDITIONAL>
                      <IMPLEMENTATION-DATA-TYPE-REF DEST="IMPLEMENTATION-DATA-TYPE">/AUTOSAR_Platform/ImplementationDataTypes/uint8</IMPLEMENTATION-DATA-TYPE-REF>
                    </SW-DATA-DEF-PROPS-CONDITIONAL>
                  </SW-DATA-DEF-PROPS-VARIANTS>
                </SW-DATA-DEF-PROPS>
              </SW-SERVICE-ARG>
            </ARGUMENTS>
          </BSW-MODULE-ENTRY>
[!ENDIF!][!//
        </ELEMENTS>
      </AR-PACKAGE>
      <AR-PACKAGE>
        <SHORT-NAME>Implementations</SHORT-NAME>
        <ELEMENTS>
          <BSW-IMPLEMENTATION>
            <SHORT-NAME>Can</SHORT-NAME>
            <CODE-DESCRIPTORS>
              <CODE>
                <SHORT-NAME>Files</SHORT-NAME>
                <ARTIFACT-DESCRIPTORS>
                  <AUTOSAR-ENGINEERING-OBJECT>
                    <SHORT-LABEL>ssc::inc::Can_17_McmCan.h</SHORT-LABEL>
                    <CATEGORY>SWHDR</CATEGORY>
                  </AUTOSAR-ENGINEERING-OBJECT>
                  <AUTOSAR-ENGINEERING-OBJECT>
                    <SHORT-LABEL>ssc::src::Can_17_McmCan.c</SHORT-LABEL>
                    <CATEGORY>SWSRC</CATEGORY>
                  </AUTOSAR-ENGINEERING-OBJECT>
                </ARTIFACT-DESCRIPTORS>
              </CODE>
            </CODE-DESCRIPTORS>
            <GENERATED-ARTIFACTS>
              <DEPENDENCY-ON-ARTIFACT>
                <SHORT-NAME>Can_Cfg_h</SHORT-NAME>
                <ARTIFACT-DESCRIPTOR>
                  <SHORT-LABEL>generate::inc:Can_17_McmCan_Cfg.h</SHORT-LABEL>
                  <CATEGORY>SWTEMPLATE</CATEGORY>
                </ARTIFACT-DESCRIPTOR>
                <USAGES>
                  <USAGE>COMPILE</USAGE>
                </USAGES>
              </DEPENDENCY-ON-ARTIFACT>
              <DEPENDENCY-ON-ARTIFACT>
                <SHORT-NAME>Can_PBcfg_h</SHORT-NAME>
                <ARTIFACT-DESCRIPTOR>
                  <SHORT-LABEL>generate::template::inc::Can_17_McmCan_PBcfg.h</SHORT-LABEL>
                  <CATEGORY>SWTEMPLATE</CATEGORY>
                </ARTIFACT-DESCRIPTOR>
                <USAGES>
                  <USAGE>EXECUTE</USAGE>
                </USAGES>
              </DEPENDENCY-ON-ARTIFACT>
              <DEPENDENCY-ON-ARTIFACT>
                <SHORT-NAME>Can_PBCfg_c</SHORT-NAME>
                <ARTIFACT-DESCRIPTOR>
                  <SHORT-LABEL>generate::src::Can_17_McmCan_PBcfg.c</SHORT-LABEL>
                  <CATEGORY>SWTEMPLATE</CATEGORY>
                </ARTIFACT-DESCRIPTOR>
                <USAGES>
                  <USAGE>EXECUTE</USAGE>
                </USAGES>
              </DEPENDENCY-ON-ARTIFACT>
              <DEPENDENCY-ON-ARTIFACT>
                <SHORT-NAME>Can_xdm</SHORT-NAME>
                <ARTIFACT-DESCRIPTOR>
                  <SHORT-LABEL>config::Can_17_McmCan.xdm</SHORT-LABEL>
                  <CATEGORY>SWTOOL</CATEGORY>
                </ARTIFACT-DESCRIPTOR>
                <USAGES>
                  <USAGE>CODEGENERATION</USAGE>
                </USAGES>
              </DEPENDENCY-ON-ARTIFACT>
              <DEPENDENCY-ON-ARTIFACT>
                <SHORT-NAME>Can_bmd</SHORT-NAME>
                <ARTIFACT-DESCRIPTOR>
                  <SHORT-LABEL>autosar::[!"concat(substring(ecu:get('Rel.SubDerivate'),1,4),'x')"!]::[!"ecu:get('Rel.SubDerivate')"!]::Can_17_McmCan.bmd</SHORT-LABEL>
                  <CATEGORY>SWTOOL</CATEGORY>
                </ARTIFACT-DESCRIPTOR>
                <USAGES>
                  <USAGE>CODEGENERATION</USAGE>
                </USAGES>
              </DEPENDENCY-ON-ARTIFACT>
            </GENERATED-ARTIFACTS>
            <PROGRAMMING-LANGUAGE>C</PROGRAMMING-LANGUAGE>
            <RESOURCE-CONSUMPTION>
              <SHORT-NAME>ResourceConsumption</SHORT-NAME>
              <MEMORY-SECTIONS>
[!FOR "CoreIndx" = "0" TO "$MaxCore - '1'"!][!//
[!VAR "CheckText" = "text:toupper(concat('CORE',$CoreIndx))"!][!//
[!IF "text:contains( text:split($CGAllocCore,','), $CheckText )"!][!//
                <MEMORY-SECTION>
                  <SHORT-NAME>VAR_CLEARED_QM_[!"$CheckText"!]_UNSPECIFIED</SHORT-NAME>
                  <ALIGNMENT>UNSPECIFIED</ALIGNMENT>
                  <SW-ADDRMETHOD-REF DEST="SW-ADDR-METHOD">/AUTOSAR_MemMap/SwAddrMethods/VAR_CLEARED</SW-ADDRMETHOD-REF>
                </MEMORY-SECTION>
                <MEMORY-SECTION>
                  <SHORT-NAME>VAR_INIT_QM_[!"$CheckText"!]_UNSPECIFIED</SHORT-NAME>
                  <ALIGNMENT>UNSPECIFIED</ALIGNMENT>
                  <SW-ADDRMETHOD-REF DEST="SW-ADDR-METHOD">/AUTOSAR_MemMap/SwAddrMethods/VAR_INIT</SW-ADDRMETHOD-REF>
                </MEMORY-SECTION>
[!ENDIF!][!//
[!ENDFOR!][!//
                <MEMORY-SECTION>
                  <SHORT-NAME>VAR_CLEARED_QM_GLOBAL_UNSPECIFIED</SHORT-NAME>
                  <ALIGNMENT>UNSPECIFIED</ALIGNMENT>
                  <SW-ADDRMETHOD-REF DEST="SW-ADDR-METHOD">/AUTOSAR_MemMap/SwAddrMethods/VAR_CLEARED</SW-ADDRMETHOD-REF>
                </MEMORY-SECTION>

                <MEMORY-SECTION>
                  <SHORT-NAME>CONST_QM_GLOBAL_UNSPECIFIED</SHORT-NAME>
                  <ALIGNMENT>UNSPECIFIED</ALIGNMENT>
                  <SW-ADDRMETHOD-REF DEST="SW-ADDR-METHOD">/AUTOSAR_MemMap/SwAddrMethods/CONST</SW-ADDRMETHOD-REF>
                </MEMORY-SECTION>
[!FOR "CoreIndx" = "0" TO "$MaxCore - '1'"!][!//
[!VAR "CheckText" = "text:toupper(concat('CORE',$CoreIndx))"!][!//
[!IF "text:contains( text:split($CGAllocCore,','), $CheckText )"!][!//
                <MEMORY-SECTION>
                  <SHORT-NAME>CONST_QM_[!"$CheckText"!]_UNSPECIFIED</SHORT-NAME>
                  <ALIGNMENT>UNSPECIFIED</ALIGNMENT>
                  <SW-ADDRMETHOD-REF DEST="SW-ADDR-METHOD">/AUTOSAR_MemMap/SwAddrMethods/CONST</SW-ADDRMETHOD-REF>
                </MEMORY-SECTION>
[!ENDIF!][!//
[!ENDFOR!][!//
                <MEMORY-SECTION>
                  <SHORT-NAME>CONFIG_DATA_QM_GLOBAL_UNSPECIFIED</SHORT-NAME>
                  <ALIGNMENT>UNSPECIFIED</ALIGNMENT>
                  <SW-ADDRMETHOD-REF DEST="SW-ADDR-METHOD">/AUTOSAR_MemMap/SwAddrMethods/CONFIG_DATA</SW-ADDRMETHOD-REF>
                </MEMORY-SECTION>
[!FOR "CoreIndx" = "0" TO "$MaxCore - '1'"!][!//
[!VAR "CheckText" = "text:toupper(concat('CORE',$CoreIndx))"!][!//
[!IF "text:contains( text:split($CGAllocCore,','), $CheckText )"!][!//
                <MEMORY-SECTION>
                  <SHORT-NAME>CONFIG_DATA_QM_[!"$CheckText"!]_UNSPECIFIED</SHORT-NAME>
                  <ALIGNMENT>UNSPECIFIED</ALIGNMENT>
                  <SW-ADDRMETHOD-REF DEST="SW-ADDR-METHOD">/AUTOSAR_MemMap/SwAddrMethods/CONFIG_DATA</SW-ADDRMETHOD-REF>
                </MEMORY-SECTION>
[!ENDIF!][!//
[!ENDFOR!][!//
                <MEMORY-SECTION>
                  <SHORT-NAME>CODE_QM_GLOBAL</SHORT-NAME>
                  <ALIGNMENT>UNSPECIFIED</ALIGNMENT>
                  <SW-ADDRMETHOD-REF DEST="SW-ADDR-METHOD">/AUTOSAR_MemMap/SwAddrMethods/CODE</SW-ADDRMETHOD-REF>
                </MEMORY-SECTION>
              </MEMORY-SECTIONS>
              <SECTION-NAME-PREFIXS>
                <SECTION-NAME-PREFIX>
                  <SHORT-NAME>CAN_17_MCMCAN</SHORT-NAME>
                  <SYMBOL>CAN_17_MCMCAN</SYMBOL>
                </SECTION-NAME-PREFIX>
              </SECTION-NAME-PREFIXS>
            </RESOURCE-CONSUMPTION>
            <SW-VERSION>20.25.0</SW-VERSION>
            <VENDOR-ID>17</VENDOR-ID>
            [!IF "$MinorVersion = num:i(2)"!][!//
            <AR-RELEASE-VERSION>4.2.2</AR-RELEASE-VERSION>
            [!ELSE!][!//
            <AR-RELEASE-VERSION>4.4.0</AR-RELEASE-VERSION>
            [!ENDIF!][!//
            <BEHAVIOR-REF DEST="BSW-INTERNAL-BEHAVIOR">/AUTOSAR_Can_17_McmCan/BswModuleDescriptions/Can/CanBehavior</BEHAVIOR-REF>
            <VENDOR-API-INFIX>McmCan</VENDOR-API-INFIX>
            <VENDOR-SPECIFIC-MODULE-DEF-REFS>
              <VENDOR-SPECIFIC-MODULE-DEF-REF DEST="ECUC-MODULE-DEF">/AURIX2G/EcucDefs/Can</VENDOR-SPECIFIC-MODULE-DEF-REF>
            </VENDOR-SPECIFIC-MODULE-DEF-REFS>
          </BSW-IMPLEMENTATION>
        </ELEMENTS>
      </AR-PACKAGE>
      <AR-PACKAGE>
        <SHORT-NAME>ImplementationDataTypes</SHORT-NAME>
        <CATEGORY>STANDARD</CATEGORY>
        <ELEMENTS>
        <IMPLEMENTATION-DATA-TYPE>
      <SHORT-NAME>Can_17_McmCan_LPduRxCalloutFnPtrType</SHORT-NAME>
      <CATEGORY>FUNCTION_REFERENCE</CATEGORY>
      <INTRODUCTION>
        <NOTE SI="This data type is for a function pointer type pointing to the callback-notification function. The referred function should be implemented by user of the driver" NOTE-TYPE="HINT"/>
      </INTRODUCTION>
      <SW-DATA-DEF-PROPS>
        <SW-DATA-DEF-PROPS-VARIANTS>
          <SW-DATA-DEF-PROPS-CONDITIONAL>
            <SW-POINTER-TARGET-PROPS>
                    <FUNCTION-POINTER-SIGNATURE-REF DEST="BSW-MODULE-ENTRY">/AUTOSAR_Stub/BswModuleEntrys/Can_LpduCallout</FUNCTION-POINTER-SIGNATURE-REF>
            </SW-POINTER-TARGET-PROPS>
          </SW-DATA-DEF-PROPS-CONDITIONAL>
        </SW-DATA-DEF-PROPS-VARIANTS>
      </SW-DATA-DEF-PROPS>
      <TYPE-EMITTER>BSW</TYPE-EMITTER>
    </IMPLEMENTATION-DATA-TYPE>
    <IMPLEMENTATION-DATA-TYPE>
      <SHORT-NAME>Can_17_Mcmcan_DrvStateMachine</SHORT-NAME>
      <CATEGORY>TYPE_REFERENCE</CATEGORY>
      <SW-DATA-DEF-PROPS>
        <SW-DATA-DEF-PROPS-VARIANTS>
          <SW-DATA-DEF-PROPS-CONDITIONAL>
            <COMPU-METHOD-REF DEST="COMPU-METHOD">/AUTOSAR_Can_17_McmCan/CompuMethods/Can_17_Mcmcan_DrvStateMachine</COMPU-METHOD-REF>
            <IMPLEMENTATION-DATA-TYPE-REF DEST="IMPLEMENTATION-DATA-TYPE">/AUTOSAR_Platform/ImplementationDataTypes/uint32</IMPLEMENTATION-DATA-TYPE-REF>
            <SW-IMPL-POLICY>STANDARD</SW-IMPL-POLICY>
            <ADDITIONAL-NATIVE-TYPE-QUALIFIER>enum</ADDITIONAL-NATIVE-TYPE-QUALIFIER>
          </SW-DATA-DEF-PROPS-CONDITIONAL>
        </SW-DATA-DEF-PROPS-VARIANTS>
      </SW-DATA-DEF-PROPS>
      <TYPE-EMITTER>BSW</TYPE-EMITTER>
    </IMPLEMENTATION-DATA-TYPE>
    <IMPLEMENTATION-DATA-TYPE>
      <SHORT-NAME>Can_17_McmCan_EventIndicesType</SHORT-NAME>
      <CATEGORY>TYPE_REFERENCE</CATEGORY>
      <SW-DATA-DEF-PROPS>
        <SW-DATA-DEF-PROPS-VARIANTS>
          <SW-DATA-DEF-PROPS-CONDITIONAL>
            <COMPU-METHOD-REF DEST="COMPU-METHOD">/AUTOSAR_Can_17_McmCan/CompuMethods/Can_17_McmCan_EventIndicesType</COMPU-METHOD-REF>
            <IMPLEMENTATION-DATA-TYPE-REF DEST="IMPLEMENTATION-DATA-TYPE">/AUTOSAR_Platform/ImplementationDataTypes/uint32</IMPLEMENTATION-DATA-TYPE-REF>
            <SW-IMPL-POLICY>STANDARD</SW-IMPL-POLICY>
            <ADDITIONAL-NATIVE-TYPE-QUALIFIER>enum</ADDITIONAL-NATIVE-TYPE-QUALIFIER>
          </SW-DATA-DEF-PROPS-CONDITIONAL>
        </SW-DATA-DEF-PROPS-VARIANTS>
      </SW-DATA-DEF-PROPS>
      <TYPE-EMITTER>BSW</TYPE-EMITTER>
    </IMPLEMENTATION-DATA-TYPE>
    <IMPLEMENTATION-DATA-TYPE>
      <SHORT-NAME>Can_17_McmCan_IDType</SHORT-NAME>
      <CATEGORY>TYPE_REFERENCE</CATEGORY>
      <SW-DATA-DEF-PROPS>
        <SW-DATA-DEF-PROPS-VARIANTS>
          <SW-DATA-DEF-PROPS-CONDITIONAL>
            <COMPU-METHOD-REF DEST="COMPU-METHOD">/AUTOSAR_Can_17_McmCan/CompuMethods/Can_17_McmCan_IDType</COMPU-METHOD-REF>
            <IMPLEMENTATION-DATA-TYPE-REF DEST="IMPLEMENTATION-DATA-TYPE">/AUTOSAR_Platform/ImplementationDataTypes/uint32</IMPLEMENTATION-DATA-TYPE-REF>
            <SW-IMPL-POLICY>STANDARD</SW-IMPL-POLICY>
            <ADDITIONAL-NATIVE-TYPE-QUALIFIER>enum</ADDITIONAL-NATIVE-TYPE-QUALIFIER>
          </SW-DATA-DEF-PROPS-CONDITIONAL>
        </SW-DATA-DEF-PROPS-VARIANTS>
      </SW-DATA-DEF-PROPS>
      <TYPE-EMITTER>BSW</TYPE-EMITTER>
    </IMPLEMENTATION-DATA-TYPE>
    <IMPLEMENTATION-DATA-TYPE>
      <SHORT-NAME>Can_17_McmCan_MOMapType</SHORT-NAME>
      <CATEGORY>TYPE_REFERENCE</CATEGORY>
      <SW-DATA-DEF-PROPS>
        <SW-DATA-DEF-PROPS-VARIANTS>
          <SW-DATA-DEF-PROPS-CONDITIONAL>
            <COMPU-METHOD-REF DEST="COMPU-METHOD">/AUTOSAR_Can_17_McmCan/CompuMethods/Can_17_McmCan_MOMapType</COMPU-METHOD-REF>
            <IMPLEMENTATION-DATA-TYPE-REF DEST="IMPLEMENTATION-DATA-TYPE">/AUTOSAR_Platform/ImplementationDataTypes/uint32</IMPLEMENTATION-DATA-TYPE-REF>
            <SW-IMPL-POLICY>STANDARD</SW-IMPL-POLICY>
            <ADDITIONAL-NATIVE-TYPE-QUALIFIER>enum</ADDITIONAL-NATIVE-TYPE-QUALIFIER>
          </SW-DATA-DEF-PROPS-CONDITIONAL>
        </SW-DATA-DEF-PROPS-VARIANTS>
      </SW-DATA-DEF-PROPS>
      <TYPE-EMITTER>BSW</TYPE-EMITTER>
    </IMPLEMENTATION-DATA-TYPE>
    <IMPLEMENTATION-DATA-TYPE>
      <SHORT-NAME>Can_17_McmCan_MsgRamMapType</SHORT-NAME>
      <CATEGORY>TYPE_REFERENCE</CATEGORY>
      <SW-DATA-DEF-PROPS>
        <SW-DATA-DEF-PROPS-VARIANTS>
          <SW-DATA-DEF-PROPS-CONDITIONAL>
            <COMPU-METHOD-REF DEST="COMPU-METHOD">/AUTOSAR_Can_17_McmCan/CompuMethods/Can_17_McmCan_MsgRamMapType</COMPU-METHOD-REF>
            <IMPLEMENTATION-DATA-TYPE-REF DEST="IMPLEMENTATION-DATA-TYPE">/AUTOSAR_Platform/ImplementationDataTypes/uint32</IMPLEMENTATION-DATA-TYPE-REF>
            <SW-IMPL-POLICY>STANDARD</SW-IMPL-POLICY>
            <ADDITIONAL-NATIVE-TYPE-QUALIFIER>enum</ADDITIONAL-NATIVE-TYPE-QUALIFIER>
          </SW-DATA-DEF-PROPS-CONDITIONAL>
        </SW-DATA-DEF-PROPS-VARIANTS>
      </SW-DATA-DEF-PROPS>
      <TYPE-EMITTER>BSW</TYPE-EMITTER>
    </IMPLEMENTATION-DATA-TYPE>
    <IMPLEMENTATION-DATA-TYPE>
      <SHORT-NAME>Can_17_McmCan_ProcessingType</SHORT-NAME>
      <CATEGORY>TYPE_REFERENCE</CATEGORY>
      <SW-DATA-DEF-PROPS>
        <SW-DATA-DEF-PROPS-VARIANTS>
          <SW-DATA-DEF-PROPS-CONDITIONAL>
            <COMPU-METHOD-REF DEST="COMPU-METHOD">/AUTOSAR_Can_17_McmCan/CompuMethods/Can_17_McmCan_ProcessingType</COMPU-METHOD-REF>
            <IMPLEMENTATION-DATA-TYPE-REF DEST="IMPLEMENTATION-DATA-TYPE">/AUTOSAR_Platform/ImplementationDataTypes/uint32</IMPLEMENTATION-DATA-TYPE-REF>
            <SW-IMPL-POLICY>STANDARD</SW-IMPL-POLICY>
            <ADDITIONAL-NATIVE-TYPE-QUALIFIER>enum</ADDITIONAL-NATIVE-TYPE-QUALIFIER>
          </SW-DATA-DEF-PROPS-CONDITIONAL>
        </SW-DATA-DEF-PROPS-VARIANTS>
      </SW-DATA-DEF-PROPS>
      <TYPE-EMITTER>BSW</TYPE-EMITTER>
    </IMPLEMENTATION-DATA-TYPE>
    <IMPLEMENTATION-DATA-TYPE>
      <SHORT-NAME>Can_17_McmCan_RxFIFOProcessingType</SHORT-NAME>
      <CATEGORY>TYPE_REFERENCE</CATEGORY>
      <SW-DATA-DEF-PROPS>
        <SW-DATA-DEF-PROPS-VARIANTS>
          <SW-DATA-DEF-PROPS-CONDITIONAL>
            <COMPU-METHOD-REF DEST="COMPU-METHOD">/AUTOSAR_Can_17_McmCan/CompuMethods/Can_17_McmCan_RxFIFOProcessingType</COMPU-METHOD-REF>
            <IMPLEMENTATION-DATA-TYPE-REF DEST="IMPLEMENTATION-DATA-TYPE">/AUTOSAR_Platform/ImplementationDataTypes/uint32</IMPLEMENTATION-DATA-TYPE-REF>
            <SW-IMPL-POLICY>STANDARD</SW-IMPL-POLICY>
            <ADDITIONAL-NATIVE-TYPE-QUALIFIER>enum</ADDITIONAL-NATIVE-TYPE-QUALIFIER>
          </SW-DATA-DEF-PROPS-CONDITIONAL>
        </SW-DATA-DEF-PROPS-VARIANTS>
      </SW-DATA-DEF-PROPS>
      <TYPE-EMITTER>BSW</TYPE-EMITTER>
    </IMPLEMENTATION-DATA-TYPE>
    <IMPLEMENTATION-DATA-TYPE>
      <SHORT-NAME>Can_17_McmCan_TxBufferType</SHORT-NAME>
      <CATEGORY>TYPE_REFERENCE</CATEGORY>
      <SW-DATA-DEF-PROPS>
        <SW-DATA-DEF-PROPS-VARIANTS>
          <SW-DATA-DEF-PROPS-CONDITIONAL>
            <COMPU-METHOD-REF DEST="COMPU-METHOD">/AUTOSAR_Can_17_McmCan/CompuMethods/Can_17_McmCan_TxBufferType</COMPU-METHOD-REF>
            <IMPLEMENTATION-DATA-TYPE-REF DEST="IMPLEMENTATION-DATA-TYPE">/AUTOSAR_Platform/ImplementationDataTypes/uint32</IMPLEMENTATION-DATA-TYPE-REF>
            <SW-IMPL-POLICY>STANDARD</SW-IMPL-POLICY>
            <ADDITIONAL-NATIVE-TYPE-QUALIFIER>enum</ADDITIONAL-NATIVE-TYPE-QUALIFIER>
          </SW-DATA-DEF-PROPS-CONDITIONAL>
        </SW-DATA-DEF-PROPS-VARIANTS>
      </SW-DATA-DEF-PROPS>
      <TYPE-EMITTER>BSW</TYPE-EMITTER>
    </IMPLEMENTATION-DATA-TYPE>
    <IMPLEMENTATION-DATA-TYPE>
      <SHORT-NAME>Can_17_McmCan_RxBufferType</SHORT-NAME>
      <CATEGORY>TYPE_REFERENCE</CATEGORY>
      <SW-DATA-DEF-PROPS>
        <SW-DATA-DEF-PROPS-VARIANTS>
          <SW-DATA-DEF-PROPS-CONDITIONAL>
            <COMPU-METHOD-REF DEST="COMPU-METHOD">/AUTOSAR_Can_17_McmCan/CompuMethods/Can_17_McmCan_RxBufferType</COMPU-METHOD-REF>
            <IMPLEMENTATION-DATA-TYPE-REF DEST="IMPLEMENTATION-DATA-TYPE">/AUTOSAR_Platform/ImplementationDataTypes/uint32</IMPLEMENTATION-DATA-TYPE-REF>
            <SW-IMPL-POLICY>STANDARD</SW-IMPL-POLICY>
            <ADDITIONAL-NATIVE-TYPE-QUALIFIER>enum</ADDITIONAL-NATIVE-TYPE-QUALIFIER>
          </SW-DATA-DEF-PROPS-CONDITIONAL>
        </SW-DATA-DEF-PROPS-VARIANTS>
      </SW-DATA-DEF-PROPS>
      <TYPE-EMITTER>BSW</TYPE-EMITTER>
    </IMPLEMENTATION-DATA-TYPE>
    <IMPLEMENTATION-DATA-TYPE>
      <SHORT-NAME>Can_17_McmCan_IcomSignalOperType</SHORT-NAME>
      <CATEGORY>TYPE_REFERENCE</CATEGORY>
      <SW-DATA-DEF-PROPS>
        <SW-DATA-DEF-PROPS-VARIANTS>
          <SW-DATA-DEF-PROPS-CONDITIONAL>
            <COMPU-METHOD-REF DEST="COMPU-METHOD">/AUTOSAR_Can_17_McmCan/CompuMethods/Can_17_McmCan_IcomSignalOperType</COMPU-METHOD-REF>
            <IMPLEMENTATION-DATA-TYPE-REF DEST="IMPLEMENTATION-DATA-TYPE">/AUTOSAR_Platform/ImplementationDataTypes/uint32</IMPLEMENTATION-DATA-TYPE-REF>
            <SW-IMPL-POLICY>STANDARD</SW-IMPL-POLICY>
            <ADDITIONAL-NATIVE-TYPE-QUALIFIER>enum</ADDITIONAL-NATIVE-TYPE-QUALIFIER>
          </SW-DATA-DEF-PROPS-CONDITIONAL>
        </SW-DATA-DEF-PROPS-VARIANTS>
      </SW-DATA-DEF-PROPS>
      <TYPE-EMITTER>BSW</TYPE-EMITTER>
    </IMPLEMENTATION-DATA-TYPE>
          <IMPLEMENTATION-DATA-TYPE>
            <SHORT-NAME>Can_17_McmCan_ControllerBaudrateConfigType</SHORT-NAME>
            <CATEGORY>STRUCTURE</CATEGORY>
            <SUB-ELEMENTS>
              <IMPLEMENTATION-DATA-TYPE-ELEMENT>
                <SHORT-NAME>CanBaudrateCfg</SHORT-NAME>
                <CATEGORY>TYPE_REFERENCE</CATEGORY>
                <SW-DATA-DEF-PROPS>
                  <SW-DATA-DEF-PROPS-VARIANTS>
                    <SW-DATA-DEF-PROPS-CONDITIONAL>
                      <IMPLEMENTATION-DATA-TYPE-REF DEST="IMPLEMENTATION-DATA-TYPE">/AUTOSAR_Platform/ImplementationDataTypes/uint16</IMPLEMENTATION-DATA-TYPE-REF>
                    </SW-DATA-DEF-PROPS-CONDITIONAL>
                  </SW-DATA-DEF-PROPS-VARIANTS>
                </SW-DATA-DEF-PROPS>
              </IMPLEMENTATION-DATA-TYPE-ELEMENT>
              <IMPLEMENTATION-DATA-TYPE-ELEMENT>
                <SHORT-NAME>CanControllerBaudrate</SHORT-NAME>
                <CATEGORY>TYPE_REFERENCE</CATEGORY>
                <SW-DATA-DEF-PROPS>
                  <SW-DATA-DEF-PROPS-VARIANTS>
                    <SW-DATA-DEF-PROPS-CONDITIONAL>
                      <IMPLEMENTATION-DATA-TYPE-REF DEST="IMPLEMENTATION-DATA-TYPE">/AUTOSAR_Platform/ImplementationDataTypes/uint32</IMPLEMENTATION-DATA-TYPE-REF>
                    </SW-DATA-DEF-PROPS-CONDITIONAL>
                  </SW-DATA-DEF-PROPS-VARIANTS>
                </SW-DATA-DEF-PROPS>
              </IMPLEMENTATION-DATA-TYPE-ELEMENT>
[!IF "$FDNodesPresentVal = 0"!][!//
              <IMPLEMENTATION-DATA-TYPE-ELEMENT>
                <SHORT-NAME>CanFDIndex</SHORT-NAME>
                <CATEGORY>TYPE_REFERENCE</CATEGORY>
                <SW-DATA-DEF-PROPS>
                  <SW-DATA-DEF-PROPS-VARIANTS>
                    <SW-DATA-DEF-PROPS-CONDITIONAL>
                      <IMPLEMENTATION-DATA-TYPE-REF DEST="IMPLEMENTATION-DATA-TYPE">/AUTOSAR_Platform/ImplementationDataTypes/uint16</IMPLEMENTATION-DATA-TYPE-REF>
                    </SW-DATA-DEF-PROPS-CONDITIONAL>
                  </SW-DATA-DEF-PROPS-VARIANTS>
                </SW-DATA-DEF-PROPS>
              </IMPLEMENTATION-DATA-TYPE-ELEMENT>
              <IMPLEMENTATION-DATA-TYPE-ELEMENT>
                <SHORT-NAME>CanFdConfigEnabled</SHORT-NAME>
                <CATEGORY>TYPE_REFERENCE</CATEGORY>
                <SW-DATA-DEF-PROPS>
                  <SW-DATA-DEF-PROPS-VARIANTS>
                    <SW-DATA-DEF-PROPS-CONDITIONAL>
                      <IMPLEMENTATION-DATA-TYPE-REF DEST="IMPLEMENTATION-DATA-TYPE">/AUTOSAR_Platform/ImplementationDataTypes/boolean</IMPLEMENTATION-DATA-TYPE-REF>
                    </SW-DATA-DEF-PROPS-CONDITIONAL>
                  </SW-DATA-DEF-PROPS-VARIANTS>
                </SW-DATA-DEF-PROPS>
              </IMPLEMENTATION-DATA-TYPE-ELEMENT>
[!ENDIF!][!//
            </SUB-ELEMENTS>
            <TYPE-EMITTER>BSW</TYPE-EMITTER>
          </IMPLEMENTATION-DATA-TYPE>
