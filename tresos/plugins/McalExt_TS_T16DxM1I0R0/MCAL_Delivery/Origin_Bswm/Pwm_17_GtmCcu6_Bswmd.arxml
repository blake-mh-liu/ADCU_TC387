<?xml version="1.0" encoding="UTF-8"?>
[!/*<!--
/*******************************************************************************
**                                                                            **
** Copyright (C) Infineon Technologies (2022)                                 **
**                                                                            **
** All rights reserved.                                                       **
**                                                                            **
** This document contains proprietary information belonging to Infineon       **
** Technologies. Passing on and copying of this document, and communication   **
** of its contents is not permitted without prior written authorization.      **
**                                                                            **
********************************************************************************
**                                                                            **
**  FILENAME  : Pwm_17_GtmCcu6_Bswmd.arxml                                    **
**                                                                            **
**  VERSION   : 25.0.0                                                        **
**                                                                            **
**  DATE      : 2022-06-17                                                    **
**                                                                            **
**  VARIANT   : Variant PB                                                    **
**                                                                            **
**  PLATFORM  : Infineon AURIX2G                                              **
**                                                                            **
**  AUTHOR    : DL-AUTOSAR-Engineering                                        **
**                                                                            **
**  VENDOR    : Infineon Technologies                                         **
**                                                                            **
**  TRACEABILITY :                                                            **
**                                                                            **
**  DESCRIPTION  : Basic Software Module Description for Pwm driver           **
**                                                                            **
**  SPECIFICATION(S) : Specification of PWM Driver                            **
**                                                                            **
**  MAY BE CHANGED BY USER : no                                               **
**                                                                            **
*******************************************************************************/
-->*/!]
<!--
/*******************************************************************************
**                                                                            **
** Copyright (C) Infineon Technologies (2022)                                 **
**                                                                            **
** All rights reserved.                                                       **
**                                                                            **
** This document contains proprietary information belonging to Infineon       **
** Technologies. Passing on and copying of this document, and communication   **
** of its contents is not permitted without prior written authorization.      **
**                                                                            **
********************************************************************************
**                                                                            **
**  FILENAME  : Pwm_17_GtmCcu6_Bswmd.arxml                                    **
**                                                                            **
**  VERSION   : 25.0.0                                                        **
**                                                                            **
**  DATE, TIME: [!"$date"!], [!"$time"!]               !!!IGNORE-LINE!!!          **
**                                                                            **
**  GENERATOR : Build [!"$buildnr"!]                 !!!IGNORE-LINE!!!          **
**                                                                            **
**  VARIANT   : Variant PB                                                    **
**                                                                            **
**  PLATFORM  : Infineon AURIX2G                                              **
**                                                                            **
**  AUTHOR    : DL-AUTOSAR-Engineering                                        **
**                                                                            **
**  VENDOR    : Infineon Technologies                                         **
**                                                                            **
**  DESCRIPTION  : Basic Software Module Description for Pwm Driver           **
**                                                                            **
**  SPECIFICATION(S) : Specification of Pwm Driver                            **
**                                                                            **
**  MAY BE CHANGED BY USER : no                                               **
**                                                                            **
*******************************************************************************/
-->
[!/*<!-- [cover parentID={27410683-A7B5-4d53-8B64-BDEDE0232B4B}] BSWMD Arxml File [/cover] -->*/!]
[!/*<!-- [cover parentID={7E2559B5-A4E1-4606-ACAD-B20137D127E0}] AUTOSAR format module description file. [/cover] -->*/!]
[!NOCODE!][!//
  [!VAR "MinorVersion" = "text:split($moduleReleaseVer, '.')[position()-1 = 1]"!][!//
[!ENDNOCODE!][!//
[!IF "$MinorVersion = num:i(2)"!][!//
<AUTOSAR xmlns="http://autosar.org/schema/r4.0" xmlns:xsi="http://www.w3.org/2001/XMLSchema-instance" xsi:schemaLocation="http://autosar.org/schema/r4.0 AUTOSAR_4-2-2.xsd">
[!ELSE!][!//
<AUTOSAR xmlns="http://autosar.org/schema/r4.0" xmlns:xsi="http://www.w3.org/2001/XMLSchema-instance" xsi:schemaLocation="http://autosar.org/schema/r4.0 AUTOSAR_00046.xsd">
[!ENDIF!][!//
[!AUTOSPACING!][!//
[!NOCODE!]
  [!SELECT "as:modconf('Pwm')[1]"!][!//
    [!INCLUDE "Pwm_17_GtmCcu6.m"!][!//
    [!VAR "MaxChannels"= "num:i(count(PwmChannelConfigSet/PwmChannel/*))"!][!//
    [!VAR "PwmDeInitApi_Var" = "PwmConfigurationOfOptApiServices/PwmDeInitApi"!][!//
    [!VAR "PwmGetOutputState_Var" = "PwmConfigurationOfOptApiServices/PwmGetOutputState"!][!//
    [!VAR "PwmSetDutyCycle_Var" = "PwmConfigurationOfOptApiServices/PwmSetDutyCycle"!][!//
    [!VAR "PwmSetOutputToIdle_Var" = "PwmConfigurationOfOptApiServices/PwmSetOutputToIdle"!][!//
    [!VAR "PwmSetPeriodAndDuty_Var" = "PwmConfigurationOfOptApiServices/PwmSetPeriodAndDuty"!][!//
    [!VAR "PwmVersionInfoApi_Var" = "PwmConfigurationOfOptApiServices/PwmVersionInfoApi"!][!//
    [!VAR "PwmNotificationSupported_Var" = "PwmGeneral/PwmNotificationSupported"!][!//
    [!VAR "PwmShifInTicks_Var" = "PwmGeneral/PwmDutyShiftInTicks"!][!//
    [!VAR "PwmSafetyEnable_Var" = "PwmGeneral/PwmSafetyEnable"!][!//
    [!VAR "PwmDevErrorDetect_Var" = "PwmGeneral/PwmDevErrorDetect"!][!//
    [!VAR "PwmCore0Idx" = "num:i(0)"!][!//
    [!VAR "PwmCore1Idx" = "num:i(0)"!][!//
    [!VAR "PwmCore2Idx" = "num:i(0)"!][!//
    [!VAR "PwmCore3Idx" = "num:i(0)"!][!//
    [!VAR "PwmCore4Idx" = "num:i(0)"!][!//
    [!VAR "PwmCore5Idx" = "num:i(0)"!][!//
    [!CALL "PWM_GenerateModuleMap", "Module" = "'PWM'"!][!//
    [!FOR "ChannelId" = "num:i(0)" TO "num:i($MaxChannels) - num:i(1)"!][!//
      [!SELECT "PwmChannelConfigSet/PwmChannel/*[PwmChannelId = num:i($ChannelId)]"!][!//
        [!VAR "NodeName" = "node:name(.)"!][!//
        [!FOR "CoreId" = "num:i(0)" TO "num:i(ecu:get('Mcu.NoOfCoreAvailable')) - num:i(1)"!][!//
          [!CALL "PWM_ValidateChAllocation", "CoreNumber" = "$CoreId", "Channel" = "$NodeName"!][!//
          [!IF "$CGAllocationResult = 'TRUE'"!][!//
            [!IF "$CoreId = num:i(0)"!][!//
              [!VAR "PwmCore0Idx" = "$PwmCore0Idx+num:i(1)"!][!//
            [!ELSEIF "$CoreId = num:i(1)"!][!//
              [!VAR "PwmCore1Idx" = "$PwmCore1Idx+num:i(1)"!][!//
            [!ELSEIF "$CoreId = num:i(2)"!][!//
              [!VAR "PwmCore2Idx" = "$PwmCore2Idx+num:i(1)"!][!//
            [!ELSEIF "$CoreId = num:i(3)"!][!//
              [!VAR "PwmCore3Idx" = "$PwmCore3Idx+num:i(1)"!][!//
            [!ELSEIF "$CoreId = num:i(4)"!][!//
              [!VAR "PwmCore4Idx" = "$PwmCore4Idx+num:i(1)"!][!//
            [!ELSEIF "$CoreId = num:i(5)"!][!//
              [!VAR "PwmCore5Idx" = "$PwmCore5Idx+num:i(1)"!][!//
            [!ELSE!]
            [!ENDIF!][!//
          [!ENDIF!][!//
        [!ENDFOR!][!//
      [!ENDSELECT!][!//
    [!ENDFOR!][!//
  [!ENDSELECT!][!//
  [!VAR "GtmAvailable" = "ecu:get('Gtm.Available')"!][!//
[!ENDNOCODE!]
  <AR-PACKAGES>
    <AR-PACKAGE>
      <SHORT-NAME>AUTOSAR_Pwm_17_GtmCcu6</SHORT-NAME>
      <AR-PACKAGES>
        <AR-PACKAGE>
          <SHORT-NAME>BswModuleDescriptions</SHORT-NAME>
          <CATEGORY>STANDARD</CATEGORY>
          <ELEMENTS>
            <BSW-MODULE-DESCRIPTION>
              <SHORT-NAME>Pwm</SHORT-NAME>
              <LONG-NAME>
                <L-4 L="EN">PWM Driver</L-4>
              </LONG-NAME>
              <CATEGORY>BSW_MODULE</CATEGORY>
              <MODULE-ID>121</MODULE-ID>
              <PROVIDED-ENTRYS>
                <BSW-MODULE-ENTRY-REF-CONDITIONAL>
                  <BSW-MODULE-ENTRY-REF DEST="BSW-MODULE-ENTRY">/AUTOSAR_Pwm_17_GtmCcu6/BswModuleEntrys/Pwm_Init</BSW-MODULE-ENTRY-REF>
                </BSW-MODULE-ENTRY-REF-CONDITIONAL>
[!IF "$PwmDeInitApi_Var = 'true'"!]
                <BSW-MODULE-ENTRY-REF-CONDITIONAL>
                  <BSW-MODULE-ENTRY-REF DEST="BSW-MODULE-ENTRY">/AUTOSAR_Pwm_17_GtmCcu6/BswModuleEntrys/Pwm_DeInit</BSW-MODULE-ENTRY-REF>
                </BSW-MODULE-ENTRY-REF-CONDITIONAL>
[!ENDIF!][!//
[!IF "$PwmSetDutyCycle_Var = 'true'"!]
                <BSW-MODULE-ENTRY-REF-CONDITIONAL>
                  <BSW-MODULE-ENTRY-REF DEST="BSW-MODULE-ENTRY">/AUTOSAR_Pwm_17_GtmCcu6/BswModuleEntrys/Pwm_SetDutyCycle</BSW-MODULE-ENTRY-REF>
                </BSW-MODULE-ENTRY-REF-CONDITIONAL>
[!ENDIF!][!//
[!IF "$PwmSetPeriodAndDuty_Var = 'true'"!]
                <BSW-MODULE-ENTRY-REF-CONDITIONAL>
                  <BSW-MODULE-ENTRY-REF DEST="BSW-MODULE-ENTRY">/AUTOSAR_Pwm_17_GtmCcu6/BswModuleEntrys/Pwm_SetPeriodAndDuty</BSW-MODULE-ENTRY-REF>
                </BSW-MODULE-ENTRY-REF-CONDITIONAL>
[!ENDIF!][!//
[!IF "$PwmSetOutputToIdle_Var = 'true'"!]
                <BSW-MODULE-ENTRY-REF-CONDITIONAL>
                  <BSW-MODULE-ENTRY-REF DEST="BSW-MODULE-ENTRY">/AUTOSAR_Pwm_17_GtmCcu6/BswModuleEntrys/Pwm_SetOutputToIdle</BSW-MODULE-ENTRY-REF>
                </BSW-MODULE-ENTRY-REF-CONDITIONAL>
[!ENDIF!][!//
[!IF "$PwmGetOutputState_Var = 'true'"!]
                <BSW-MODULE-ENTRY-REF-CONDITIONAL>
                  <BSW-MODULE-ENTRY-REF DEST="BSW-MODULE-ENTRY">/AUTOSAR_Pwm_17_GtmCcu6/BswModuleEntrys/Pwm_GetOutputState</BSW-MODULE-ENTRY-REF>
                </BSW-MODULE-ENTRY-REF-CONDITIONAL>
[!ENDIF!][!//
[!IF "$PwmNotificationSupported_Var = 'true'"!]
                <BSW-MODULE-ENTRY-REF-CONDITIONAL>
                  <BSW-MODULE-ENTRY-REF DEST="BSW-MODULE-ENTRY">/AUTOSAR_Pwm_17_GtmCcu6/BswModuleEntrys/Pwm_DisableNotification</BSW-MODULE-ENTRY-REF>
                </BSW-MODULE-ENTRY-REF-CONDITIONAL>
[!ENDIF!][!//
[!IF "$PwmNotificationSupported_Var = 'true'"!]
                <BSW-MODULE-ENTRY-REF-CONDITIONAL>
                  <BSW-MODULE-ENTRY-REF DEST="BSW-MODULE-ENTRY">/AUTOSAR_Pwm_17_GtmCcu6/BswModuleEntrys/Pwm_EnableNotification</BSW-MODULE-ENTRY-REF>
                </BSW-MODULE-ENTRY-REF-CONDITIONAL>
[!ENDIF!][!//
[!IF "$PwmVersionInfoApi_Var = 'true'"!]
                <BSW-MODULE-ENTRY-REF-CONDITIONAL>
                  <BSW-MODULE-ENTRY-REF DEST="BSW-MODULE-ENTRY">/AUTOSAR_Pwm_17_GtmCcu6/BswModuleEntrys/Pwm_GetVersionInfo</BSW-MODULE-ENTRY-REF>
                </BSW-MODULE-ENTRY-REF-CONDITIONAL>
[!ENDIF!][!//
                <BSW-MODULE-ENTRY-REF-CONDITIONAL>
                  <BSW-MODULE-ENTRY-REF DEST="BSW-MODULE-ENTRY">/AUTOSAR_Pwm_17_GtmCcu6/BswModuleEntrys/Pwm_Isr</BSW-MODULE-ENTRY-REF>
                </BSW-MODULE-ENTRY-REF-CONDITIONAL>
              </PROVIDED-ENTRYS>
              <BSW-MODULE-DEPENDENCYS>
[!IF "$PwmDevErrorDetect_Var = 'true'"!][!//
                <BSW-MODULE-DEPENDENCY>
                  <SHORT-NAME>DetDependency</SHORT-NAME>
                  <TARGET-MODULE-ID>15</TARGET-MODULE-ID>
                  <REQUIRED-ENTRYS>
                    <BSW-MODULE-ENTRY-REF-CONDITIONAL>
                      <BSW-MODULE-ENTRY-REF DEST="BSW-MODULE-ENTRY">/AUTOSAR_Det/BswModuleEntrys/Det_ReportError</BSW-MODULE-ENTRY-REF>
                    </BSW-MODULE-ENTRY-REF-CONDITIONAL>
                  </REQUIRED-ENTRYS>
                </BSW-MODULE-DEPENDENCY>
[!ENDIF!][!//
[!IF "$PwmSafetyEnable_Var = 'true'"!][!//
                <BSW-MODULE-DEPENDENCY>
                  <SHORT-NAME>McalSafetyErrorDependency</SHORT-NAME>
                  <TARGET-MODULE-ID>255</TARGET-MODULE-ID>
                  <REQUIRED-ENTRYS>
                    <BSW-MODULE-ENTRY-REF-CONDITIONAL>
                      <BSW-MODULE-ENTRY-REF DEST="BSW-MODULE-ENTRY">/AUTOSAR_Stub/BswModuleEntrys/Mcal_ReportSafetyError</BSW-MODULE-ENTRY-REF>
                    </BSW-MODULE-ENTRY-REF-CONDITIONAL>
                  </REQUIRED-ENTRYS>
                </BSW-MODULE-DEPENDENCY>
[!ENDIF!][!//
                <BSW-MODULE-DEPENDENCY>
                  <SHORT-NAME>McuDependency</SHORT-NAME>
                  <TARGET-MODULE-ID>101</TARGET-MODULE-ID>
                  <REQUIRED-ENTRYS>
[!IF "$GtmAvailable = 'true'"!][!//
                    <BSW-MODULE-ENTRY-REF-CONDITIONAL>
                      <BSW-MODULE-ENTRY-REF DEST="BSW-MODULE-ENTRY">/AUTOSAR_Mcu/BswModuleEntrys/Mcu_17_Gtm_TomChannelInit</BSW-MODULE-ENTRY-REF>
                    </BSW-MODULE-ENTRY-REF-CONDITIONAL>
                    <BSW-MODULE-ENTRY-REF-CONDITIONAL>
                      <BSW-MODULE-ENTRY-REF DEST="BSW-MODULE-ENTRY">/AUTOSAR_Mcu/BswModuleEntrys/Mcu_17_Gtm_TomChannelShadowTransfer</BSW-MODULE-ENTRY-REF>
                    </BSW-MODULE-ENTRY-REF-CONDITIONAL>
                    <BSW-MODULE-ENTRY-REF-CONDITIONAL>
                      <BSW-MODULE-ENTRY-REF DEST="BSW-MODULE-ENTRY">/AUTOSAR_Mcu/BswModuleEntrys/Mcu_17_Gtm_ConnectTimerOutToPortPin</BSW-MODULE-ENTRY-REF>
                    </BSW-MODULE-ENTRY-REF-CONDITIONAL>
                    <BSW-MODULE-ENTRY-REF-CONDITIONAL>
                      <BSW-MODULE-ENTRY-REF DEST="BSW-MODULE-ENTRY">/AUTOSAR_Mcu/BswModuleEntrys/Mcu_17_Gtm_AtomChannelInit</BSW-MODULE-ENTRY-REF>
                    </BSW-MODULE-ENTRY-REF-CONDITIONAL>
                    <BSW-MODULE-ENTRY-REF-CONDITIONAL>
                      <BSW-MODULE-ENTRY-REF DEST="BSW-MODULE-ENTRY">/AUTOSAR_Mcu/BswModuleEntrys/Mcu_17_Gtm_AtomChannelShadowTransfer</BSW-MODULE-ENTRY-REF>
                    </BSW-MODULE-ENTRY-REF-CONDITIONAL>
[!ENDIF!][!//
                    <BSW-MODULE-ENTRY-REF-CONDITIONAL>
                      <BSW-MODULE-ENTRY-REF DEST="BSW-MODULE-ENTRY">/AUTOSAR_Mcu/BswModuleEntrys/Mcu_17_Ccu6_TimerInit</BSW-MODULE-ENTRY-REF>
                    </BSW-MODULE-ENTRY-REF-CONDITIONAL>
                    <BSW-MODULE-ENTRY-REF-CONDITIONAL>
                      <BSW-MODULE-ENTRY-REF DEST="BSW-MODULE-ENTRY">/AUTOSAR_Mcu/BswModuleEntrys/Mcu_17_Ccu6_TimerShadowTransfer</BSW-MODULE-ENTRY-REF>
                    </BSW-MODULE-ENTRY-REF-CONDITIONAL>
                    <BSW-MODULE-ENTRY-REF-CONDITIONAL>
                      <BSW-MODULE-ENTRY-REF DEST="BSW-MODULE-ENTRY">/AUTOSAR_Mcu/BswModuleEntrys/Mcu_17_Ccu6_TimerIntEnDis</BSW-MODULE-ENTRY-REF>
                    </BSW-MODULE-ENTRY-REF-CONDITIONAL>
                    <BSW-MODULE-ENTRY-REF-CONDITIONAL>
                      <BSW-MODULE-ENTRY-REF DEST="BSW-MODULE-ENTRY">/AUTOSAR_Mcu/BswModuleEntrys/Mcu_17_Ccu6_TimerStart</BSW-MODULE-ENTRY-REF>
                    </BSW-MODULE-ENTRY-REF-CONDITIONAL>
                    <BSW-MODULE-ENTRY-REF-CONDITIONAL>
                      <BSW-MODULE-ENTRY-REF DEST="BSW-MODULE-ENTRY">/AUTOSAR_Mcu/BswModuleEntrys/Mcu_17_Ccu6_TimerStop</BSW-MODULE-ENTRY-REF>
                    </BSW-MODULE-ENTRY-REF-CONDITIONAL>
                  </REQUIRED-ENTRYS>
                </BSW-MODULE-DEPENDENCY>
                <BSW-MODULE-DEPENDENCY>
                  <SHORT-NAME>McalLibDependency</SHORT-NAME>
                  <TARGET-MODULE-ID>255</TARGET-MODULE-ID>
                  <REQUIRED-ENTRYS>
                    <BSW-MODULE-ENTRY-REF-CONDITIONAL>
                      <BSW-MODULE-ENTRY-REF DEST="BSW-MODULE-ENTRY">/AURIX2G_McalLib/BswModuleEntrys/Mcal_GetCpuIndex</BSW-MODULE-ENTRY-REF>
                    </BSW-MODULE-ENTRY-REF-CONDITIONAL>
                    <BSW-MODULE-ENTRY-REF-CONDITIONAL>
                      <BSW-MODULE-ENTRY-REF DEST="BSW-MODULE-ENTRY">/AURIX2G_McalLib/BswModuleEntrys/Mcal_SetBitAtomic</BSW-MODULE-ENTRY-REF>
                    </BSW-MODULE-ENTRY-REF-CONDITIONAL>
                  </REQUIRED-ENTRYS>
                </BSW-MODULE-DEPENDENCY>
              </BSW-MODULE-DEPENDENCYS>
              <INTERNAL-BEHAVIORS>
                <BSW-INTERNAL-BEHAVIOR>
                  <SHORT-NAME>PwmBehavior</SHORT-NAME>
                  <EXCLUSIVE-AREAS>
[!IF "$PwmSetDutyCycle_Var = 'true' or $PwmSetPeriodAndDuty_Var = 'true' or $PwmSetOutputToIdle_Var = 'true' or $PwmNotificationSupported_Var = 'true'"!]
                    <EXCLUSIVE-AREA>
                      <SHORT-NAME>HandleNotification</SHORT-NAME>
                      <INTRODUCTION>
                        <NOTE SI="User of MCU TOM shall ensure that the critical section protection provided by MCU for TOM is implemented as suspend and resume interrupts" NOTE-TYPE="HINT"/>
                      </INTRODUCTION>
                    </EXCLUSIVE-AREA>
[!ENDIF!][!//
[!IF "$PwmSetDutyCycle_Var = 'true' or $PwmSetPeriodAndDuty_Var = 'true' or $PwmSetOutputToIdle_Var = 'true'"!]
                    <EXCLUSIVE-AREA>
                      <SHORT-NAME>PeriodAndDutyUpdate</SHORT-NAME>
                      <INTRODUCTION>
                        <NOTE SI="User of PWM driver shall ensure PeriodAndDutyUpdate critical section is implemenmted as suspend and resume of interrupts" NOTE-TYPE="HINT"/>
                      </INTRODUCTION>
                    </EXCLUSIVE-AREA>
[!ENDIF!][!//
                  </EXCLUSIVE-AREAS>
                  <ENTITYS>
                    <BSW-CALLED-ENTITY>
                      <SHORT-NAME>Pwm_Init</SHORT-NAME>
                      <REENTRANCY-LEVEL>NON-REENTRANT</REENTRANCY-LEVEL>
                      <IMPLEMENTED-ENTRY-REF DEST="BSW-MODULE-ENTRY">/AUTOSAR_Pwm_17_GtmCcu6/BswModuleEntrys/Pwm_Init</IMPLEMENTED-ENTRY-REF>
                    </BSW-CALLED-ENTITY>
[!IF "$PwmDeInitApi_Var = 'true'"!]
                    <BSW-CALLED-ENTITY>
                      <SHORT-NAME>Pwm_DeInit</SHORT-NAME>
                      <REENTRANCY-LEVEL>NON-REENTRANT</REENTRANCY-LEVEL>
                      <IMPLEMENTED-ENTRY-REF DEST="BSW-MODULE-ENTRY">/AUTOSAR_Pwm_17_GtmCcu6/BswModuleEntrys/Pwm_DeInit</IMPLEMENTED-ENTRY-REF>
                    </BSW-CALLED-ENTITY>
[!ENDIF!][!//
[!IF "$PwmSetDutyCycle_Var = 'true'"!]
                    <BSW-CALLED-ENTITY>
                      <SHORT-NAME>Pwm_SetDutyCycle</SHORT-NAME>
                      <CAN-ENTER-EXCLUSIVE-AREA-REFS>
                        <CAN-ENTER-EXCLUSIVE-AREA-REF DEST="EXCLUSIVE-AREA">/AUTOSAR_Pwm_17_GtmCcu6/BswModuleDescriptions/Pwm/PwmBehavior/HandleNotification</CAN-ENTER-EXCLUSIVE-AREA-REF>
                        <CAN-ENTER-EXCLUSIVE-AREA-REF DEST="EXCLUSIVE-AREA">/AUTOSAR_Pwm_17_GtmCcu6/BswModuleDescriptions/Pwm/PwmBehavior/PeriodAndDutyUpdate</CAN-ENTER-EXCLUSIVE-AREA-REF>
                      </CAN-ENTER-EXCLUSIVE-AREA-REFS>
                      <REENTRANCY-LEVEL>MULTICORE-REENTRANT</REENTRANCY-LEVEL>
                      <IMPLEMENTED-ENTRY-REF DEST="BSW-MODULE-ENTRY">/AUTOSAR_Pwm_17_GtmCcu6/BswModuleEntrys/Pwm_SetDutyCycle</IMPLEMENTED-ENTRY-REF>
                    </BSW-CALLED-ENTITY>
[!ENDIF!][!//
[!IF "$PwmSetPeriodAndDuty_Var = 'true'"!]
                    <BSW-CALLED-ENTITY>
                      <SHORT-NAME>Pwm_SetPeriodAndDuty</SHORT-NAME>
                      <CAN-ENTER-EXCLUSIVE-AREA-REFS>
                        <CAN-ENTER-EXCLUSIVE-AREA-REF DEST="EXCLUSIVE-AREA">/AUTOSAR_Pwm_17_GtmCcu6/BswModuleDescriptions/Pwm/PwmBehavior/HandleNotification</CAN-ENTER-EXCLUSIVE-AREA-REF>
                        <CAN-ENTER-EXCLUSIVE-AREA-REF DEST="EXCLUSIVE-AREA">/AUTOSAR_Pwm_17_GtmCcu6/BswModuleDescriptions/Pwm/PwmBehavior/PeriodAndDutyUpdate</CAN-ENTER-EXCLUSIVE-AREA-REF>
                      </CAN-ENTER-EXCLUSIVE-AREA-REFS>
                      <REENTRANCY-LEVEL>MULTICORE-REENTRANT</REENTRANCY-LEVEL>
                      <IMPLEMENTED-ENTRY-REF DEST="BSW-MODULE-ENTRY">/AUTOSAR_Pwm_17_GtmCcu6/BswModuleEntrys/Pwm_SetPeriodAndDuty</IMPLEMENTED-ENTRY-REF>
                    </BSW-CALLED-ENTITY>
[!ENDIF!][!//
[!IF "$PwmSetOutputToIdle_Var = 'true'"!]
                    <BSW-CALLED-ENTITY>
                      <SHORT-NAME>Pwm_SetOutputToIdle</SHORT-NAME>
                      <CAN-ENTER-EXCLUSIVE-AREA-REFS>
                        <CAN-ENTER-EXCLUSIVE-AREA-REF DEST="EXCLUSIVE-AREA">/AUTOSAR_Pwm_17_GtmCcu6/BswModuleDescriptions/Pwm/PwmBehavior/HandleNotification</CAN-ENTER-EXCLUSIVE-AREA-REF>
                        <CAN-ENTER-EXCLUSIVE-AREA-REF DEST="EXCLUSIVE-AREA">/AUTOSAR_Pwm_17_GtmCcu6/BswModuleDescriptions/Pwm/PwmBehavior/PeriodAndDutyUpdate</CAN-ENTER-EXCLUSIVE-AREA-REF>
                      </CAN-ENTER-EXCLUSIVE-AREA-REFS>
                      <REENTRANCY-LEVEL>MULTICORE-REENTRANT</REENTRANCY-LEVEL>
                      <IMPLEMENTED-ENTRY-REF DEST="BSW-MODULE-ENTRY">/AUTOSAR_Pwm_17_GtmCcu6/BswModuleEntrys/Pwm_SetOutputToIdle</IMPLEMENTED-ENTRY-REF>
                    </BSW-CALLED-ENTITY>
[!ENDIF!][!//
[!IF "$PwmGetOutputState_Var = 'true'"!]
                    <BSW-CALLED-ENTITY>
                      <SHORT-NAME>Pwm_GetOutputState</SHORT-NAME>
                      <REENTRANCY-LEVEL>MULTICORE-REENTRANT</REENTRANCY-LEVEL>
                      <IMPLEMENTED-ENTRY-REF DEST="BSW-MODULE-ENTRY">/AUTOSAR_Pwm_17_GtmCcu6/BswModuleEntrys/Pwm_GetOutputState</IMPLEMENTED-ENTRY-REF>
                    </BSW-CALLED-ENTITY>
[!ENDIF!][!//
[!IF "$PwmNotificationSupported_Var = 'true'"!]
                    <BSW-CALLED-ENTITY>
                      <SHORT-NAME>Pwm_DisableNotification</SHORT-NAME>
                      <CAN-ENTER-EXCLUSIVE-AREA-REFS>
                        <CAN-ENTER-EXCLUSIVE-AREA-REF DEST="EXCLUSIVE-AREA">/AUTOSAR_Pwm_17_GtmCcu6/BswModuleDescriptions/Pwm/PwmBehavior/HandleNotification</CAN-ENTER-EXCLUSIVE-AREA-REF>
                      </CAN-ENTER-EXCLUSIVE-AREA-REFS>
                      <REENTRANCY-LEVEL>MULTICORE-REENTRANT</REENTRANCY-LEVEL>
                      <IMPLEMENTED-ENTRY-REF DEST="BSW-MODULE-ENTRY">/AUTOSAR_Pwm_17_GtmCcu6/BswModuleEntrys/Pwm_DisableNotification</IMPLEMENTED-ENTRY-REF>
                    </BSW-CALLED-ENTITY>
[!ENDIF!][!//
[!IF "$PwmNotificationSupported_Var = 'true'"!]
                    <BSW-CALLED-ENTITY>
                      <SHORT-NAME>Pwm_EnableNotification</SHORT-NAME>
                      <CAN-ENTER-EXCLUSIVE-AREA-REFS>
                        <CAN-ENTER-EXCLUSIVE-AREA-REF DEST="EXCLUSIVE-AREA">/AUTOSAR_Pwm_17_GtmCcu6/BswModuleDescriptions/Pwm/PwmBehavior/HandleNotification</CAN-ENTER-EXCLUSIVE-AREA-REF>
                      </CAN-ENTER-EXCLUSIVE-AREA-REFS>
                      <REENTRANCY-LEVEL>MULTICORE-REENTRANT</REENTRANCY-LEVEL>
                      <IMPLEMENTED-ENTRY-REF DEST="BSW-MODULE-ENTRY">/AUTOSAR_Pwm_17_GtmCcu6/BswModuleEntrys/Pwm_EnableNotification</IMPLEMENTED-ENTRY-REF>
                    </BSW-CALLED-ENTITY>
[!ENDIF!][!//
[!IF "$PwmVersionInfoApi_Var = 'true'"!]
                    <BSW-CALLED-ENTITY>
                      <SHORT-NAME>Pwm_GetVersionInfo</SHORT-NAME>
                      <REENTRANCY-LEVEL>MULTICORE-REENTRANT</REENTRANCY-LEVEL>
                      <IMPLEMENTED-ENTRY-REF DEST="BSW-MODULE-ENTRY">/AUTOSAR_Pwm_17_GtmCcu6/BswModuleEntrys/Pwm_GetVersionInfo</IMPLEMENTED-ENTRY-REF>
                    </BSW-CALLED-ENTITY>
[!ENDIF!][!//
                    <BSW-INTERRUPT-ENTITY>
                      <SHORT-NAME>Pwm_Isr</SHORT-NAME>
                      <REENTRANCY-LEVEL>NON-REENTRANT</REENTRANCY-LEVEL>
                      <IMPLEMENTED-ENTRY-REF DEST="BSW-MODULE-ENTRY">/AUTOSAR_Pwm_17_GtmCcu6/BswModuleEntrys/Pwm_Isr</IMPLEMENTED-ENTRY-REF>
                      <INTERRUPT-CATEGORY>CAT-1</INTERRUPT-CATEGORY>
                      <INTERRUPT-SOURCE>SRC_GTMTOMxy, SRC_GTMATOMxy</INTERRUPT-SOURCE>
                    </BSW-INTERRUPT-ENTITY>
                  </ENTITYS>
                </BSW-INTERNAL-BEHAVIOR>
              </INTERNAL-BEHAVIORS>
            </BSW-MODULE-DESCRIPTION>
          </ELEMENTS>
        </AR-PACKAGE>
        <AR-PACKAGE>
          <SHORT-NAME>BswModuleEntrys</SHORT-NAME>
          <CATEGORY>STANDARD</CATEGORY>
          <ELEMENTS>
            <BSW-MODULE-ENTRY>
              <SHORT-NAME>Pwm_Init</SHORT-NAME>
              <INTRODUCTION>
                <NOTE SI="Reentrany Condition Non Reentrant for same Core" NOTE-TYPE="HINT"/>
              </INTRODUCTION>
              <SERVICE-ID>0</SERVICE-ID>
              <IS-REENTRANT>false</IS-REENTRANT>
              <IS-SYNCHRONOUS>true</IS-SYNCHRONOUS>
              <CALL-TYPE>REGULAR</CALL-TYPE>
              <EXECUTION-CONTEXT>TASK</EXECUTION-CONTEXT>
              <SW-SERVICE-IMPL-POLICY>STANDARD</SW-SERVICE-IMPL-POLICY>
              <ARGUMENTS>
                <SW-SERVICE-ARG>
                  <SHORT-NAME>ConfigPtr</SHORT-NAME>
                  <CATEGORY>DATA_REFERENCE</CATEGORY>
                  <SW-DATA-DEF-PROPS>
                    <SW-DATA-DEF-PROPS-VARIANTS>
                      <SW-DATA-DEF-PROPS-CONDITIONAL>
                        <SW-POINTER-TARGET-PROPS>
                          <TARGET-CATEGORY>TYPE_REFERENCE</TARGET-CATEGORY>
                          <SW-DATA-DEF-PROPS>
                            <SW-DATA-DEF-PROPS-VARIANTS>
                              <SW-DATA-DEF-PROPS-CONDITIONAL>
                                <IMPLEMENTATION-DATA-TYPE-REF DEST = "IMPLEMENTATION-DATA-TYPE">/AUTOSAR_Pwm_17_GtmCcu6/ImplementationDataTypes/Pwm_17_GtmCcu6_ConfigType</IMPLEMENTATION-DATA-TYPE-REF>
                              </SW-DATA-DEF-PROPS-CONDITIONAL>
                            </SW-DATA-DEF-PROPS-VARIANTS>
                          </SW-DATA-DEF-PROPS>
                        </SW-POINTER-TARGET-PROPS>
                      </SW-DATA-DEF-PROPS-CONDITIONAL>
                    </SW-DATA-DEF-PROPS-VARIANTS>
                  </SW-DATA-DEF-PROPS>
                </SW-SERVICE-ARG>
              </ARGUMENTS>
            </BSW-MODULE-ENTRY>
[!IF "$PwmDeInitApi_Var = 'true'"!]
            <BSW-MODULE-ENTRY>
              <SHORT-NAME>Pwm_DeInit</SHORT-NAME>
              <INTRODUCTION>
                <NOTE SI="Reentrany Condition Non Reentrant for same Core" NOTE-TYPE="HINT"/>
              </INTRODUCTION>
              <SERVICE-ID>1</SERVICE-ID>
              <IS-REENTRANT>false</IS-REENTRANT>
              <IS-SYNCHRONOUS>true</IS-SYNCHRONOUS>
              <CALL-TYPE>REGULAR</CALL-TYPE>
              <EXECUTION-CONTEXT>TASK</EXECUTION-CONTEXT>
              <SW-SERVICE-IMPL-POLICY>STANDARD</SW-SERVICE-IMPL-POLICY>
            </BSW-MODULE-ENTRY>
[!ENDIF!][!//
[!IF "$PwmSetDutyCycle_Var = 'true'"!]
            <BSW-MODULE-ENTRY>
              <SHORT-NAME>Pwm_SetDutyCycle</SHORT-NAME>
              <INTRODUCTION>
                <NOTE SI="Reentrany Condition Re-entrant for different channels" NOTE-TYPE="HINT"/>
              </INTRODUCTION>
              <SERVICE-ID>2</SERVICE-ID>
              <IS-REENTRANT>true</IS-REENTRANT>
              <IS-SYNCHRONOUS>true</IS-SYNCHRONOUS>
              <CALL-TYPE>REGULAR</CALL-TYPE>
              <EXECUTION-CONTEXT>TASK</EXECUTION-CONTEXT>
              <SW-SERVICE-IMPL-POLICY>STANDARD</SW-SERVICE-IMPL-POLICY>
              <ARGUMENTS>
                <SW-SERVICE-ARG>
                  <SHORT-NAME>ChannelNumber</SHORT-NAME>
                  <CATEGORY>TYPE_REFERENCE</CATEGORY>
                  <SW-DATA-DEF-PROPS>
                    <SW-DATA-DEF-PROPS-VARIANTS>
                      <SW-DATA-DEF-PROPS-CONDITIONAL>
                        <IMPLEMENTATION-DATA-TYPE-REF DEST = "IMPLEMENTATION-DATA-TYPE">/AUTOSAR_Pwm_17_GtmCcu6/ImplementationDataTypes/Pwm_17_GtmCcu6_ChannelType</IMPLEMENTATION-DATA-TYPE-REF>
                      </SW-DATA-DEF-PROPS-CONDITIONAL>
                    </SW-DATA-DEF-PROPS-VARIANTS>
                  </SW-DATA-DEF-PROPS>
                </SW-SERVICE-ARG>
                <SW-SERVICE-ARG>
                  <SHORT-NAME>DutyCycle</SHORT-NAME>
                  <CATEGORY>TYPE_REFERENCE</CATEGORY>
                  <SW-DATA-DEF-PROPS>
                    <SW-DATA-DEF-PROPS-VARIANTS>
                      <SW-DATA-DEF-PROPS-CONDITIONAL>
[!IF "$PwmShifInTicks_Var = 'false'"!][!//
                        <IMPLEMENTATION-DATA-TYPE-REF DEST = "IMPLEMENTATION-DATA-TYPE">/AUTOSAR_Platform/ImplementationDataTypes/uint16</IMPLEMENTATION-DATA-TYPE-REF>
[!ELSE!][!//
                        <IMPLEMENTATION-DATA-TYPE-REF DEST = "IMPLEMENTATION-DATA-TYPE">/AUTOSAR_Platform/ImplementationDataTypes/uint32</IMPLEMENTATION-DATA-TYPE-REF>
[!ENDIF!][!//
                      </SW-DATA-DEF-PROPS-CONDITIONAL>
                    </SW-DATA-DEF-PROPS-VARIANTS>
                  </SW-DATA-DEF-PROPS>
                </SW-SERVICE-ARG>
              </ARGUMENTS>
            </BSW-MODULE-ENTRY>
[!ENDIF!][!//
[!IF "$PwmSetPeriodAndDuty_Var = 'true'"!]
            <BSW-MODULE-ENTRY>
              <SHORT-NAME>Pwm_SetPeriodAndDuty</SHORT-NAME>
              <INTRODUCTION>
                <NOTE SI="Reentrany Condition Re-entrant for different channels" NOTE-TYPE="HINT"/>
              </INTRODUCTION>
              <SERVICE-ID>3</SERVICE-ID>
              <IS-REENTRANT>true</IS-REENTRANT>
              <IS-SYNCHRONOUS>true</IS-SYNCHRONOUS>
              <CALL-TYPE>REGULAR</CALL-TYPE>
              <EXECUTION-CONTEXT>TASK</EXECUTION-CONTEXT>
              <SW-SERVICE-IMPL-POLICY>STANDARD</SW-SERVICE-IMPL-POLICY>
              <ARGUMENTS>
                <SW-SERVICE-ARG>
                  <SHORT-NAME>ChannelNumber</SHORT-NAME>
                  <CATEGORY>TYPE_REFERENCE</CATEGORY>
                  <SW-DATA-DEF-PROPS>
                    <SW-DATA-DEF-PROPS-VARIANTS>
                      <SW-DATA-DEF-PROPS-CONDITIONAL>
                        <IMPLEMENTATION-DATA-TYPE-REF DEST = "IMPLEMENTATION-DATA-TYPE">/AUTOSAR_Pwm_17_GtmCcu6/ImplementationDataTypes/Pwm_17_GtmCcu6_ChannelType</IMPLEMENTATION-DATA-TYPE-REF>
                      </SW-DATA-DEF-PROPS-CONDITIONAL>
                    </SW-DATA-DEF-PROPS-VARIANTS>
                  </SW-DATA-DEF-PROPS>
                </SW-SERVICE-ARG>
                <SW-SERVICE-ARG>
                  <SHORT-NAME>Period</SHORT-NAME>
                  <CATEGORY>TYPE_REFERENCE</CATEGORY>
                  <SW-DATA-DEF-PROPS>
                    <SW-DATA-DEF-PROPS-VARIANTS>
                      <SW-DATA-DEF-PROPS-CONDITIONAL>
                        <IMPLEMENTATION-DATA-TYPE-REF DEST = "IMPLEMENTATION-DATA-TYPE">/AUTOSAR_Pwm_17_GtmCcu6/ImplementationDataTypes/Pwm_17_GtmCcu6_PeriodType</IMPLEMENTATION-DATA-TYPE-REF>
                      </SW-DATA-DEF-PROPS-CONDITIONAL>
                    </SW-DATA-DEF-PROPS-VARIANTS>
                  </SW-DATA-DEF-PROPS>
                </SW-SERVICE-ARG>
                <SW-SERVICE-ARG>
                  <SHORT-NAME>DutyCycle</SHORT-NAME>
                  <CATEGORY>TYPE_REFERENCE</CATEGORY>
                  <SW-DATA-DEF-PROPS>
                    <SW-DATA-DEF-PROPS-VARIANTS>
                      <SW-DATA-DEF-PROPS-CONDITIONAL>
[!IF "$PwmShifInTicks_Var = 'false'"!][!//
                        <IMPLEMENTATION-DATA-TYPE-REF DEST = "IMPLEMENTATION-DATA-TYPE">/AUTOSAR_Platform/ImplementationDataTypes/uint16</IMPLEMENTATION-DATA-TYPE-REF>
[!ELSE!][!//
                        <IMPLEMENTATION-DATA-TYPE-REF DEST = "IMPLEMENTATION-DATA-TYPE">/AUTOSAR_Platform/ImplementationDataTypes/uint32</IMPLEMENTATION-DATA-TYPE-REF>
[!ENDIF!][!//
                      </SW-DATA-DEF-PROPS-CONDITIONAL>
                    </SW-DATA-DEF-PROPS-VARIANTS>
                  </SW-DATA-DEF-PROPS>
                </SW-SERVICE-ARG>
              </ARGUMENTS>
            </BSW-MODULE-ENTRY>
[!ENDIF!][!//
[!IF "$PwmSetOutputToIdle_Var = 'true'"!]
            <BSW-MODULE-ENTRY>
              <SHORT-NAME>Pwm_SetOutputToIdle</SHORT-NAME>
              <INTRODUCTION>
                <NOTE SI="Reentrany Condition Re-entrant for different channels" NOTE-TYPE="HINT"/>
              </INTRODUCTION>
              <SERVICE-ID>4</SERVICE-ID>
              <IS-REENTRANT>true</IS-REENTRANT>
              <IS-SYNCHRONOUS>true</IS-SYNCHRONOUS>
              <CALL-TYPE>REGULAR</CALL-TYPE>
              <EXECUTION-CONTEXT>TASK</EXECUTION-CONTEXT>
              <SW-SERVICE-IMPL-POLICY>STANDARD</SW-SERVICE-IMPL-POLICY>
              <ARGUMENTS>
                <SW-SERVICE-ARG>
                  <SHORT-NAME>ChannelNumber</SHORT-NAME>
                  <CATEGORY>TYPE_REFERENCE</CATEGORY>
                  <SW-DATA-DEF-PROPS>
                    <SW-DATA-DEF-PROPS-VARIANTS>
                      <SW-DATA-DEF-PROPS-CONDITIONAL>
                        <IMPLEMENTATION-DATA-TYPE-REF DEST = "IMPLEMENTATION-DATA-TYPE">/AUTOSAR_Pwm_17_GtmCcu6/ImplementationDataTypes/Pwm_17_GtmCcu6_ChannelType</IMPLEMENTATION-DATA-TYPE-REF>
                      </SW-DATA-DEF-PROPS-CONDITIONAL>
                    </SW-DATA-DEF-PROPS-VARIANTS>
                  </SW-DATA-DEF-PROPS>
                </SW-SERVICE-ARG>
              </ARGUMENTS>
            </BSW-MODULE-ENTRY>
[!ENDIF!][!//
[!IF "$PwmGetOutputState_Var = 'true'"!]
            <BSW-MODULE-ENTRY>
              <SHORT-NAME>Pwm_GetOutputState</SHORT-NAME>
              <INTRODUCTION>
                <NOTE SI="Reentrany Condition Re-entrant for different channels" NOTE-TYPE="HINT"/>
              </INTRODUCTION>
              <SERVICE-ID>5</SERVICE-ID>
              <IS-REENTRANT>true</IS-REENTRANT>
              <IS-SYNCHRONOUS>true</IS-SYNCHRONOUS>
              <CALL-TYPE>REGULAR</CALL-TYPE>
              <EXECUTION-CONTEXT>TASK</EXECUTION-CONTEXT>
              <SW-SERVICE-IMPL-POLICY>STANDARD</SW-SERVICE-IMPL-POLICY>
              <RETURN-TYPE>
                <SHORT-NAME>Return</SHORT-NAME>
                <CATEGORY>TYPE_REFERENCE</CATEGORY>
                <SW-DATA-DEF-PROPS>
                  <SW-DATA-DEF-PROPS-VARIANTS>
                    <SW-DATA-DEF-PROPS-CONDITIONAL>
                      <IMPLEMENTATION-DATA-TYPE-REF DEST = "IMPLEMENTATION-DATA-TYPE">/AUTOSAR_Pwm_17_GtmCcu6/ImplementationDataTypes/Pwm_17_GtmCcu6_OutputStateType</IMPLEMENTATION-DATA-TYPE-REF>
                    </SW-DATA-DEF-PROPS-CONDITIONAL>
                  </SW-DATA-DEF-PROPS-VARIANTS>
                </SW-DATA-DEF-PROPS>
              </RETURN-TYPE>
              <ARGUMENTS>
                <SW-SERVICE-ARG>
                  <SHORT-NAME>ChannelNumber</SHORT-NAME>
                  <CATEGORY>TYPE_REFERENCE</CATEGORY>
                  <SW-DATA-DEF-PROPS>
                    <SW-DATA-DEF-PROPS-VARIANTS>
                      <SW-DATA-DEF-PROPS-CONDITIONAL>
                        <IMPLEMENTATION-DATA-TYPE-REF DEST = "IMPLEMENTATION-DATA-TYPE">/AUTOSAR_Pwm_17_GtmCcu6/ImplementationDataTypes/Pwm_17_GtmCcu6_ChannelType</IMPLEMENTATION-DATA-TYPE-REF>
                      </SW-DATA-DEF-PROPS-CONDITIONAL>
                    </SW-DATA-DEF-PROPS-VARIANTS>
                  </SW-DATA-DEF-PROPS>
                </SW-SERVICE-ARG>
              </ARGUMENTS>
            </BSW-MODULE-ENTRY>
[!ENDIF!][!//
[!IF "$PwmNotificationSupported_Var = 'true'"!]
            <BSW-MODULE-ENTRY>
              <SHORT-NAME>Pwm_DisableNotification</SHORT-NAME>
              <INTRODUCTION>
                <NOTE SI="Reentrany Condition Re-entrant for different channels" NOTE-TYPE="HINT"/>
              </INTRODUCTION>
              <SERVICE-ID>6</SERVICE-ID>
              <IS-REENTRANT>true</IS-REENTRANT>
              <IS-SYNCHRONOUS>true</IS-SYNCHRONOUS>
              <CALL-TYPE>REGULAR</CALL-TYPE>
              <EXECUTION-CONTEXT>TASK</EXECUTION-CONTEXT>
              <SW-SERVICE-IMPL-POLICY>STANDARD</SW-SERVICE-IMPL-POLICY>
              <ARGUMENTS>
                <SW-SERVICE-ARG>
                  <SHORT-NAME>ChannelNumber</SHORT-NAME>
                  <CATEGORY>TYPE_REFERENCE</CATEGORY>
                  <SW-DATA-DEF-PROPS>
                    <SW-DATA-DEF-PROPS-VARIANTS>
                      <SW-DATA-DEF-PROPS-CONDITIONAL>
                        <IMPLEMENTATION-DATA-TYPE-REF DEST = "IMPLEMENTATION-DATA-TYPE">/AUTOSAR_Pwm_17_GtmCcu6/ImplementationDataTypes/Pwm_17_GtmCcu6_ChannelType</IMPLEMENTATION-DATA-TYPE-REF>
                      </SW-DATA-DEF-PROPS-CONDITIONAL>
                    </SW-DATA-DEF-PROPS-VARIANTS>
                  </SW-DATA-DEF-PROPS>
                </SW-SERVICE-ARG>
              </ARGUMENTS>
            </BSW-MODULE-ENTRY>
[!ENDIF!][!//
[!IF "$PwmNotificationSupported_Var = 'true'"!]
            <BSW-MODULE-ENTRY>
              <SHORT-NAME>Pwm_EnableNotification</SHORT-NAME>
              <INTRODUCTION>
                <NOTE SI="Reentrany Condition Re-entrant for different channels" NOTE-TYPE="HINT"/>
              </INTRODUCTION>
              <SERVICE-ID>7</SERVICE-ID>
              <IS-REENTRANT>true</IS-REENTRANT>
              <IS-SYNCHRONOUS>true</IS-SYNCHRONOUS>
              <CALL-TYPE>REGULAR</CALL-TYPE>
              <EXECUTION-CONTEXT>TASK</EXECUTION-CONTEXT>
              <SW-SERVICE-IMPL-POLICY>STANDARD</SW-SERVICE-IMPL-POLICY>
              <ARGUMENTS>
                <SW-SERVICE-ARG>
                  <SHORT-NAME>ChannelNumber</SHORT-NAME>
                  <CATEGORY>TYPE_REFERENCE</CATEGORY>
                  <SW-DATA-DEF-PROPS>
                    <SW-DATA-DEF-PROPS-VARIANTS>
                      <SW-DATA-DEF-PROPS-CONDITIONAL>
                        <IMPLEMENTATION-DATA-TYPE-REF DEST = "IMPLEMENTATION-DATA-TYPE">/AUTOSAR_Pwm_17_GtmCcu6/ImplementationDataTypes/Pwm_17_GtmCcu6_ChannelType</IMPLEMENTATION-DATA-TYPE-REF>
                      </SW-DATA-DEF-PROPS-CONDITIONAL>
                    </SW-DATA-DEF-PROPS-VARIANTS>
                  </SW-DATA-DEF-PROPS>
                </SW-SERVICE-ARG>
                <SW-SERVICE-ARG>
                  <SHORT-NAME>Notification</SHORT-NAME>
                  <CATEGORY>TYPE_REFERENCE</CATEGORY>
                  <SW-DATA-DEF-PROPS>
                    <SW-DATA-DEF-PROPS-VARIANTS>
                      <SW-DATA-DEF-PROPS-CONDITIONAL>
                        <IMPLEMENTATION-DATA-TYPE-REF DEST = "IMPLEMENTATION-DATA-TYPE">/AUTOSAR_Pwm_17_GtmCcu6/ImplementationDataTypes/Pwm_17_GtmCcu6_EdgeNotificationType</IMPLEMENTATION-DATA-TYPE-REF>
                      </SW-DATA-DEF-PROPS-CONDITIONAL>
                    </SW-DATA-DEF-PROPS-VARIANTS>
                  </SW-DATA-DEF-PROPS>
                </SW-SERVICE-ARG>
              </ARGUMENTS>
            </BSW-MODULE-ENTRY>
[!ENDIF!][!//
[!IF "$PwmVersionInfoApi_Var = 'true'"!]
            <BSW-MODULE-ENTRY>
              <SHORT-NAME>Pwm_GetVersionInfo</SHORT-NAME>
              <SERVICE-ID>8</SERVICE-ID>
              <IS-REENTRANT>true</IS-REENTRANT>
              <IS-SYNCHRONOUS>true</IS-SYNCHRONOUS>
              <CALL-TYPE>REGULAR</CALL-TYPE>
              <EXECUTION-CONTEXT>TASK</EXECUTION-CONTEXT>
              <SW-SERVICE-IMPL-POLICY>STANDARD</SW-SERVICE-IMPL-POLICY>
              <ARGUMENTS>
                <SW-SERVICE-ARG>
                  <SHORT-NAME>VersionInfoPtr</SHORT-NAME>
                  <CATEGORY>DATA_REFERENCE</CATEGORY>
                  <SW-DATA-DEF-PROPS>
                    <SW-DATA-DEF-PROPS-VARIANTS>
                      <SW-DATA-DEF-PROPS-CONDITIONAL>
                        <SW-POINTER-TARGET-PROPS>
                          <TARGET-CATEGORY>TYPE_REFERENCE</TARGET-CATEGORY>
                          <SW-DATA-DEF-PROPS>
                            <SW-DATA-DEF-PROPS-VARIANTS>
                              <SW-DATA-DEF-PROPS-CONDITIONAL>
                                <IMPLEMENTATION-DATA-TYPE-REF DEST = "IMPLEMENTATION-DATA-TYPE">/AUTOSAR_Std/ImplementationDataTypes/Std_VersionInfoType</IMPLEMENTATION-DATA-TYPE-REF>
                              </SW-DATA-DEF-PROPS-CONDITIONAL>
                            </SW-DATA-DEF-PROPS-VARIANTS>
                          </SW-DATA-DEF-PROPS>
                        </SW-POINTER-TARGET-PROPS>
                      </SW-DATA-DEF-PROPS-CONDITIONAL>
                    </SW-DATA-DEF-PROPS-VARIANTS>
                  </SW-DATA-DEF-PROPS>
                </SW-SERVICE-ARG>
              </ARGUMENTS>
            </BSW-MODULE-ENTRY>
[!ENDIF!][!//
            <BSW-MODULE-ENTRY>
              <SHORT-NAME>Pwm_Isr</SHORT-NAME>
              <SERVICE-ID>9</SERVICE-ID>
              <IS-REENTRANT>false</IS-REENTRANT>
              <IS-SYNCHRONOUS>true</IS-SYNCHRONOUS>
              <CALL-TYPE>INTERRUPT</CALL-TYPE>
              <EXECUTION-CONTEXT>INTERRUPT-CAT-1</EXECUTION-CONTEXT>
              <SW-SERVICE-IMPL-POLICY>STANDARD</SW-SERVICE-IMPL-POLICY>
              <ARGUMENTS>
                <SW-SERVICE-ARG>
                  <SHORT-NAME>ChannelNumber</SHORT-NAME>
                  <CATEGORY>TYPE_REFERENCE</CATEGORY>
                  <SW-DATA-DEF-PROPS>
                    <SW-DATA-DEF-PROPS-VARIANTS>
                      <SW-DATA-DEF-PROPS-CONDITIONAL>
                        <IMPLEMENTATION-DATA-TYPE-REF DEST = "IMPLEMENTATION-DATA-TYPE">/AUTOSAR_Pwm_17_GtmCcu6/ImplementationDataTypes/Pwm_17_GtmCcu6_ChannelType</IMPLEMENTATION-DATA-TYPE-REF>
                        <SW-IMPL-POLICY>STANDARD</SW-IMPL-POLICY>
                      </SW-DATA-DEF-PROPS-CONDITIONAL>
                    </SW-DATA-DEF-PROPS-VARIANTS>
                  </SW-DATA-DEF-PROPS>
                </SW-SERVICE-ARG>
              </ARGUMENTS>
            </BSW-MODULE-ENTRY>
          </ELEMENTS>
        </AR-PACKAGE>
        <AR-PACKAGE>
          <SHORT-NAME>Implementations</SHORT-NAME>
          <ELEMENTS>
            <BSW-IMPLEMENTATION>
              <SHORT-NAME>Pwm</SHORT-NAME>
              <CODE-DESCRIPTORS>
                <CODE>
                  <SHORT-NAME>Files</SHORT-NAME>
                  <ARTIFACT-DESCRIPTORS>
                    <AUTOSAR-ENGINEERING-OBJECT>
                      <SHORT-LABEL>src::Pwm_17_GtmCcu6.c</SHORT-LABEL>
                      <CATEGORY>SWSRC</CATEGORY>
                    </AUTOSAR-ENGINEERING-OBJECT>
                    <AUTOSAR-ENGINEERING-OBJECT>
                      <SHORT-LABEL>inc::Pwm_17_GtmCcu6.h</SHORT-LABEL>
                      <CATEGORY>SWHDR</CATEGORY>
                    </AUTOSAR-ENGINEERING-OBJECT>
                    <AUTOSAR-ENGINEERING-OBJECT>
                      <SHORT-LABEL>inc::Pwm_17_GtmCcu6_Cbk.h</SHORT-LABEL>
                      <CATEGORY>SWHDR</CATEGORY>
                    </AUTOSAR-ENGINEERING-OBJECT>
                  </ARTIFACT-DESCRIPTORS>
                </CODE>
              </CODE-DESCRIPTORS>
              <GENERATED-ARTIFACTS>
                <DEPENDENCY-ON-ARTIFACT>
                  <SHORT-NAME>Pwm_PBcfg_c</SHORT-NAME>
                  <ARTIFACT-DESCRIPTOR>
                    <SHORT-LABEL>plugins::Pwm_17_GtmCcu6_Aurix::generate::src::Pwm_17_GtmCcu6_PBcfg.c</SHORT-LABEL>
                    <CATEGORY>SWTEMPLATE</CATEGORY>
                  </ARTIFACT-DESCRIPTOR>
                  <USAGES>
                    <USAGE>EXECUTE</USAGE>
                  </USAGES>
                </DEPENDENCY-ON-ARTIFACT>
                <DEPENDENCY-ON-ARTIFACT>
                  <SHORT-NAME>Pwm_Cfg_h</SHORT-NAME>
                  <ARTIFACT-DESCRIPTOR>
                    <SHORT-LABEL>plugins::Pwm_17_GtmCcu6_Aurix::generate::inc::Pwm_17_GtmCcu6_Cfg.h</SHORT-LABEL>
                    <CATEGORY>SWTEMPLATE</CATEGORY>
                  </ARTIFACT-DESCRIPTOR>
                  <USAGES>
                    <USAGE>COMPILE</USAGE>
                  </USAGES>
                </DEPENDENCY-ON-ARTIFACT>
                <DEPENDENCY-ON-ARTIFACT>
                  <SHORT-NAME>Pwm_PBcfg_h</SHORT-NAME>
                  <ARTIFACT-DESCRIPTOR>
                    <SHORT-LABEL>plugins::Pwm_17_GtmCcu6_Aurix::generate::inc::Pwm_17_GtmCcu6_PBcfg.h</SHORT-LABEL>
                    <CATEGORY>SWTEMPLATE</CATEGORY>
                  </ARTIFACT-DESCRIPTOR>
                  <USAGES>
                    <USAGE>EXECUTE</USAGE>
                  </USAGES>
                </DEPENDENCY-ON-ARTIFACT>
                <DEPENDENCY-ON-ARTIFACT>
                  <SHORT-NAME>Pwm_xdm</SHORT-NAME>
                  <ARTIFACT-DESCRIPTOR>
                    <SHORT-LABEL>config::Pwm_17_GtmCcu6.xdm</SHORT-LABEL>
                    <CATEGORY>SWTOOL</CATEGORY>
                  </ARTIFACT-DESCRIPTOR>
                  <USAGES>
                    <USAGE>CODEGENERATION</USAGE>
                  </USAGES>
                </DEPENDENCY-ON-ARTIFACT>
                <DEPENDENCY-ON-ARTIFACT>
                  <SHORT-NAME>Pwm_bmd</SHORT-NAME>
                  <ARTIFACT-DESCRIPTOR>
                    <SHORT-LABEL>autosar::[!"concat(substring(ecu:get('Rel.SubDerivate'),1,4),'x')"!]::[!"ecu:get('Rel.SubDerivate')"!]::Pwm_17_GtmCcu6.bmd</SHORT-LABEL>
                    <CATEGORY>SWTOOL</CATEGORY>
                  </ARTIFACT-DESCRIPTOR>
                  <USAGES>
                    <USAGE>CODEGENERATION</USAGE>
                  </USAGES>
                </DEPENDENCY-ON-ARTIFACT>
              </GENERATED-ARTIFACTS>
              <PROGRAMMING-LANGUAGE>C</PROGRAMMING-LANGUAGE>
              <RESOURCE-CONSUMPTION>
                <SHORT-NAME>ResourceConsumption</SHORT-NAME>
                <MEMORY-SECTIONS>
                  <MEMORY-SECTION>
                    <SHORT-NAME>VAR_CLEARED_ASIL_B_GLOBAL_32</SHORT-NAME>
                    <ALIGNMENT>32</ALIGNMENT>
                    <SW-ADDRMETHOD-REF DEST="SW-ADDR-METHOD">/AUTOSAR_MemMap/SwAddrMethods/VAR_CLEARED</SW-ADDRMETHOD-REF>
                  </MEMORY-SECTION>
                  <MEMORY-SECTION>
                    <SHORT-NAME>CODE_ASIL_B_GLOBAL</SHORT-NAME>
                    <ALIGNMENT>UNSPECIFIED</ALIGNMENT>
                    <SW-ADDRMETHOD-REF DEST="SW-ADDR-METHOD">/AUTOSAR_MemMap/SwAddrMethods/CODE</SW-ADDRMETHOD-REF>
                  </MEMORY-SECTION>
[!IF "$PwmCore0Idx > num:i(0)"!][!//
                <MEMORY-SECTION>
                  <SHORT-NAME>VAR_CLEARED_ASIL_B_CORE0_UNSPECIFIED</SHORT-NAME>
                  <ALIGNMENT>UNSPECIFIED</ALIGNMENT>
                  <SW-ADDRMETHOD-REF DEST="SW-ADDR-METHOD">/AUTOSAR_MemMap/SwAddrMethods/VAR_CLEARED</SW-ADDRMETHOD-REF>
                </MEMORY-SECTION>
[!ENDIF!][!//
[!IF "$PwmCore1Idx > num:i(0)"!][!//
              <MEMORY-SECTION>
                <SHORT-NAME>VAR_CLEARED_ASIL_B_CORE1_UNSPECIFIED</SHORT-NAME>
                <ALIGNMENT>UNSPECIFIED</ALIGNMENT>
                <SW-ADDRMETHOD-REF DEST="SW-ADDR-METHOD">/AUTOSAR_MemMap/SwAddrMethods/VAR_CLEARED</SW-ADDRMETHOD-REF>
              </MEMORY-SECTION>
[!ENDIF!][!//
[!IF "$PwmCore2Idx > num:i(0)"!][!//
            <MEMORY-SECTION>
              <SHORT-NAME>VAR_CLEARED_ASIL_B_CORE2_UNSPECIFIED</SHORT-NAME>
              <ALIGNMENT>UNSPECIFIED</ALIGNMENT>
              <SW-ADDRMETHOD-REF DEST="SW-ADDR-METHOD">/AUTOSAR_MemMap/SwAddrMethods/VAR_CLEARED</SW-ADDRMETHOD-REF>
            </MEMORY-SECTION>
[!ENDIF!][!//
[!IF "$PwmCore3Idx > num:i(0)"!][!//
          <MEMORY-SECTION>
            <SHORT-NAME>VAR_CLEARED_ASIL_B_CORE3_UNSPECIFIED</SHORT-NAME>
            <ALIGNMENT>UNSPECIFIED</ALIGNMENT>
            <SW-ADDRMETHOD-REF DEST="SW-ADDR-METHOD">/AUTOSAR_MemMap/SwAddrMethods/VAR_CLEARED</SW-ADDRMETHOD-REF>
          </MEMORY-SECTION>
[!ENDIF!][!//
[!IF "$PwmCore4Idx > num:i(0)"!][!//
        <MEMORY-SECTION>
          <SHORT-NAME>VAR_CLEARED_ASIL_B_CORE4_UNSPECIFIED</SHORT-NAME>
          <ALIGNMENT>UNSPECIFIED</ALIGNMENT>
          <SW-ADDRMETHOD-REF DEST="SW-ADDR-METHOD">/AUTOSAR_MemMap/SwAddrMethods/VAR_CLEARED</SW-ADDRMETHOD-REF>
        </MEMORY-SECTION>
[!ENDIF!][!//
[!IF "$PwmCore5Idx > num:i(0)"!][!//
      <MEMORY-SECTION>
        <SHORT-NAME>VAR_CLEARED_ASIL_B_CORE5_UNSPECIFIED</SHORT-NAME>
        <ALIGNMENT>UNSPECIFIED</ALIGNMENT>
        <SW-ADDRMETHOD-REF DEST="SW-ADDR-METHOD">/AUTOSAR_MemMap/SwAddrMethods/VAR_CLEARED</SW-ADDRMETHOD-REF>
      </MEMORY-SECTION>
[!ENDIF!][!//
      <MEMORY-SECTION>
        <SHORT-NAME>CONST_ASIL_B_GLOBAL_UNSPECIFIED</SHORT-NAME>
        <ALIGNMENT>UNSPECIFIED</ALIGNMENT>
        <SW-ADDRMETHOD-REF DEST="SW-ADDR-METHOD">/AUTOSAR_MemMap/SwAddrMethods/CONST</SW-ADDRMETHOD-REF>
      </MEMORY-SECTION>
      <MEMORY-SECTION>
        <SHORT-NAME>CONFIG_DATA_ASIL_B_GLOBAL_UNSPECIFIED</SHORT-NAME>
        <ALIGNMENT>UNSPECIFIED</ALIGNMENT>
        <SW-ADDRMETHOD-REF DEST="SW-ADDR-METHOD">/AUTOSAR_MemMap/SwAddrMethods/CONFIG_DATA</SW-ADDRMETHOD-REF>
      </MEMORY-SECTION>
[!IF "$PwmCore0Idx > num:i(0)"!][!//
    <MEMORY-SECTION>
      <SHORT-NAME>CONFIG_DATA_ASIL_B_CORE0_UNSPECIFIED</SHORT-NAME>
      <ALIGNMENT>UNSPECIFIED</ALIGNMENT>
      <SW-ADDRMETHOD-REF DEST="SW-ADDR-METHOD">/AUTOSAR_MemMap/SwAddrMethods/CONFIG_DATA</SW-ADDRMETHOD-REF>
    </MEMORY-SECTION>
[!ENDIF!][!//
[!IF "$PwmCore1Idx > num:i(0)"!][!//
  <MEMORY-SECTION>
    <SHORT-NAME>CONFIG_DATA_ASIL_B_CORE1_UNSPECIFIED</SHORT-NAME>
    <ALIGNMENT>UNSPECIFIED</ALIGNMENT>
    <SW-ADDRMETHOD-REF DEST="SW-ADDR-METHOD">/AUTOSAR_MemMap/SwAddrMethods/CONFIG_DATA</SW-ADDRMETHOD-REF>
  </MEMORY-SECTION>
[!ENDIF!][!//
[!IF "$PwmCore2Idx > num:i(0)"!][!//
<MEMORY-SECTION>
  <SHORT-NAME>CONFIG_DATA_ASIL_B_CORE2_UNSPECIFIED</SHORT-NAME>
  <ALIGNMENT>UNSPECIFIED</ALIGNMENT>
  <SW-ADDRMETHOD-REF DEST="SW-ADDR-METHOD">/AUTOSAR_MemMap/SwAddrMethods/CONFIG_DATA</SW-ADDRMETHOD-REF>
</MEMORY-SECTION>
[!ENDIF!][!//
[!IF "$PwmCore3Idx > num:i(0)"!][!//
<MEMORY-SECTION>
  <SHORT-NAME>CONFIG_DATA_ASIL_B_CORE3_UNSPECIFIED</SHORT-NAME>
  <ALIGNMENT>UNSPECIFIED</ALIGNMENT>
  <SW-ADDRMETHOD-REF DEST="SW-ADDR-METHOD">/AUTOSAR_MemMap/SwAddrMethods/CONFIG_DATA</SW-ADDRMETHOD-REF>
</MEMORY-SECTION>
[!ENDIF!][!//
[!IF "$PwmCore4Idx > num:i(0)"!][!//
<MEMORY-SECTION>
  <SHORT-NAME>CONFIG_DATA_ASIL_B_CORE4_UNSPECIFIED</SHORT-NAME>
  <ALIGNMENT>UNSPECIFIED</ALIGNMENT>
  <SW-ADDRMETHOD-REF DEST="SW-ADDR-METHOD">/AUTOSAR_MemMap/SwAddrMethods/CONFIG_DATA</SW-ADDRMETHOD-REF>
</MEMORY-SECTION>
[!ENDIF!][!//
[!IF "$PwmCore5Idx > num:i(0)"!][!//
<MEMORY-SECTION>
  <SHORT-NAME>CONFIG_DATA_ASIL_B_CORE5_UNSPECIFIED</SHORT-NAME>
  <ALIGNMENT>UNSPECIFIED</ALIGNMENT>
  <SW-ADDRMETHOD-REF DEST="SW-ADDR-METHOD">/AUTOSAR_MemMap/SwAddrMethods/CONFIG_DATA</SW-ADDRMETHOD-REF>
</MEMORY-SECTION>
[!ENDIF!][!//
<MEMORY-SECTION>
  <SHORT-NAME>CODE_FAST_ASIL_B_GLOBAL</SHORT-NAME>
  <ALIGNMENT>UNSPECIFIED</ALIGNMENT>
  <SW-ADDRMETHOD-REF DEST="SW-ADDR-METHOD">/AUTOSAR_MemMap/SwAddrMethods/CODE_FAST</SW-ADDRMETHOD-REF>
</MEMORY-SECTION>
</MEMORY-SECTIONS>
<SECTION-NAME-PREFIXS>
  <SECTION-NAME-PREFIX>
    <SHORT-NAME>PWM_17_GTMCCU6</SHORT-NAME>
    <SYMBOL>PWM_17_GTMCCU6</SYMBOL>
  </SECTION-NAME-PREFIX>
</SECTION-NAME-PREFIXS>
</RESOURCE-CONSUMPTION>
<SW-VERSION>20.20.0</SW-VERSION>
<VENDOR-ID>17</VENDOR-ID>
[!IF "$MinorVersion = num:i(2)"!][!//
<AR-RELEASE-VERSION>4.2.2</AR-RELEASE-VERSION>
[!ELSE!]
<AR-RELEASE-VERSION>4.4.0</AR-RELEASE-VERSION>
[!ENDIF!]
<BEHAVIOR-REF DEST="BSW-INTERNAL-BEHAVIOR">/AUTOSAR_Pwm_17_GtmCcu6/BswModuleDescriptions/Pwm/PwmBehavior</BEHAVIOR-REF>
<VENDOR-API-INFIX>GtmCcu6</VENDOR-API-INFIX>
<VENDOR-SPECIFIC-MODULE-DEF-REFS>
  <VENDOR-SPECIFIC-MODULE-DEF-REF DEST="ECUC-MODULE-DEF">/AURIX2G/EcucDefs/Pwm</VENDOR-SPECIFIC-MODULE-DEF-REF>
</VENDOR-SPECIFIC-MODULE-DEF-REFS>
</BSW-IMPLEMENTATION>
</ELEMENTS>
</AR-PACKAGE>
<AR-PACKAGE>
  <SHORT-NAME>ImplementationDataTypes</SHORT-NAME>
  <CATEGORY>STANDARD</CATEGORY>
  <ELEMENTS>
    <IMPLEMENTATION-DATA-TYPE>
      <SHORT-NAME>Pwm_17_GtmCcu6_ChannelType</SHORT-NAME>
      <CATEGORY>TYPE_REFERENCE</CATEGORY>
      <SW-DATA-DEF-PROPS>
        <SW-DATA-DEF-PROPS-VARIANTS>
          <SW-DATA-DEF-PROPS-CONDITIONAL>
            <IMPLEMENTATION-DATA-TYPE-REF DEST="IMPLEMENTATION-DATA-TYPE">/AUTOSAR_Platform/ImplementationDataTypes/uint8</IMPLEMENTATION-DATA-TYPE-REF>
            <SW-IMPL-POLICY>STANDARD</SW-IMPL-POLICY>
          </SW-DATA-DEF-PROPS-CONDITIONAL>
        </SW-DATA-DEF-PROPS-VARIANTS>
      </SW-DATA-DEF-PROPS>
      <TYPE-EMITTER>BSW</TYPE-EMITTER>
    </IMPLEMENTATION-DATA-TYPE>
    <IMPLEMENTATION-DATA-TYPE>
      <SHORT-NAME>Pwm_17_GtmCcu6_NotifiPtrType</SHORT-NAME>
      <CATEGORY>FUNCTION_REFERENCE</CATEGORY>
      <INTRODUCTION>
        <NOTE SI="This data type is for a function pointer type pointing to the callback-notification function. The referred function should be implemented by user of the driver" NOTE-TYPE="HINT"/>
      </INTRODUCTION>
      <SW-DATA-DEF-PROPS>
        <SW-DATA-DEF-PROPS-VARIANTS>
          <SW-DATA-DEF-PROPS-CONDITIONAL>
            <SW-POINTER-TARGET-PROPS>
              <FUNCTION-POINTER-SIGNATURE-REF DEST="BSW-MODULE-ENTRY">/AUTOSAR_Stub/BswModuleEntrys/IoHwAb_Pwm_17_GtmCcu6Notification</FUNCTION-POINTER-SIGNATURE-REF>
            </SW-POINTER-TARGET-PROPS>
          </SW-DATA-DEF-PROPS-CONDITIONAL>
        </SW-DATA-DEF-PROPS-VARIANTS>
      </SW-DATA-DEF-PROPS>
      <TYPE-EMITTER>BSW</TYPE-EMITTER>
    </IMPLEMENTATION-DATA-TYPE>
    <IMPLEMENTATION-DATA-TYPE>
      <SHORT-NAME>Pwm_17_GtmCcu6_PeriodType</SHORT-NAME>
      <CATEGORY>TYPE_REFERENCE</CATEGORY>
      <SW-DATA-DEF-PROPS>
        <SW-DATA-DEF-PROPS-VARIANTS>
          <SW-DATA-DEF-PROPS-CONDITIONAL>
            <IMPLEMENTATION-DATA-TYPE-REF DEST="IMPLEMENTATION-DATA-TYPE">/AUTOSAR_Platform/ImplementationDataTypes/uint32</IMPLEMENTATION-DATA-TYPE-REF>
            <SW-IMPL-POLICY>STANDARD</SW-IMPL-POLICY>
          </SW-DATA-DEF-PROPS-CONDITIONAL>
        </SW-DATA-DEF-PROPS-VARIANTS>
      </SW-DATA-DEF-PROPS>
      <TYPE-EMITTER>BSW</TYPE-EMITTER>
    </IMPLEMENTATION-DATA-TYPE>
[!IF "$PwmGetOutputState_Var = 'true'"!]
    <IMPLEMENTATION-DATA-TYPE>
      <SHORT-NAME>Pwm_17_GtmCcu6_OutputStateType</SHORT-NAME>
      <CATEGORY>TYPE_REFERENCE</CATEGORY>
      <SW-DATA-DEF-PROPS>
        <SW-DATA-DEF-PROPS-VARIANTS>
          <SW-DATA-DEF-PROPS-CONDITIONAL>
            <IMPLEMENTATION-DATA-TYPE-REF DEST="IMPLEMENTATION-DATA-TYPE">/AUTOSAR_Platform/ImplementationDataTypes/uint8</IMPLEMENTATION-DATA-TYPE-REF>
            <SW-IMPL-POLICY>STANDARD</SW-IMPL-POLICY>
          </SW-DATA-DEF-PROPS-CONDITIONAL>
        </SW-DATA-DEF-PROPS-VARIANTS>
      </SW-DATA-DEF-PROPS>
      <TYPE-EMITTER>BSW</TYPE-EMITTER>
    </IMPLEMENTATION-DATA-TYPE>
[!ENDIF!][!//
[!IF "$PwmNotificationSupported_Var = 'true'"!]
    <IMPLEMENTATION-DATA-TYPE>
      <SHORT-NAME>Pwm_17_GtmCcu6_EdgeNotificationType</SHORT-NAME>
      <CATEGORY>TYPE_REFERENCE</CATEGORY>
      <SW-DATA-DEF-PROPS>
        <SW-DATA-DEF-PROPS-VARIANTS>
          <SW-DATA-DEF-PROPS-CONDITIONAL>
            <IMPLEMENTATION-DATA-TYPE-REF DEST="IMPLEMENTATION-DATA-TYPE">/AUTOSAR_Platform/ImplementationDataTypes/uint8</IMPLEMENTATION-DATA-TYPE-REF>
            <SW-IMPL-POLICY>STANDARD</SW-IMPL-POLICY>
          </SW-DATA-DEF-PROPS-CONDITIONAL>
        </SW-DATA-DEF-PROPS-VARIANTS>
      </SW-DATA-DEF-PROPS>
      <TYPE-EMITTER>BSW</TYPE-EMITTER>
    </IMPLEMENTATION-DATA-TYPE>
[!ENDIF!][!//
    <IMPLEMENTATION-DATA-TYPE>
      <SHORT-NAME>Pwm_17_GtmCcu6_ConfigType</SHORT-NAME>
      <CATEGORY>STRUCTURE</CATEGORY>
      <SUB-ELEMENTS>
        <IMPLEMENTATION-DATA-TYPE-ELEMENT>
          <SHORT-NAME>PwmChannelIdxmapPtr</SHORT-NAME>
          <CATEGORY>DATA_REFERENCE</CATEGORY>
          <SW-DATA-DEF-PROPS>
            <SW-DATA-DEF-PROPS-VARIANTS>
              <SW-DATA-DEF-PROPS-CONDITIONAL>
                <SW-POINTER-TARGET-PROPS>
                  <TARGET-CATEGORY>TYPE_REFERENCE</TARGET-CATEGORY>
                  <SW-DATA-DEF-PROPS>
                    <SW-DATA-DEF-PROPS-VARIANTS>
                      <SW-DATA-DEF-PROPS-CONDITIONAL>
                        <IMPLEMENTATION-DATA-TYPE-REF DEST="IMPLEMENTATION-DATA-TYPE">/AUTOSAR_Platform/ImplementationDataTypes/uint8</IMPLEMENTATION-DATA-TYPE-REF>
                      </SW-DATA-DEF-PROPS-CONDITIONAL>
                    </SW-DATA-DEF-PROPS-VARIANTS>
                  </SW-DATA-DEF-PROPS>
                </SW-POINTER-TARGET-PROPS>
              </SW-DATA-DEF-PROPS-CONDITIONAL>
            </SW-DATA-DEF-PROPS-VARIANTS>
          </SW-DATA-DEF-PROPS>
        </IMPLEMENTATION-DATA-TYPE-ELEMENT>
        <IMPLEMENTATION-DATA-TYPE-ELEMENT>
          <SHORT-NAME>PwmCoreAdd</SHORT-NAME>
          <CATEGORY>DATA_REFERENCE</CATEGORY>
          <ARRAY-SIZE>[!"ecu:get('Mcu.NoOfCoreAvailable')"!]</ARRAY-SIZE>
          <ARRAY-SIZE-SEMANTICS>FIXED-SIZE</ARRAY-SIZE-SEMANTICS>
          <SW-DATA-DEF-PROPS>
            <SW-DATA-DEF-PROPS-VARIANTS>
              <SW-DATA-DEF-PROPS-CONDITIONAL>
                <SW-POINTER-TARGET-PROPS>
                  <TARGET-CATEGORY>TYPE_REFERENCE</TARGET-CATEGORY>
                  <SW-DATA-DEF-PROPS>
                    <SW-DATA-DEF-PROPS-VARIANTS>
                      <SW-DATA-DEF-PROPS-CONDITIONAL>
                        <IMPLEMENTATION-DATA-TYPE-REF DEST="IMPLEMENTATION-DATA-TYPE">/AUTOSAR_Pwm_17_GtmCcu6/ImplementationDataTypes/Pwm_17_GtmCcu6_CoreConfigType</IMPLEMENTATION-DATA-TYPE-REF>
                      </SW-DATA-DEF-PROPS-CONDITIONAL>
                    </SW-DATA-DEF-PROPS-VARIANTS>
                  </SW-DATA-DEF-PROPS>
                </SW-POINTER-TARGET-PROPS>
              </SW-DATA-DEF-PROPS-CONDITIONAL>
            </SW-DATA-DEF-PROPS-VARIANTS>
          </SW-DATA-DEF-PROPS>
        </IMPLEMENTATION-DATA-TYPE-ELEMENT>
        <IMPLEMENTATION-DATA-TYPE-ELEMENT>
          <SHORT-NAME>PwmCcu6ChIdx</SHORT-NAME>
          <CATEGORY>DATA_REFERENCE</CATEGORY>
          <SW-DATA-DEF-PROPS>
            <SW-DATA-DEF-PROPS-VARIANTS>
              <SW-DATA-DEF-PROPS-CONDITIONAL>
                <SW-POINTER-TARGET-PROPS>
                  <TARGET-CATEGORY>TYPE_REFERENCE</TARGET-CATEGORY>
                  <SW-DATA-DEF-PROPS>
                    <SW-DATA-DEF-PROPS-VARIANTS>
                      <SW-DATA-DEF-PROPS-CONDITIONAL>
                        <IMPLEMENTATION-DATA-TYPE-REF DEST="IMPLEMENTATION-DATA-TYPE">/AUTOSAR_Platform/ImplementationDataTypes/uint32</IMPLEMENTATION-DATA-TYPE-REF>
                      </SW-DATA-DEF-PROPS-CONDITIONAL>
                    </SW-DATA-DEF-PROPS-VARIANTS>
                  </SW-DATA-DEF-PROPS>
                </SW-POINTER-TARGET-PROPS>
              </SW-DATA-DEF-PROPS-CONDITIONAL>
            </SW-DATA-DEF-PROPS-VARIANTS>
          </SW-DATA-DEF-PROPS>
        </IMPLEMENTATION-DATA-TYPE-ELEMENT>
      </SUB-ELEMENTS>
      <TYPE-EMITTER>BSW</TYPE-EMITTER>
    </IMPLEMENTATION-DATA-TYPE>
    <IMPLEMENTATION-DATA-TYPE>
      <SHORT-NAME>Pwm_17_GtmCcu6_CoreConfigType</SHORT-NAME>
      <CATEGORY>STRUCTURE</CATEGORY>
      <SUB-ELEMENTS>
        <IMPLEMENTATION-DATA-TYPE-ELEMENT>
          <SHORT-NAME>MaxChannels</SHORT-NAME>
          <CATEGORY>TYPE_REFERENCE</CATEGORY>
          <SW-DATA-DEF-PROPS>
            <SW-DATA-DEF-PROPS-VARIANTS>
              <SW-DATA-DEF-PROPS-CONDITIONAL>
                <IMPLEMENTATION-DATA-TYPE-REF DEST="IMPLEMENTATION-DATA-TYPE">/AUTOSAR_Pwm_17_GtmCcu6/ImplementationDataTypes/Pwm_17_GtmCcu6_ChannelType</IMPLEMENTATION-DATA-TYPE-REF>
              </SW-DATA-DEF-PROPS-CONDITIONAL>
            </SW-DATA-DEF-PROPS-VARIANTS>
          </SW-DATA-DEF-PROPS>
        </IMPLEMENTATION-DATA-TYPE-ELEMENT>
        <IMPLEMENTATION-DATA-TYPE-ELEMENT>
          <SHORT-NAME>Pwm_ChannelConfigPtr</SHORT-NAME>
          <CATEGORY>DATA_REFERENCE</CATEGORY>
          <SW-DATA-DEF-PROPS>
            <SW-DATA-DEF-PROPS-VARIANTS>
              <SW-DATA-DEF-PROPS-CONDITIONAL>
                <SW-POINTER-TARGET-PROPS>
                  <TARGET-CATEGORY>TYPE_REFERENCE</TARGET-CATEGORY>
                  <SW-DATA-DEF-PROPS>
                    <SW-DATA-DEF-PROPS-VARIANTS>
                      <SW-DATA-DEF-PROPS-CONDITIONAL>
                        <IMPLEMENTATION-DATA-TYPE-REF DEST="IMPLEMENTATION-DATA-TYPE">/AUTOSAR_Pwm_17_GtmCcu6/ImplementationDataTypes/Pwm_17_GtmCcu6_ChannelType</IMPLEMENTATION-DATA-TYPE-REF>
                      </SW-DATA-DEF-PROPS-CONDITIONAL>
                    </SW-DATA-DEF-PROPS-VARIANTS>
                  </SW-DATA-DEF-PROPS>
                </SW-POINTER-TARGET-PROPS>
              </SW-DATA-DEF-PROPS-CONDITIONAL>
            </SW-DATA-DEF-PROPS-VARIANTS>
          </SW-DATA-DEF-PROPS>
        </IMPLEMENTATION-DATA-TYPE-ELEMENT>
      </SUB-ELEMENTS>
    <TYPE-EMITTER>BSW</TYPE-EMITTER>
    </IMPLEMENTATION-DATA-TYPE>
    <IMPLEMENTATION-DATA-TYPE>
      <SHORT-NAME>Pwm_17_GtmCcu6_ChannelConfigType</SHORT-NAME>
      <CATEGORY>STRUCTURE</CATEGORY>
      <SUB-ELEMENTS>
        <IMPLEMENTATION-DATA-TYPE-ELEMENT>
          <SHORT-NAME>PwmNotification</SHORT-NAME>
          <CATEGORY>TYPE_REFERENCE</CATEGORY>
          <SW-DATA-DEF-PROPS>
            <SW-DATA-DEF-PROPS-VARIANTS>
              <SW-DATA-DEF-PROPS-CONDITIONAL>
                <IMPLEMENTATION-DATA-TYPE-REF DEST="IMPLEMENTATION-DATA-TYPE">/AUTOSAR_Pwm_17_GtmCcu6/ImplementationDataTypes/Pwm_17_GtmCcu6_NotifiPtrType</IMPLEMENTATION-DATA-TYPE-REF>
              </SW-DATA-DEF-PROPS-CONDITIONAL>
            </SW-DATA-DEF-PROPS-VARIANTS>
          </SW-DATA-DEF-PROPS>
        </IMPLEMENTATION-DATA-TYPE-ELEMENT>
        <IMPLEMENTATION-DATA-TYPE-ELEMENT>
          <SHORT-NAME>PwmChannelInfo</SHORT-NAME>
          <CATEGORY>TYPE_REFERENCE</CATEGORY>
          <SW-DATA-DEF-PROPS>
            <SW-DATA-DEF-PROPS-VARIANTS>
              <SW-DATA-DEF-PROPS-CONDITIONAL>
                <IMPLEMENTATION-DATA-TYPE-REF DEST="IMPLEMENTATION-DATA-TYPE">/AUTOSAR_Platform/ImplementationDataTypes/uint16</IMPLEMENTATION-DATA-TYPE-REF>
              </SW-DATA-DEF-PROPS-CONDITIONAL>
            </SW-DATA-DEF-PROPS-VARIANTS>
          </SW-DATA-DEF-PROPS>
        </IMPLEMENTATION-DATA-TYPE-ELEMENT>
        <IMPLEMENTATION-DATA-TYPE-ELEMENT>
          <SHORT-NAME>PwmPeriodDefault</SHORT-NAME>
          <CATEGORY>TYPE_REFERENCE</CATEGORY>
          <SW-DATA-DEF-PROPS>
            <SW-DATA-DEF-PROPS-VARIANTS>
              <SW-DATA-DEF-PROPS-CONDITIONAL>
                <IMPLEMENTATION-DATA-TYPE-REF DEST="IMPLEMENTATION-DATA-TYPE">/AUTOSAR_Pwm_17_GtmCcu6/ImplementationDataTypes/Pwm_17_GtmCcu6_PeriodType</IMPLEMENTATION-DATA-TYPE-REF>
              </SW-DATA-DEF-PROPS-CONDITIONAL>
            </SW-DATA-DEF-PROPS-VARIANTS>
          </SW-DATA-DEF-PROPS>
        </IMPLEMENTATION-DATA-TYPE-ELEMENT>
        <IMPLEMENTATION-DATA-TYPE-ELEMENT>
          <SHORT-NAME>PwmDutycycleDefault</SHORT-NAME>
          <CATEGORY>TYPE_REFERENCE</CATEGORY>
          <SW-DATA-DEF-PROPS>
            <SW-DATA-DEF-PROPS-VARIANTS>
              <SW-DATA-DEF-PROPS-CONDITIONAL>
                <IMPLEMENTATION-DATA-TYPE-REF DEST="IMPLEMENTATION-DATA-TYPE">/AUTOSAR_Platform/ImplementationDataTypes/uint32</IMPLEMENTATION-DATA-TYPE-REF>
              </SW-DATA-DEF-PROPS-CONDITIONAL>
            </SW-DATA-DEF-PROPS-VARIANTS>
          </SW-DATA-DEF-PROPS>
        </IMPLEMENTATION-DATA-TYPE-ELEMENT>
        <IMPLEMENTATION-DATA-TYPE-ELEMENT>
          <SHORT-NAME>PwmShiftValue</SHORT-NAME>
          <CATEGORY>TYPE_REFERENCE</CATEGORY>
          <SW-DATA-DEF-PROPS>
            <SW-DATA-DEF-PROPS-VARIANTS>
              <SW-DATA-DEF-PROPS-CONDITIONAL>
                <IMPLEMENTATION-DATA-TYPE-REF DEST="IMPLEMENTATION-DATA-TYPE">/AUTOSAR_Platform/ImplementationDataTypes/uint32</IMPLEMENTATION-DATA-TYPE-REF>
              </SW-DATA-DEF-PROPS-CONDITIONAL>
            </SW-DATA-DEF-PROPS-VARIANTS>
          </SW-DATA-DEF-PROPS>
        </IMPLEMENTATION-DATA-TYPE-ELEMENT>
        <IMPLEMENTATION-DATA-TYPE-ELEMENT>
          <SHORT-NAME>PwmChanneId</SHORT-NAME>
          <CATEGORY>TYPE_REFERENCE</CATEGORY>
          <SW-DATA-DEF-PROPS>
            <SW-DATA-DEF-PROPS-VARIANTS>
              <SW-DATA-DEF-PROPS-CONDITIONAL>
                <IMPLEMENTATION-DATA-TYPE-REF DEST="IMPLEMENTATION-DATA-TYPE">/AUTOSAR_Pwm_17_GtmCcu6/ImplementationDataTypes/Pwm_17_GtmCcu6_ChannelType</IMPLEMENTATION-DATA-TYPE-REF>
              </SW-DATA-DEF-PROPS-CONDITIONAL>
            </SW-DATA-DEF-PROPS-VARIANTS>
          </SW-DATA-DEF-PROPS>
        </IMPLEMENTATION-DATA-TYPE-ELEMENT>
        <IMPLEMENTATION-DATA-TYPE-ELEMENT>
          <SHORT-NAME>PwmTimerPtr</SHORT-NAME>
          <CATEGORY>DATA_REFERENCE</CATEGORY>
          <SW-DATA-DEF-PROPS>
            <SW-DATA-DEF-PROPS-VARIANTS>
              <SW-DATA-DEF-PROPS-CONDITIONAL>
                <SW-POINTER-TARGET-PROPS>
                  <TARGET-CATEGORY>TYPE_REFERENCE</TARGET-CATEGORY>
                  <SW-DATA-DEF-PROPS>
                    <SW-DATA-DEF-PROPS-VARIANTS>
                      <SW-DATA-DEF-PROPS-CONDITIONAL>
                        <IMPLEMENTATION-DATA-TYPE-REF DEST="IMPLEMENTATION-DATA-TYPE">/AUTOSAR_Platform/ImplementationDataTypes/uint32</IMPLEMENTATION-DATA-TYPE-REF>
                      </SW-DATA-DEF-PROPS-CONDITIONAL>
                    </SW-DATA-DEF-PROPS-VARIANTS>
                  </SW-DATA-DEF-PROPS>
                </SW-POINTER-TARGET-PROPS>
              </SW-DATA-DEF-PROPS-CONDITIONAL>
            </SW-DATA-DEF-PROPS-VARIANTS>
          </SW-DATA-DEF-PROPS>
        </IMPLEMENTATION-DATA-TYPE-ELEMENT>
        <IMPLEMENTATION-DATA-TYPE-ELEMENT>
          <SHORT-NAME>PwmTimerUsed</SHORT-NAME>
          <CATEGORY>TYPE_REFERENCE</CATEGORY>
          <SW-DATA-DEF-PROPS>
            <SW-DATA-DEF-PROPS-VARIANTS>
              <SW-DATA-DEF-PROPS-CONDITIONAL>
                <IMPLEMENTATION-DATA-TYPE-REF DEST="IMPLEMENTATION-DATA-TYPE">/AUTOSAR_Platform/ImplementationDataTypes/uint8</IMPLEMENTATION-DATA-TYPE-REF>
              </SW-DATA-DEF-PROPS-CONDITIONAL>
            </SW-DATA-DEF-PROPS-VARIANTS>
          </SW-DATA-DEF-PROPS>
        </IMPLEMENTATION-DATA-TYPE-ELEMENT>
      </SUB-ELEMENTS>
      <TYPE-EMITTER>BSW</TYPE-EMITTER>
    </IMPLEMENTATION-DATA-TYPE>
  </ELEMENTS>
</AR-PACKAGE>
</AR-PACKAGES>
</AR-PACKAGE>
</AR-PACKAGES>
</AUTOSAR>
