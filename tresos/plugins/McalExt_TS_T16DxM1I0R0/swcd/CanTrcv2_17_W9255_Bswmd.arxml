<?xml version="1.0" encoding="ISO-8859-1"?>
[!AUTOSPACING!][!//
<AUTOSAR xmlns="http://autosar.org/schema/r4.0"
  xmlns:xsi="http://www.w3.org/2001/XMLSchema-instance"
  xsi:schemaLocation="http://autosar.org/schema/r4.0 AUTOSAR_4-0-3.xsd">
 
[!NOCODE!][!//
[!SELECT "(as:stod( 'AURIX2G_W9255/EcucDefs/CanTrcv'))"!][!//

  [!VAR "CanTrcv_WakeUpSupport"="CanTrcvGeneral/CanTrcvWakeUpSupport"!][!//
  [!IF "node:exists(./CanTrcvGeneral/CanTrcvMainFunctionPeriod/*[1])"!]
    [!VAR "CanTrcv_MainFunctionPeriod"="./CanTrcvGeneral/CanTrcvMainFunctionPeriod/*[1]"!][!//
  [!ELSE!]
    [!VAR "CanTrcv_MainFunctionPeriod"="0.005"!][!//
  [!ENDIF!][!//
[!ENDSELECT!][!//

[!ENDNOCODE!][!// 
  
  <AR-PACKAGES>
    <AR-PACKAGE>
      <SHORT-NAME>AUTOSAR_CanTrcv</SHORT-NAME>
          <AR-PACKAGES>
            <AR-PACKAGE>
              <SHORT-NAME>BswModuleDescriptions</SHORT-NAME>
              <ELEMENTS>
                <BSW-MODULE-DESCRIPTION>
                  <SHORT-NAME>CanTrcv_17_W9255</SHORT-NAME>
                  <MODULE-ID>70</MODULE-ID>
                  <PROVIDED-ENTRYS>
                    <BSW-MODULE-ENTRY-REF-CONDITIONAL>
                      <BSW-MODULE-ENTRY-REF DEST="BSW-MODULE-ENTRY">/AUTOSAR_CanTrcv/BswModuleEntrys/CanTrcv_17_W9255_Init</BSW-MODULE-ENTRY-REF>
                    </BSW-MODULE-ENTRY-REF-CONDITIONAL>
[!IF "$CanTrcv_WakeUpSupport = 'CANTRCV_17_W9255_WAKE_UP_BY_POLLING'"!][!//
                    <BSW-MODULE-ENTRY-REF-CONDITIONAL>
                       <BSW-MODULE-ENTRY-REF DEST="BSW-MODULE-ENTRY">/AUTOSAR_CanTrcv/BswModuleEntrys/CanTrcv_17_W9255_MainFunction</BSW-MODULE-ENTRY-REF>
                    </BSW-MODULE-ENTRY-REF-CONDITIONAL>
[!ENDIF!][!//					
                  </PROVIDED-ENTRYS>
                  <INTERNAL-BEHAVIORS>
                    <BSW-INTERNAL-BEHAVIOR>
                      <SHORT-NAME>InternalBehavior_0</SHORT-NAME>
                      <EXCLUSIVE-AREAS>
                        <EXCLUSIVE-AREA>
                          <SHORT-NAME>SpiStatusUpdate</SHORT-NAME>
                        </EXCLUSIVE-AREA>
                      </EXCLUSIVE-AREAS>
                      <ENTITYS>
                        <BSW-CALLED-ENTITY>
                          <SHORT-NAME>CanTrcv_17_W9255_Init</SHORT-NAME>
                          <CAN-ENTER-EXCLUSIVE-AREA-REFS>
                            <CAN-ENTER-EXCLUSIVE-AREA-REF DEST="EXCLUSIVE-AREA">/AUTOSAR_CanTrcv/BswModuleDescriptions/CanTrcv_17_W9255/InternalBehavior_0/SpiStatusUpdate</CAN-ENTER-EXCLUSIVE-AREA-REF>
                          </CAN-ENTER-EXCLUSIVE-AREA-REFS>
                          <MINIMUM-START-INTERVAL>0.0</MINIMUM-START-INTERVAL>
                          <IMPLEMENTED-ENTRY-REF DEST="BSW-MODULE-ENTRY">/AUTOSAR_CanTrcv/BswModuleEntrys/CanTrcv_17_W9255_Init</IMPLEMENTED-ENTRY-REF>
                        </BSW-CALLED-ENTITY>
[!IF "$CanTrcv_WakeUpSupport = 'CANTRCV_17_W9255_WAKE_UP_BY_POLLING'"!][!//
                        <BSW-SCHEDULABLE-ENTITY>
                          <SHORT-NAME>CanTrcv_17_W9255_MainFunction</SHORT-NAME>
                          <CAN-ENTER-EXCLUSIVE-AREA-REFS>
                             <CAN-ENTER-EXCLUSIVE-AREA-REF DEST="EXCLUSIVE-AREA">/AUTOSAR_CanTrcv/BswModuleDescriptions/CanTrcv_17_W9255/InternalBehavior_0/SpiStatusUpdate</CAN-ENTER-EXCLUSIVE-AREA-REF>
                          </CAN-ENTER-EXCLUSIVE-AREA-REFS>
                          <MINIMUM-START-INTERVAL>0.005</MINIMUM-START-INTERVAL>
                          <IMPLEMENTED-ENTRY-REF DEST="BSW-MODULE-ENTRY">/AUTOSAR_CanTrcv/BswModuleEntrys/CanTrcv_17_W9255_MainFunction</IMPLEMENTED-ENTRY-REF>
                        </BSW-SCHEDULABLE-ENTITY>
[!ENDIF!][!//						
                      </ENTITYS>
              <EVENTS>
[!IF "$CanTrcv_WakeUpSupport = 'CANTRCV_17_W9255_WAKE_UP_BY_POLLING'"!][!//
                <BSW-TIMING-EVENT>
                  <SHORT-NAME>TimingEvent_CanTrcv_17_W9255_MainFunction</SHORT-NAME>
                  <STARTS-ON-EVENT-REF DEST="BSW-SCHEDULABLE-ENTITY">/AUTOSAR_CanTrcv/BswModuleDescriptions/CanTrcv_17_W9255/InternalBehavior_0/CanTrcv_17_W9255_MainFunction</STARTS-ON-EVENT-REF>
                  <PERIOD>[!"num:f($CanTrcv_MainFunctionPeriod)"!]</PERIOD>
                </BSW-TIMING-EVENT>
[!ENDIF!][!//
              </EVENTS>					  
                    </BSW-INTERNAL-BEHAVIOR>
                  </INTERNAL-BEHAVIORS>
                </BSW-MODULE-DESCRIPTION>
              </ELEMENTS>
            </AR-PACKAGE>
            <AR-PACKAGE>
              <SHORT-NAME>BswModuleEntrys</SHORT-NAME>
              <ELEMENTS>
                <BSW-MODULE-ENTRY>
                  <SHORT-NAME>CanTrcv_17_W9255_Init</SHORT-NAME>
                  <SERVICE-ID>70</SERVICE-ID>
                  <IS-REENTRANT>false</IS-REENTRANT>
                  <IS-SYNCHRONOUS>true</IS-SYNCHRONOUS>
                  <CALL-TYPE>REGULAR</CALL-TYPE>
                  <EXECUTION-CONTEXT>UNSPECIFIED</EXECUTION-CONTEXT>
                  <SW-SERVICE-IMPL-POLICY>STANDARD</SW-SERVICE-IMPL-POLICY>
                </BSW-MODULE-ENTRY>
[!IF "$CanTrcv_WakeUpSupport = 'CANTRCV_17_W9255_WAKE_UP_BY_POLLING'"!][!//
                <BSW-MODULE-ENTRY>
                  <SHORT-NAME>CanTrcv_17_W9255_MainFunction</SHORT-NAME>
                  <SERVICE-ID>6</SERVICE-ID>
                  <IS-REENTRANT>false</IS-REENTRANT>
                  <IS-SYNCHRONOUS>true</IS-SYNCHRONOUS>
                  <CALL-TYPE>SCHEDULED</CALL-TYPE>
                  <EXECUTION-CONTEXT>TASK</EXECUTION-CONTEXT>
                  <SW-SERVICE-IMPL-POLICY>STANDARD</SW-SERVICE-IMPL-POLICY>
                </BSW-MODULE-ENTRY>
[!ENDIF!][!//				
              </ELEMENTS>
        </AR-PACKAGE>
      </AR-PACKAGES>
    </AR-PACKAGE>

    <AR-PACKAGE>
      <SHORT-NAME>CanTrcv2_17_W9255_Aurix2GAS440</SHORT-NAME>
      <AR-PACKAGES>
        <AR-PACKAGE>
          <SHORT-NAME>Implementations</SHORT-NAME>
          <ELEMENTS>
            <BSW-IMPLEMENTATION>
              <SHORT-NAME>BswImplementation_0</SHORT-NAME>
              <CODE-DESCRIPTORS>
                <CODE>
                  <SHORT-NAME>Files</SHORT-NAME>
                  <ARTIFACT-DESCRIPTORS>
                    <AUTOSAR-ENGINEERING-OBJECT>
                      <SHORT-LABEL>make::CanTrcv_defs.mak</SHORT-LABEL>
                      <CATEGORY>SWMAKE</CATEGORY>
                    </AUTOSAR-ENGINEERING-OBJECT>
                    <AUTOSAR-ENGINEERING-OBJECT>
                      <SHORT-LABEL>make::CanTrcv_rules.mak</SHORT-LABEL>
                      <CATEGORY>SWMAKE</CATEGORY>
                    </AUTOSAR-ENGINEERING-OBJECT>
                  </ARTIFACT-DESCRIPTORS>
                </CODE>
              </CODE-DESCRIPTORS>
              <PROGRAMMING-LANGUAGE>C</PROGRAMMING-LANGUAGE>
            <RESOURCE-CONSUMPTION>
              <SHORT-NAME>ResourceConsumption</SHORT-NAME>
              <MEMORY-SECTIONS>
                <MEMORY-SECTION>
                  <SHORT-NAME>VAR_CLEARED_QM_LOCAL_16</SHORT-NAME>
                  <ALIGNMENT>16</ALIGNMENT>
                    <OPTIONS>
                    	<OPTION>coreLocal</OPTION>
                 	</OPTIONS>
                  <SW-ADDRMETHOD-REF DEST="SW-ADDR-METHOD">/AUTOSAR_MemMap/SwAddrMethods/VAR_CLEARED_LOCAL</SW-ADDRMETHOD-REF>
                </MEMORY-SECTION>
                <MEMORY-SECTION>
                  <SHORT-NAME>VAR_CLEARED_QM_LOCAL_8</SHORT-NAME>
                  <ALIGNMENT>8</ALIGNMENT>
                    <OPTIONS>
                    	<OPTION>coreLocal</OPTION>
                 	</OPTIONS>
                  <SW-ADDRMETHOD-REF DEST="SW-ADDR-METHOD">/AUTOSAR_MemMap/SwAddrMethods/VAR_CLEARED_LOCAL</SW-ADDRMETHOD-REF>
                </MEMORY-SECTION>
                <MEMORY-SECTION>
                  <SHORT-NAME>CODE_QM_LOCAL</SHORT-NAME>
                  <ALIGNMENT>UNSPECIFIED</ALIGNMENT>
                    <OPTIONS>
                    	<OPTION>coreLocal</OPTION>
                 	</OPTIONS>
                  <SW-ADDRMETHOD-REF DEST="SW-ADDR-METHOD">/AUTOSAR_McalExt/SwAddrMethods_McalExt/CODE_QM_LOCAL</SW-ADDRMETHOD-REF>
                </MEMORY-SECTION>
                <MEMORY-SECTION>
                  <SHORT-NAME>CODE</SHORT-NAME>
                  <ALIGNMENT>UNSPECIFIED</ALIGNMENT>
                  <SW-ADDRMETHOD-REF DEST="SW-ADDR-METHOD">/AUTOSAR_MemMap/SwAddrMethods/CODE</SW-ADDRMETHOD-REF>
                </MEMORY-SECTION>
                <MEMORY-SECTION>
                  <SHORT-NAME>VAR_CLEARED_QM_LOCAL_32</SHORT-NAME>
                  <ALIGNMENT>32</ALIGNMENT>
                    <OPTIONS>
                    	<OPTION>coreLocal</OPTION>
                 	</OPTIONS>
                  <SW-ADDRMETHOD-REF DEST="SW-ADDR-METHOD">/AUTOSAR_MemMap/SwAddrMethods/VAR_CLEARED_LOCAL</SW-ADDRMETHOD-REF>
                </MEMORY-SECTION>
                <MEMORY-SECTION>
                  <SHORT-NAME>CONFIG_DATA_QM_LOCAL_8</SHORT-NAME>
                  <ALIGNMENT>8</ALIGNMENT>
                    <OPTIONS>
                    	<OPTION>coreLocal</OPTION>
                 	</OPTIONS>
                  <SW-ADDRMETHOD-REF DEST="SW-ADDR-METHOD">/AUTOSAR_McalExt/SwAddrMethods_McalExt/CONFIG_DATA_LOCAL</SW-ADDRMETHOD-REF>
                </MEMORY-SECTION>
                <MEMORY-SECTION>
                  <SHORT-NAME>CONFIG_DATA_QM_LOCAL_UNSPECIFIED</SHORT-NAME>
                  <ALIGNMENT>UNSPECIFIED</ALIGNMENT>
                    <OPTIONS>
                    	<OPTION>coreLocal</OPTION>
                 	</OPTIONS>
                  <SW-ADDRMETHOD-REF DEST="SW-ADDR-METHOD">/AUTOSAR_McalExt/SwAddrMethods_McalExt/CONFIG_DATA_LOCAL</SW-ADDRMETHOD-REF>
                </MEMORY-SECTION>
                <MEMORY-SECTION>
                  <SHORT-NAME>CONFIG_DATA_QM_LOCAL_16</SHORT-NAME>
                  <ALIGNMENT>16</ALIGNMENT>
                    <OPTIONS>
                    	<OPTION>coreLocal</OPTION>
                 	</OPTIONS>
                  <SW-ADDRMETHOD-REF DEST="SW-ADDR-METHOD">/AUTOSAR_McalExt/SwAddrMethods_McalExt/CONFIG_DATA_LOCAL</SW-ADDRMETHOD-REF>
                </MEMORY-SECTION>
              </MEMORY-SECTIONS>
              <SECTION-NAME-PREFIXS>
                <SECTION-NAME-PREFIX>
                  <SHORT-NAME>CANTRCV_17_W9255</SHORT-NAME>
                  <SYMBOL>CANTRCV_17_W9255</SYMBOL>
                </SECTION-NAME-PREFIX>
              </SECTION-NAME-PREFIXS>
            </RESOURCE-CONSUMPTION>
              <SW-VERSION>20.25.0</SW-VERSION>
              <VENDOR-ID>17</VENDOR-ID>
              <AR-RELEASE-VERSION>4.4.0</AR-RELEASE-VERSION>
              <BEHAVIOR-REF DEST="BSW-INTERNAL-BEHAVIOR">/AUTOSAR_CanTrcv/BswModuleDescriptions/CanTrcv_17_W9255/InternalBehavior_0</BEHAVIOR-REF>
              <VENDOR-SPECIFIC-MODULE-DEF-REFS>
                <VENDOR-SPECIFIC-MODULE-DEF-REF DEST="ECUC-MODULE-DEF">/AURIX2G_W9255/EcucDefs/CanTrcv</VENDOR-SPECIFIC-MODULE-DEF-REF>
              </VENDOR-SPECIFIC-MODULE-DEF-REFS>
            </BSW-IMPLEMENTATION>
          </ELEMENTS>
        </AR-PACKAGE>
      </AR-PACKAGES>
    </AR-PACKAGE>
  </AR-PACKAGES>
</AUTOSAR>
