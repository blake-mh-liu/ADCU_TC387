<?xml version="1.0" encoding="ISO-8859-1"?>
[!AUTOSPACING!][!//
<AUTOSAR xmlns="http://autosar.org/schema/r4.0"
  xmlns:xsi="http://www.w3.org/2001/XMLSchema-instance"
  xsi:schemaLocation="http://autosar.org/schema/r4.0 AUTOSAR_4-0-3.xsd">
  <AR-PACKAGES>
    <AR-PACKAGE>
      <SHORT-NAME>AUTOSAR_Fee</SHORT-NAME>
      <AR-PACKAGES>
            <AR-PACKAGE>
              <SHORT-NAME>BswModuleDescriptions</SHORT-NAME>
              <ELEMENTS>
                <BSW-MODULE-DESCRIPTION>
                  <SHORT-NAME>Fee</SHORT-NAME>
                  <MODULE-ID>21</MODULE-ID>
                  <PROVIDED-ENTRYS>
                    <BSW-MODULE-ENTRY-REF-CONDITIONAL>
                      <BSW-MODULE-ENTRY-REF DEST="BSW-MODULE-ENTRY">/AUTOSAR_Fee/BswModuleEntrys/Fee_Init</BSW-MODULE-ENTRY-REF>
                    </BSW-MODULE-ENTRY-REF-CONDITIONAL>
                    <BSW-MODULE-ENTRY-REF-CONDITIONAL>
                      <BSW-MODULE-ENTRY-REF DEST="BSW-MODULE-ENTRY">/AUTOSAR_Fee/BswModuleEntrys/Fee_MainFunction</BSW-MODULE-ENTRY-REF>
                    </BSW-MODULE-ENTRY-REF-CONDITIONAL>
		    </PROVIDED-ENTRYS>
                  <INTERNAL-BEHAVIORS>
                    <BSW-INTERNAL-BEHAVIOR>
                      <SHORT-NAME>InternalBehavior_0</SHORT-NAME>
                      <EXCLUSIVE-AREAS>
                      </EXCLUSIVE-AREAS>
                      <ENTITYS>
                        <BSW-CALLED-ENTITY>
                          <SHORT-NAME>Fee_Init</SHORT-NAME>
                          <CAN-ENTER-EXCLUSIVE-AREA-REFS>
                          </CAN-ENTER-EXCLUSIVE-AREA-REFS>
                          <MINIMUM-START-INTERVAL>0.0</MINIMUM-START-INTERVAL>
                          <IMPLEMENTED-ENTRY-REF DEST="BSW-MODULE-ENTRY">/AUTOSAR_Fee/BswModuleEntrys/Fee_Init</IMPLEMENTED-ENTRY-REF>
                        </BSW-CALLED-ENTITY>
                        <BSW-SCHEDULABLE-ENTITY>
                          <SHORT-NAME>Fee_MainFunction</SHORT-NAME>
                          <MINIMUM-START-INTERVAL>0.0</MINIMUM-START-INTERVAL>
                          <IMPLEMENTED-ENTRY-REF DEST="BSW-MODULE-ENTRY">/AUTOSAR_Fee/BswModuleEntrys/Fee_MainFunction</IMPLEMENTED-ENTRY-REF>
                        </BSW-SCHEDULABLE-ENTITY>
                      </ENTITYS>
                      <EVENTS>
                        <BSW-TIMING-EVENT>
                          <SHORT-NAME>TimingEvent_MainFunction</SHORT-NAME>
                          <STARTS-ON-EVENT-REF DEST="BSW-SCHEDULABLE-ENTITY">/AUTOSAR_Fee/BswModuleDescriptions/Fee/InternalBehavior_0/Fee_MainFunction</STARTS-ON-EVENT-REF>
[!IF "node:exists(/AUTOSAR/TOP-LEVEL-PACKAGES/NvM/ELEMENTS/NvM/NvMCommon/NvMMainFunctionCycleTime)"!]
                          <PERIOD>[!"/AUTOSAR/TOP-LEVEL-PACKAGES/NvM/ELEMENTS/NvM/NvMCommon/NvMMainFunctionCycleTime"!]</PERIOD>
[!ELSE!]
                          <PERIOD>0.01</PERIOD>
[!ENDIF!]
                        </BSW-TIMING-EVENT>
                     </EVENTS>
                    </BSW-INTERNAL-BEHAVIOR>
                  </INTERNAL-BEHAVIORS>
                </BSW-MODULE-DESCRIPTION>
              </ELEMENTS>
            </AR-PACKAGE>
            <AR-PACKAGE>
              <SHORT-NAME>BswModuleEntrys</SHORT-NAME>
              <ELEMENTS>
                <BSW-MODULE-ENTRY>
                  <SHORT-NAME>Fee_Init</SHORT-NAME>
                  <SERVICE-ID>0</SERVICE-ID>
                  <IS-REENTRANT>false</IS-REENTRANT>
                  <IS-SYNCHRONOUS>true</IS-SYNCHRONOUS>
                  <CALL-TYPE>REGULAR</CALL-TYPE>
                  <EXECUTION-CONTEXT>UNSPECIFIED</EXECUTION-CONTEXT>
                  <SW-SERVICE-IMPL-POLICY>STANDARD</SW-SERVICE-IMPL-POLICY>
                </BSW-MODULE-ENTRY>
                 <BSW-MODULE-ENTRY>
                  <SHORT-NAME>Fee_MainFunction</SHORT-NAME>
                  <SERVICE-ID>18</SERVICE-ID>
                  <IS-REENTRANT>false</IS-REENTRANT>
                  <IS-SYNCHRONOUS>true</IS-SYNCHRONOUS>
                  <CALL-TYPE>SCHEDULED</CALL-TYPE>
                  <EXECUTION-CONTEXT>TASK</EXECUTION-CONTEXT>
                  <SW-SERVICE-IMPL-POLICY>STANDARD</SW-SERVICE-IMPL-POLICY>
                </BSW-MODULE-ENTRY>
              </ELEMENTS>
        </AR-PACKAGE>
      </AR-PACKAGES>
    </AR-PACKAGE>

    <AR-PACKAGE>
      <SHORT-NAME>Fee_Aurix2GAS440</SHORT-NAME>
      <AR-PACKAGES>
        <AR-PACKAGE>
          <SHORT-NAME>Implementations</SHORT-NAME>
          <ELEMENTS>
            <BSW-IMPLEMENTATION>
              <SHORT-NAME>BswImplementation_0</SHORT-NAME>
              <CODE-DESCRIPTORS>
                <CODE>
                  <SHORT-NAME>Files</SHORT-NAME>
                  <ARTIFACT-DESCRIPTORS>
                    <AUTOSAR-ENGINEERING-OBJECT>
                      <SHORT-LABEL>make::Fee_defs.mak</SHORT-LABEL>
                      <CATEGORY>SWMAKE</CATEGORY>
                    </AUTOSAR-ENGINEERING-OBJECT>
                    <AUTOSAR-ENGINEERING-OBJECT>
                      <SHORT-LABEL>make::Fee_rules.mak</SHORT-LABEL>
                      <CATEGORY>SWMAKE</CATEGORY>
                    </AUTOSAR-ENGINEERING-OBJECT>
                  </ARTIFACT-DESCRIPTORS>
                </CODE>
              </CODE-DESCRIPTORS>
              <PROGRAMMING-LANGUAGE>C</PROGRAMMING-LANGUAGE>
            <RESOURCE-CONSUMPTION>
              <SHORT-NAME>ResourceConsumption</SHORT-NAME>
                <MEMORY-SECTIONS>
                  <MEMORY-SECTION>
                    <SHORT-NAME>FEE_CODE</SHORT-NAME>				
                    <SW-ADDRMETHOD-REF DEST="SW-ADDR-METHOD">/AUTOSAR_MemMap/SwAddrMethods/CODE</SW-ADDRMETHOD-REF>
                    <SYMBOL>CODE</SYMBOL>
                  </MEMORY-SECTION>	
                  <MEMORY-SECTION>
                    <SHORT-NAME>CODE_ASIL_B_LOCAL</SHORT-NAME>
                    <ALIGNMENT>UNSPECIFIED</ALIGNMENT>
                    <OPTIONS>
                    	<OPTION>coreLocal</OPTION>
                    	<OPTION>safetyAsilB</OPTION>
                    </OPTIONS>
                    <SW-ADDRMETHOD-REF DEST="SW-ADDR-METHOD">/AUTOSAR_MemMap/SwAddrMethods/CODE_ASIL_B_LOCAL</SW-ADDRMETHOD-REF>
                  </MEMORY-SECTION>
                  <MEMORY-SECTION>
                    <SHORT-NAME>JOBENDNOTIF_CODE_ASIL_B_LOCAL</SHORT-NAME>
                    <ALIGNMENT>UNSPECIFIED</ALIGNMENT>
                    <OPTIONS>
                    	<OPTION>coreLocal</OPTION>
                    	<OPTION>safetyAsilB</OPTION>
                    </OPTIONS>
                    <SW-ADDRMETHOD-REF DEST="SW-ADDR-METHOD">/AUTOSAR_MemMap/SwAddrMethods/CODE_ASIL_B_LOCAL</SW-ADDRMETHOD-REF>
                  </MEMORY-SECTION>
                  <MEMORY-SECTION>
                    <SHORT-NAME>JOBERRNOTIF_CODE_ASIL_B_LOCAL</SHORT-NAME>
                    <ALIGNMENT>UNSPECIFIED</ALIGNMENT>
                    <OPTIONS>
                    	<OPTION>coreLocal</OPTION>
                    	<OPTION>safetyAsilB</OPTION>
                    </OPTIONS>
                    <SW-ADDRMETHOD-REF DEST="SW-ADDR-METHOD">/AUTOSAR_MemMap/SwAddrMethods/CODE_ASIL_B_LOCAL</SW-ADDRMETHOD-REF>
                  </MEMORY-SECTION>
                  <MEMORY-SECTION>
                    <SHORT-NAME>ILLEGALNOTIF_CODE_ASIL_B_LOCAL</SHORT-NAME>
                    <ALIGNMENT>UNSPECIFIED</ALIGNMENT>
                    <OPTIONS>
                    	<OPTION>coreLocal</OPTION>
                    	<OPTION>safetyAsilB</OPTION>
                    </OPTIONS>
                    <SW-ADDRMETHOD-REF DEST="SW-ADDR-METHOD">/AUTOSAR_MemMap/SwAddrMethods/CODE_ASIL_B_LOCAL</SW-ADDRMETHOD-REF>
                  </MEMORY-SECTION>
                  <MEMORY-SECTION>
                    <SHORT-NAME>ERASEERRORNOTI_CODE_ASIL_B_LOCAL</SHORT-NAME>
                    <ALIGNMENT>UNSPECIFIED</ALIGNMENT>
                    <OPTIONS>
                    	<OPTION>coreLocal</OPTION>
                    	<OPTION>safetyAsilB</OPTION>
                    </OPTIONS>
                    <SW-ADDRMETHOD-REF DEST="SW-ADDR-METHOD">/AUTOSAR_MemMap/SwAddrMethods/CODE_ASIL_B_LOCAL</SW-ADDRMETHOD-REF>
                  </MEMORY-SECTION>
                  <MEMORY-SECTION>
                    <SHORT-NAME>PROGERRORNOTI_CODE_ASIL_B_LOCAL</SHORT-NAME>
                    <ALIGNMENT>UNSPECIFIED</ALIGNMENT>
                    <OPTIONS>
                    	<OPTION>coreLocal</OPTION>
                    	<OPTION>safetyAsilB</OPTION>
                    </OPTIONS>
                    <SW-ADDRMETHOD-REF DEST="SW-ADDR-METHOD">/AUTOSAR_MemMap/SwAddrMethods/CODE_ASIL_B_LOCAL</SW-ADDRMETHOD-REF>
                  </MEMORY-SECTION>
                  <MEMORY-SECTION>
                    <SHORT-NAME>VAR_CLEARED_ASIL_B_LOCAL_UNSPECIFIED</SHORT-NAME>
                    <ALIGNMENT>UNSPECIFIED</ALIGNMENT>
                    <OPTIONS>
                    	<OPTION>coreLocal</OPTION>
                    	<OPTION>safetyAsilB</OPTION>
                    </OPTIONS>
                    <SW-ADDRMETHOD-REF DEST="SW-ADDR-METHOD">/AUTOSAR_MemMap/SwAddrMethods/VAR_CLEARED_ASIL_B_LOCAL</SW-ADDRMETHOD-REF>
                  </MEMORY-SECTION>
                  <MEMORY-SECTION>
                    <SHORT-NAME>VAR_CLEARED_ASIL_B_LOCAL_32</SHORT-NAME>
                    <ALIGNMENT>32</ALIGNMENT>
                    <OPTIONS>
                    	<OPTION>coreLocal</OPTION>
                    	<OPTION>safetyAsilB</OPTION>
                    </OPTIONS>
                    <SW-ADDRMETHOD-REF DEST="SW-ADDR-METHOD">/AUTOSAR_MemMap/SwAddrMethods/VAR_CLEARED_ASIL_B_LOCAL</SW-ADDRMETHOD-REF>
                  </MEMORY-SECTION>
                  <MEMORY-SECTION>
                    <SHORT-NAME>VAR_INIT_ASIL_B_LOCAL_8</SHORT-NAME>
                    <ALIGNMENT>8</ALIGNMENT>
                    <OPTIONS>
                    	<OPTION>coreLocal</OPTION>
                    	<OPTION>safetyAsilB</OPTION>
                    </OPTIONS>
                    <SW-ADDRMETHOD-REF DEST="SW-ADDR-METHOD">/AUTOSAR_MemMap/SwAddrMethods/VAR_INIT_ASIL_B_LOCAL</SW-ADDRMETHOD-REF>
                  </MEMORY-SECTION>
                  <MEMORY-SECTION>
                    <SHORT-NAME>CONST_ASIL_B_LOCAL_32</SHORT-NAME>
                    <ALIGNMENT>32</ALIGNMENT>
                    <OPTIONS>
                    	<OPTION>coreLocal</OPTION>
                    	<OPTION>safetyAsilB</OPTION>
                    </OPTIONS>
                    <SW-ADDRMETHOD-REF DEST="SW-ADDR-METHOD">/AUTOSAR_McalExt/SwAddrMethods_McalExt/CONST_ASIL_B_LOCAL</SW-ADDRMETHOD-REF>
                  </MEMORY-SECTION>
                  <MEMORY-SECTION>
                    <SHORT-NAME>CONFIG_DATA_ASIL_B_LOCAL_UNSPECIFIED</SHORT-NAME>
                    <ALIGNMENT>UNSPECIFIED</ALIGNMENT>
                    <OPTIONS>
                    	<OPTION>coreLocal</OPTION>
                    	<OPTION>safetyAsilB</OPTION>
                    </OPTIONS>
                    <SW-ADDRMETHOD-REF DEST="SW-ADDR-METHOD">/AUTOSAR_McalExt/SwAddrMethods_McalExt/CONFIG_DATA_ASIL_B_LOCAL</SW-ADDRMETHOD-REF>
                  </MEMORY-SECTION>
                </MEMORY-SECTIONS>
                <SECTION-NAME-PREFIXS>
                  <SECTION-NAME-PREFIX>
                    <SHORT-NAME>FEE</SHORT-NAME>
                    <SYMBOL>FEE</SYMBOL>
                  </SECTION-NAME-PREFIX>
                </SECTION-NAME-PREFIXS>
            </RESOURCE-CONSUMPTION>
              <SW-VERSION>20.25.0</SW-VERSION>
              <VENDOR-ID>17</VENDOR-ID>
              <AR-RELEASE-VERSION>4.4.0</AR-RELEASE-VERSION>
              <BEHAVIOR-REF DEST="BSW-INTERNAL-BEHAVIOR">/AUTOSAR_Fee/BswModuleDescriptions/Fee/InternalBehavior_0</BEHAVIOR-REF>
              <VENDOR-SPECIFIC-MODULE-DEF-REFS>
                <VENDOR-SPECIFIC-MODULE-DEF-REF DEST="ECUC-MODULE-DEF">/AURIX2G/EcucDefs/Fee</VENDOR-SPECIFIC-MODULE-DEF-REF>
              </VENDOR-SPECIFIC-MODULE-DEF-REFS>
            </BSW-IMPLEMENTATION>
          </ELEMENTS>
        </AR-PACKAGE>
      </AR-PACKAGES>
    </AR-PACKAGE>
  </AR-PACKAGES>
</AUTOSAR>
