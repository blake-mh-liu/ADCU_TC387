<?xml version="1.0" encoding="UTF-8"?>
<AUTOSAR xmlns="http://autosar.org/schema/r4.0"
         xmlns:xsi="http://www.w3.org/2001/XMLSchema-instance"
         xsi:schemaLocation="http://autosar.org/schema/r4.0 AUTOSAR_4-0-3_STRICT_COMPACT.xsd">
[!/* do not generate this file if RTE is not used */!][!//
[!IF "CsmGeneral/CsmRteUsage = 'false'"!][!//
  [!SKIPFILE!][!//
[!ELSE!][!//

  <AR-PACKAGES>
    <!-- AUTOSAR_Csm -->
    <AR-PACKAGE>
      <SHORT-NAME>AUTOSAR_Csm</SHORT-NAME>
      <ELEMENTS/>
      <AR-PACKAGES>
        <AR-PACKAGE>
          <SHORT-NAME>CompuMethods</SHORT-NAME>
          <ELEMENTS>
            <COMPU-METHOD>
              <SHORT-NAME>CM_Csm_ReturnType</SHORT-NAME>
              <CATEGORY>TEXTTABLE</CATEGORY>
              <COMPU-INTERNAL-TO-PHYS>
                <COMPU-SCALES>
                  <COMPU-SCALE>
                    <LOWER-LIMIT INTERVAL-TYPE="CLOSED">0</LOWER-LIMIT>
                    <UPPER-LIMIT INTERVAL-TYPE="CLOSED">0</UPPER-LIMIT>
                    <COMPU-CONST>
                      <VT>CSM_E_OK</VT>
                    </COMPU-CONST>
                  </COMPU-SCALE>
                  <COMPU-SCALE>
                    <LOWER-LIMIT INTERVAL-TYPE="CLOSED">1</LOWER-LIMIT>
                    <UPPER-LIMIT INTERVAL-TYPE="CLOSED">1</UPPER-LIMIT>
                    <COMPU-CONST>
                      <VT>CSM_E_NOT_OK</VT>
                    </COMPU-CONST>
                  </COMPU-SCALE>
                  <COMPU-SCALE>
                    <LOWER-LIMIT INTERVAL-TYPE="CLOSED">2</LOWER-LIMIT>
                    <UPPER-LIMIT INTERVAL-TYPE="CLOSED">2</UPPER-LIMIT>
                    <COMPU-CONST>
                      <VT>CSM_E_BUSY</VT>
                    </COMPU-CONST>
                  </COMPU-SCALE>
                  <COMPU-SCALE>
                    <LOWER-LIMIT INTERVAL-TYPE="CLOSED">3</LOWER-LIMIT>
                    <UPPER-LIMIT INTERVAL-TYPE="CLOSED">3</UPPER-LIMIT>
                    <COMPU-CONST>
                      <VT>CSM_E_SMALL_BUFFER</VT>
                    </COMPU-CONST>
                  </COMPU-SCALE>
                  <COMPU-SCALE>
                    <LOWER-LIMIT INTERVAL-TYPE="CLOSED">4</LOWER-LIMIT>
                    <UPPER-LIMIT INTERVAL-TYPE="CLOSED">4</UPPER-LIMIT>
                    <COMPU-CONST>
                      <VT>CSM_E_ENTROPY_EXHAUSTION</VT>
                    </COMPU-CONST>
                  </COMPU-SCALE>
                </COMPU-SCALES>
              </COMPU-INTERNAL-TO-PHYS>
            </COMPU-METHOD>
            <COMPU-METHOD>
              <SHORT-NAME>CM_Csm_VerifyResultType</SHORT-NAME>
              <CATEGORY>TEXTTABLE</CATEGORY>
              <COMPU-INTERNAL-TO-PHYS>
                <COMPU-SCALES>
                  <COMPU-SCALE>
                    <LOWER-LIMIT INTERVAL-TYPE="CLOSED">0</LOWER-LIMIT>
                    <UPPER-LIMIT INTERVAL-TYPE="CLOSED">0</UPPER-LIMIT>
                    <COMPU-CONST>
                      <VT>CSM_E_VER_OK</VT>
                    </COMPU-CONST>
                  </COMPU-SCALE>
                  <COMPU-SCALE>
                    <LOWER-LIMIT INTERVAL-TYPE="CLOSED">1</LOWER-LIMIT>
                    <UPPER-LIMIT INTERVAL-TYPE="CLOSED">1</UPPER-LIMIT>
                    <COMPU-CONST>
                      <VT>CSM_E_VER_NOT_OK</VT>
                    </COMPU-CONST>
                  </COMPU-SCALE>
                </COMPU-SCALES>
              </COMPU-INTERNAL-TO-PHYS>
            </COMPU-METHOD>
          </ELEMENTS>
        </AR-PACKAGE>

        <AR-PACKAGE>
          <SHORT-NAME>ImplementationDataTypes</SHORT-NAME>
          <ELEMENTS>
            <!-- !LINKSTO EB_CSM0069_01, 1 -->
            <IMPLEMENTATION-DATA-TYPE>
              <SHORT-NAME>Csm_ReturnType</SHORT-NAME>
              <CATEGORY>TYPE_REFERENCE</CATEGORY>
              <SW-DATA-DEF-PROPS>
                <SW-DATA-DEF-PROPS-VARIANTS>
                  <SW-DATA-DEF-PROPS-CONDITIONAL>
                    <COMPU-METHOD-REF DEST="COMPU-METHOD">/AUTOSAR_Csm/CompuMethods/CM_Csm_ReturnType</COMPU-METHOD-REF>
                    <IMPLEMENTATION-DATA-TYPE-REF DEST="IMPLEMENTATION-DATA-TYPE">/AUTOSAR_Platform/ImplementationDataTypes/uint8</IMPLEMENTATION-DATA-TYPE-REF>
                  </SW-DATA-DEF-PROPS-CONDITIONAL>
                </SW-DATA-DEF-PROPS-VARIANTS>
              </SW-DATA-DEF-PROPS>
            </IMPLEMENTATION-DATA-TYPE>
            <!-- !LINKSTO EB_CSM0075_01, 1 -->
            <IMPLEMENTATION-DATA-TYPE>
              <SHORT-NAME>Csm_VerifyResultType</SHORT-NAME>
              <CATEGORY>TYPE_REFERENCE</CATEGORY>
              <SW-DATA-DEF-PROPS>
                <SW-DATA-DEF-PROPS-VARIANTS>
                  <SW-DATA-DEF-PROPS-CONDITIONAL>
                    <COMPU-METHOD-REF DEST="COMPU-METHOD">/AUTOSAR_Csm/CompuMethods/CM_Csm_VerifyResultType</COMPU-METHOD-REF>
                    <IMPLEMENTATION-DATA-TYPE-REF DEST="IMPLEMENTATION-DATA-TYPE">/AUTOSAR_Platform/ImplementationDataTypes/uint8</IMPLEMENTATION-DATA-TYPE-REF>
                  </SW-DATA-DEF-PROPS-CONDITIONAL>
                </SW-DATA-DEF-PROPS-VARIANTS>
              </SW-DATA-DEF-PROPS>
            </IMPLEMENTATION-DATA-TYPE>
            <!-- !LINKSTO CSM0691, 1 -->
            <IMPLEMENTATION-DATA-TYPE>
              <SHORT-NAME>Csm_ConfigIdType</SHORT-NAME>
              <CATEGORY>TYPE_REFERENCE</CATEGORY>
              <SW-DATA-DEF-PROPS>
                <SW-DATA-DEF-PROPS-VARIANTS>
                  <SW-DATA-DEF-PROPS-CONDITIONAL>
                    <IMPLEMENTATION-DATA-TYPE-REF DEST="IMPLEMENTATION-DATA-TYPE">/AUTOSAR_Platform/ImplementationDataTypes/uint16</IMPLEMENTATION-DATA-TYPE-REF>
                  </SW-DATA-DEF-PROPS-CONDITIONAL>
                </SW-DATA-DEF-PROPS-VARIANTS>
              </SW-DATA-DEF-PROPS>
            </IMPLEMENTATION-DATA-TYPE>
            <!-- !LINKSTO CSM0728, 1 -->
            <IMPLEMENTATION-DATA-TYPE>
              <SHORT-NAME>Csm_AlignType</SHORT-NAME>
              <CATEGORY>TYPE_REFERENCE</CATEGORY>
              <SW-DATA-DEF-PROPS>
                <SW-DATA-DEF-PROPS-VARIANTS>
                  <SW-DATA-DEF-PROPS-CONDITIONAL>
                    <IMPLEMENTATION-DATA-TYPE-REF DEST="IMPLEMENTATION-DATA-TYPE">/AUTOSAR_Platform/ImplementationDataTypes/[!"node:value(as:modconf('Csm')/CsmGeneral/CsmMaxAlignScalarType)"!]</IMPLEMENTATION-DATA-TYPE-REF>
                  </SW-DATA-DEF-PROPS-CONDITIONAL>
                </SW-DATA-DEF-PROPS-VARIANTS>
              </SW-DATA-DEF-PROPS>
            </IMPLEMENTATION-DATA-TYPE>
[!//
[!// The following parameters are not used for the calculation of the size of the type
[!// Csm_SymKeyType/SymKeyType because the corresponding services
[!// are not implemented
[!//   CsmKeyDeriveMaxKeySize
[!//   CsmKeyExchangeCalcSymKeyMaxSymKeySize
[!//   CsmKeyDeriveSymKeyMaxSymKeySize
[!//
[!VAR "CsmSymKeyLength" = "1"!][!//
[!IF "$CsmSymKeyLength < node:value(as:modconf('Csm')/CsmSymBlockEncrypt/CsmSymBlockEncryptMaxKeySize)"!][!//
  [!VAR "CsmSymKeyLength" = "node:value(as:modconf('Csm')/CsmSymBlockEncrypt/CsmSymBlockEncryptMaxKeySize)"!][!//
[!ENDIF!][!//
[!IF "$CsmSymKeyLength < node:value(as:modconf('Csm')/CsmSymBlockDecrypt/CsmSymBlockDecryptMaxKeySize)"!][!//
  [!VAR "CsmSymKeyLength" = "node:value(as:modconf('Csm')/CsmSymBlockDecrypt/CsmSymBlockDecryptMaxKeySize)"!][!//
[!ENDIF!][!//
[!IF "$CsmSymKeyLength < node:value(as:modconf('Csm')/CsmSymEncrypt/CsmSymEncryptMaxKeySize)"!][!//
  [!VAR "CsmSymKeyLength" = "node:value(as:modconf('Csm')/CsmSymEncrypt/CsmSymEncryptMaxKeySize)"!][!//
[!ENDIF!][!//
[!IF "$CsmSymKeyLength < node:value(as:modconf('Csm')/CsmSymDecrypt/CsmSymDecryptMaxKeySize)"!][!//
  [!VAR "CsmSymKeyLength" = "node:value(as:modconf('Csm')/CsmSymDecrypt/CsmSymDecryptMaxKeySize)"!][!//
[!ENDIF!][!//
[!IF "$CsmSymKeyLength < node:value(as:modconf('Csm')/CsmSymKeyExtract/CsmSymKeyExtractMaxKeySize)"!][!//
  [!VAR "CsmSymKeyLength" = "node:value(as:modconf('Csm')/CsmSymKeyExtract/CsmSymKeyExtractMaxKeySize)"!][!//
[!ENDIF!][!//
[!IF "$CsmSymKeyLength < node:value(as:modconf('Csm')/CsmMacGenerate/CsmMacGenerateMaxKeySize)"!][!//
  [!VAR "CsmSymKeyLength" = "node:value(as:modconf('Csm')/CsmMacGenerate/CsmMacGenerateMaxKeySize)"!][!//
[!ENDIF!][!//
[!IF "$CsmSymKeyLength < node:value(as:modconf('Csm')/CsmMacVerify/CsmMacVerifyMaxKeySize)"!][!//
  [!VAR "CsmSymKeyLength" = "node:value(as:modconf('Csm')/CsmMacVerify/CsmMacVerifyMaxKeySize)"!][!//
[!ENDIF!][!//
[!IF "$CsmSymKeyLength < node:value(as:modconf('Csm')/CsmSymKeyWrapSym/CsmSymKeyWrapSymMaxSymKeySize)"!][!//
  [!VAR "CsmSymKeyLength" = "node:value(as:modconf('Csm')/CsmSymKeyWrapSym/CsmSymKeyWrapSymMaxSymKeySize)"!][!//
[!ENDIF!][!//
[!IF "$CsmSymKeyLength < node:value(as:modconf('Csm')/CsmSymKeyWrapAsym/CsmSymKeyWrapAsymMaxSymKeySize)"!][!//
  [!VAR "CsmSymKeyLength" = "node:value(as:modconf('Csm')/CsmSymKeyWrapAsym/CsmSymKeyWrapAsymMaxSymKeySize)"!][!//
[!ENDIF!][!//
[!IF "$CsmSymKeyLength < node:value(as:modconf('Csm')/CsmAsymPrivateKeyWrapSym/CsmAsymPrivateKeyWrapSymMaxSymKeySize)"!][!//
  [!VAR "CsmSymKeyLength" = "node:value(as:modconf('Csm')/CsmAsymPrivateKeyWrapSym/CsmAsymPrivateKeyWrapSymMaxSymKeySize)"!][!//
[!ENDIF!][!//
[!//
            <!-- !LINKSTO CSM0802, 1 -->
            <IMPLEMENTATION-DATA-TYPE>
              <SHORT-NAME>SymKeyType</SHORT-NAME>
              <CATEGORY>STRUCTURE</CATEGORY>
              <SUB-ELEMENTS>
                <IMPLEMENTATION-DATA-TYPE-ELEMENT>
                  <SHORT-NAME>length</SHORT-NAME>
                  <CATEGORY>TYPE_REFERENCE</CATEGORY>
                  <SW-DATA-DEF-PROPS>
                    <SW-DATA-DEF-PROPS-VARIANTS>
                      <SW-DATA-DEF-PROPS-CONDITIONAL>
                        <IMPLEMENTATION-DATA-TYPE-REF DEST="IMPLEMENTATION-DATA-TYPE">/AUTOSAR_Platform/ImplementationDataTypes/uint32</IMPLEMENTATION-DATA-TYPE-REF>
                      </SW-DATA-DEF-PROPS-CONDITIONAL>
                    </SW-DATA-DEF-PROPS-VARIANTS>
                  </SW-DATA-DEF-PROPS>
                </IMPLEMENTATION-DATA-TYPE-ELEMENT>
                <IMPLEMENTATION-DATA-TYPE-ELEMENT>
                  <SHORT-NAME>data</SHORT-NAME>
                  <CATEGORY>TYPE_REFERENCE</CATEGORY>
                    <SW-DATA-DEF-PROPS>
                      <SW-DATA-DEF-PROPS-VARIANTS>
                        <SW-DATA-DEF-PROPS-CONDITIONAL>
                          <IMPLEMENTATION-DATA-TYPE-REF DEST="IMPLEMENTATION-DATA-TYPE">/AUTOSAR_Csm/ImplementationDataTypes/SymKeyTypeData</IMPLEMENTATION-DATA-TYPE-REF>
                        </SW-DATA-DEF-PROPS-CONDITIONAL>
                      </SW-DATA-DEF-PROPS-VARIANTS>
                    </SW-DATA-DEF-PROPS>
                 </IMPLEMENTATION-DATA-TYPE-ELEMENT>
              </SUB-ELEMENTS>
            </IMPLEMENTATION-DATA-TYPE>
            <!-- !LINKSTO CSM0802, 1 -->
            <IMPLEMENTATION-DATA-TYPE>
              <SHORT-NAME>SymKeyTypeData</SHORT-NAME>
              <CATEGORY>ARRAY</CATEGORY>
              <SUB-ELEMENTS>
                <IMPLEMENTATION-DATA-TYPE-ELEMENT>
                  <SHORT-NAME>AuxSymKeyTypeData</SHORT-NAME>
                  <CATEGORY>TYPE_REFERENCE</CATEGORY>
                  <ARRAY-SIZE>[!"num:i((($CsmSymKeyLength - 1) div node:value(as:modconf('Csm')/CsmGeneral/CsmSizeMaxAlignScalarType)) + 1)"!]</ARRAY-SIZE>
                  <ARRAY-SIZE-SEMANTICS>FIXED-SIZE</ARRAY-SIZE-SEMANTICS>
                  <SW-DATA-DEF-PROPS>
                    <SW-DATA-DEF-PROPS-VARIANTS>
                      <SW-DATA-DEF-PROPS-CONDITIONAL>
                        <IMPLEMENTATION-DATA-TYPE-REF DEST="IMPLEMENTATION-DATA-TYPE">/AUTOSAR_Platform/ImplementationDataTypes/[!"CsmGeneral/CsmMaxAlignScalarType"!]</IMPLEMENTATION-DATA-TYPE-REF>
                      </SW-DATA-DEF-PROPS-CONDITIONAL>
                    </SW-DATA-DEF-PROPS-VARIANTS>
                  </SW-DATA-DEF-PROPS>
                </IMPLEMENTATION-DATA-TYPE-ELEMENT>
              </SUB-ELEMENTS>
            </IMPLEMENTATION-DATA-TYPE>
[!//
[!// The following parameters are not used for the calculation of the size of the type
[!// Csm_AsymPrivateKeyType/AsymPrivateKeyType because the corresponding services
[!// are not implemented
[!//   CsmAsymDecryptMaxKeySize
[!//   CsmAsymPrivateKeyExtractMaxKeySize
[!//
[!VAR "CsmAsymPrivateKeyLength" = "1"!][!//
[!IF "$CsmAsymPrivateKeyLength < node:value(as:modconf('Csm')/CsmSignatureGenerate/CsmSignatureGenerateMaxKeySize)"!][!//
  [!VAR "CsmAsymPrivateKeyLength" = "node:value(as:modconf('Csm')/CsmSignatureGenerate/CsmSignatureGenerateMaxKeySize)"!][!//
[!ENDIF!][!//
[!IF "$CsmAsymPrivateKeyLength < node:value(as:modconf('Csm')/CsmAsymPrivateKeyWrapSym/CsmAsymPrivateKeyWrapSymMaxPrivKeySize)"!][!//
  [!VAR "CsmAsymPrivateKeyLength" = "node:value(as:modconf('Csm')/CsmAsymPrivateKeyWrapSym/CsmAsymPrivateKeyWrapSymMaxPrivKeySize)"!][!//
[!ENDIF!][!//
[!IF "$CsmAsymPrivateKeyLength < node:value(as:modconf('Csm')/CsmAsymPrivateKeyWrapAsym/CsmAsymPrivateKeyWrapAsymMaxPrivKeySize)"!][!//
  [!VAR "CsmAsymPrivateKeyLength" = "node:value(as:modconf('Csm')/CsmAsymPrivateKeyWrapAsym/CsmAsymPrivateKeyWrapAsymMaxPrivKeySize)"!][!//
[!ENDIF!][!//
[!//
            <!-- !LINKSTO CSM0802, 1 -->
            <IMPLEMENTATION-DATA-TYPE>
              <SHORT-NAME>AsymPrivateKeyType</SHORT-NAME>
              <CATEGORY>STRUCTURE</CATEGORY>
              <SUB-ELEMENTS>
                <IMPLEMENTATION-DATA-TYPE-ELEMENT>
                  <SHORT-NAME>length</SHORT-NAME>
                  <CATEGORY>TYPE_REFERENCE</CATEGORY>
                  <SW-DATA-DEF-PROPS>
                    <SW-DATA-DEF-PROPS-VARIANTS>
                      <SW-DATA-DEF-PROPS-CONDITIONAL>
                        <IMPLEMENTATION-DATA-TYPE-REF DEST="IMPLEMENTATION-DATA-TYPE">/AUTOSAR_Platform/ImplementationDataTypes/uint32</IMPLEMENTATION-DATA-TYPE-REF>
                      </SW-DATA-DEF-PROPS-CONDITIONAL>
                    </SW-DATA-DEF-PROPS-VARIANTS>
                  </SW-DATA-DEF-PROPS>
                </IMPLEMENTATION-DATA-TYPE-ELEMENT>
                <IMPLEMENTATION-DATA-TYPE-ELEMENT>
                  <SHORT-NAME>data</SHORT-NAME>
                  <CATEGORY>TYPE_REFERENCE</CATEGORY>
                    <SW-DATA-DEF-PROPS>
                      <SW-DATA-DEF-PROPS-VARIANTS>
                        <SW-DATA-DEF-PROPS-CONDITIONAL>
                          <IMPLEMENTATION-DATA-TYPE-REF DEST="IMPLEMENTATION-DATA-TYPE">/AUTOSAR_Csm/ImplementationDataTypes/AsymPrivateKeyTypeData</IMPLEMENTATION-DATA-TYPE-REF>
                        </SW-DATA-DEF-PROPS-CONDITIONAL>
                      </SW-DATA-DEF-PROPS-VARIANTS>
                    </SW-DATA-DEF-PROPS>
                 </IMPLEMENTATION-DATA-TYPE-ELEMENT>
              </SUB-ELEMENTS>
            </IMPLEMENTATION-DATA-TYPE>
            <!-- !LINKSTO CSM0802, 1 -->
            <IMPLEMENTATION-DATA-TYPE>
              <SHORT-NAME>AsymPrivateKeyTypeData</SHORT-NAME>
              <CATEGORY>ARRAY</CATEGORY>
              <SUB-ELEMENTS>
                <IMPLEMENTATION-DATA-TYPE-ELEMENT>
                  <SHORT-NAME>AuxAsymPrivateKeyTypeData</SHORT-NAME>
                  <CATEGORY>TYPE_REFERENCE</CATEGORY>
                  <ARRAY-SIZE>[!"num:i((($CsmAsymPrivateKeyLength - 1) div node:value(as:modconf('Csm')/CsmGeneral/CsmSizeMaxAlignScalarType)) + 1)"!]</ARRAY-SIZE>
                  <ARRAY-SIZE-SEMANTICS>FIXED-SIZE</ARRAY-SIZE-SEMANTICS>
                  <SW-DATA-DEF-PROPS>
                    <SW-DATA-DEF-PROPS-VARIANTS>
                      <SW-DATA-DEF-PROPS-CONDITIONAL>
                        <IMPLEMENTATION-DATA-TYPE-REF DEST="IMPLEMENTATION-DATA-TYPE">/AUTOSAR_Platform/ImplementationDataTypes/[!"CsmGeneral/CsmMaxAlignScalarType"!]</IMPLEMENTATION-DATA-TYPE-REF>
                      </SW-DATA-DEF-PROPS-CONDITIONAL>
                    </SW-DATA-DEF-PROPS-VARIANTS>
                  </SW-DATA-DEF-PROPS>
                </IMPLEMENTATION-DATA-TYPE-ELEMENT>
              </SUB-ELEMENTS>
            </IMPLEMENTATION-DATA-TYPE>
[!//
[!// The following parameters are not used for the calculation of the size of the type
[!// Csm_AsymPublicKeyType/AsymPublicKeyType because the corresponding services
[!// are not implemented
[!//   CsmAsymEncryptMaxKeySize
[!//
[!VAR "CsmAsymPublicKeyLength" = "1"!][!//
[!IF "$CsmAsymPublicKeyLength < node:value(as:modconf('Csm')/CsmSignatureVerify/CsmSignatureVerifyMaxKeySize)"!][!//
  [!VAR "CsmAsymPublicKeyLength" = "node:value(as:modconf('Csm')/CsmSignatureVerify/CsmSignatureVerifyMaxKeySize)"!][!//
[!ENDIF!][!//
[!IF "$CsmAsymPublicKeyLength < node:value(as:modconf('Csm')/CsmAsymPublicKeyExtract/CsmAsymPublicKeyExtractMaxKeySize)"!][!//
  [!VAR "CsmAsymPublicKeyLength" = "node:value(as:modconf('Csm')/CsmAsymPublicKeyExtract/CsmAsymPublicKeyExtractMaxKeySize)"!][!//
[!ENDIF!][!//
[!IF "$CsmAsymPublicKeyLength < node:value(as:modconf('Csm')/CsmSymKeyWrapAsym/CsmSymKeyWrapAsymMaxPubKeySize)"!][!//
  [!VAR "CsmAsymPublicKeyLength" = "node:value(as:modconf('Csm')/CsmSymKeyWrapAsym/CsmSymKeyWrapAsymMaxPubKeySize)"!][!//
[!ENDIF!][!//
[!IF "$CsmAsymPublicKeyLength < node:value(as:modconf('Csm')/CsmAsymPrivateKeyWrapAsym/CsmAsymPrivateKeyWrapAsymMaxPubKeySize)"!][!//
  [!VAR "CsmAsymPublicKeyLength" = "node:value(as:modconf('Csm')/CsmAsymPrivateKeyWrapAsym/CsmAsymPrivateKeyWrapAsymMaxPubKeySize)"!][!//
[!ENDIF!][!//
[!//
            <!-- !LINKSTO CSM0802, 1 -->
            <IMPLEMENTATION-DATA-TYPE>
              <SHORT-NAME>AsymPublicKeyType</SHORT-NAME>
              <CATEGORY>STRUCTURE</CATEGORY>
              <SUB-ELEMENTS>
                <IMPLEMENTATION-DATA-TYPE-ELEMENT>
                  <SHORT-NAME>length</SHORT-NAME>
                  <CATEGORY>TYPE_REFERENCE</CATEGORY>
                  <SW-DATA-DEF-PROPS>
                    <SW-DATA-DEF-PROPS-VARIANTS>
                      <SW-DATA-DEF-PROPS-CONDITIONAL>
                        <IMPLEMENTATION-DATA-TYPE-REF DEST="IMPLEMENTATION-DATA-TYPE">/AUTOSAR_Platform/ImplementationDataTypes/uint32</IMPLEMENTATION-DATA-TYPE-REF>
                      </SW-DATA-DEF-PROPS-CONDITIONAL>
                    </SW-DATA-DEF-PROPS-VARIANTS>
                  </SW-DATA-DEF-PROPS>
                </IMPLEMENTATION-DATA-TYPE-ELEMENT>
                <IMPLEMENTATION-DATA-TYPE-ELEMENT>
                  <SHORT-NAME>data</SHORT-NAME>
                  <CATEGORY>TYPE_REFERENCE</CATEGORY>
                    <SW-DATA-DEF-PROPS>
                      <SW-DATA-DEF-PROPS-VARIANTS>
                        <SW-DATA-DEF-PROPS-CONDITIONAL>
                          <IMPLEMENTATION-DATA-TYPE-REF DEST="IMPLEMENTATION-DATA-TYPE">/AUTOSAR_Csm/ImplementationDataTypes/AsymPublicKeyTypeData</IMPLEMENTATION-DATA-TYPE-REF>
                        </SW-DATA-DEF-PROPS-CONDITIONAL>
                      </SW-DATA-DEF-PROPS-VARIANTS>
                    </SW-DATA-DEF-PROPS>
                 </IMPLEMENTATION-DATA-TYPE-ELEMENT>
              </SUB-ELEMENTS>
            </IMPLEMENTATION-DATA-TYPE>
            <!-- !LINKSTO CSM0802, 1 -->
            <IMPLEMENTATION-DATA-TYPE>
              <SHORT-NAME>AsymPublicKeyTypeData</SHORT-NAME>
              <CATEGORY>ARRAY</CATEGORY>
              <SUB-ELEMENTS>
                <IMPLEMENTATION-DATA-TYPE-ELEMENT>
                  <SHORT-NAME>AuxAsymPublicKeyTypeData</SHORT-NAME>
                  <CATEGORY>TYPE_REFERENCE</CATEGORY>
                  <ARRAY-SIZE>[!"num:i((($CsmAsymPublicKeyLength - 1) div node:value(as:modconf('Csm')/CsmGeneral/CsmSizeMaxAlignScalarType)) + 1)"!]</ARRAY-SIZE>
                  <ARRAY-SIZE-SEMANTICS>FIXED-SIZE</ARRAY-SIZE-SEMANTICS>
                  <SW-DATA-DEF-PROPS>
                    <SW-DATA-DEF-PROPS-VARIANTS>
                      <SW-DATA-DEF-PROPS-CONDITIONAL>
                        <IMPLEMENTATION-DATA-TYPE-REF DEST="IMPLEMENTATION-DATA-TYPE">/AUTOSAR_Platform/ImplementationDataTypes/[!"CsmGeneral/CsmMaxAlignScalarType"!]</IMPLEMENTATION-DATA-TYPE-REF>
                      </SW-DATA-DEF-PROPS-CONDITIONAL>
                    </SW-DATA-DEF-PROPS-VARIANTS>
                  </SW-DATA-DEF-PROPS>
                </IMPLEMENTATION-DATA-TYPE-ELEMENT>
              </SUB-ELEMENTS>
            </IMPLEMENTATION-DATA-TYPE>
            <!-- !LINKSTO CSM0802, 1 -->
            <IMPLEMENTATION-DATA-TYPE>
              <SHORT-NAME>Csm_SymKeyType</SHORT-NAME>
              <CATEGORY>STRUCTURE</CATEGORY>
              <SUB-ELEMENTS>
                <IMPLEMENTATION-DATA-TYPE-ELEMENT>
                  <SHORT-NAME>length</SHORT-NAME>
                  <CATEGORY>TYPE_REFERENCE</CATEGORY>
                  <SW-DATA-DEF-PROPS>
                    <SW-DATA-DEF-PROPS-VARIANTS>
                      <SW-DATA-DEF-PROPS-CONDITIONAL>
                        <IMPLEMENTATION-DATA-TYPE-REF DEST="IMPLEMENTATION-DATA-TYPE">/AUTOSAR_Platform/ImplementationDataTypes/uint32</IMPLEMENTATION-DATA-TYPE-REF>
                      </SW-DATA-DEF-PROPS-CONDITIONAL>
                    </SW-DATA-DEF-PROPS-VARIANTS>
                  </SW-DATA-DEF-PROPS>
                </IMPLEMENTATION-DATA-TYPE-ELEMENT>
                <IMPLEMENTATION-DATA-TYPE-ELEMENT>
                  <SHORT-NAME>data</SHORT-NAME>
                  <CATEGORY>TYPE_REFERENCE</CATEGORY>
                    <SW-DATA-DEF-PROPS>
                      <SW-DATA-DEF-PROPS-VARIANTS>
                        <SW-DATA-DEF-PROPS-CONDITIONAL>
                          <IMPLEMENTATION-DATA-TYPE-REF DEST="IMPLEMENTATION-DATA-TYPE">/AUTOSAR_Csm/ImplementationDataTypes/Csm_SymKeyTypeData</IMPLEMENTATION-DATA-TYPE-REF>
                        </SW-DATA-DEF-PROPS-CONDITIONAL>
                      </SW-DATA-DEF-PROPS-VARIANTS>
                    </SW-DATA-DEF-PROPS>
                 </IMPLEMENTATION-DATA-TYPE-ELEMENT>
              </SUB-ELEMENTS>
            </IMPLEMENTATION-DATA-TYPE>
            <!-- !LINKSTO CSM0802, 1 -->
            <IMPLEMENTATION-DATA-TYPE>
              <SHORT-NAME>Csm_SymKeyTypeData</SHORT-NAME>
              <CATEGORY>ARRAY</CATEGORY>
              <SUB-ELEMENTS>
                <IMPLEMENTATION-DATA-TYPE-ELEMENT>
                  <SHORT-NAME>AuxSymKeyTypeData</SHORT-NAME>
                  <CATEGORY>TYPE_REFERENCE</CATEGORY>
                  <ARRAY-SIZE>[!"num:i((($CsmSymKeyLength - 1) div node:value(as:modconf('Csm')/CsmGeneral/CsmSizeMaxAlignScalarType)) + 1)"!]</ARRAY-SIZE>
                  <ARRAY-SIZE-SEMANTICS>FIXED-SIZE</ARRAY-SIZE-SEMANTICS>
                  <SW-DATA-DEF-PROPS>
                    <SW-DATA-DEF-PROPS-VARIANTS>
                      <SW-DATA-DEF-PROPS-CONDITIONAL>
                        <IMPLEMENTATION-DATA-TYPE-REF DEST="IMPLEMENTATION-DATA-TYPE">/AUTOSAR_Platform/ImplementationDataTypes/[!"CsmGeneral/CsmMaxAlignScalarType"!]</IMPLEMENTATION-DATA-TYPE-REF>
                      </SW-DATA-DEF-PROPS-CONDITIONAL>
                    </SW-DATA-DEF-PROPS-VARIANTS>
                  </SW-DATA-DEF-PROPS>
                </IMPLEMENTATION-DATA-TYPE-ELEMENT>
              </SUB-ELEMENTS>
            </IMPLEMENTATION-DATA-TYPE>
            <!-- !LINKSTO CSM0802, 1 -->
            <IMPLEMENTATION-DATA-TYPE>
              <SHORT-NAME>Csm_AsymPrivateKeyType</SHORT-NAME>
              <CATEGORY>STRUCTURE</CATEGORY>
              <SUB-ELEMENTS>
                <IMPLEMENTATION-DATA-TYPE-ELEMENT>
                  <SHORT-NAME>length</SHORT-NAME>
                  <CATEGORY>TYPE_REFERENCE</CATEGORY>
                  <SW-DATA-DEF-PROPS>
                    <SW-DATA-DEF-PROPS-VARIANTS>
                      <SW-DATA-DEF-PROPS-CONDITIONAL>
                        <IMPLEMENTATION-DATA-TYPE-REF DEST="IMPLEMENTATION-DATA-TYPE">/AUTOSAR_Platform/ImplementationDataTypes/uint32</IMPLEMENTATION-DATA-TYPE-REF>
                      </SW-DATA-DEF-PROPS-CONDITIONAL>
                    </SW-DATA-DEF-PROPS-VARIANTS>
                  </SW-DATA-DEF-PROPS>
                </IMPLEMENTATION-DATA-TYPE-ELEMENT>
                <IMPLEMENTATION-DATA-TYPE-ELEMENT>
                  <SHORT-NAME>data</SHORT-NAME>
                  <CATEGORY>TYPE_REFERENCE</CATEGORY>
                    <SW-DATA-DEF-PROPS>
                      <SW-DATA-DEF-PROPS-VARIANTS>
                        <SW-DATA-DEF-PROPS-CONDITIONAL>
                          <IMPLEMENTATION-DATA-TYPE-REF DEST="IMPLEMENTATION-DATA-TYPE">/AUTOSAR_Csm/ImplementationDataTypes/Csm_AsymPrivateKeyTypeData</IMPLEMENTATION-DATA-TYPE-REF>
                        </SW-DATA-DEF-PROPS-CONDITIONAL>
                      </SW-DATA-DEF-PROPS-VARIANTS>
                    </SW-DATA-DEF-PROPS>
                 </IMPLEMENTATION-DATA-TYPE-ELEMENT>
              </SUB-ELEMENTS>
            </IMPLEMENTATION-DATA-TYPE>
            <!-- !LINKSTO CSM0802, 1 -->
            <IMPLEMENTATION-DATA-TYPE>
              <SHORT-NAME>Csm_AsymPrivateKeyTypeData</SHORT-NAME>
              <CATEGORY>ARRAY</CATEGORY>
              <SUB-ELEMENTS>
                <IMPLEMENTATION-DATA-TYPE-ELEMENT>
                  <SHORT-NAME>AuxAsymPrivateKeyTypeData</SHORT-NAME>
                  <CATEGORY>TYPE_REFERENCE</CATEGORY>
                  <ARRAY-SIZE>[!"num:i((($CsmAsymPrivateKeyLength - 1) div node:value(as:modconf('Csm')/CsmGeneral/CsmSizeMaxAlignScalarType)) + 1)"!]</ARRAY-SIZE>
                  <ARRAY-SIZE-SEMANTICS>FIXED-SIZE</ARRAY-SIZE-SEMANTICS>
                  <SW-DATA-DEF-PROPS>
                    <SW-DATA-DEF-PROPS-VARIANTS>
                      <SW-DATA-DEF-PROPS-CONDITIONAL>
                        <IMPLEMENTATION-DATA-TYPE-REF DEST="IMPLEMENTATION-DATA-TYPE">/AUTOSAR_Platform/ImplementationDataTypes/[!"CsmGeneral/CsmMaxAlignScalarType"!]</IMPLEMENTATION-DATA-TYPE-REF>
                      </SW-DATA-DEF-PROPS-CONDITIONAL>
                    </SW-DATA-DEF-PROPS-VARIANTS>
                  </SW-DATA-DEF-PROPS>
                </IMPLEMENTATION-DATA-TYPE-ELEMENT>
              </SUB-ELEMENTS>
            </IMPLEMENTATION-DATA-TYPE>
            <!-- !LINKSTO CSM0802, 1 -->
            <IMPLEMENTATION-DATA-TYPE>
              <SHORT-NAME>Csm_AsymPublicKeyType</SHORT-NAME>
              <CATEGORY>STRUCTURE</CATEGORY>
              <SUB-ELEMENTS>
                <IMPLEMENTATION-DATA-TYPE-ELEMENT>
                  <SHORT-NAME>length</SHORT-NAME>
                  <CATEGORY>TYPE_REFERENCE</CATEGORY>
                  <SW-DATA-DEF-PROPS>
                    <SW-DATA-DEF-PROPS-VARIANTS>
                      <SW-DATA-DEF-PROPS-CONDITIONAL>
                        <IMPLEMENTATION-DATA-TYPE-REF DEST="IMPLEMENTATION-DATA-TYPE">/AUTOSAR_Platform/ImplementationDataTypes/uint32</IMPLEMENTATION-DATA-TYPE-REF>
                      </SW-DATA-DEF-PROPS-CONDITIONAL>
                    </SW-DATA-DEF-PROPS-VARIANTS>
                  </SW-DATA-DEF-PROPS>
                </IMPLEMENTATION-DATA-TYPE-ELEMENT>
                <IMPLEMENTATION-DATA-TYPE-ELEMENT>
                  <SHORT-NAME>data</SHORT-NAME>
                  <CATEGORY>TYPE_REFERENCE</CATEGORY>
                    <SW-DATA-DEF-PROPS>
                      <SW-DATA-DEF-PROPS-VARIANTS>
                        <SW-DATA-DEF-PROPS-CONDITIONAL>
                          <IMPLEMENTATION-DATA-TYPE-REF DEST="IMPLEMENTATION-DATA-TYPE">/AUTOSAR_Csm/ImplementationDataTypes/Csm_AsymPublicKeyTypeData</IMPLEMENTATION-DATA-TYPE-REF>
                        </SW-DATA-DEF-PROPS-CONDITIONAL>
                      </SW-DATA-DEF-PROPS-VARIANTS>
                    </SW-DATA-DEF-PROPS>
                 </IMPLEMENTATION-DATA-TYPE-ELEMENT>
              </SUB-ELEMENTS>
            </IMPLEMENTATION-DATA-TYPE>
            <!-- !LINKSTO CSM0802, 1 -->
            <IMPLEMENTATION-DATA-TYPE>
              <SHORT-NAME>Csm_AsymPublicKeyTypeData</SHORT-NAME>
              <CATEGORY>ARRAY</CATEGORY>
              <SUB-ELEMENTS>
                <IMPLEMENTATION-DATA-TYPE-ELEMENT>
                  <SHORT-NAME>AuxAsymPublicKeyTypeData</SHORT-NAME>
                  <CATEGORY>TYPE_REFERENCE</CATEGORY>
                  <ARRAY-SIZE>[!"num:i((($CsmAsymPublicKeyLength - 1) div node:value(as:modconf('Csm')/CsmGeneral/CsmSizeMaxAlignScalarType)) + 1)"!]</ARRAY-SIZE>
                  <ARRAY-SIZE-SEMANTICS>FIXED-SIZE</ARRAY-SIZE-SEMANTICS>
                  <SW-DATA-DEF-PROPS>
                    <SW-DATA-DEF-PROPS-VARIANTS>
                      <SW-DATA-DEF-PROPS-CONDITIONAL>
                        <IMPLEMENTATION-DATA-TYPE-REF DEST="IMPLEMENTATION-DATA-TYPE">/AUTOSAR_Platform/ImplementationDataTypes/[!"CsmGeneral/CsmMaxAlignScalarType"!]</IMPLEMENTATION-DATA-TYPE-REF>
                      </SW-DATA-DEF-PROPS-CONDITIONAL>
                    </SW-DATA-DEF-PROPS-VARIANTS>
                  </SW-DATA-DEF-PROPS>
                </IMPLEMENTATION-DATA-TYPE-ELEMENT>
              </SUB-ELEMENTS>
            </IMPLEMENTATION-DATA-TYPE>
[!IF "count(CsmAsymPrivateKeyWrapAsym/CsmAsymPrivateKeyWrapAsymConfig/*[CsmAsymPrivateKeyWrapAsymEnableRteInterface='true']) > 0"!][!//
            <!-- !LINKSTO CSM0803, 1 -->
            <IMPLEMENTATION-DATA-TYPE>
              <SHORT-NAME>AsymPrivateKeyWrapAsymDataBuffer</SHORT-NAME>
              <CATEGORY>ARRAY</CATEGORY>
              <SUB-ELEMENTS>
                <IMPLEMENTATION-DATA-TYPE-ELEMENT>
                  <SHORT-NAME>AuxAsymPrivateKeyWrapAsymDataBufferSize</SHORT-NAME>
                  <CATEGORY>TYPE_REFERENCE</CATEGORY>
                  <ARRAY-SIZE>[!"CsmAsymPrivateKeyWrapAsym/CsmAsymPrivateKeyWrapAsymDataBufferSize"!]</ARRAY-SIZE>
                  <ARRAY-SIZE-SEMANTICS>FIXED-SIZE</ARRAY-SIZE-SEMANTICS>
                  <SW-DATA-DEF-PROPS>
                    <SW-DATA-DEF-PROPS-VARIANTS>
                      <SW-DATA-DEF-PROPS-CONDITIONAL>
                        <IMPLEMENTATION-DATA-TYPE-REF DEST="IMPLEMENTATION-DATA-TYPE">/AUTOSAR_Platform/ImplementationDataTypes/uint8</IMPLEMENTATION-DATA-TYPE-REF>
                      </SW-DATA-DEF-PROPS-CONDITIONAL>
                    </SW-DATA-DEF-PROPS-VARIANTS>
                  </SW-DATA-DEF-PROPS>
                </IMPLEMENTATION-DATA-TYPE-ELEMENT>
              </SUB-ELEMENTS>
            </IMPLEMENTATION-DATA-TYPE>
[!ENDIF!][!//
[!IF "count(CsmAsymPrivateKeyWrapSym/CsmAsymPrivateKeyWrapSymConfig/*[CsmAsymPrivateKeyWrapSymEnableRteInterface='true']) > 0"!][!//
            <!-- !LINKSTO CSM0803, 1 -->
            <IMPLEMENTATION-DATA-TYPE>
              <SHORT-NAME>AsymPrivateKeyWrapSymDataBuffer</SHORT-NAME>
              <CATEGORY>ARRAY</CATEGORY>
              <SUB-ELEMENTS>
                <IMPLEMENTATION-DATA-TYPE-ELEMENT>
                  <SHORT-NAME>AuxAsymPrivateKeyWrapSymDataBufferSize</SHORT-NAME>
                  <CATEGORY>TYPE_REFERENCE</CATEGORY>
                  <ARRAY-SIZE>[!"CsmAsymPrivateKeyWrapSym/CsmAsymPrivateKeyWrapSymDataBufferSize"!]</ARRAY-SIZE>
                  <ARRAY-SIZE-SEMANTICS>FIXED-SIZE</ARRAY-SIZE-SEMANTICS>
                  <SW-DATA-DEF-PROPS>
                    <SW-DATA-DEF-PROPS-VARIANTS>
                      <SW-DATA-DEF-PROPS-CONDITIONAL>
                        <IMPLEMENTATION-DATA-TYPE-REF DEST="IMPLEMENTATION-DATA-TYPE">/AUTOSAR_Platform/ImplementationDataTypes/uint8</IMPLEMENTATION-DATA-TYPE-REF>
                      </SW-DATA-DEF-PROPS-CONDITIONAL>
                    </SW-DATA-DEF-PROPS-VARIANTS>
                  </SW-DATA-DEF-PROPS>
                </IMPLEMENTATION-DATA-TYPE-ELEMENT>
              </SUB-ELEMENTS>
            </IMPLEMENTATION-DATA-TYPE>
[!ENDIF!][!//
[!IF "count(CsmAsymPublicKeyExtract/CsmAsymPublicKeyExtractConfig/*[CsmAsymPublicKeyExtractEnableRteInterface='true']) > 0"!][!//
            <!-- !LINKSTO CSM0803, 1 -->
            <IMPLEMENTATION-DATA-TYPE>
              <SHORT-NAME>AsymPublicKeyExtractDataBuffer</SHORT-NAME>
              <CATEGORY>ARRAY</CATEGORY>
              <SUB-ELEMENTS>
                <IMPLEMENTATION-DATA-TYPE-ELEMENT>
                  <SHORT-NAME>AuxAsymPublicKeyExtractDataBufferSize</SHORT-NAME>
                  <CATEGORY>TYPE_REFERENCE</CATEGORY>
                  <ARRAY-SIZE>[!"CsmAsymPublicKeyExtract/CsmAsymPublicKeyExtractDataBufferSize"!]</ARRAY-SIZE>
                  <ARRAY-SIZE-SEMANTICS>FIXED-SIZE</ARRAY-SIZE-SEMANTICS>
                  <SW-DATA-DEF-PROPS>
                    <SW-DATA-DEF-PROPS-VARIANTS>
                      <SW-DATA-DEF-PROPS-CONDITIONAL>
                        <IMPLEMENTATION-DATA-TYPE-REF DEST="IMPLEMENTATION-DATA-TYPE">/AUTOSAR_Platform/ImplementationDataTypes/uint8</IMPLEMENTATION-DATA-TYPE-REF>
                      </SW-DATA-DEF-PROPS-CONDITIONAL>
                    </SW-DATA-DEF-PROPS-VARIANTS>
                  </SW-DATA-DEF-PROPS>
                </IMPLEMENTATION-DATA-TYPE-ELEMENT>
              </SUB-ELEMENTS>
            </IMPLEMENTATION-DATA-TYPE>
[!ENDIF!][!//
[!IF "count(CsmChecksum/CsmChecksumConfig/*[CsmChecksumEnableRteInterface='true']) > 0"!][!//
            <!-- !LINKSTO CSM0803, 1 -->
            <IMPLEMENTATION-DATA-TYPE>
              <SHORT-NAME>ChecksumDataBuffer</SHORT-NAME>
              <CATEGORY>ARRAY</CATEGORY>
              <SUB-ELEMENTS>
                <IMPLEMENTATION-DATA-TYPE-ELEMENT>
                  <SHORT-NAME>AuxChecksumDataBufferSize</SHORT-NAME>
                  <CATEGORY>TYPE_REFERENCE</CATEGORY>
                  <ARRAY-SIZE>[!"CsmChecksum/CsmChecksumDataBufferSize"!]</ARRAY-SIZE>
                  <ARRAY-SIZE-SEMANTICS>FIXED-SIZE</ARRAY-SIZE-SEMANTICS>
                  <SW-DATA-DEF-PROPS>
                    <SW-DATA-DEF-PROPS-VARIANTS>
                      <SW-DATA-DEF-PROPS-CONDITIONAL>
                        <IMPLEMENTATION-DATA-TYPE-REF DEST="IMPLEMENTATION-DATA-TYPE">/AUTOSAR_Platform/ImplementationDataTypes/uint8</IMPLEMENTATION-DATA-TYPE-REF>
                      </SW-DATA-DEF-PROPS-CONDITIONAL>
                    </SW-DATA-DEF-PROPS-VARIANTS>
                  </SW-DATA-DEF-PROPS>
                </IMPLEMENTATION-DATA-TYPE-ELEMENT>
              </SUB-ELEMENTS>
            </IMPLEMENTATION-DATA-TYPE>
            <!-- !LINKSTO CSM0803, 1 -->
            <IMPLEMENTATION-DATA-TYPE>
              <SHORT-NAME>ChecksumResultBuffer</SHORT-NAME>
              <CATEGORY>ARRAY</CATEGORY>
              <SUB-ELEMENTS>
                <IMPLEMENTATION-DATA-TYPE-ELEMENT>
                  <SHORT-NAME>AuxChecksumResultBufferSize</SHORT-NAME>
                  <CATEGORY>TYPE_REFERENCE</CATEGORY>
                  <ARRAY-SIZE>[!"CsmChecksum/CsmChecksumResultBufferSize"!]</ARRAY-SIZE>
                  <ARRAY-SIZE-SEMANTICS>FIXED-SIZE</ARRAY-SIZE-SEMANTICS>
                  <SW-DATA-DEF-PROPS>
                    <SW-DATA-DEF-PROPS-VARIANTS>
                      <SW-DATA-DEF-PROPS-CONDITIONAL>
                        <IMPLEMENTATION-DATA-TYPE-REF DEST="IMPLEMENTATION-DATA-TYPE">/AUTOSAR_Platform/ImplementationDataTypes/uint8</IMPLEMENTATION-DATA-TYPE-REF>
                      </SW-DATA-DEF-PROPS-CONDITIONAL>
                    </SW-DATA-DEF-PROPS-VARIANTS>
                  </SW-DATA-DEF-PROPS>
                </IMPLEMENTATION-DATA-TYPE-ELEMENT>
              </SUB-ELEMENTS>
            </IMPLEMENTATION-DATA-TYPE>
[!ENDIF!][!//
[!IF "count(CsmHash/CsmHashConfig/*[CsmHashEnableRteInterface='true']) > 0"!][!//
            <!-- !LINKSTO CSM0803, 1 -->
            <IMPLEMENTATION-DATA-TYPE>
              <SHORT-NAME>HashDataBuffer</SHORT-NAME>
              <CATEGORY>ARRAY</CATEGORY>
              <SUB-ELEMENTS>
                <IMPLEMENTATION-DATA-TYPE-ELEMENT>
                  <SHORT-NAME>AuxHashDataBufferSize</SHORT-NAME>
                  <CATEGORY>TYPE_REFERENCE</CATEGORY>
                  <ARRAY-SIZE>[!"CsmHash/CsmHashDataBufferSize"!]</ARRAY-SIZE>
                  <ARRAY-SIZE-SEMANTICS>FIXED-SIZE</ARRAY-SIZE-SEMANTICS>
                  <SW-DATA-DEF-PROPS>
                    <SW-DATA-DEF-PROPS-VARIANTS>
                      <SW-DATA-DEF-PROPS-CONDITIONAL>
                        <IMPLEMENTATION-DATA-TYPE-REF DEST="IMPLEMENTATION-DATA-TYPE">/AUTOSAR_Platform/ImplementationDataTypes/uint8</IMPLEMENTATION-DATA-TYPE-REF>
                      </SW-DATA-DEF-PROPS-CONDITIONAL>
                    </SW-DATA-DEF-PROPS-VARIANTS>
                  </SW-DATA-DEF-PROPS>
                </IMPLEMENTATION-DATA-TYPE-ELEMENT>
              </SUB-ELEMENTS>
            </IMPLEMENTATION-DATA-TYPE>
            <!-- !LINKSTO CSM0803, 1 -->
            <IMPLEMENTATION-DATA-TYPE>
              <SHORT-NAME>HashResultBuffer</SHORT-NAME>
              <CATEGORY>ARRAY</CATEGORY>
              <SUB-ELEMENTS>
                <IMPLEMENTATION-DATA-TYPE-ELEMENT>
                  <SHORT-NAME>AuxHashResultBufferSize</SHORT-NAME>
                  <CATEGORY>TYPE_REFERENCE</CATEGORY>
                  <ARRAY-SIZE>[!"CsmHash/CsmHashResultBufferSize"!]</ARRAY-SIZE>
                  <ARRAY-SIZE-SEMANTICS>FIXED-SIZE</ARRAY-SIZE-SEMANTICS>
                  <SW-DATA-DEF-PROPS>
                    <SW-DATA-DEF-PROPS-VARIANTS>
                      <SW-DATA-DEF-PROPS-CONDITIONAL>
                        <IMPLEMENTATION-DATA-TYPE-REF DEST="IMPLEMENTATION-DATA-TYPE">/AUTOSAR_Platform/ImplementationDataTypes/uint8</IMPLEMENTATION-DATA-TYPE-REF>
                      </SW-DATA-DEF-PROPS-CONDITIONAL>
                    </SW-DATA-DEF-PROPS-VARIANTS>
                  </SW-DATA-DEF-PROPS>
                </IMPLEMENTATION-DATA-TYPE-ELEMENT>
              </SUB-ELEMENTS>
            </IMPLEMENTATION-DATA-TYPE>
[!ENDIF!][!//
[!IF "count(CsmMacGenerate/CsmMacGenerateConfig/*[CsmMacGenerateEnableRteInterface='true']) > 0"!][!//
            <!-- !LINKSTO CSM0803, 1 -->
            <IMPLEMENTATION-DATA-TYPE>
              <SHORT-NAME>MacGenerateDataBuffer</SHORT-NAME>
              <CATEGORY>ARRAY</CATEGORY>
              <SUB-ELEMENTS>
                <IMPLEMENTATION-DATA-TYPE-ELEMENT>
                  <SHORT-NAME>AuxMacGenerateDataBufferSize</SHORT-NAME>
                  <CATEGORY>TYPE_REFERENCE</CATEGORY>
                  <ARRAY-SIZE>[!"CsmMacGenerate/CsmMacGenerateDataBufferSize"!]</ARRAY-SIZE>
                  <ARRAY-SIZE-SEMANTICS>FIXED-SIZE</ARRAY-SIZE-SEMANTICS>
                  <SW-DATA-DEF-PROPS>
                    <SW-DATA-DEF-PROPS-VARIANTS>
                      <SW-DATA-DEF-PROPS-CONDITIONAL>
                        <IMPLEMENTATION-DATA-TYPE-REF DEST="IMPLEMENTATION-DATA-TYPE">/AUTOSAR_Platform/ImplementationDataTypes/uint8</IMPLEMENTATION-DATA-TYPE-REF>
                      </SW-DATA-DEF-PROPS-CONDITIONAL>
                    </SW-DATA-DEF-PROPS-VARIANTS>
                  </SW-DATA-DEF-PROPS>
                </IMPLEMENTATION-DATA-TYPE-ELEMENT>
              </SUB-ELEMENTS>
            </IMPLEMENTATION-DATA-TYPE>
            <!-- !LINKSTO CSM0803, 1 -->
            <IMPLEMENTATION-DATA-TYPE>
              <SHORT-NAME>MacGenerateResultBuffer</SHORT-NAME>
              <CATEGORY>ARRAY</CATEGORY>
              <SUB-ELEMENTS>
                <IMPLEMENTATION-DATA-TYPE-ELEMENT>
                  <SHORT-NAME>AuxMacGenerateResultBufferSize</SHORT-NAME>
                  <CATEGORY>TYPE_REFERENCE</CATEGORY>
                  <ARRAY-SIZE>[!"CsmMacGenerate/CsmMacGenerateResultBufferSize"!]</ARRAY-SIZE>
                  <ARRAY-SIZE-SEMANTICS>FIXED-SIZE</ARRAY-SIZE-SEMANTICS>
                  <SW-DATA-DEF-PROPS>
                    <SW-DATA-DEF-PROPS-VARIANTS>
                      <SW-DATA-DEF-PROPS-CONDITIONAL>
                        <IMPLEMENTATION-DATA-TYPE-REF DEST="IMPLEMENTATION-DATA-TYPE">/AUTOSAR_Platform/ImplementationDataTypes/uint8</IMPLEMENTATION-DATA-TYPE-REF>
                      </SW-DATA-DEF-PROPS-CONDITIONAL>
                    </SW-DATA-DEF-PROPS-VARIANTS>
                  </SW-DATA-DEF-PROPS>
                </IMPLEMENTATION-DATA-TYPE-ELEMENT>
              </SUB-ELEMENTS>
            </IMPLEMENTATION-DATA-TYPE>
[!ENDIF!][!//
[!IF "count(CsmMacVerify/CsmMacVerifyConfig/*[CsmMacVerifyEnableRteInterface='true']) > 0"!][!//
            <!-- !LINKSTO CSM0803, 1 -->
            <IMPLEMENTATION-DATA-TYPE>
              <SHORT-NAME>MacVerifyDataBuffer</SHORT-NAME>
              <CATEGORY>ARRAY</CATEGORY>
              <SUB-ELEMENTS>
                <IMPLEMENTATION-DATA-TYPE-ELEMENT>
                  <SHORT-NAME>AuxMacVerifyDataBufferSize</SHORT-NAME>
                  <CATEGORY>TYPE_REFERENCE</CATEGORY>
                  <ARRAY-SIZE>[!"CsmMacVerify/CsmMacVerifyDataBufferSize"!]</ARRAY-SIZE>
                  <ARRAY-SIZE-SEMANTICS>FIXED-SIZE</ARRAY-SIZE-SEMANTICS>
                  <SW-DATA-DEF-PROPS>
                    <SW-DATA-DEF-PROPS-VARIANTS>
                      <SW-DATA-DEF-PROPS-CONDITIONAL>
                        <IMPLEMENTATION-DATA-TYPE-REF DEST="IMPLEMENTATION-DATA-TYPE">/AUTOSAR_Platform/ImplementationDataTypes/uint8</IMPLEMENTATION-DATA-TYPE-REF>
                      </SW-DATA-DEF-PROPS-CONDITIONAL>
                    </SW-DATA-DEF-PROPS-VARIANTS>
                  </SW-DATA-DEF-PROPS>
                </IMPLEMENTATION-DATA-TYPE-ELEMENT>
              </SUB-ELEMENTS>
            </IMPLEMENTATION-DATA-TYPE>
            <!-- !LINKSTO CSM0803, 1 -->
            <IMPLEMENTATION-DATA-TYPE>
              <SHORT-NAME>MacVerifyCompareBuffer</SHORT-NAME>
              <CATEGORY>ARRAY</CATEGORY>
              <SUB-ELEMENTS>
                <IMPLEMENTATION-DATA-TYPE-ELEMENT>
                  <SHORT-NAME>AuxMacVerifyCompareBufferSize</SHORT-NAME>
                  <CATEGORY>TYPE_REFERENCE</CATEGORY>
                  <ARRAY-SIZE>[!"CsmMacVerify/CsmMacVerifyCompareBufferSize"!]</ARRAY-SIZE>
                  <ARRAY-SIZE-SEMANTICS>FIXED-SIZE</ARRAY-SIZE-SEMANTICS>
                  <SW-DATA-DEF-PROPS>
                    <SW-DATA-DEF-PROPS-VARIANTS>
                      <SW-DATA-DEF-PROPS-CONDITIONAL>
                        <IMPLEMENTATION-DATA-TYPE-REF DEST="IMPLEMENTATION-DATA-TYPE">/AUTOSAR_Platform/ImplementationDataTypes/uint8</IMPLEMENTATION-DATA-TYPE-REF>
                      </SW-DATA-DEF-PROPS-CONDITIONAL>
                    </SW-DATA-DEF-PROPS-VARIANTS>
                  </SW-DATA-DEF-PROPS>
                </IMPLEMENTATION-DATA-TYPE-ELEMENT>
              </SUB-ELEMENTS>
            </IMPLEMENTATION-DATA-TYPE>
[!ENDIF!][!//
[!IF "count(CsmRandomGenerate/CsmRandomGenerateConfig/*[CsmRandomGenerateEnableRteInterface='true']) > 0"!][!//
            <!-- !LINKSTO CSM0803, 1 -->
            <IMPLEMENTATION-DATA-TYPE>
              <SHORT-NAME>RandomGenerateResultBuffer</SHORT-NAME>
              <CATEGORY>ARRAY</CATEGORY>
              <SUB-ELEMENTS>
                <IMPLEMENTATION-DATA-TYPE-ELEMENT>
                  <SHORT-NAME>AuxRandomGenerateResultBufferSize</SHORT-NAME>
                  <CATEGORY>TYPE_REFERENCE</CATEGORY>
                  <ARRAY-SIZE>[!"CsmRandomGenerate/CsmRandomGenerateResultBufferSize"!]</ARRAY-SIZE>
                  <ARRAY-SIZE-SEMANTICS>FIXED-SIZE</ARRAY-SIZE-SEMANTICS>
                  <SW-DATA-DEF-PROPS>
                    <SW-DATA-DEF-PROPS-VARIANTS>
                      <SW-DATA-DEF-PROPS-CONDITIONAL>
                        <IMPLEMENTATION-DATA-TYPE-REF DEST="IMPLEMENTATION-DATA-TYPE">/AUTOSAR_Platform/ImplementationDataTypes/uint8</IMPLEMENTATION-DATA-TYPE-REF>
                      </SW-DATA-DEF-PROPS-CONDITIONAL>
                    </SW-DATA-DEF-PROPS-VARIANTS>
                  </SW-DATA-DEF-PROPS>
                </IMPLEMENTATION-DATA-TYPE-ELEMENT>
              </SUB-ELEMENTS>
            </IMPLEMENTATION-DATA-TYPE>
[!ENDIF!][!//
[!IF "count(CsmRandomSeed/CsmRandomSeedConfig/*[CsmRandomSeedEnableRteInterface='true']) > 0"!][!//
            <!-- !LINKSTO CSM0803, 1 -->
            <IMPLEMENTATION-DATA-TYPE>
              <SHORT-NAME>RandomSeedDataBuffer</SHORT-NAME>
              <CATEGORY>ARRAY</CATEGORY>
              <SUB-ELEMENTS>
                <IMPLEMENTATION-DATA-TYPE-ELEMENT>
                  <SHORT-NAME>AuxRandomSeedDataBufferSize</SHORT-NAME>
                  <CATEGORY>TYPE_REFERENCE</CATEGORY>
                  <ARRAY-SIZE>[!"CsmRandomSeed/CsmRandomSeedDataBufferSize"!]</ARRAY-SIZE>
                  <ARRAY-SIZE-SEMANTICS>FIXED-SIZE</ARRAY-SIZE-SEMANTICS>
                  <SW-DATA-DEF-PROPS>
                    <SW-DATA-DEF-PROPS-VARIANTS>
                      <SW-DATA-DEF-PROPS-CONDITIONAL>
                        <IMPLEMENTATION-DATA-TYPE-REF DEST="IMPLEMENTATION-DATA-TYPE">/AUTOSAR_Platform/ImplementationDataTypes/uint8</IMPLEMENTATION-DATA-TYPE-REF>
                      </SW-DATA-DEF-PROPS-CONDITIONAL>
                    </SW-DATA-DEF-PROPS-VARIANTS>
                  </SW-DATA-DEF-PROPS>
                </IMPLEMENTATION-DATA-TYPE-ELEMENT>
              </SUB-ELEMENTS>
            </IMPLEMENTATION-DATA-TYPE>
[!ENDIF!][!//
[!IF "count(CsmSignatureGenerate/CsmSignatureGenerateConfig/*[CsmSignatureGenerateEnableRteInterface='true']) > 0"!][!//
            <!-- !LINKSTO CSM0803, 1 -->
            <IMPLEMENTATION-DATA-TYPE>
              <SHORT-NAME>SignatureGenerateDataBuffer</SHORT-NAME>
              <CATEGORY>ARRAY</CATEGORY>
              <SUB-ELEMENTS>
                <IMPLEMENTATION-DATA-TYPE-ELEMENT>
                  <SHORT-NAME>AuxSignatureGenerateDataBufferSize</SHORT-NAME>
                  <CATEGORY>TYPE_REFERENCE</CATEGORY>
                  <ARRAY-SIZE>[!"CsmSignatureGenerate/CsmSignatureGenerateDataBufferSize"!]</ARRAY-SIZE>
                  <ARRAY-SIZE-SEMANTICS>FIXED-SIZE</ARRAY-SIZE-SEMANTICS>
                  <SW-DATA-DEF-PROPS>
                    <SW-DATA-DEF-PROPS-VARIANTS>
                      <SW-DATA-DEF-PROPS-CONDITIONAL>
                        <IMPLEMENTATION-DATA-TYPE-REF DEST="IMPLEMENTATION-DATA-TYPE">/AUTOSAR_Platform/ImplementationDataTypes/uint8</IMPLEMENTATION-DATA-TYPE-REF>
                      </SW-DATA-DEF-PROPS-CONDITIONAL>
                    </SW-DATA-DEF-PROPS-VARIANTS>
                  </SW-DATA-DEF-PROPS>
                </IMPLEMENTATION-DATA-TYPE-ELEMENT>
              </SUB-ELEMENTS>
            </IMPLEMENTATION-DATA-TYPE>
            <!-- !LINKSTO CSM0803, 1 -->
            <IMPLEMENTATION-DATA-TYPE>
              <SHORT-NAME>SignatureGenerateResultBuffer</SHORT-NAME>
              <CATEGORY>ARRAY</CATEGORY>
              <SUB-ELEMENTS>
                <IMPLEMENTATION-DATA-TYPE-ELEMENT>
                  <SHORT-NAME>AuxSignatureGenerateResultBufferSize</SHORT-NAME>
                  <CATEGORY>TYPE_REFERENCE</CATEGORY>
                  <ARRAY-SIZE>[!"CsmSignatureGenerate/CsmSignatureGenerateResultBufferSize"!]</ARRAY-SIZE>
                  <ARRAY-SIZE-SEMANTICS>FIXED-SIZE</ARRAY-SIZE-SEMANTICS>
                  <SW-DATA-DEF-PROPS>
                    <SW-DATA-DEF-PROPS-VARIANTS>
                      <SW-DATA-DEF-PROPS-CONDITIONAL>
                        <IMPLEMENTATION-DATA-TYPE-REF DEST="IMPLEMENTATION-DATA-TYPE">/AUTOSAR_Platform/ImplementationDataTypes/uint8</IMPLEMENTATION-DATA-TYPE-REF>
                      </SW-DATA-DEF-PROPS-CONDITIONAL>
                    </SW-DATA-DEF-PROPS-VARIANTS>
                  </SW-DATA-DEF-PROPS>
                </IMPLEMENTATION-DATA-TYPE-ELEMENT>
              </SUB-ELEMENTS>
            </IMPLEMENTATION-DATA-TYPE>
[!ENDIF!][!//
[!IF "count(CsmSignatureVerify/CsmSignatureVerifyConfig/*[CsmSignatureVerifyEnableRteInterface='true']) > 0"!][!//
            <!-- !LINKSTO CSM0803, 1 -->
            <IMPLEMENTATION-DATA-TYPE>
              <SHORT-NAME>SignatureVerifyDataBuffer</SHORT-NAME>
              <CATEGORY>ARRAY</CATEGORY>
              <SUB-ELEMENTS>
                <IMPLEMENTATION-DATA-TYPE-ELEMENT>
                  <SHORT-NAME>AuxSignatureVerifyDataBufferSize</SHORT-NAME>
                  <CATEGORY>TYPE_REFERENCE</CATEGORY>
                  <ARRAY-SIZE>[!"CsmSignatureVerify/CsmSignatureVerifyDataBufferSize"!]</ARRAY-SIZE>
                  <ARRAY-SIZE-SEMANTICS>FIXED-SIZE</ARRAY-SIZE-SEMANTICS>
                  <SW-DATA-DEF-PROPS>
                    <SW-DATA-DEF-PROPS-VARIANTS>
                      <SW-DATA-DEF-PROPS-CONDITIONAL>
                        <IMPLEMENTATION-DATA-TYPE-REF DEST="IMPLEMENTATION-DATA-TYPE">/AUTOSAR_Platform/ImplementationDataTypes/uint8</IMPLEMENTATION-DATA-TYPE-REF>
                      </SW-DATA-DEF-PROPS-CONDITIONAL>
                    </SW-DATA-DEF-PROPS-VARIANTS>
                  </SW-DATA-DEF-PROPS>
                </IMPLEMENTATION-DATA-TYPE-ELEMENT>
              </SUB-ELEMENTS>
            </IMPLEMENTATION-DATA-TYPE>
            <!-- !LINKSTO CSM0803, 1 -->
            <IMPLEMENTATION-DATA-TYPE>
              <SHORT-NAME>SignatureVerifyCompareSignatureBuffer</SHORT-NAME>
              <CATEGORY>ARRAY</CATEGORY>
              <SUB-ELEMENTS>
                <IMPLEMENTATION-DATA-TYPE-ELEMENT>
                  <SHORT-NAME>AuxSignatureVerifyCompareSignatureBufferSize</SHORT-NAME>
                  <CATEGORY>TYPE_REFERENCE</CATEGORY>
                  <ARRAY-SIZE>[!"CsmSignatureVerify/CsmSignatureVerifyCompareSignatureBufferSize"!]</ARRAY-SIZE>
                  <ARRAY-SIZE-SEMANTICS>FIXED-SIZE</ARRAY-SIZE-SEMANTICS>
                  <SW-DATA-DEF-PROPS>
                    <SW-DATA-DEF-PROPS-VARIANTS>
                      <SW-DATA-DEF-PROPS-CONDITIONAL>
                        <IMPLEMENTATION-DATA-TYPE-REF DEST="IMPLEMENTATION-DATA-TYPE">/AUTOSAR_Platform/ImplementationDataTypes/uint8</IMPLEMENTATION-DATA-TYPE-REF>
                      </SW-DATA-DEF-PROPS-CONDITIONAL>
                    </SW-DATA-DEF-PROPS-VARIANTS>
                  </SW-DATA-DEF-PROPS>
                </IMPLEMENTATION-DATA-TYPE-ELEMENT>
              </SUB-ELEMENTS>
            </IMPLEMENTATION-DATA-TYPE>
[!ENDIF!][!//
[!IF "count(CsmSymBlockEncrypt/CsmSymBlockEncryptConfig/*[CsmSymBlockEncryptEnableRteInterface='true']) > 0"!][!//
            <!-- !LINKSTO CSM0803, 1 -->
            <IMPLEMENTATION-DATA-TYPE>
              <SHORT-NAME>SymBlockEncryptDataBuffer</SHORT-NAME>
              <CATEGORY>ARRAY</CATEGORY>
              <SUB-ELEMENTS>
                <IMPLEMENTATION-DATA-TYPE-ELEMENT>
                  <SHORT-NAME>AuxSymBlockEncryptDataBufferSize</SHORT-NAME>
                  <CATEGORY>TYPE_REFERENCE</CATEGORY>
                  <ARRAY-SIZE>[!"CsmSymBlockEncrypt/CsmSymBlockEncryptDataBufferSize"!]</ARRAY-SIZE>
                  <ARRAY-SIZE-SEMANTICS>FIXED-SIZE</ARRAY-SIZE-SEMANTICS>
                  <SW-DATA-DEF-PROPS>
                    <SW-DATA-DEF-PROPS-VARIANTS>
                      <SW-DATA-DEF-PROPS-CONDITIONAL>
                        <IMPLEMENTATION-DATA-TYPE-REF DEST="IMPLEMENTATION-DATA-TYPE">/AUTOSAR_Platform/ImplementationDataTypes/uint8</IMPLEMENTATION-DATA-TYPE-REF>
                      </SW-DATA-DEF-PROPS-CONDITIONAL>
                    </SW-DATA-DEF-PROPS-VARIANTS>
                  </SW-DATA-DEF-PROPS>
                </IMPLEMENTATION-DATA-TYPE-ELEMENT>
              </SUB-ELEMENTS>
            </IMPLEMENTATION-DATA-TYPE>
            <!-- !LINKSTO CSM0803, 1 -->
            <IMPLEMENTATION-DATA-TYPE>
              <SHORT-NAME>SymBlockEncryptResultBuffer</SHORT-NAME>
              <CATEGORY>ARRAY</CATEGORY>
              <SUB-ELEMENTS>
                <IMPLEMENTATION-DATA-TYPE-ELEMENT>
                  <SHORT-NAME>AuxSymBlockEncryptResultBufferSize</SHORT-NAME>
                  <CATEGORY>TYPE_REFERENCE</CATEGORY>
                  <ARRAY-SIZE>[!"CsmSymBlockEncrypt/CsmSymBlockEncryptResultBufferSize"!]</ARRAY-SIZE>
                  <ARRAY-SIZE-SEMANTICS>FIXED-SIZE</ARRAY-SIZE-SEMANTICS>
                  <SW-DATA-DEF-PROPS>
                    <SW-DATA-DEF-PROPS-VARIANTS>
                      <SW-DATA-DEF-PROPS-CONDITIONAL>
                        <IMPLEMENTATION-DATA-TYPE-REF DEST="IMPLEMENTATION-DATA-TYPE">/AUTOSAR_Platform/ImplementationDataTypes/uint8</IMPLEMENTATION-DATA-TYPE-REF>
                      </SW-DATA-DEF-PROPS-CONDITIONAL>
                    </SW-DATA-DEF-PROPS-VARIANTS>
                  </SW-DATA-DEF-PROPS>
                </IMPLEMENTATION-DATA-TYPE-ELEMENT>
              </SUB-ELEMENTS>
            </IMPLEMENTATION-DATA-TYPE>
[!ENDIF!][!//
[!IF "count(CsmSymBlockDecrypt/CsmSymBlockDecryptConfig/*[CsmSymBlockDecryptEnableRteInterface='true']) > 0"!][!//
            <!-- !LINKSTO CSM0803, 1 -->
            <IMPLEMENTATION-DATA-TYPE>
              <SHORT-NAME>SymBlockDecryptDataBuffer</SHORT-NAME>
              <CATEGORY>ARRAY</CATEGORY>
              <SUB-ELEMENTS>
                <IMPLEMENTATION-DATA-TYPE-ELEMENT>
                  <SHORT-NAME>AuxSymBlockDecryptDataBufferSize</SHORT-NAME>
                  <CATEGORY>TYPE_REFERENCE</CATEGORY>
                  <ARRAY-SIZE>[!"CsmSymBlockDecrypt/CsmSymBlockDecryptDataBufferSize"!]</ARRAY-SIZE>
                  <ARRAY-SIZE-SEMANTICS>FIXED-SIZE</ARRAY-SIZE-SEMANTICS>
                  <SW-DATA-DEF-PROPS>
                    <SW-DATA-DEF-PROPS-VARIANTS>
                      <SW-DATA-DEF-PROPS-CONDITIONAL>
                        <IMPLEMENTATION-DATA-TYPE-REF DEST="IMPLEMENTATION-DATA-TYPE">/AUTOSAR_Platform/ImplementationDataTypes/uint8</IMPLEMENTATION-DATA-TYPE-REF>
                      </SW-DATA-DEF-PROPS-CONDITIONAL>
                    </SW-DATA-DEF-PROPS-VARIANTS>
                  </SW-DATA-DEF-PROPS>
                </IMPLEMENTATION-DATA-TYPE-ELEMENT>
              </SUB-ELEMENTS>
            </IMPLEMENTATION-DATA-TYPE>
            <!-- !LINKSTO CSM0803, 1 -->
            <IMPLEMENTATION-DATA-TYPE>
              <SHORT-NAME>SymBlockDecryptResultBuffer</SHORT-NAME>
              <CATEGORY>ARRAY</CATEGORY>
              <SUB-ELEMENTS>
                <IMPLEMENTATION-DATA-TYPE-ELEMENT>
                  <SHORT-NAME>AuxSymBlockDecryptResultBufferSize</SHORT-NAME>
                  <CATEGORY>TYPE_REFERENCE</CATEGORY>
                  <ARRAY-SIZE>[!"CsmSymBlockDecrypt/CsmSymBlockDecryptResultBufferSize"!]</ARRAY-SIZE>
                  <ARRAY-SIZE-SEMANTICS>FIXED-SIZE</ARRAY-SIZE-SEMANTICS>
                  <SW-DATA-DEF-PROPS>
                    <SW-DATA-DEF-PROPS-VARIANTS>
                      <SW-DATA-DEF-PROPS-CONDITIONAL>
                        <IMPLEMENTATION-DATA-TYPE-REF DEST="IMPLEMENTATION-DATA-TYPE">/AUTOSAR_Platform/ImplementationDataTypes/uint8</IMPLEMENTATION-DATA-TYPE-REF>
                      </SW-DATA-DEF-PROPS-CONDITIONAL>
                    </SW-DATA-DEF-PROPS-VARIANTS>
                  </SW-DATA-DEF-PROPS>
                </IMPLEMENTATION-DATA-TYPE-ELEMENT>
              </SUB-ELEMENTS>
            </IMPLEMENTATION-DATA-TYPE>
[!ENDIF!][!//
[!IF "count(CsmSymEncrypt/CsmSymEncryptConfig/*[CsmSymEncryptEnableRteInterface='true']) > 0"!][!//
            <!-- !LINKSTO CSM0803, 1 -->
            <IMPLEMENTATION-DATA-TYPE>
              <SHORT-NAME>SymEncryptInitVectorBuffer</SHORT-NAME>
              <CATEGORY>ARRAY</CATEGORY>
              <SUB-ELEMENTS>
                <IMPLEMENTATION-DATA-TYPE-ELEMENT>
                  <SHORT-NAME>AuxSymEncryptInitVectorBufferSize</SHORT-NAME>
                  <CATEGORY>TYPE_REFERENCE</CATEGORY>
                  <ARRAY-SIZE>[!"CsmSymEncrypt/CsmSymEncryptInitVectorBufferSize"!]</ARRAY-SIZE>
                  <ARRAY-SIZE-SEMANTICS>FIXED-SIZE</ARRAY-SIZE-SEMANTICS>
                  <SW-DATA-DEF-PROPS>
                    <SW-DATA-DEF-PROPS-VARIANTS>
                      <SW-DATA-DEF-PROPS-CONDITIONAL>
                        <IMPLEMENTATION-DATA-TYPE-REF DEST="IMPLEMENTATION-DATA-TYPE">/AUTOSAR_Platform/ImplementationDataTypes/uint8</IMPLEMENTATION-DATA-TYPE-REF>
                      </SW-DATA-DEF-PROPS-CONDITIONAL>
                    </SW-DATA-DEF-PROPS-VARIANTS>
                  </SW-DATA-DEF-PROPS>
                </IMPLEMENTATION-DATA-TYPE-ELEMENT>
              </SUB-ELEMENTS>
            </IMPLEMENTATION-DATA-TYPE>
            <!-- !LINKSTO CSM0803, 1 -->
            <IMPLEMENTATION-DATA-TYPE>
              <SHORT-NAME>SymEncryptDataBuffer</SHORT-NAME>
              <CATEGORY>ARRAY</CATEGORY>
              <SUB-ELEMENTS>
                <IMPLEMENTATION-DATA-TYPE-ELEMENT>
                  <SHORT-NAME>AuxSymEncryptDataBufferSize</SHORT-NAME>
                  <CATEGORY>TYPE_REFERENCE</CATEGORY>
                  <ARRAY-SIZE>[!"CsmSymEncrypt/CsmSymEncryptDataBufferSize"!]</ARRAY-SIZE>
                  <ARRAY-SIZE-SEMANTICS>FIXED-SIZE</ARRAY-SIZE-SEMANTICS>
                  <SW-DATA-DEF-PROPS>
                    <SW-DATA-DEF-PROPS-VARIANTS>
                      <SW-DATA-DEF-PROPS-CONDITIONAL>
                        <IMPLEMENTATION-DATA-TYPE-REF DEST="IMPLEMENTATION-DATA-TYPE">/AUTOSAR_Platform/ImplementationDataTypes/uint8</IMPLEMENTATION-DATA-TYPE-REF>
                      </SW-DATA-DEF-PROPS-CONDITIONAL>
                    </SW-DATA-DEF-PROPS-VARIANTS>
                  </SW-DATA-DEF-PROPS>
                </IMPLEMENTATION-DATA-TYPE-ELEMENT>
              </SUB-ELEMENTS>
            </IMPLEMENTATION-DATA-TYPE>
            <!-- !LINKSTO CSM0803, 1 -->
            <IMPLEMENTATION-DATA-TYPE>
              <SHORT-NAME>SymEncryptResultBuffer</SHORT-NAME>
              <CATEGORY>ARRAY</CATEGORY>
              <SUB-ELEMENTS>
                <IMPLEMENTATION-DATA-TYPE-ELEMENT>
                  <SHORT-NAME>AuxSymEncryptResultBufferSize</SHORT-NAME>
                  <CATEGORY>TYPE_REFERENCE</CATEGORY>
                  <ARRAY-SIZE>[!"CsmSymEncrypt/CsmSymEncryptResultBufferSize"!]</ARRAY-SIZE>
                  <ARRAY-SIZE-SEMANTICS>FIXED-SIZE</ARRAY-SIZE-SEMANTICS>
                  <SW-DATA-DEF-PROPS>
                    <SW-DATA-DEF-PROPS-VARIANTS>
                      <SW-DATA-DEF-PROPS-CONDITIONAL>
                        <IMPLEMENTATION-DATA-TYPE-REF DEST="IMPLEMENTATION-DATA-TYPE">/AUTOSAR_Platform/ImplementationDataTypes/uint8</IMPLEMENTATION-DATA-TYPE-REF>
                      </SW-DATA-DEF-PROPS-CONDITIONAL>
                    </SW-DATA-DEF-PROPS-VARIANTS>
                  </SW-DATA-DEF-PROPS>
                </IMPLEMENTATION-DATA-TYPE-ELEMENT>
              </SUB-ELEMENTS>
            </IMPLEMENTATION-DATA-TYPE>
[!ENDIF!][!//
[!IF "count(CsmSymDecrypt/CsmSymDecryptConfig/*[CsmSymDecryptEnableRteInterface='true']) > 0"!][!//
            <!-- !LINKSTO CSM0803, 1 -->
            <IMPLEMENTATION-DATA-TYPE>
              <SHORT-NAME>SymDecryptInitVectorBuffer</SHORT-NAME>
              <CATEGORY>ARRAY</CATEGORY>
              <SUB-ELEMENTS>
                <IMPLEMENTATION-DATA-TYPE-ELEMENT>
                  <SHORT-NAME>AuxSymDecryptInitVectorBufferSize</SHORT-NAME>
                  <CATEGORY>TYPE_REFERENCE</CATEGORY>
                  <ARRAY-SIZE>[!"CsmSymDecrypt/CsmSymDecryptInitVectorBufferSize"!]</ARRAY-SIZE>
                  <ARRAY-SIZE-SEMANTICS>FIXED-SIZE</ARRAY-SIZE-SEMANTICS>
                  <SW-DATA-DEF-PROPS>
                    <SW-DATA-DEF-PROPS-VARIANTS>
                      <SW-DATA-DEF-PROPS-CONDITIONAL>
                        <IMPLEMENTATION-DATA-TYPE-REF DEST="IMPLEMENTATION-DATA-TYPE">/AUTOSAR_Platform/ImplementationDataTypes/uint8</IMPLEMENTATION-DATA-TYPE-REF>
                      </SW-DATA-DEF-PROPS-CONDITIONAL>
                    </SW-DATA-DEF-PROPS-VARIANTS>
                  </SW-DATA-DEF-PROPS>
                </IMPLEMENTATION-DATA-TYPE-ELEMENT>
              </SUB-ELEMENTS>
            </IMPLEMENTATION-DATA-TYPE>
            <!-- !LINKSTO CSM0803, 1 -->
            <IMPLEMENTATION-DATA-TYPE>
              <SHORT-NAME>SymDecryptDataBuffer</SHORT-NAME>
              <CATEGORY>ARRAY</CATEGORY>
              <SUB-ELEMENTS>
                <IMPLEMENTATION-DATA-TYPE-ELEMENT>
                  <SHORT-NAME>AuxSymDecryptDataBufferSize</SHORT-NAME>
                  <CATEGORY>TYPE_REFERENCE</CATEGORY>
                  <ARRAY-SIZE>[!"CsmSymDecrypt/CsmSymDecryptDataBufferSize"!]</ARRAY-SIZE>
                  <ARRAY-SIZE-SEMANTICS>FIXED-SIZE</ARRAY-SIZE-SEMANTICS>
                  <SW-DATA-DEF-PROPS>
                    <SW-DATA-DEF-PROPS-VARIANTS>
                      <SW-DATA-DEF-PROPS-CONDITIONAL>
                        <IMPLEMENTATION-DATA-TYPE-REF DEST="IMPLEMENTATION-DATA-TYPE">/AUTOSAR_Platform/ImplementationDataTypes/uint8</IMPLEMENTATION-DATA-TYPE-REF>
                      </SW-DATA-DEF-PROPS-CONDITIONAL>
                    </SW-DATA-DEF-PROPS-VARIANTS>
                  </SW-DATA-DEF-PROPS>
                </IMPLEMENTATION-DATA-TYPE-ELEMENT>
              </SUB-ELEMENTS>
            </IMPLEMENTATION-DATA-TYPE>
            <!-- !LINKSTO CSM0803, 1 -->
            <IMPLEMENTATION-DATA-TYPE>
              <SHORT-NAME>SymDecryptResultBuffer</SHORT-NAME>
              <CATEGORY>ARRAY</CATEGORY>
              <SUB-ELEMENTS>
                <IMPLEMENTATION-DATA-TYPE-ELEMENT>
                  <SHORT-NAME>AuxSymDecryptResultBufferSize</SHORT-NAME>
                  <CATEGORY>TYPE_REFERENCE</CATEGORY>
                  <ARRAY-SIZE>[!"CsmSymDecrypt/CsmSymDecryptResultBufferSize"!]</ARRAY-SIZE>
                  <ARRAY-SIZE-SEMANTICS>FIXED-SIZE</ARRAY-SIZE-SEMANTICS>
                  <SW-DATA-DEF-PROPS>
                    <SW-DATA-DEF-PROPS-VARIANTS>
                      <SW-DATA-DEF-PROPS-CONDITIONAL>
                        <IMPLEMENTATION-DATA-TYPE-REF DEST="IMPLEMENTATION-DATA-TYPE">/AUTOSAR_Platform/ImplementationDataTypes/uint8</IMPLEMENTATION-DATA-TYPE-REF>
                      </SW-DATA-DEF-PROPS-CONDITIONAL>
                    </SW-DATA-DEF-PROPS-VARIANTS>
                  </SW-DATA-DEF-PROPS>
                </IMPLEMENTATION-DATA-TYPE-ELEMENT>
              </SUB-ELEMENTS>
            </IMPLEMENTATION-DATA-TYPE>
[!ENDIF!][!//
[!IF "count(CsmSymKeyExtract/CsmSymKeyExtractConfig/*[CsmSymKeyExtractEnableRteInterface='true']) > 0"!][!//
            <!-- !LINKSTO CSM0803, 1 -->
            <IMPLEMENTATION-DATA-TYPE>
              <SHORT-NAME>SymKeyExtractDataBuffer</SHORT-NAME>
              <CATEGORY>ARRAY</CATEGORY>
              <SUB-ELEMENTS>
                <IMPLEMENTATION-DATA-TYPE-ELEMENT>
                  <SHORT-NAME>AuxSymKeyExtractDataBufferSize</SHORT-NAME>
                  <CATEGORY>TYPE_REFERENCE</CATEGORY>
                  <ARRAY-SIZE>[!"CsmSymKeyExtract/CsmSymKeyExtractDataBufferSize"!]</ARRAY-SIZE>
                  <ARRAY-SIZE-SEMANTICS>FIXED-SIZE</ARRAY-SIZE-SEMANTICS>
                  <SW-DATA-DEF-PROPS>
                    <SW-DATA-DEF-PROPS-VARIANTS>
                      <SW-DATA-DEF-PROPS-CONDITIONAL>
                        <IMPLEMENTATION-DATA-TYPE-REF DEST="IMPLEMENTATION-DATA-TYPE">/AUTOSAR_Platform/ImplementationDataTypes/uint8</IMPLEMENTATION-DATA-TYPE-REF>
                      </SW-DATA-DEF-PROPS-CONDITIONAL>
                    </SW-DATA-DEF-PROPS-VARIANTS>
                  </SW-DATA-DEF-PROPS>
                </IMPLEMENTATION-DATA-TYPE-ELEMENT>
              </SUB-ELEMENTS>
            </IMPLEMENTATION-DATA-TYPE>
[!ENDIF!][!//
[!IF "count(CsmSymKeyWrapAsym/CsmSymKeyWrapAsymConfig/*[CsmSymKeyWrapAsymEnableRteInterface='true']) > 0"!][!//
            <!-- !LINKSTO CSM0803, 1 -->
            <IMPLEMENTATION-DATA-TYPE>
              <SHORT-NAME>SymKeyWrapAsymDataBuffer</SHORT-NAME>
              <CATEGORY>ARRAY</CATEGORY>
              <SUB-ELEMENTS>
                <IMPLEMENTATION-DATA-TYPE-ELEMENT>
                  <SHORT-NAME>AuxSymKeyWrapAsymDataBufferSize</SHORT-NAME>
                  <CATEGORY>TYPE_REFERENCE</CATEGORY>
                  <ARRAY-SIZE>[!"CsmSymKeyWrapAsym/CsmSymKeyWrapAsymDataBufferSize"!]</ARRAY-SIZE>
                  <ARRAY-SIZE-SEMANTICS>FIXED-SIZE</ARRAY-SIZE-SEMANTICS>
                  <SW-DATA-DEF-PROPS>
                    <SW-DATA-DEF-PROPS-VARIANTS>
                      <SW-DATA-DEF-PROPS-CONDITIONAL>
                        <IMPLEMENTATION-DATA-TYPE-REF DEST="IMPLEMENTATION-DATA-TYPE">/AUTOSAR_Platform/ImplementationDataTypes/uint8</IMPLEMENTATION-DATA-TYPE-REF>
                      </SW-DATA-DEF-PROPS-CONDITIONAL>
                    </SW-DATA-DEF-PROPS-VARIANTS>
                  </SW-DATA-DEF-PROPS>
                </IMPLEMENTATION-DATA-TYPE-ELEMENT>
              </SUB-ELEMENTS>
            </IMPLEMENTATION-DATA-TYPE>
[!ENDIF!][!//
[!IF "count(CsmSymKeyWrapSym/CsmSymKeyWrapSymConfig/*[CsmSymKeyWrapSymEnableRteInterface='true']) > 0"!][!//
            <!-- !LINKSTO CSM0803, 1 -->
            <IMPLEMENTATION-DATA-TYPE>
              <SHORT-NAME>SymKeyWrapSymDataBuffer</SHORT-NAME>
              <CATEGORY>ARRAY</CATEGORY>
              <SUB-ELEMENTS>
                <IMPLEMENTATION-DATA-TYPE-ELEMENT>
                  <SHORT-NAME>AuxSymKeyWrapSymDataBufferSize</SHORT-NAME>
                  <CATEGORY>TYPE_REFERENCE</CATEGORY>
                  <ARRAY-SIZE>[!"CsmSymKeyWrapSym/CsmSymKeyWrapSymDataBufferSize"!]</ARRAY-SIZE>
                  <ARRAY-SIZE-SEMANTICS>FIXED-SIZE</ARRAY-SIZE-SEMANTICS>
                  <SW-DATA-DEF-PROPS>
                    <SW-DATA-DEF-PROPS-VARIANTS>
                      <SW-DATA-DEF-PROPS-CONDITIONAL>
                        <IMPLEMENTATION-DATA-TYPE-REF DEST="IMPLEMENTATION-DATA-TYPE">/AUTOSAR_Platform/ImplementationDataTypes/uint8</IMPLEMENTATION-DATA-TYPE-REF>
                      </SW-DATA-DEF-PROPS-CONDITIONAL>
                    </SW-DATA-DEF-PROPS-VARIANTS>
                  </SW-DATA-DEF-PROPS>
                </IMPLEMENTATION-DATA-TYPE-ELEMENT>
              </SUB-ELEMENTS>
            </IMPLEMENTATION-DATA-TYPE>
[!ENDIF!][!//
          </ELEMENTS>
        </AR-PACKAGE>

        <AR-PACKAGE>
          <SHORT-NAME>PortInterfaces</SHORT-NAME>
          <ELEMENTS>
[!IF "count(CsmAsymPrivateKeyWrapAsym/CsmAsymPrivateKeyWrapAsymConfig/*[CsmAsymPrivateKeyWrapAsymEnableRteInterface='true']) > 0"!][!//
            <!-- !LINKSTO EB_CSM0800_01, 1 -->
            <CLIENT-SERVER-INTERFACE>
              <SHORT-NAME>CsmAsymPrivateKeyWrapAsym</SHORT-NAME>
              <IS-SERVICE>true</IS-SERVICE>
              <OPERATIONS>
                <CLIENT-SERVER-OPERATION>
                  <SHORT-NAME>AsymPrivateKeyWrapAsymStart</SHORT-NAME>
                  <ARGUMENTS>
                    <ARGUMENT-DATA-PROTOTYPE>
                      <SHORT-NAME>key</SHORT-NAME>
                      <TYPE-TREF DEST="IMPLEMENTATION-DATA-TYPE">/AUTOSAR_Csm/ImplementationDataTypes/AsymPrivateKeyType</TYPE-TREF>
                      <DIRECTION>IN</DIRECTION>
                    </ARGUMENT-DATA-PROTOTYPE>
                    <ARGUMENT-DATA-PROTOTYPE>
                      <SHORT-NAME>wrappingKey</SHORT-NAME>
                      <TYPE-TREF DEST="IMPLEMENTATION-DATA-TYPE">/AUTOSAR_Csm/ImplementationDataTypes/AsymPublicKeyType</TYPE-TREF>
                      <DIRECTION>IN</DIRECTION>
                    </ARGUMENT-DATA-PROTOTYPE>
                  </ARGUMENTS>
                  <POSSIBLE-ERROR-REFS>
                    <POSSIBLE-ERROR-REF DEST="APPLICATION-ERROR">/AUTOSAR_Csm/PortInterfaces/CsmAsymPrivateKeyWrapAsym/CSM_E_NOT_OK</POSSIBLE-ERROR-REF>
                    <POSSIBLE-ERROR-REF DEST="APPLICATION-ERROR">/AUTOSAR_Csm/PortInterfaces/CsmAsymPrivateKeyWrapAsym/CSM_E_BUSY</POSSIBLE-ERROR-REF>
                  </POSSIBLE-ERROR-REFS>
                </CLIENT-SERVER-OPERATION>
                <CLIENT-SERVER-OPERATION>
                  <SHORT-NAME>AsymPrivateKeyWrapAsymUpdate</SHORT-NAME>
                  <ARGUMENTS>
                    <ARGUMENT-DATA-PROTOTYPE>
                      <SHORT-NAME>dataBuffer</SHORT-NAME>
                      <TYPE-TREF DEST="IMPLEMENTATION-DATA-TYPE">/AUTOSAR_Csm/ImplementationDataTypes/AsymPrivateKeyWrapAsymDataBuffer</TYPE-TREF>
                      <DIRECTION>OUT</DIRECTION>
                    </ARGUMENT-DATA-PROTOTYPE>
                    <ARGUMENT-DATA-PROTOTYPE>
                      <SHORT-NAME>dataLength</SHORT-NAME>
                      <TYPE-TREF DEST="IMPLEMENTATION-DATA-TYPE">/AUTOSAR_Platform/ImplementationDataTypes/uint32</TYPE-TREF>
                      <DIRECTION>INOUT</DIRECTION>
                    </ARGUMENT-DATA-PROTOTYPE>
                  </ARGUMENTS>
                  <POSSIBLE-ERROR-REFS>
                    <POSSIBLE-ERROR-REF DEST="APPLICATION-ERROR">/AUTOSAR_Csm/PortInterfaces/CsmAsymPrivateKeyWrapAsym/CSM_E_NOT_OK</POSSIBLE-ERROR-REF>
                    <POSSIBLE-ERROR-REF DEST="APPLICATION-ERROR">/AUTOSAR_Csm/PortInterfaces/CsmAsymPrivateKeyWrapAsym/CSM_E_BUSY</POSSIBLE-ERROR-REF>
                  </POSSIBLE-ERROR-REFS>
                </CLIENT-SERVER-OPERATION>
                <CLIENT-SERVER-OPERATION>
                  <SHORT-NAME>AsymPrivateKeyWrapAsymFinish</SHORT-NAME>
                  <ARGUMENTS>
                  </ARGUMENTS>
                  <POSSIBLE-ERROR-REFS>
                    <POSSIBLE-ERROR-REF DEST="APPLICATION-ERROR">/AUTOSAR_Csm/PortInterfaces/CsmAsymPrivateKeyWrapAsym/CSM_E_NOT_OK</POSSIBLE-ERROR-REF>
                    <POSSIBLE-ERROR-REF DEST="APPLICATION-ERROR">/AUTOSAR_Csm/PortInterfaces/CsmAsymPrivateKeyWrapAsym/CSM_E_BUSY</POSSIBLE-ERROR-REF>
                  </POSSIBLE-ERROR-REFS>
                </CLIENT-SERVER-OPERATION>
              </OPERATIONS>
              <POSSIBLE-ERRORS>
                <APPLICATION-ERROR>
                  <SHORT-NAME>CSM_E_NOT_OK</SHORT-NAME>
                  <ERROR-CODE>1</ERROR-CODE>
                </APPLICATION-ERROR>
                <APPLICATION-ERROR>
                  <SHORT-NAME>CSM_E_BUSY</SHORT-NAME>
                  <ERROR-CODE>2</ERROR-CODE>
                </APPLICATION-ERROR>
              </POSSIBLE-ERRORS>
            </CLIENT-SERVER-INTERFACE>
[!ENDIF!][!//
[!IF "count(CsmAsymPrivateKeyWrapSym/CsmAsymPrivateKeyWrapSymConfig/*[CsmAsymPrivateKeyWrapSymEnableRteInterface='true']) > 0"!][!//
            <!-- !LINKSTO EB_CSM0799_01, 1 -->
            <CLIENT-SERVER-INTERFACE>
              <SHORT-NAME>CsmAsymPrivateKeyWrapSym</SHORT-NAME>
              <IS-SERVICE>true</IS-SERVICE>
              <OPERATIONS>
                <CLIENT-SERVER-OPERATION>
                  <SHORT-NAME>AsymPrivateKeyWrapSymStart</SHORT-NAME>
                  <ARGUMENTS>
                    <ARGUMENT-DATA-PROTOTYPE>
                      <SHORT-NAME>key</SHORT-NAME>
                      <TYPE-TREF DEST="IMPLEMENTATION-DATA-TYPE">/AUTOSAR_Csm/ImplementationDataTypes/AsymPrivateKeyType</TYPE-TREF>
                      <DIRECTION>IN</DIRECTION>
                    </ARGUMENT-DATA-PROTOTYPE>
                    <ARGUMENT-DATA-PROTOTYPE>
                      <SHORT-NAME>wrappingKey</SHORT-NAME>
                      <TYPE-TREF DEST="IMPLEMENTATION-DATA-TYPE">/AUTOSAR_Csm/ImplementationDataTypes/SymKeyType</TYPE-TREF>
                      <DIRECTION>IN</DIRECTION>
                    </ARGUMENT-DATA-PROTOTYPE>
                  </ARGUMENTS>
                  <POSSIBLE-ERROR-REFS>
                    <POSSIBLE-ERROR-REF DEST="APPLICATION-ERROR">/AUTOSAR_Csm/PortInterfaces/CsmAsymPrivateKeyWrapSym/CSM_E_NOT_OK</POSSIBLE-ERROR-REF>
                    <POSSIBLE-ERROR-REF DEST="APPLICATION-ERROR">/AUTOSAR_Csm/PortInterfaces/CsmAsymPrivateKeyWrapSym/CSM_E_BUSY</POSSIBLE-ERROR-REF>
                  </POSSIBLE-ERROR-REFS>
                </CLIENT-SERVER-OPERATION>
                <CLIENT-SERVER-OPERATION>
                  <SHORT-NAME>AsymPrivateKeyWrapSymUpdate</SHORT-NAME>
                  <ARGUMENTS>
                    <ARGUMENT-DATA-PROTOTYPE>
                      <SHORT-NAME>dataBuffer</SHORT-NAME>
                      <TYPE-TREF DEST="IMPLEMENTATION-DATA-TYPE">/AUTOSAR_Csm/ImplementationDataTypes/AsymPrivateKeyWrapSymDataBuffer</TYPE-TREF>
                      <DIRECTION>OUT</DIRECTION>
                    </ARGUMENT-DATA-PROTOTYPE>
                    <ARGUMENT-DATA-PROTOTYPE>
                      <SHORT-NAME>dataLength</SHORT-NAME>
                      <TYPE-TREF DEST="IMPLEMENTATION-DATA-TYPE">/AUTOSAR_Platform/ImplementationDataTypes/uint32</TYPE-TREF>
                      <DIRECTION>INOUT</DIRECTION>
                    </ARGUMENT-DATA-PROTOTYPE>
                  </ARGUMENTS>
                  <POSSIBLE-ERROR-REFS>
                    <POSSIBLE-ERROR-REF DEST="APPLICATION-ERROR">/AUTOSAR_Csm/PortInterfaces/CsmAsymPrivateKeyWrapSym/CSM_E_NOT_OK</POSSIBLE-ERROR-REF>
                    <POSSIBLE-ERROR-REF DEST="APPLICATION-ERROR">/AUTOSAR_Csm/PortInterfaces/CsmAsymPrivateKeyWrapSym/CSM_E_BUSY</POSSIBLE-ERROR-REF>
                  </POSSIBLE-ERROR-REFS>
                </CLIENT-SERVER-OPERATION>
                <CLIENT-SERVER-OPERATION>
                  <SHORT-NAME>AsymPrivateKeyWrapSymFinish</SHORT-NAME>
                  <ARGUMENTS>
                  </ARGUMENTS>
                  <POSSIBLE-ERROR-REFS>
                    <POSSIBLE-ERROR-REF DEST="APPLICATION-ERROR">/AUTOSAR_Csm/PortInterfaces/CsmAsymPrivateKeyWrapSym/CSM_E_NOT_OK</POSSIBLE-ERROR-REF>
                    <POSSIBLE-ERROR-REF DEST="APPLICATION-ERROR">/AUTOSAR_Csm/PortInterfaces/CsmAsymPrivateKeyWrapSym/CSM_E_BUSY</POSSIBLE-ERROR-REF>
                  </POSSIBLE-ERROR-REFS>
                </CLIENT-SERVER-OPERATION>
              </OPERATIONS>
              <POSSIBLE-ERRORS>
                <APPLICATION-ERROR>
                  <SHORT-NAME>CSM_E_NOT_OK</SHORT-NAME>
                  <ERROR-CODE>1</ERROR-CODE>
                </APPLICATION-ERROR>
                <APPLICATION-ERROR>
                  <SHORT-NAME>CSM_E_BUSY</SHORT-NAME>
                  <ERROR-CODE>2</ERROR-CODE>
                </APPLICATION-ERROR>
              </POSSIBLE-ERRORS>
            </CLIENT-SERVER-INTERFACE>
[!ENDIF!][!//
[!IF "count(CsmAsymPublicKeyExtract/CsmAsymPublicKeyExtractConfig/*[CsmAsymPublicKeyExtractEnableRteInterface='true']) > 0"!][!//
            <!-- !LINKSTO CSM0797, 1 -->
            <CLIENT-SERVER-INTERFACE>
              <SHORT-NAME>CsmAsymPublicKeyExtract</SHORT-NAME>
              <IS-SERVICE>true</IS-SERVICE>
              <OPERATIONS>
                <CLIENT-SERVER-OPERATION>
                  <SHORT-NAME>AsymPublicKeyExtractStart</SHORT-NAME>
                  <ARGUMENTS>
                  </ARGUMENTS>
                  <POSSIBLE-ERROR-REFS>
                    <POSSIBLE-ERROR-REF DEST="APPLICATION-ERROR">/AUTOSAR_Csm/PortInterfaces/CsmAsymPublicKeyExtract/CSM_E_NOT_OK</POSSIBLE-ERROR-REF>
                    <POSSIBLE-ERROR-REF DEST="APPLICATION-ERROR">/AUTOSAR_Csm/PortInterfaces/CsmAsymPublicKeyExtract/CSM_E_BUSY</POSSIBLE-ERROR-REF>
                  </POSSIBLE-ERROR-REFS>
                </CLIENT-SERVER-OPERATION>
                <CLIENT-SERVER-OPERATION>
                  <SHORT-NAME>AsymPublicKeyExtractUpdate</SHORT-NAME>
                  <ARGUMENTS>
                    <ARGUMENT-DATA-PROTOTYPE>
                      <SHORT-NAME>dataBuffer</SHORT-NAME>
                      <TYPE-TREF DEST="IMPLEMENTATION-DATA-TYPE">/AUTOSAR_Csm/ImplementationDataTypes/AsymPublicKeyExtractDataBuffer</TYPE-TREF>
                      <DIRECTION>IN</DIRECTION>
                    </ARGUMENT-DATA-PROTOTYPE>
                    <ARGUMENT-DATA-PROTOTYPE>
                      <SHORT-NAME>dataLength</SHORT-NAME>
                      <TYPE-TREF DEST="IMPLEMENTATION-DATA-TYPE">/AUTOSAR_Platform/ImplementationDataTypes/uint32</TYPE-TREF>
                      <DIRECTION>IN</DIRECTION>
                    </ARGUMENT-DATA-PROTOTYPE>
                  </ARGUMENTS>
                  <POSSIBLE-ERROR-REFS>
                    <POSSIBLE-ERROR-REF DEST="APPLICATION-ERROR">/AUTOSAR_Csm/PortInterfaces/CsmAsymPublicKeyExtract/CSM_E_NOT_OK</POSSIBLE-ERROR-REF>
                    <POSSIBLE-ERROR-REF DEST="APPLICATION-ERROR">/AUTOSAR_Csm/PortInterfaces/CsmAsymPublicKeyExtract/CSM_E_BUSY</POSSIBLE-ERROR-REF>
                  </POSSIBLE-ERROR-REFS>
                </CLIENT-SERVER-OPERATION>
                <CLIENT-SERVER-OPERATION>
                  <SHORT-NAME>AsymPublicKeyExtractFinish</SHORT-NAME>
                  <ARGUMENTS>
                    <ARGUMENT-DATA-PROTOTYPE>
                      <SHORT-NAME>key</SHORT-NAME>
                      <TYPE-TREF DEST="IMPLEMENTATION-DATA-TYPE">/AUTOSAR_Csm/ImplementationDataTypes/AsymPublicKeyType</TYPE-TREF>
                      <DIRECTION>INOUT</DIRECTION>
                    </ARGUMENT-DATA-PROTOTYPE>
                  </ARGUMENTS>
                  <POSSIBLE-ERROR-REFS>
                    <POSSIBLE-ERROR-REF DEST="APPLICATION-ERROR">/AUTOSAR_Csm/PortInterfaces/CsmAsymPublicKeyExtract/CSM_E_NOT_OK</POSSIBLE-ERROR-REF>
                    <POSSIBLE-ERROR-REF DEST="APPLICATION-ERROR">/AUTOSAR_Csm/PortInterfaces/CsmAsymPublicKeyExtract/CSM_E_BUSY</POSSIBLE-ERROR-REF>
                  </POSSIBLE-ERROR-REFS>
                </CLIENT-SERVER-OPERATION>
              </OPERATIONS>
              <POSSIBLE-ERRORS>
                <APPLICATION-ERROR>
                  <SHORT-NAME>CSM_E_NOT_OK</SHORT-NAME>
                  <ERROR-CODE>1</ERROR-CODE>
                </APPLICATION-ERROR>
                <APPLICATION-ERROR>
                  <SHORT-NAME>CSM_E_BUSY</SHORT-NAME>
                  <ERROR-CODE>2</ERROR-CODE>
                </APPLICATION-ERROR>
              </POSSIBLE-ERRORS>
            </CLIENT-SERVER-INTERFACE>
[!ENDIF!][!//
[!IF "count(CsmChecksum/CsmChecksumConfig/*[CsmChecksumEnableRteInterface='true']) > 0"!][!//
            <!-- !LINKSTO EB_CSM0788_01, 1 -->
            <CLIENT-SERVER-INTERFACE>
              <SHORT-NAME>CsmChecksum</SHORT-NAME>
              <IS-SERVICE>true</IS-SERVICE>
              <OPERATIONS>
                <CLIENT-SERVER-OPERATION>
                  <SHORT-NAME>ChecksumStart</SHORT-NAME>
                  <ARGUMENTS>
                  </ARGUMENTS>
                  <POSSIBLE-ERROR-REFS>
                    <POSSIBLE-ERROR-REF DEST="APPLICATION-ERROR">/AUTOSAR_Csm/PortInterfaces/CsmChecksum/CSM_E_NOT_OK</POSSIBLE-ERROR-REF>
                    <POSSIBLE-ERROR-REF DEST="APPLICATION-ERROR">/AUTOSAR_Csm/PortInterfaces/CsmChecksum/CSM_E_BUSY</POSSIBLE-ERROR-REF>
                  </POSSIBLE-ERROR-REFS>
                </CLIENT-SERVER-OPERATION>
                <CLIENT-SERVER-OPERATION>
                  <SHORT-NAME>ChecksumUpdate</SHORT-NAME>
                  <ARGUMENTS>
                    <ARGUMENT-DATA-PROTOTYPE>
                      <SHORT-NAME>dataBuffer</SHORT-NAME>
                      <TYPE-TREF DEST="IMPLEMENTATION-DATA-TYPE">/AUTOSAR_Csm/ImplementationDataTypes/ChecksumDataBuffer</TYPE-TREF>
                      <DIRECTION>IN</DIRECTION>
                    </ARGUMENT-DATA-PROTOTYPE>
                    <ARGUMENT-DATA-PROTOTYPE>
                      <SHORT-NAME>dataLength</SHORT-NAME>
                      <TYPE-TREF DEST="IMPLEMENTATION-DATA-TYPE">/AUTOSAR_Platform/ImplementationDataTypes/uint32</TYPE-TREF>
                      <DIRECTION>IN</DIRECTION>
                    </ARGUMENT-DATA-PROTOTYPE>
                  </ARGUMENTS>
                  <POSSIBLE-ERROR-REFS>
                    <POSSIBLE-ERROR-REF DEST="APPLICATION-ERROR">/AUTOSAR_Csm/PortInterfaces/CsmChecksum/CSM_E_NOT_OK</POSSIBLE-ERROR-REF>
                    <POSSIBLE-ERROR-REF DEST="APPLICATION-ERROR">/AUTOSAR_Csm/PortInterfaces/CsmChecksum/CSM_E_BUSY</POSSIBLE-ERROR-REF>
                  </POSSIBLE-ERROR-REFS>
                </CLIENT-SERVER-OPERATION>
                <CLIENT-SERVER-OPERATION>
                  <SHORT-NAME>ChecksumFinish</SHORT-NAME>
                  <ARGUMENTS>
                    <ARGUMENT-DATA-PROTOTYPE>
                      <SHORT-NAME>resultBuffer</SHORT-NAME>
                      <TYPE-TREF DEST="IMPLEMENTATION-DATA-TYPE">/AUTOSAR_Csm/ImplementationDataTypes/ChecksumResultBuffer</TYPE-TREF>
                      <DIRECTION>OUT</DIRECTION>
                    </ARGUMENT-DATA-PROTOTYPE>
                    <ARGUMENT-DATA-PROTOTYPE>
                      <SHORT-NAME>resultLength</SHORT-NAME>
                      <TYPE-TREF DEST="IMPLEMENTATION-DATA-TYPE">/AUTOSAR_Platform/ImplementationDataTypes/uint32</TYPE-TREF>
                      <DIRECTION>INOUT</DIRECTION>
                    </ARGUMENT-DATA-PROTOTYPE>
                    <ARGUMENT-DATA-PROTOTYPE>
                      <SHORT-NAME>TruncationIsAllowed</SHORT-NAME>
                      <TYPE-TREF DEST="IMPLEMENTATION-DATA-TYPE">/AUTOSAR_Platform/ImplementationDataTypes/boolean</TYPE-TREF>
                      <DIRECTION>IN</DIRECTION>
                    </ARGUMENT-DATA-PROTOTYPE>
                  </ARGUMENTS>
                  <POSSIBLE-ERROR-REFS>
                    <POSSIBLE-ERROR-REF DEST="APPLICATION-ERROR">/AUTOSAR_Csm/PortInterfaces/CsmChecksum/CSM_E_NOT_OK</POSSIBLE-ERROR-REF>
                    <POSSIBLE-ERROR-REF DEST="APPLICATION-ERROR">/AUTOSAR_Csm/PortInterfaces/CsmChecksum/CSM_E_BUSY</POSSIBLE-ERROR-REF>
                    <POSSIBLE-ERROR-REF DEST="APPLICATION-ERROR">/AUTOSAR_Csm/PortInterfaces/CsmChecksum/CSM_E_SMALL_BUFFER</POSSIBLE-ERROR-REF>
                  </POSSIBLE-ERROR-REFS>
                </CLIENT-SERVER-OPERATION>
              </OPERATIONS>
              <POSSIBLE-ERRORS>
                <APPLICATION-ERROR>
                  <SHORT-NAME>CSM_E_NOT_OK</SHORT-NAME>
                  <ERROR-CODE>1</ERROR-CODE>
                </APPLICATION-ERROR>
                <APPLICATION-ERROR>
                  <SHORT-NAME>CSM_E_BUSY</SHORT-NAME>
                  <ERROR-CODE>2</ERROR-CODE>
                </APPLICATION-ERROR>
                <APPLICATION-ERROR>
                  <SHORT-NAME>CSM_E_SMALL_BUFFER</SHORT-NAME>
                  <ERROR-CODE>3</ERROR-CODE>
                </APPLICATION-ERROR>
              </POSSIBLE-ERRORS>
            </CLIENT-SERVER-INTERFACE>
[!ENDIF!][!//
[!IF "count(CsmHash/CsmHashConfig/*[CsmHashEnableRteInterface='true']) > 0"!][!//
            <!-- !LINKSTO EB_CSM0775_01, 1 -->
            <CLIENT-SERVER-INTERFACE>
              <SHORT-NAME>CsmHash</SHORT-NAME>
              <IS-SERVICE>true</IS-SERVICE>
              <OPERATIONS>
                <CLIENT-SERVER-OPERATION>
                  <SHORT-NAME>HashStart</SHORT-NAME>
                  <ARGUMENTS>
                  </ARGUMENTS>
                  <POSSIBLE-ERROR-REFS>
                    <POSSIBLE-ERROR-REF DEST="APPLICATION-ERROR">/AUTOSAR_Csm/PortInterfaces/CsmHash/CSM_E_NOT_OK</POSSIBLE-ERROR-REF>
                    <POSSIBLE-ERROR-REF DEST="APPLICATION-ERROR">/AUTOSAR_Csm/PortInterfaces/CsmHash/CSM_E_BUSY</POSSIBLE-ERROR-REF>
                  </POSSIBLE-ERROR-REFS>
                </CLIENT-SERVER-OPERATION>
                <CLIENT-SERVER-OPERATION>
                  <SHORT-NAME>HashUpdate</SHORT-NAME>
                  <ARGUMENTS>
                    <ARGUMENT-DATA-PROTOTYPE>
                      <SHORT-NAME>dataBuffer</SHORT-NAME>
                      <TYPE-TREF DEST="IMPLEMENTATION-DATA-TYPE">/AUTOSAR_Csm/ImplementationDataTypes/HashDataBuffer</TYPE-TREF>
                      <DIRECTION>IN</DIRECTION>
                    </ARGUMENT-DATA-PROTOTYPE>
                    <ARGUMENT-DATA-PROTOTYPE>
                      <SHORT-NAME>dataLength</SHORT-NAME>
                      <TYPE-TREF DEST="IMPLEMENTATION-DATA-TYPE">/AUTOSAR_Platform/ImplementationDataTypes/uint32</TYPE-TREF>
                      <DIRECTION>IN</DIRECTION>
                    </ARGUMENT-DATA-PROTOTYPE>
                  </ARGUMENTS>
                  <POSSIBLE-ERROR-REFS>
                    <POSSIBLE-ERROR-REF DEST="APPLICATION-ERROR">/AUTOSAR_Csm/PortInterfaces/CsmHash/CSM_E_NOT_OK</POSSIBLE-ERROR-REF>
                    <POSSIBLE-ERROR-REF DEST="APPLICATION-ERROR">/AUTOSAR_Csm/PortInterfaces/CsmHash/CSM_E_BUSY</POSSIBLE-ERROR-REF>
                  </POSSIBLE-ERROR-REFS>
                </CLIENT-SERVER-OPERATION>
                <CLIENT-SERVER-OPERATION>
                  <SHORT-NAME>HashFinish</SHORT-NAME>
                  <ARGUMENTS>
                    <ARGUMENT-DATA-PROTOTYPE>
                      <SHORT-NAME>resultBuffer</SHORT-NAME>
                      <TYPE-TREF DEST="IMPLEMENTATION-DATA-TYPE">/AUTOSAR_Csm/ImplementationDataTypes/HashResultBuffer</TYPE-TREF>
                      <DIRECTION>OUT</DIRECTION>
                    </ARGUMENT-DATA-PROTOTYPE>
                    <ARGUMENT-DATA-PROTOTYPE>
                      <SHORT-NAME>resultLength</SHORT-NAME>
                      <TYPE-TREF DEST="IMPLEMENTATION-DATA-TYPE">/AUTOSAR_Platform/ImplementationDataTypes/uint32</TYPE-TREF>
                      <DIRECTION>INOUT</DIRECTION>
                    </ARGUMENT-DATA-PROTOTYPE>
                    <ARGUMENT-DATA-PROTOTYPE>
                      <SHORT-NAME>TruncationIsAllowed</SHORT-NAME>
                      <TYPE-TREF DEST="IMPLEMENTATION-DATA-TYPE">/AUTOSAR_Platform/ImplementationDataTypes/boolean</TYPE-TREF>
                      <DIRECTION>IN</DIRECTION>
                    </ARGUMENT-DATA-PROTOTYPE>
                  </ARGUMENTS>
                  <POSSIBLE-ERROR-REFS>
                    <POSSIBLE-ERROR-REF DEST="APPLICATION-ERROR">/AUTOSAR_Csm/PortInterfaces/CsmHash/CSM_E_NOT_OK</POSSIBLE-ERROR-REF>
                    <POSSIBLE-ERROR-REF DEST="APPLICATION-ERROR">/AUTOSAR_Csm/PortInterfaces/CsmHash/CSM_E_BUSY</POSSIBLE-ERROR-REF>
                    <POSSIBLE-ERROR-REF DEST="APPLICATION-ERROR">/AUTOSAR_Csm/PortInterfaces/CsmHash/CSM_E_SMALL_BUFFER</POSSIBLE-ERROR-REF>
                  </POSSIBLE-ERROR-REFS>
                </CLIENT-SERVER-OPERATION>
              </OPERATIONS>
              <POSSIBLE-ERRORS>
                <APPLICATION-ERROR>
                  <SHORT-NAME>CSM_E_NOT_OK</SHORT-NAME>
                  <ERROR-CODE>1</ERROR-CODE>
                </APPLICATION-ERROR>
                <APPLICATION-ERROR>
                  <SHORT-NAME>CSM_E_BUSY</SHORT-NAME>
                  <ERROR-CODE>2</ERROR-CODE>
                </APPLICATION-ERROR>
                <APPLICATION-ERROR>
                  <SHORT-NAME>CSM_E_SMALL_BUFFER</SHORT-NAME>
                  <ERROR-CODE>3</ERROR-CODE>
                </APPLICATION-ERROR>
              </POSSIBLE-ERRORS>
            </CLIENT-SERVER-INTERFACE>
[!ENDIF!][!//
[!IF "count(CsmMacGenerate/CsmMacGenerateConfig/*[CsmMacGenerateEnableRteInterface='true']) > 0"!][!//
            <!-- !LINKSTO EB_CSM0776_01, 1 -->
            <CLIENT-SERVER-INTERFACE>
              <SHORT-NAME>CsmMacGenerate</SHORT-NAME>
              <IS-SERVICE>true</IS-SERVICE>
              <OPERATIONS>
                <CLIENT-SERVER-OPERATION>
                  <SHORT-NAME>MacGenerateStart</SHORT-NAME>
                  <ARGUMENTS>
                    <ARGUMENT-DATA-PROTOTYPE>
                      <SHORT-NAME>key</SHORT-NAME>
                      <TYPE-TREF DEST="IMPLEMENTATION-DATA-TYPE">/AUTOSAR_Csm/ImplementationDataTypes/SymKeyType</TYPE-TREF>
                      <DIRECTION>IN</DIRECTION>
                    </ARGUMENT-DATA-PROTOTYPE>
                  </ARGUMENTS>
                  <POSSIBLE-ERROR-REFS>
                    <POSSIBLE-ERROR-REF DEST="APPLICATION-ERROR">/AUTOSAR_Csm/PortInterfaces/CsmMacGenerate/CSM_E_NOT_OK</POSSIBLE-ERROR-REF>
                    <POSSIBLE-ERROR-REF DEST="APPLICATION-ERROR">/AUTOSAR_Csm/PortInterfaces/CsmMacGenerate/CSM_E_BUSY</POSSIBLE-ERROR-REF>
                  </POSSIBLE-ERROR-REFS>
                </CLIENT-SERVER-OPERATION>
                <CLIENT-SERVER-OPERATION>
                  <SHORT-NAME>MacGenerateUpdate</SHORT-NAME>
                  <ARGUMENTS>
                    <ARGUMENT-DATA-PROTOTYPE>
                      <SHORT-NAME>dataBuffer</SHORT-NAME>
                      <TYPE-TREF DEST="IMPLEMENTATION-DATA-TYPE">/AUTOSAR_Csm/ImplementationDataTypes/MacGenerateDataBuffer</TYPE-TREF>
                      <DIRECTION>IN</DIRECTION>
                    </ARGUMENT-DATA-PROTOTYPE>
                    <ARGUMENT-DATA-PROTOTYPE>
                      <SHORT-NAME>dataLength</SHORT-NAME>
                      <TYPE-TREF DEST="IMPLEMENTATION-DATA-TYPE">/AUTOSAR_Platform/ImplementationDataTypes/uint32</TYPE-TREF>
                      <DIRECTION>IN</DIRECTION>
                    </ARGUMENT-DATA-PROTOTYPE>
                  </ARGUMENTS>
                  <POSSIBLE-ERROR-REFS>
                    <POSSIBLE-ERROR-REF DEST="APPLICATION-ERROR">/AUTOSAR_Csm/PortInterfaces/CsmMacGenerate/CSM_E_NOT_OK</POSSIBLE-ERROR-REF>
                    <POSSIBLE-ERROR-REF DEST="APPLICATION-ERROR">/AUTOSAR_Csm/PortInterfaces/CsmMacGenerate/CSM_E_BUSY</POSSIBLE-ERROR-REF>
                  </POSSIBLE-ERROR-REFS>
                </CLIENT-SERVER-OPERATION>
                <CLIENT-SERVER-OPERATION>
                  <SHORT-NAME>MacGenerateFinish</SHORT-NAME>
                  <ARGUMENTS>
                    <ARGUMENT-DATA-PROTOTYPE>
                      <SHORT-NAME>resultBuffer</SHORT-NAME>
                      <TYPE-TREF DEST="IMPLEMENTATION-DATA-TYPE">/AUTOSAR_Csm/ImplementationDataTypes/MacGenerateResultBuffer</TYPE-TREF>
                      <DIRECTION>OUT</DIRECTION>
                    </ARGUMENT-DATA-PROTOTYPE>
                    <ARGUMENT-DATA-PROTOTYPE>
                      <SHORT-NAME>resultLength</SHORT-NAME>
                      <TYPE-TREF DEST="IMPLEMENTATION-DATA-TYPE">/AUTOSAR_Platform/ImplementationDataTypes/uint32</TYPE-TREF>
                      <DIRECTION>INOUT</DIRECTION>
                    </ARGUMENT-DATA-PROTOTYPE>
                    <ARGUMENT-DATA-PROTOTYPE>
                      <SHORT-NAME>TruncationIsAllowed</SHORT-NAME>
                      <TYPE-TREF DEST="IMPLEMENTATION-DATA-TYPE">/AUTOSAR_Platform/ImplementationDataTypes/boolean</TYPE-TREF>
                      <DIRECTION>IN</DIRECTION>
                    </ARGUMENT-DATA-PROTOTYPE>
                  </ARGUMENTS>
                  <POSSIBLE-ERROR-REFS>
                    <POSSIBLE-ERROR-REF DEST="APPLICATION-ERROR">/AUTOSAR_Csm/PortInterfaces/CsmMacGenerate/CSM_E_NOT_OK</POSSIBLE-ERROR-REF>
                    <POSSIBLE-ERROR-REF DEST="APPLICATION-ERROR">/AUTOSAR_Csm/PortInterfaces/CsmMacGenerate/CSM_E_BUSY</POSSIBLE-ERROR-REF>
                    <POSSIBLE-ERROR-REF DEST="APPLICATION-ERROR">/AUTOSAR_Csm/PortInterfaces/CsmMacGenerate/CSM_E_SMALL_BUFFER</POSSIBLE-ERROR-REF>
                  </POSSIBLE-ERROR-REFS>
                </CLIENT-SERVER-OPERATION>
              </OPERATIONS>
              <POSSIBLE-ERRORS>
                <APPLICATION-ERROR>
                  <SHORT-NAME>CSM_E_NOT_OK</SHORT-NAME>
                  <ERROR-CODE>1</ERROR-CODE>
                </APPLICATION-ERROR>
                <APPLICATION-ERROR>
                  <SHORT-NAME>CSM_E_BUSY</SHORT-NAME>
                  <ERROR-CODE>2</ERROR-CODE>
                </APPLICATION-ERROR>
                <APPLICATION-ERROR>
                  <SHORT-NAME>CSM_E_SMALL_BUFFER</SHORT-NAME>
                  <ERROR-CODE>3</ERROR-CODE>
                </APPLICATION-ERROR>
              </POSSIBLE-ERRORS>
            </CLIENT-SERVER-INTERFACE>
[!ENDIF!][!//
[!IF "count(CsmMacVerify/CsmMacVerifyConfig/*[CsmMacVerifyEnableRteInterface='true']) > 0"!][!//
            <!-- !LINKSTO EB_CSM0777_01, 1 -->
            <CLIENT-SERVER-INTERFACE>
              <SHORT-NAME>CsmMacVerify</SHORT-NAME>
              <IS-SERVICE>true</IS-SERVICE>
              <OPERATIONS>
                <CLIENT-SERVER-OPERATION>
                  <SHORT-NAME>MacVerifyStart</SHORT-NAME>
                  <ARGUMENTS>
                    <ARGUMENT-DATA-PROTOTYPE>
                      <SHORT-NAME>key</SHORT-NAME>
                      <TYPE-TREF DEST="IMPLEMENTATION-DATA-TYPE">/AUTOSAR_Csm/ImplementationDataTypes/SymKeyType</TYPE-TREF>
                      <DIRECTION>IN</DIRECTION>
                    </ARGUMENT-DATA-PROTOTYPE>
                  </ARGUMENTS>
                  <POSSIBLE-ERROR-REFS>
                    <POSSIBLE-ERROR-REF DEST="APPLICATION-ERROR">/AUTOSAR_Csm/PortInterfaces/CsmMacVerify/CSM_E_NOT_OK</POSSIBLE-ERROR-REF>
                    <POSSIBLE-ERROR-REF DEST="APPLICATION-ERROR">/AUTOSAR_Csm/PortInterfaces/CsmMacVerify/CSM_E_BUSY</POSSIBLE-ERROR-REF>
                  </POSSIBLE-ERROR-REFS>
                </CLIENT-SERVER-OPERATION>
                <CLIENT-SERVER-OPERATION>
                  <SHORT-NAME>MacVerifyUpdate</SHORT-NAME>
                  <ARGUMENTS>
                    <ARGUMENT-DATA-PROTOTYPE>
                      <SHORT-NAME>dataBuffer</SHORT-NAME>
                      <TYPE-TREF DEST="IMPLEMENTATION-DATA-TYPE">/AUTOSAR_Csm/ImplementationDataTypes/MacVerifyDataBuffer</TYPE-TREF>
                      <DIRECTION>IN</DIRECTION>
                    </ARGUMENT-DATA-PROTOTYPE>
                    <ARGUMENT-DATA-PROTOTYPE>
                      <SHORT-NAME>dataLength</SHORT-NAME>
                      <TYPE-TREF DEST="IMPLEMENTATION-DATA-TYPE">/AUTOSAR_Platform/ImplementationDataTypes/uint32</TYPE-TREF>
                      <DIRECTION>IN</DIRECTION>
                    </ARGUMENT-DATA-PROTOTYPE>
                  </ARGUMENTS>
                  <POSSIBLE-ERROR-REFS>
                    <POSSIBLE-ERROR-REF DEST="APPLICATION-ERROR">/AUTOSAR_Csm/PortInterfaces/CsmMacVerify/CSM_E_NOT_OK</POSSIBLE-ERROR-REF>
                    <POSSIBLE-ERROR-REF DEST="APPLICATION-ERROR">/AUTOSAR_Csm/PortInterfaces/CsmMacVerify/CSM_E_BUSY</POSSIBLE-ERROR-REF>
                  </POSSIBLE-ERROR-REFS>
                </CLIENT-SERVER-OPERATION>
                <CLIENT-SERVER-OPERATION>
                  <SHORT-NAME>MacVerifyFinish</SHORT-NAME>
                  <ARGUMENTS>
                    <ARGUMENT-DATA-PROTOTYPE>
                      <SHORT-NAME>MacBuffer</SHORT-NAME>
                      <TYPE-TREF DEST="IMPLEMENTATION-DATA-TYPE">/AUTOSAR_Csm/ImplementationDataTypes/MacVerifyCompareBuffer</TYPE-TREF>
                      <DIRECTION>IN</DIRECTION>
                    </ARGUMENT-DATA-PROTOTYPE>
                    <ARGUMENT-DATA-PROTOTYPE>
                      <SHORT-NAME>MacLength</SHORT-NAME>
                      <TYPE-TREF DEST="IMPLEMENTATION-DATA-TYPE">/AUTOSAR_Platform/ImplementationDataTypes/uint32</TYPE-TREF>
                      <DIRECTION>IN</DIRECTION>
                    </ARGUMENT-DATA-PROTOTYPE>
                    <ARGUMENT-DATA-PROTOTYPE>
                      <SHORT-NAME>resultBuffer</SHORT-NAME>
                      <TYPE-TREF DEST="IMPLEMENTATION-DATA-TYPE">/AUTOSAR_Csm/ImplementationDataTypes/Csm_VerifyResultType</TYPE-TREF>
                      <DIRECTION>OUT</DIRECTION>
                    </ARGUMENT-DATA-PROTOTYPE>
                  </ARGUMENTS>
                  <POSSIBLE-ERROR-REFS>
                    <POSSIBLE-ERROR-REF DEST="APPLICATION-ERROR">/AUTOSAR_Csm/PortInterfaces/CsmMacVerify/CSM_E_NOT_OK</POSSIBLE-ERROR-REF>
                    <POSSIBLE-ERROR-REF DEST="APPLICATION-ERROR">/AUTOSAR_Csm/PortInterfaces/CsmMacVerify/CSM_E_BUSY</POSSIBLE-ERROR-REF>
                  </POSSIBLE-ERROR-REFS>
                </CLIENT-SERVER-OPERATION>
              </OPERATIONS>
              <POSSIBLE-ERRORS>
                <APPLICATION-ERROR>
                  <SHORT-NAME>CSM_E_NOT_OK</SHORT-NAME>
                  <ERROR-CODE>1</ERROR-CODE>
                </APPLICATION-ERROR>
                <APPLICATION-ERROR>
                  <SHORT-NAME>CSM_E_BUSY</SHORT-NAME>
                  <ERROR-CODE>2</ERROR-CODE>
                </APPLICATION-ERROR>
              </POSSIBLE-ERRORS>
            </CLIENT-SERVER-INTERFACE>
[!ENDIF!][!//
[!IF "count(CsmRandomGenerate/CsmRandomGenerateConfig/*[CsmRandomGenerateEnableRteInterface='true']) > 0"!][!//
            <CLIENT-SERVER-INTERFACE>
              <SHORT-NAME>CsmRandomGenerate</SHORT-NAME>
              <IS-SERVICE>true</IS-SERVICE>
              <OPERATIONS>
                <CLIENT-SERVER-OPERATION>
                  <SHORT-NAME>RandomGenerate</SHORT-NAME>
                  <ARGUMENTS>
                    <ARGUMENT-DATA-PROTOTYPE>
                      <SHORT-NAME>resultBuffer</SHORT-NAME>
                      <TYPE-TREF DEST="IMPLEMENTATION-DATA-TYPE">/AUTOSAR_Csm/ImplementationDataTypes/RandomGenerateResultBuffer</TYPE-TREF>
                      <DIRECTION>OUT</DIRECTION>
                    </ARGUMENT-DATA-PROTOTYPE>
                    <ARGUMENT-DATA-PROTOTYPE>
                      <SHORT-NAME>resultLength</SHORT-NAME>
                      <TYPE-TREF DEST="IMPLEMENTATION-DATA-TYPE">/AUTOSAR_Platform/ImplementationDataTypes/uint32</TYPE-TREF>
                      <DIRECTION>IN</DIRECTION>
                    </ARGUMENT-DATA-PROTOTYPE>
                  </ARGUMENTS>
                  <POSSIBLE-ERROR-REFS>
                    <POSSIBLE-ERROR-REF DEST="APPLICATION-ERROR">/AUTOSAR_Csm/PortInterfaces/CsmRandomGenerate/CSM_E_NOT_OK</POSSIBLE-ERROR-REF>
                    <POSSIBLE-ERROR-REF DEST="APPLICATION-ERROR">/AUTOSAR_Csm/PortInterfaces/CsmRandomGenerate/CSM_E_BUSY</POSSIBLE-ERROR-REF>
                    <POSSIBLE-ERROR-REF DEST="APPLICATION-ERROR">/AUTOSAR_Csm/PortInterfaces/CsmRandomGenerate/CSM_E_ENTROPY_EXHAUSTION</POSSIBLE-ERROR-REF>
                  </POSSIBLE-ERROR-REFS>
                </CLIENT-SERVER-OPERATION>
              </OPERATIONS>
              <POSSIBLE-ERRORS>
                <APPLICATION-ERROR>
                  <SHORT-NAME>CSM_E_NOT_OK</SHORT-NAME>
                  <ERROR-CODE>1</ERROR-CODE>
                </APPLICATION-ERROR>
                <APPLICATION-ERROR>
                  <SHORT-NAME>CSM_E_BUSY</SHORT-NAME>
                  <ERROR-CODE>2</ERROR-CODE>
                </APPLICATION-ERROR>
                <APPLICATION-ERROR>
                  <SHORT-NAME>CSM_E_ENTROPY_EXHAUSTION</SHORT-NAME>
                  <ERROR-CODE>4</ERROR-CODE>
                </APPLICATION-ERROR>
              </POSSIBLE-ERRORS>
            </CLIENT-SERVER-INTERFACE>
[!ENDIF!][!//
[!IF "count(CsmRandomSeed/CsmRandomSeedConfig/*[CsmRandomSeedEnableRteInterface='true']) > 0"!][!//
            <!-- !LINKSTO CSM0778, 1 -->
            <CLIENT-SERVER-INTERFACE>
              <SHORT-NAME>CsmRandomSeed</SHORT-NAME>
              <IS-SERVICE>true</IS-SERVICE>
              <OPERATIONS>
                <CLIENT-SERVER-OPERATION>
                  <SHORT-NAME>RandomSeedStart</SHORT-NAME>
                  <ARGUMENTS>
                  </ARGUMENTS>
                  <POSSIBLE-ERROR-REFS>
                    <POSSIBLE-ERROR-REF DEST="APPLICATION-ERROR">/AUTOSAR_Csm/PortInterfaces/CsmRandomSeed/CSM_E_NOT_OK</POSSIBLE-ERROR-REF>
                    <POSSIBLE-ERROR-REF DEST="APPLICATION-ERROR">/AUTOSAR_Csm/PortInterfaces/CsmRandomSeed/CSM_E_BUSY</POSSIBLE-ERROR-REF>
                  </POSSIBLE-ERROR-REFS>
                </CLIENT-SERVER-OPERATION>
                <CLIENT-SERVER-OPERATION>
                  <SHORT-NAME>RandomSeedUpdate</SHORT-NAME>
                  <ARGUMENTS>
                    <ARGUMENT-DATA-PROTOTYPE>
                      <SHORT-NAME>seedBuffer</SHORT-NAME>
                      <TYPE-TREF DEST="IMPLEMENTATION-DATA-TYPE">/AUTOSAR_Csm/ImplementationDataTypes/RandomSeedDataBuffer</TYPE-TREF>
                      <DIRECTION>IN</DIRECTION>
                    </ARGUMENT-DATA-PROTOTYPE>
                    <ARGUMENT-DATA-PROTOTYPE>
                      <SHORT-NAME>seedLength</SHORT-NAME>
                      <TYPE-TREF DEST="IMPLEMENTATION-DATA-TYPE">/AUTOSAR_Platform/ImplementationDataTypes/uint32</TYPE-TREF>
                      <DIRECTION>IN</DIRECTION>
                    </ARGUMENT-DATA-PROTOTYPE>
                  </ARGUMENTS>
                  <POSSIBLE-ERROR-REFS>
                    <POSSIBLE-ERROR-REF DEST="APPLICATION-ERROR">/AUTOSAR_Csm/PortInterfaces/CsmRandomSeed/CSM_E_NOT_OK</POSSIBLE-ERROR-REF>
                    <POSSIBLE-ERROR-REF DEST="APPLICATION-ERROR">/AUTOSAR_Csm/PortInterfaces/CsmRandomSeed/CSM_E_BUSY</POSSIBLE-ERROR-REF>
                  </POSSIBLE-ERROR-REFS>
                </CLIENT-SERVER-OPERATION>
                <CLIENT-SERVER-OPERATION>
                  <SHORT-NAME>RandomSeedFinish</SHORT-NAME>
                  <ARGUMENTS>
                  </ARGUMENTS>
                  <POSSIBLE-ERROR-REFS>
                    <POSSIBLE-ERROR-REF DEST="APPLICATION-ERROR">/AUTOSAR_Csm/PortInterfaces/CsmRandomSeed/CSM_E_NOT_OK</POSSIBLE-ERROR-REF>
                    <POSSIBLE-ERROR-REF DEST="APPLICATION-ERROR">/AUTOSAR_Csm/PortInterfaces/CsmRandomSeed/CSM_E_BUSY</POSSIBLE-ERROR-REF>
                  </POSSIBLE-ERROR-REFS>
                </CLIENT-SERVER-OPERATION>
              </OPERATIONS>
              <POSSIBLE-ERRORS>
                <APPLICATION-ERROR>
                  <SHORT-NAME>CSM_E_NOT_OK</SHORT-NAME>
                  <ERROR-CODE>1</ERROR-CODE>
                </APPLICATION-ERROR>
                <APPLICATION-ERROR>
                  <SHORT-NAME>CSM_E_BUSY</SHORT-NAME>
                  <ERROR-CODE>2</ERROR-CODE>
                </APPLICATION-ERROR>
              </POSSIBLE-ERRORS>
            </CLIENT-SERVER-INTERFACE>
[!ENDIF!][!//
[!IF "count(CsmSignatureGenerate/CsmSignatureGenerateConfig/*[CsmSignatureGenerateEnableRteInterface='true']) > 0"!][!//
            <!-- !LINKSTO EB_CSM0786_01, 1 -->
            <CLIENT-SERVER-INTERFACE>
              <SHORT-NAME>CsmSignatureGenerate</SHORT-NAME>
              <IS-SERVICE>true</IS-SERVICE>
              <OPERATIONS>
                <CLIENT-SERVER-OPERATION>
                  <SHORT-NAME>SignatureGenerateStart</SHORT-NAME>
                  <ARGUMENTS>
                    <ARGUMENT-DATA-PROTOTYPE>
                      <SHORT-NAME>key</SHORT-NAME>
                      <TYPE-TREF DEST="IMPLEMENTATION-DATA-TYPE">/AUTOSAR_Csm/ImplementationDataTypes/AsymPrivateKeyType</TYPE-TREF>
                      <DIRECTION>IN</DIRECTION>
                    </ARGUMENT-DATA-PROTOTYPE>
                  </ARGUMENTS>
                  <POSSIBLE-ERROR-REFS>
                    <POSSIBLE-ERROR-REF DEST="APPLICATION-ERROR">/AUTOSAR_Csm/PortInterfaces/CsmSignatureGenerate/CSM_E_NOT_OK</POSSIBLE-ERROR-REF>
                    <POSSIBLE-ERROR-REF DEST="APPLICATION-ERROR">/AUTOSAR_Csm/PortInterfaces/CsmSignatureGenerate/CSM_E_BUSY</POSSIBLE-ERROR-REF>
                  </POSSIBLE-ERROR-REFS>
                </CLIENT-SERVER-OPERATION>
                <CLIENT-SERVER-OPERATION>
                  <SHORT-NAME>SignatureGenerateUpdate</SHORT-NAME>
                  <ARGUMENTS>
                    <ARGUMENT-DATA-PROTOTYPE>
                      <SHORT-NAME>dataBuffer</SHORT-NAME>
                      <TYPE-TREF DEST="IMPLEMENTATION-DATA-TYPE">/AUTOSAR_Csm/ImplementationDataTypes/SignatureGenerateDataBuffer</TYPE-TREF>
                      <DIRECTION>IN</DIRECTION>
                    </ARGUMENT-DATA-PROTOTYPE>
                    <ARGUMENT-DATA-PROTOTYPE>
                      <SHORT-NAME>dataLength</SHORT-NAME>
                      <TYPE-TREF DEST="IMPLEMENTATION-DATA-TYPE">/AUTOSAR_Platform/ImplementationDataTypes/uint32</TYPE-TREF>
                      <DIRECTION>IN</DIRECTION>
                    </ARGUMENT-DATA-PROTOTYPE>
                  </ARGUMENTS>
                  <POSSIBLE-ERROR-REFS>
                    <POSSIBLE-ERROR-REF DEST="APPLICATION-ERROR">/AUTOSAR_Csm/PortInterfaces/CsmSignatureGenerate/CSM_E_NOT_OK</POSSIBLE-ERROR-REF>
                    <POSSIBLE-ERROR-REF DEST="APPLICATION-ERROR">/AUTOSAR_Csm/PortInterfaces/CsmSignatureGenerate/CSM_E_BUSY</POSSIBLE-ERROR-REF>
                  </POSSIBLE-ERROR-REFS>
                </CLIENT-SERVER-OPERATION>
                <CLIENT-SERVER-OPERATION>
                  <SHORT-NAME>SignatureGenerateFinish</SHORT-NAME>
                  <ARGUMENTS>
                    <ARGUMENT-DATA-PROTOTYPE>
                      <SHORT-NAME>resultBuffer</SHORT-NAME>
                      <TYPE-TREF DEST="IMPLEMENTATION-DATA-TYPE">/AUTOSAR_Csm/ImplementationDataTypes/SignatureGenerateResultBuffer</TYPE-TREF>
                      <DIRECTION>OUT</DIRECTION>
                    </ARGUMENT-DATA-PROTOTYPE>
                    <ARGUMENT-DATA-PROTOTYPE>
                      <SHORT-NAME>resultLength</SHORT-NAME>
                      <TYPE-TREF DEST="IMPLEMENTATION-DATA-TYPE">/AUTOSAR_Platform/ImplementationDataTypes/uint32</TYPE-TREF>
                      <DIRECTION>INOUT</DIRECTION>
                    </ARGUMENT-DATA-PROTOTYPE>
                  </ARGUMENTS>
                  <POSSIBLE-ERROR-REFS>
                    <POSSIBLE-ERROR-REF DEST="APPLICATION-ERROR">/AUTOSAR_Csm/PortInterfaces/CsmSignatureGenerate/CSM_E_NOT_OK</POSSIBLE-ERROR-REF>
                    <POSSIBLE-ERROR-REF DEST="APPLICATION-ERROR">/AUTOSAR_Csm/PortInterfaces/CsmSignatureGenerate/CSM_E_BUSY</POSSIBLE-ERROR-REF>
                    <POSSIBLE-ERROR-REF DEST="APPLICATION-ERROR">/AUTOSAR_Csm/PortInterfaces/CsmSignatureGenerate/CSM_E_SMALL_BUFFER</POSSIBLE-ERROR-REF>
                  </POSSIBLE-ERROR-REFS>
                </CLIENT-SERVER-OPERATION>
              </OPERATIONS>
              <POSSIBLE-ERRORS>
                <APPLICATION-ERROR>
                  <SHORT-NAME>CSM_E_NOT_OK</SHORT-NAME>
                  <ERROR-CODE>1</ERROR-CODE>
                </APPLICATION-ERROR>
                <APPLICATION-ERROR>
                  <SHORT-NAME>CSM_E_BUSY</SHORT-NAME>
                  <ERROR-CODE>2</ERROR-CODE>
                </APPLICATION-ERROR>
                <APPLICATION-ERROR>
                  <SHORT-NAME>CSM_E_SMALL_BUFFER</SHORT-NAME>
                  <ERROR-CODE>3</ERROR-CODE>
                </APPLICATION-ERROR>
              </POSSIBLE-ERRORS>
            </CLIENT-SERVER-INTERFACE>
[!ENDIF!][!//
[!IF "count(CsmSignatureVerify/CsmSignatureVerifyConfig/*[CsmSignatureVerifyEnableRteInterface='true']) > 0"!][!//
            <!-- !LINKSTO EB_CSM0787_01, 1 -->
            <CLIENT-SERVER-INTERFACE>
              <SHORT-NAME>CsmSignatureVerify</SHORT-NAME>
              <IS-SERVICE>true</IS-SERVICE>
              <OPERATIONS>
                <CLIENT-SERVER-OPERATION>
                  <SHORT-NAME>SignatureVerifyStart</SHORT-NAME>
                  <ARGUMENTS>
                    <ARGUMENT-DATA-PROTOTYPE>
                      <SHORT-NAME>key</SHORT-NAME>
                      <TYPE-TREF DEST="IMPLEMENTATION-DATA-TYPE">/AUTOSAR_Csm/ImplementationDataTypes/AsymPublicKeyType</TYPE-TREF>
                      <DIRECTION>IN</DIRECTION>
                    </ARGUMENT-DATA-PROTOTYPE>
                  </ARGUMENTS>
                  <POSSIBLE-ERROR-REFS>
                    <POSSIBLE-ERROR-REF DEST="APPLICATION-ERROR">/AUTOSAR_Csm/PortInterfaces/CsmSignatureVerify/CSM_E_NOT_OK</POSSIBLE-ERROR-REF>
                    <POSSIBLE-ERROR-REF DEST="APPLICATION-ERROR">/AUTOSAR_Csm/PortInterfaces/CsmSignatureVerify/CSM_E_BUSY</POSSIBLE-ERROR-REF>
                  </POSSIBLE-ERROR-REFS>
                </CLIENT-SERVER-OPERATION>
                <CLIENT-SERVER-OPERATION>
                  <SHORT-NAME>SignatureVerifyUpdate</SHORT-NAME>
                  <ARGUMENTS>
                    <ARGUMENT-DATA-PROTOTYPE>
                      <SHORT-NAME>dataBuffer</SHORT-NAME>
                      <TYPE-TREF DEST="IMPLEMENTATION-DATA-TYPE">/AUTOSAR_Csm/ImplementationDataTypes/SignatureVerifyDataBuffer</TYPE-TREF>
                      <DIRECTION>IN</DIRECTION>
                    </ARGUMENT-DATA-PROTOTYPE>
                    <ARGUMENT-DATA-PROTOTYPE>
                      <SHORT-NAME>dataLength</SHORT-NAME>
                      <TYPE-TREF DEST="IMPLEMENTATION-DATA-TYPE">/AUTOSAR_Platform/ImplementationDataTypes/uint32</TYPE-TREF>
                      <DIRECTION>IN</DIRECTION>
                    </ARGUMENT-DATA-PROTOTYPE>
                  </ARGUMENTS>
                  <POSSIBLE-ERROR-REFS>
                    <POSSIBLE-ERROR-REF DEST="APPLICATION-ERROR">/AUTOSAR_Csm/PortInterfaces/CsmSignatureVerify/CSM_E_NOT_OK</POSSIBLE-ERROR-REF>
                    <POSSIBLE-ERROR-REF DEST="APPLICATION-ERROR">/AUTOSAR_Csm/PortInterfaces/CsmSignatureVerify/CSM_E_BUSY</POSSIBLE-ERROR-REF>
                  </POSSIBLE-ERROR-REFS>
                </CLIENT-SERVER-OPERATION>
                <CLIENT-SERVER-OPERATION>
                  <SHORT-NAME>SignatureVerifyFinish</SHORT-NAME>
                  <ARGUMENTS>
                    <ARGUMENT-DATA-PROTOTYPE>
                      <SHORT-NAME>signatureBuffer</SHORT-NAME>
                      <TYPE-TREF DEST="IMPLEMENTATION-DATA-TYPE">/AUTOSAR_Csm/ImplementationDataTypes/SignatureVerifyCompareSignatureBuffer</TYPE-TREF>
                      <DIRECTION>IN</DIRECTION>
                    </ARGUMENT-DATA-PROTOTYPE>
                    <ARGUMENT-DATA-PROTOTYPE>
                      <SHORT-NAME>signatureLength</SHORT-NAME>
                      <TYPE-TREF DEST="IMPLEMENTATION-DATA-TYPE">/AUTOSAR_Platform/ImplementationDataTypes/uint32</TYPE-TREF>
                      <DIRECTION>IN</DIRECTION>
                    </ARGUMENT-DATA-PROTOTYPE>
                    <ARGUMENT-DATA-PROTOTYPE>
                      <SHORT-NAME>resultBuffer</SHORT-NAME>
                      <TYPE-TREF DEST="IMPLEMENTATION-DATA-TYPE">/AUTOSAR_Csm/ImplementationDataTypes/Csm_VerifyResultType</TYPE-TREF>
                      <DIRECTION>OUT</DIRECTION>
                    </ARGUMENT-DATA-PROTOTYPE>
                  </ARGUMENTS>
                  <POSSIBLE-ERROR-REFS>
                    <POSSIBLE-ERROR-REF DEST="APPLICATION-ERROR">/AUTOSAR_Csm/PortInterfaces/CsmSignatureVerify/CSM_E_NOT_OK</POSSIBLE-ERROR-REF>
                    <POSSIBLE-ERROR-REF DEST="APPLICATION-ERROR">/AUTOSAR_Csm/PortInterfaces/CsmSignatureVerify/CSM_E_BUSY</POSSIBLE-ERROR-REF>
                  </POSSIBLE-ERROR-REFS>
                </CLIENT-SERVER-OPERATION>
              </OPERATIONS>
              <POSSIBLE-ERRORS>
                <APPLICATION-ERROR>
                  <SHORT-NAME>CSM_E_NOT_OK</SHORT-NAME>
                  <ERROR-CODE>1</ERROR-CODE>
                </APPLICATION-ERROR>
                <APPLICATION-ERROR>
                  <SHORT-NAME>CSM_E_BUSY</SHORT-NAME>
                  <ERROR-CODE>2</ERROR-CODE>
                </APPLICATION-ERROR>
              </POSSIBLE-ERRORS>
            </CLIENT-SERVER-INTERFACE>
[!ENDIF!][!//
[!IF "count(CsmSymBlockEncrypt/CsmSymBlockEncryptConfig/*[CsmSymBlockEncryptEnableRteInterface='true']) > 0"!][!//
            <!-- !LINKSTO EB_CSM0780_01, 1 -->
            <CLIENT-SERVER-INTERFACE>
              <SHORT-NAME>CsmSymBlockEncrypt</SHORT-NAME>
              <IS-SERVICE>true</IS-SERVICE>
              <OPERATIONS>
                <CLIENT-SERVER-OPERATION>
                  <SHORT-NAME>SymBlockEncryptStart</SHORT-NAME>
                  <ARGUMENTS>
                    <ARGUMENT-DATA-PROTOTYPE>
                      <SHORT-NAME>key</SHORT-NAME>
                      <TYPE-TREF DEST="IMPLEMENTATION-DATA-TYPE">/AUTOSAR_Csm/ImplementationDataTypes/SymKeyType</TYPE-TREF>
                      <DIRECTION>IN</DIRECTION>
                    </ARGUMENT-DATA-PROTOTYPE>
                  </ARGUMENTS>
                  <POSSIBLE-ERROR-REFS>
                    <POSSIBLE-ERROR-REF DEST="APPLICATION-ERROR">/AUTOSAR_Csm/PortInterfaces/CsmSymBlockEncrypt/CSM_E_NOT_OK</POSSIBLE-ERROR-REF>
                    <POSSIBLE-ERROR-REF DEST="APPLICATION-ERROR">/AUTOSAR_Csm/PortInterfaces/CsmSymBlockEncrypt/CSM_E_BUSY</POSSIBLE-ERROR-REF>
                  </POSSIBLE-ERROR-REFS>
                </CLIENT-SERVER-OPERATION>
                <CLIENT-SERVER-OPERATION>
                  <SHORT-NAME>SymBlockEncryptUpdate</SHORT-NAME>
                  <ARGUMENTS>
                    <ARGUMENT-DATA-PROTOTYPE>
                      <SHORT-NAME>plainTextBuffer</SHORT-NAME>
                      <TYPE-TREF DEST="IMPLEMENTATION-DATA-TYPE">/AUTOSAR_Csm/ImplementationDataTypes/SymBlockEncryptDataBuffer</TYPE-TREF>
                      <DIRECTION>IN</DIRECTION>
                    </ARGUMENT-DATA-PROTOTYPE>
                    <ARGUMENT-DATA-PROTOTYPE>
                      <SHORT-NAME>plainTextLength</SHORT-NAME>
                      <TYPE-TREF DEST="IMPLEMENTATION-DATA-TYPE">/AUTOSAR_Platform/ImplementationDataTypes/uint32</TYPE-TREF>
                      <DIRECTION>IN</DIRECTION>
                    </ARGUMENT-DATA-PROTOTYPE>
                    <ARGUMENT-DATA-PROTOTYPE>
                      <SHORT-NAME>cipherTextBuffer</SHORT-NAME>
                      <TYPE-TREF DEST="IMPLEMENTATION-DATA-TYPE">/AUTOSAR_Csm/ImplementationDataTypes/SymBlockEncryptResultBuffer</TYPE-TREF>
                      <DIRECTION>OUT</DIRECTION>
                    </ARGUMENT-DATA-PROTOTYPE>
                    <ARGUMENT-DATA-PROTOTYPE>
                      <SHORT-NAME>cipherTextLength</SHORT-NAME>
                      <TYPE-TREF DEST="IMPLEMENTATION-DATA-TYPE">/AUTOSAR_Platform/ImplementationDataTypes/uint32</TYPE-TREF>
                      <DIRECTION>INOUT</DIRECTION>
                    </ARGUMENT-DATA-PROTOTYPE>
                  </ARGUMENTS>
                  <POSSIBLE-ERROR-REFS>
                    <POSSIBLE-ERROR-REF DEST="APPLICATION-ERROR">/AUTOSAR_Csm/PortInterfaces/CsmSymBlockEncrypt/CSM_E_NOT_OK</POSSIBLE-ERROR-REF>
                    <POSSIBLE-ERROR-REF DEST="APPLICATION-ERROR">/AUTOSAR_Csm/PortInterfaces/CsmSymBlockEncrypt/CSM_E_BUSY</POSSIBLE-ERROR-REF>
                    <POSSIBLE-ERROR-REF DEST="APPLICATION-ERROR">/AUTOSAR_Csm/PortInterfaces/CsmSymBlockEncrypt/CSM_E_SMALL_BUFFER</POSSIBLE-ERROR-REF>
                  </POSSIBLE-ERROR-REFS>
                </CLIENT-SERVER-OPERATION>
                <CLIENT-SERVER-OPERATION>
                  <SHORT-NAME>SymBlockEncryptFinish</SHORT-NAME>
                  <ARGUMENTS>
                  </ARGUMENTS>
                  <POSSIBLE-ERROR-REFS>
                    <POSSIBLE-ERROR-REF DEST="APPLICATION-ERROR">/AUTOSAR_Csm/PortInterfaces/CsmSymBlockEncrypt/CSM_E_NOT_OK</POSSIBLE-ERROR-REF>
                    <POSSIBLE-ERROR-REF DEST="APPLICATION-ERROR">/AUTOSAR_Csm/PortInterfaces/CsmSymBlockEncrypt/CSM_E_BUSY</POSSIBLE-ERROR-REF>
                  </POSSIBLE-ERROR-REFS>
                </CLIENT-SERVER-OPERATION>
              </OPERATIONS>
              <POSSIBLE-ERRORS>
                <APPLICATION-ERROR>
                  <SHORT-NAME>CSM_E_NOT_OK</SHORT-NAME>
                  <ERROR-CODE>1</ERROR-CODE>
                </APPLICATION-ERROR>
                <APPLICATION-ERROR>
                  <SHORT-NAME>CSM_E_BUSY</SHORT-NAME>
                  <ERROR-CODE>2</ERROR-CODE>
                </APPLICATION-ERROR>
                <APPLICATION-ERROR>
                  <SHORT-NAME>CSM_E_SMALL_BUFFER</SHORT-NAME>
                  <ERROR-CODE>3</ERROR-CODE>
                </APPLICATION-ERROR>
              </POSSIBLE-ERRORS>
            </CLIENT-SERVER-INTERFACE>
[!ENDIF!][!//
[!IF "count(CsmSymBlockDecrypt/CsmSymBlockDecryptConfig/*[CsmSymBlockDecryptEnableRteInterface='true']) > 0"!][!//
            <!-- !LINKSTO EB_CSM0781_01, 1 -->
            <CLIENT-SERVER-INTERFACE>
              <SHORT-NAME>CsmSymBlockDecrypt</SHORT-NAME>
              <IS-SERVICE>true</IS-SERVICE>
              <OPERATIONS>
                <CLIENT-SERVER-OPERATION>
                  <SHORT-NAME>SymBlockDecryptStart</SHORT-NAME>
                  <ARGUMENTS>
                    <ARGUMENT-DATA-PROTOTYPE>
                      <SHORT-NAME>key</SHORT-NAME>
                      <TYPE-TREF DEST="IMPLEMENTATION-DATA-TYPE">/AUTOSAR_Csm/ImplementationDataTypes/SymKeyType</TYPE-TREF>
                      <DIRECTION>IN</DIRECTION>
                    </ARGUMENT-DATA-PROTOTYPE>
                  </ARGUMENTS>
                  <POSSIBLE-ERROR-REFS>
                    <POSSIBLE-ERROR-REF DEST="APPLICATION-ERROR">/AUTOSAR_Csm/PortInterfaces/CsmSymBlockDecrypt/CSM_E_NOT_OK</POSSIBLE-ERROR-REF>
                    <POSSIBLE-ERROR-REF DEST="APPLICATION-ERROR">/AUTOSAR_Csm/PortInterfaces/CsmSymBlockDecrypt/CSM_E_BUSY</POSSIBLE-ERROR-REF>
                  </POSSIBLE-ERROR-REFS>
                </CLIENT-SERVER-OPERATION>
                <CLIENT-SERVER-OPERATION>
                  <SHORT-NAME>SymBlockDecryptUpdate</SHORT-NAME>
                  <ARGUMENTS>
                    <ARGUMENT-DATA-PROTOTYPE>
                      <SHORT-NAME>cipherTextBuffer</SHORT-NAME>
                      <TYPE-TREF DEST="IMPLEMENTATION-DATA-TYPE">/AUTOSAR_Csm/ImplementationDataTypes/SymBlockDecryptDataBuffer</TYPE-TREF>
                      <DIRECTION>IN</DIRECTION>
                    </ARGUMENT-DATA-PROTOTYPE>
                    <ARGUMENT-DATA-PROTOTYPE>
                      <SHORT-NAME>cipherTextLength</SHORT-NAME>
                      <TYPE-TREF DEST="IMPLEMENTATION-DATA-TYPE">/AUTOSAR_Platform/ImplementationDataTypes/uint32</TYPE-TREF>
                      <DIRECTION>IN</DIRECTION>
                    </ARGUMENT-DATA-PROTOTYPE>
                    <ARGUMENT-DATA-PROTOTYPE>
                      <SHORT-NAME>plainTextBuffer</SHORT-NAME>
                      <TYPE-TREF DEST="IMPLEMENTATION-DATA-TYPE">/AUTOSAR_Csm/ImplementationDataTypes/SymBlockDecryptResultBuffer</TYPE-TREF>
                      <DIRECTION>OUT</DIRECTION>
                    </ARGUMENT-DATA-PROTOTYPE>
                    <ARGUMENT-DATA-PROTOTYPE>
                      <SHORT-NAME>plainTextLength</SHORT-NAME>
                      <TYPE-TREF DEST="IMPLEMENTATION-DATA-TYPE">/AUTOSAR_Platform/ImplementationDataTypes/uint32</TYPE-TREF>
                      <DIRECTION>INOUT</DIRECTION>
                    </ARGUMENT-DATA-PROTOTYPE>
                  </ARGUMENTS>
                  <POSSIBLE-ERROR-REFS>
                    <POSSIBLE-ERROR-REF DEST="APPLICATION-ERROR">/AUTOSAR_Csm/PortInterfaces/CsmSymBlockDecrypt/CSM_E_NOT_OK</POSSIBLE-ERROR-REF>
                    <POSSIBLE-ERROR-REF DEST="APPLICATION-ERROR">/AUTOSAR_Csm/PortInterfaces/CsmSymBlockDecrypt/CSM_E_BUSY</POSSIBLE-ERROR-REF>
                    <POSSIBLE-ERROR-REF DEST="APPLICATION-ERROR">/AUTOSAR_Csm/PortInterfaces/CsmSymBlockDecrypt/CSM_E_SMALL_BUFFER</POSSIBLE-ERROR-REF>
                  </POSSIBLE-ERROR-REFS>
                </CLIENT-SERVER-OPERATION>
                <CLIENT-SERVER-OPERATION>
                  <SHORT-NAME>SymBlockDecryptFinish</SHORT-NAME>
                  <ARGUMENTS>
                  </ARGUMENTS>
                  <POSSIBLE-ERROR-REFS>
                    <POSSIBLE-ERROR-REF DEST="APPLICATION-ERROR">/AUTOSAR_Csm/PortInterfaces/CsmSymBlockDecrypt/CSM_E_NOT_OK</POSSIBLE-ERROR-REF>
                    <POSSIBLE-ERROR-REF DEST="APPLICATION-ERROR">/AUTOSAR_Csm/PortInterfaces/CsmSymBlockDecrypt/CSM_E_BUSY</POSSIBLE-ERROR-REF>
                  </POSSIBLE-ERROR-REFS>
                </CLIENT-SERVER-OPERATION>
              </OPERATIONS>
              <POSSIBLE-ERRORS>
                <APPLICATION-ERROR>
                  <SHORT-NAME>CSM_E_NOT_OK</SHORT-NAME>
                  <ERROR-CODE>1</ERROR-CODE>
                </APPLICATION-ERROR>
                <APPLICATION-ERROR>
                  <SHORT-NAME>CSM_E_BUSY</SHORT-NAME>
                  <ERROR-CODE>2</ERROR-CODE>
                </APPLICATION-ERROR>
                <APPLICATION-ERROR>
                  <SHORT-NAME>CSM_E_SMALL_BUFFER</SHORT-NAME>
                  <ERROR-CODE>3</ERROR-CODE>
                </APPLICATION-ERROR>
              </POSSIBLE-ERRORS>
            </CLIENT-SERVER-INTERFACE>
[!ENDIF!][!//
[!IF "count(CsmSymEncrypt/CsmSymEncryptConfig/*[CsmSymEncryptEnableRteInterface='true']) > 0"!][!//
            <!-- !LINKSTO EB_CSM0782_01, 1 -->
            <CLIENT-SERVER-INTERFACE>
              <SHORT-NAME>CsmSymEncrypt</SHORT-NAME>
              <IS-SERVICE>true</IS-SERVICE>
              <OPERATIONS>
                <CLIENT-SERVER-OPERATION>
                  <SHORT-NAME>SymEncryptStart</SHORT-NAME>
                  <ARGUMENTS>
                    <ARGUMENT-DATA-PROTOTYPE>
                      <SHORT-NAME>key</SHORT-NAME>
                      <TYPE-TREF DEST="IMPLEMENTATION-DATA-TYPE">/AUTOSAR_Csm/ImplementationDataTypes/SymKeyType</TYPE-TREF>
                      <DIRECTION>IN</DIRECTION>
                    </ARGUMENT-DATA-PROTOTYPE>
                    <ARGUMENT-DATA-PROTOTYPE>
                      <SHORT-NAME>InitVectorBuffer</SHORT-NAME>
                      <TYPE-TREF DEST="IMPLEMENTATION-DATA-TYPE">/AUTOSAR_Csm/ImplementationDataTypes/SymEncryptInitVectorBuffer</TYPE-TREF>
                      <DIRECTION>IN</DIRECTION>
                    </ARGUMENT-DATA-PROTOTYPE>
                    <ARGUMENT-DATA-PROTOTYPE>
                      <SHORT-NAME>InitVectorLength</SHORT-NAME>
                      <TYPE-TREF DEST="IMPLEMENTATION-DATA-TYPE">/AUTOSAR_Platform/ImplementationDataTypes/uint32</TYPE-TREF>
                      <DIRECTION>IN</DIRECTION>
                    </ARGUMENT-DATA-PROTOTYPE>
                  </ARGUMENTS>
                  <POSSIBLE-ERROR-REFS>
                    <POSSIBLE-ERROR-REF DEST="APPLICATION-ERROR">/AUTOSAR_Csm/PortInterfaces/CsmSymEncrypt/CSM_E_NOT_OK</POSSIBLE-ERROR-REF>
                    <POSSIBLE-ERROR-REF DEST="APPLICATION-ERROR">/AUTOSAR_Csm/PortInterfaces/CsmSymEncrypt/CSM_E_BUSY</POSSIBLE-ERROR-REF>
                  </POSSIBLE-ERROR-REFS>
                </CLIENT-SERVER-OPERATION>
                <CLIENT-SERVER-OPERATION>
                  <SHORT-NAME>SymEncryptUpdate</SHORT-NAME>
                  <ARGUMENTS>
                    <ARGUMENT-DATA-PROTOTYPE>
                      <SHORT-NAME>plainTextBuffer</SHORT-NAME>
                      <TYPE-TREF DEST="IMPLEMENTATION-DATA-TYPE">/AUTOSAR_Csm/ImplementationDataTypes/SymEncryptDataBuffer</TYPE-TREF>
                      <DIRECTION>IN</DIRECTION>
                    </ARGUMENT-DATA-PROTOTYPE>
                    <ARGUMENT-DATA-PROTOTYPE>
                      <SHORT-NAME>plainTextLength</SHORT-NAME>
                      <TYPE-TREF DEST="IMPLEMENTATION-DATA-TYPE">/AUTOSAR_Platform/ImplementationDataTypes/uint32</TYPE-TREF>
                      <DIRECTION>IN</DIRECTION>
                    </ARGUMENT-DATA-PROTOTYPE>
                    <ARGUMENT-DATA-PROTOTYPE>
                      <SHORT-NAME>cipherTextBuffer</SHORT-NAME>
                      <TYPE-TREF DEST="IMPLEMENTATION-DATA-TYPE">/AUTOSAR_Csm/ImplementationDataTypes/SymEncryptResultBuffer</TYPE-TREF>
                      <DIRECTION>OUT</DIRECTION>
                    </ARGUMENT-DATA-PROTOTYPE>
                    <ARGUMENT-DATA-PROTOTYPE>
                      <SHORT-NAME>cipherTextLength</SHORT-NAME>
                      <TYPE-TREF DEST="IMPLEMENTATION-DATA-TYPE">/AUTOSAR_Platform/ImplementationDataTypes/uint32</TYPE-TREF>
                      <DIRECTION>INOUT</DIRECTION>
                    </ARGUMENT-DATA-PROTOTYPE>
                  </ARGUMENTS>
                  <POSSIBLE-ERROR-REFS>
                    <POSSIBLE-ERROR-REF DEST="APPLICATION-ERROR">/AUTOSAR_Csm/PortInterfaces/CsmSymEncrypt/CSM_E_NOT_OK</POSSIBLE-ERROR-REF>
                    <POSSIBLE-ERROR-REF DEST="APPLICATION-ERROR">/AUTOSAR_Csm/PortInterfaces/CsmSymEncrypt/CSM_E_BUSY</POSSIBLE-ERROR-REF>
                    <POSSIBLE-ERROR-REF DEST="APPLICATION-ERROR">/AUTOSAR_Csm/PortInterfaces/CsmSymEncrypt/CSM_E_SMALL_BUFFER</POSSIBLE-ERROR-REF>
                  </POSSIBLE-ERROR-REFS>
                </CLIENT-SERVER-OPERATION>
                <CLIENT-SERVER-OPERATION>
                  <SHORT-NAME>SymEncryptFinish</SHORT-NAME>
                  <ARGUMENTS>
                    <ARGUMENT-DATA-PROTOTYPE>
                      <SHORT-NAME>cipherTextBuffer</SHORT-NAME>
                      <TYPE-TREF DEST="IMPLEMENTATION-DATA-TYPE">/AUTOSAR_Csm/ImplementationDataTypes/SymEncryptResultBuffer</TYPE-TREF>
                      <DIRECTION>OUT</DIRECTION>
                    </ARGUMENT-DATA-PROTOTYPE>
                    <ARGUMENT-DATA-PROTOTYPE>
                      <SHORT-NAME>cipherTextLength</SHORT-NAME>
                      <TYPE-TREF DEST="IMPLEMENTATION-DATA-TYPE">/AUTOSAR_Platform/ImplementationDataTypes/uint32</TYPE-TREF>
                      <DIRECTION>INOUT</DIRECTION>
                    </ARGUMENT-DATA-PROTOTYPE>
                  </ARGUMENTS>
                  <POSSIBLE-ERROR-REFS>
                    <POSSIBLE-ERROR-REF DEST="APPLICATION-ERROR">/AUTOSAR_Csm/PortInterfaces/CsmSymEncrypt/CSM_E_NOT_OK</POSSIBLE-ERROR-REF>
                    <POSSIBLE-ERROR-REF DEST="APPLICATION-ERROR">/AUTOSAR_Csm/PortInterfaces/CsmSymEncrypt/CSM_E_BUSY</POSSIBLE-ERROR-REF>
                    <POSSIBLE-ERROR-REF DEST="APPLICATION-ERROR">/AUTOSAR_Csm/PortInterfaces/CsmSymEncrypt/CSM_E_SMALL_BUFFER</POSSIBLE-ERROR-REF>
                  </POSSIBLE-ERROR-REFS>
                </CLIENT-SERVER-OPERATION>
              </OPERATIONS>
              <POSSIBLE-ERRORS>
                <APPLICATION-ERROR>
                  <SHORT-NAME>CSM_E_NOT_OK</SHORT-NAME>
                  <ERROR-CODE>1</ERROR-CODE>
                </APPLICATION-ERROR>
                <APPLICATION-ERROR>
                  <SHORT-NAME>CSM_E_BUSY</SHORT-NAME>
                  <ERROR-CODE>2</ERROR-CODE>
                </APPLICATION-ERROR>
                <APPLICATION-ERROR>
                  <SHORT-NAME>CSM_E_SMALL_BUFFER</SHORT-NAME>
                  <ERROR-CODE>3</ERROR-CODE>
                </APPLICATION-ERROR>
              </POSSIBLE-ERRORS>
            </CLIENT-SERVER-INTERFACE>
[!ENDIF!][!//
[!IF "count(CsmSymDecrypt/CsmSymDecryptConfig/*[CsmSymDecryptEnableRteInterface='true']) > 0"!][!//
            <!-- !LINKSTO EB_CSM0783_01, 1 -->
            <CLIENT-SERVER-INTERFACE>
              <SHORT-NAME>CsmSymDecrypt</SHORT-NAME>
              <IS-SERVICE>true</IS-SERVICE>
              <OPERATIONS>
                <CLIENT-SERVER-OPERATION>
                  <SHORT-NAME>SymDecryptStart</SHORT-NAME>
                  <ARGUMENTS>
                    <ARGUMENT-DATA-PROTOTYPE>
                      <SHORT-NAME>key</SHORT-NAME>
                      <TYPE-TREF DEST="IMPLEMENTATION-DATA-TYPE">/AUTOSAR_Csm/ImplementationDataTypes/SymKeyType</TYPE-TREF>
                      <DIRECTION>IN</DIRECTION>
                    </ARGUMENT-DATA-PROTOTYPE>
                    <ARGUMENT-DATA-PROTOTYPE>
                      <SHORT-NAME>InitVectorBuffer</SHORT-NAME>
                      <TYPE-TREF DEST="IMPLEMENTATION-DATA-TYPE">/AUTOSAR_Csm/ImplementationDataTypes/SymDecryptInitVectorBuffer</TYPE-TREF>
                      <DIRECTION>IN</DIRECTION>
                    </ARGUMENT-DATA-PROTOTYPE>
                    <ARGUMENT-DATA-PROTOTYPE>
                      <SHORT-NAME>InitVectorLength</SHORT-NAME>
                      <TYPE-TREF DEST="IMPLEMENTATION-DATA-TYPE">/AUTOSAR_Platform/ImplementationDataTypes/uint32</TYPE-TREF>
                      <DIRECTION>IN</DIRECTION>
                    </ARGUMENT-DATA-PROTOTYPE>
                  </ARGUMENTS>
                  <POSSIBLE-ERROR-REFS>
                    <POSSIBLE-ERROR-REF DEST="APPLICATION-ERROR">/AUTOSAR_Csm/PortInterfaces/CsmSymDecrypt/CSM_E_NOT_OK</POSSIBLE-ERROR-REF>
                    <POSSIBLE-ERROR-REF DEST="APPLICATION-ERROR">/AUTOSAR_Csm/PortInterfaces/CsmSymDecrypt/CSM_E_BUSY</POSSIBLE-ERROR-REF>
                  </POSSIBLE-ERROR-REFS>
                </CLIENT-SERVER-OPERATION>
                <CLIENT-SERVER-OPERATION>
                  <SHORT-NAME>SymDecryptUpdate</SHORT-NAME>
                  <ARGUMENTS>
                    <ARGUMENT-DATA-PROTOTYPE>
                      <SHORT-NAME>cipherTextBuffer</SHORT-NAME>
                      <TYPE-TREF DEST="IMPLEMENTATION-DATA-TYPE">/AUTOSAR_Csm/ImplementationDataTypes/SymDecryptDataBuffer</TYPE-TREF>
                      <DIRECTION>IN</DIRECTION>
                    </ARGUMENT-DATA-PROTOTYPE>
                    <ARGUMENT-DATA-PROTOTYPE>
                      <SHORT-NAME>cipherTextLength</SHORT-NAME>
                      <TYPE-TREF DEST="IMPLEMENTATION-DATA-TYPE">/AUTOSAR_Platform/ImplementationDataTypes/uint32</TYPE-TREF>
                      <DIRECTION>IN</DIRECTION>
                    </ARGUMENT-DATA-PROTOTYPE>
                    <ARGUMENT-DATA-PROTOTYPE>
                      <SHORT-NAME>plainTextBuffer</SHORT-NAME>
                      <TYPE-TREF DEST="IMPLEMENTATION-DATA-TYPE">/AUTOSAR_Csm/ImplementationDataTypes/SymDecryptResultBuffer</TYPE-TREF>
                      <DIRECTION>OUT</DIRECTION>
                    </ARGUMENT-DATA-PROTOTYPE>
                    <ARGUMENT-DATA-PROTOTYPE>
                      <SHORT-NAME>plainTextLength</SHORT-NAME>
                      <TYPE-TREF DEST="IMPLEMENTATION-DATA-TYPE">/AUTOSAR_Platform/ImplementationDataTypes/uint32</TYPE-TREF>
                      <DIRECTION>INOUT</DIRECTION>
                    </ARGUMENT-DATA-PROTOTYPE>
                  </ARGUMENTS>
                  <POSSIBLE-ERROR-REFS>
                    <POSSIBLE-ERROR-REF DEST="APPLICATION-ERROR">/AUTOSAR_Csm/PortInterfaces/CsmSymDecrypt/CSM_E_NOT_OK</POSSIBLE-ERROR-REF>
                    <POSSIBLE-ERROR-REF DEST="APPLICATION-ERROR">/AUTOSAR_Csm/PortInterfaces/CsmSymDecrypt/CSM_E_BUSY</POSSIBLE-ERROR-REF>
                    <POSSIBLE-ERROR-REF DEST="APPLICATION-ERROR">/AUTOSAR_Csm/PortInterfaces/CsmSymDecrypt/CSM_E_SMALL_BUFFER</POSSIBLE-ERROR-REF>
                  </POSSIBLE-ERROR-REFS>
                </CLIENT-SERVER-OPERATION>
                <CLIENT-SERVER-OPERATION>
                  <SHORT-NAME>SymDecryptFinish</SHORT-NAME>
                  <ARGUMENTS>
                    <ARGUMENT-DATA-PROTOTYPE>
                      <SHORT-NAME>plainTextBuffer</SHORT-NAME>
                      <TYPE-TREF DEST="IMPLEMENTATION-DATA-TYPE">/AUTOSAR_Csm/ImplementationDataTypes/SymDecryptResultBuffer</TYPE-TREF>
                      <DIRECTION>OUT</DIRECTION>
                    </ARGUMENT-DATA-PROTOTYPE>
                    <ARGUMENT-DATA-PROTOTYPE>
                      <SHORT-NAME>plainTextLength</SHORT-NAME>
                      <TYPE-TREF DEST="IMPLEMENTATION-DATA-TYPE">/AUTOSAR_Platform/ImplementationDataTypes/uint32</TYPE-TREF>
                      <DIRECTION>INOUT</DIRECTION>
                    </ARGUMENT-DATA-PROTOTYPE>
                  </ARGUMENTS>
                  <POSSIBLE-ERROR-REFS>
                    <POSSIBLE-ERROR-REF DEST="APPLICATION-ERROR">/AUTOSAR_Csm/PortInterfaces/CsmSymDecrypt/CSM_E_NOT_OK</POSSIBLE-ERROR-REF>
                    <POSSIBLE-ERROR-REF DEST="APPLICATION-ERROR">/AUTOSAR_Csm/PortInterfaces/CsmSymDecrypt/CSM_E_BUSY</POSSIBLE-ERROR-REF>
                    <POSSIBLE-ERROR-REF DEST="APPLICATION-ERROR">/AUTOSAR_Csm/PortInterfaces/CsmSymDecrypt/CSM_E_SMALL_BUFFER</POSSIBLE-ERROR-REF>
                  </POSSIBLE-ERROR-REFS>
                </CLIENT-SERVER-OPERATION>
              </OPERATIONS>
              <POSSIBLE-ERRORS>
                <APPLICATION-ERROR>
                  <SHORT-NAME>CSM_E_NOT_OK</SHORT-NAME>
                  <ERROR-CODE>1</ERROR-CODE>
                </APPLICATION-ERROR>
                <APPLICATION-ERROR>
                  <SHORT-NAME>CSM_E_BUSY</SHORT-NAME>
                  <ERROR-CODE>2</ERROR-CODE>
                </APPLICATION-ERROR>
                <APPLICATION-ERROR>
                  <SHORT-NAME>CSM_E_SMALL_BUFFER</SHORT-NAME>
                  <ERROR-CODE>3</ERROR-CODE>
                </APPLICATION-ERROR>
              </POSSIBLE-ERRORS>
            </CLIENT-SERVER-INTERFACE>
[!ENDIF!][!//
[!IF "count(CsmSymKeyExtract/CsmSymKeyExtractConfig/*[CsmSymKeyExtractEnableRteInterface='true']) > 0"!][!//
            <!-- !LINKSTO CSM0794, 1 -->
            <CLIENT-SERVER-INTERFACE>
              <SHORT-NAME>CsmSymKeyExtract</SHORT-NAME>
              <IS-SERVICE>true</IS-SERVICE>
              <OPERATIONS>
                <CLIENT-SERVER-OPERATION>
                  <SHORT-NAME>SymKeyExtractStart</SHORT-NAME>
                  <ARGUMENTS>
                  </ARGUMENTS>
                  <POSSIBLE-ERROR-REFS>
                    <POSSIBLE-ERROR-REF DEST="APPLICATION-ERROR">/AUTOSAR_Csm/PortInterfaces/CsmSymKeyExtract/CSM_E_NOT_OK</POSSIBLE-ERROR-REF>
                    <POSSIBLE-ERROR-REF DEST="APPLICATION-ERROR">/AUTOSAR_Csm/PortInterfaces/CsmSymKeyExtract/CSM_E_BUSY</POSSIBLE-ERROR-REF>
                  </POSSIBLE-ERROR-REFS>
                </CLIENT-SERVER-OPERATION>
                <CLIENT-SERVER-OPERATION>
                  <SHORT-NAME>SymKeyExtractUpdate</SHORT-NAME>
                  <ARGUMENTS>
                    <ARGUMENT-DATA-PROTOTYPE>
                      <SHORT-NAME>dataBuffer</SHORT-NAME>
                      <TYPE-TREF DEST="IMPLEMENTATION-DATA-TYPE">/AUTOSAR_Csm/ImplementationDataTypes/SymKeyExtractDataBuffer</TYPE-TREF>
                      <DIRECTION>IN</DIRECTION>
                    </ARGUMENT-DATA-PROTOTYPE>
                    <ARGUMENT-DATA-PROTOTYPE>
                      <SHORT-NAME>dataLength</SHORT-NAME>
                      <TYPE-TREF DEST="IMPLEMENTATION-DATA-TYPE">/AUTOSAR_Platform/ImplementationDataTypes/uint32</TYPE-TREF>
                      <DIRECTION>IN</DIRECTION>
                    </ARGUMENT-DATA-PROTOTYPE>
                  </ARGUMENTS>
                  <POSSIBLE-ERROR-REFS>
                    <POSSIBLE-ERROR-REF DEST="APPLICATION-ERROR">/AUTOSAR_Csm/PortInterfaces/CsmSymKeyExtract/CSM_E_NOT_OK</POSSIBLE-ERROR-REF>
                    <POSSIBLE-ERROR-REF DEST="APPLICATION-ERROR">/AUTOSAR_Csm/PortInterfaces/CsmSymKeyExtract/CSM_E_BUSY</POSSIBLE-ERROR-REF>
                  </POSSIBLE-ERROR-REFS>
                </CLIENT-SERVER-OPERATION>
                <CLIENT-SERVER-OPERATION>
                  <SHORT-NAME>SymKeyExtractFinish</SHORT-NAME>
                  <ARGUMENTS>
                    <ARGUMENT-DATA-PROTOTYPE>
                      <SHORT-NAME>key</SHORT-NAME>
                      <TYPE-TREF DEST="IMPLEMENTATION-DATA-TYPE">/AUTOSAR_Csm/ImplementationDataTypes/SymKeyType</TYPE-TREF>
                      <DIRECTION>INOUT</DIRECTION>
                    </ARGUMENT-DATA-PROTOTYPE>
                  </ARGUMENTS>
                  <POSSIBLE-ERROR-REFS>
                    <POSSIBLE-ERROR-REF DEST="APPLICATION-ERROR">/AUTOSAR_Csm/PortInterfaces/CsmSymKeyExtract/CSM_E_NOT_OK</POSSIBLE-ERROR-REF>
                    <POSSIBLE-ERROR-REF DEST="APPLICATION-ERROR">/AUTOSAR_Csm/PortInterfaces/CsmSymKeyExtract/CSM_E_BUSY</POSSIBLE-ERROR-REF>
                  </POSSIBLE-ERROR-REFS>
                </CLIENT-SERVER-OPERATION>
              </OPERATIONS>
              <POSSIBLE-ERRORS>
                <APPLICATION-ERROR>
                  <SHORT-NAME>CSM_E_NOT_OK</SHORT-NAME>
                  <ERROR-CODE>1</ERROR-CODE>
                </APPLICATION-ERROR>
                <APPLICATION-ERROR>
                  <SHORT-NAME>CSM_E_BUSY</SHORT-NAME>
                  <ERROR-CODE>2</ERROR-CODE>
                </APPLICATION-ERROR>
              </POSSIBLE-ERRORS>
            </CLIENT-SERVER-INTERFACE>
[!ENDIF!][!//
[!IF "count(CsmSymKeyWrapAsym/CsmSymKeyWrapAsymConfig/*[CsmSymKeyWrapAsymEnableRteInterface='true']) > 0"!][!//
            <!-- !LINKSTO EB_CSM0796_01, 1 -->
            <CLIENT-SERVER-INTERFACE>
              <SHORT-NAME>CsmSymKeyWrapAsym</SHORT-NAME>
              <IS-SERVICE>true</IS-SERVICE>
              <OPERATIONS>
                <CLIENT-SERVER-OPERATION>
                  <SHORT-NAME>SymKeyWrapAsymStart</SHORT-NAME>
                  <ARGUMENTS>
                    <ARGUMENT-DATA-PROTOTYPE>
                      <SHORT-NAME>key</SHORT-NAME>
                      <TYPE-TREF DEST="IMPLEMENTATION-DATA-TYPE">/AUTOSAR_Csm/ImplementationDataTypes/SymKeyType</TYPE-TREF>
                      <DIRECTION>IN</DIRECTION>
                    </ARGUMENT-DATA-PROTOTYPE>
                    <ARGUMENT-DATA-PROTOTYPE>
                      <SHORT-NAME>wrappingKey</SHORT-NAME>
                      <TYPE-TREF DEST="IMPLEMENTATION-DATA-TYPE">/AUTOSAR_Csm/ImplementationDataTypes/AsymPublicKeyType</TYPE-TREF>
                      <DIRECTION>IN</DIRECTION>
                    </ARGUMENT-DATA-PROTOTYPE>
                  </ARGUMENTS>
                  <POSSIBLE-ERROR-REFS>
                    <POSSIBLE-ERROR-REF DEST="APPLICATION-ERROR">/AUTOSAR_Csm/PortInterfaces/CsmSymKeyWrapAsym/CSM_E_NOT_OK</POSSIBLE-ERROR-REF>
                    <POSSIBLE-ERROR-REF DEST="APPLICATION-ERROR">/AUTOSAR_Csm/PortInterfaces/CsmSymKeyWrapAsym/CSM_E_BUSY</POSSIBLE-ERROR-REF>
                  </POSSIBLE-ERROR-REFS>
                </CLIENT-SERVER-OPERATION>
                <CLIENT-SERVER-OPERATION>
                  <SHORT-NAME>SymKeyWrapAsymUpdate</SHORT-NAME>
                  <ARGUMENTS>
                    <ARGUMENT-DATA-PROTOTYPE>
                      <SHORT-NAME>dataBuffer</SHORT-NAME>
                      <TYPE-TREF DEST="IMPLEMENTATION-DATA-TYPE">/AUTOSAR_Csm/ImplementationDataTypes/SymKeyWrapAsymDataBuffer</TYPE-TREF>
                      <DIRECTION>OUT</DIRECTION>
                    </ARGUMENT-DATA-PROTOTYPE>
                    <ARGUMENT-DATA-PROTOTYPE>
                      <SHORT-NAME>dataLength</SHORT-NAME>
                      <TYPE-TREF DEST="IMPLEMENTATION-DATA-TYPE">/AUTOSAR_Platform/ImplementationDataTypes/uint32</TYPE-TREF>
                      <DIRECTION>INOUT</DIRECTION>
                    </ARGUMENT-DATA-PROTOTYPE>
                  </ARGUMENTS>
                  <POSSIBLE-ERROR-REFS>
                    <POSSIBLE-ERROR-REF DEST="APPLICATION-ERROR">/AUTOSAR_Csm/PortInterfaces/CsmSymKeyWrapAsym/CSM_E_NOT_OK</POSSIBLE-ERROR-REF>
                    <POSSIBLE-ERROR-REF DEST="APPLICATION-ERROR">/AUTOSAR_Csm/PortInterfaces/CsmSymKeyWrapAsym/CSM_E_BUSY</POSSIBLE-ERROR-REF>
                  </POSSIBLE-ERROR-REFS>
                </CLIENT-SERVER-OPERATION>
                <CLIENT-SERVER-OPERATION>
                  <SHORT-NAME>SymKeyWrapAsymFinish</SHORT-NAME>
                  <ARGUMENTS>
                  </ARGUMENTS>
                  <POSSIBLE-ERROR-REFS>
                    <POSSIBLE-ERROR-REF DEST="APPLICATION-ERROR">/AUTOSAR_Csm/PortInterfaces/CsmSymKeyWrapAsym/CSM_E_NOT_OK</POSSIBLE-ERROR-REF>
                    <POSSIBLE-ERROR-REF DEST="APPLICATION-ERROR">/AUTOSAR_Csm/PortInterfaces/CsmSymKeyWrapAsym/CSM_E_BUSY</POSSIBLE-ERROR-REF>
                  </POSSIBLE-ERROR-REFS>
                </CLIENT-SERVER-OPERATION>
              </OPERATIONS>
              <POSSIBLE-ERRORS>
                <APPLICATION-ERROR>
                  <SHORT-NAME>CSM_E_NOT_OK</SHORT-NAME>
                  <ERROR-CODE>1</ERROR-CODE>
                </APPLICATION-ERROR>
                <APPLICATION-ERROR>
                  <SHORT-NAME>CSM_E_BUSY</SHORT-NAME>
                  <ERROR-CODE>2</ERROR-CODE>
                </APPLICATION-ERROR>
              </POSSIBLE-ERRORS>
            </CLIENT-SERVER-INTERFACE>
[!ENDIF!][!//
[!IF "count(CsmSymKeyWrapSym/CsmSymKeyWrapSymConfig/*[CsmSymKeyWrapSymEnableRteInterface='true']) > 0"!][!//
            <!-- !LINKSTO EB_CSM0795_01, 1 -->
            <CLIENT-SERVER-INTERFACE>
              <SHORT-NAME>CsmSymKeyWrapSym</SHORT-NAME>
              <IS-SERVICE>true</IS-SERVICE>
              <OPERATIONS>
                <CLIENT-SERVER-OPERATION>
                  <SHORT-NAME>SymKeyWrapSymStart</SHORT-NAME>
                  <ARGUMENTS>
                    <ARGUMENT-DATA-PROTOTYPE>
                      <SHORT-NAME>key</SHORT-NAME>
                      <TYPE-TREF DEST="IMPLEMENTATION-DATA-TYPE">/AUTOSAR_Csm/ImplementationDataTypes/SymKeyType</TYPE-TREF>
                      <DIRECTION>IN</DIRECTION>
                    </ARGUMENT-DATA-PROTOTYPE>
                    <ARGUMENT-DATA-PROTOTYPE>
                      <SHORT-NAME>wrappingKey</SHORT-NAME>
                      <TYPE-TREF DEST="IMPLEMENTATION-DATA-TYPE">/AUTOSAR_Csm/ImplementationDataTypes/SymKeyType</TYPE-TREF>
                      <DIRECTION>IN</DIRECTION>
                    </ARGUMENT-DATA-PROTOTYPE>
                  </ARGUMENTS>
                  <POSSIBLE-ERROR-REFS>
                    <POSSIBLE-ERROR-REF DEST="APPLICATION-ERROR">/AUTOSAR_Csm/PortInterfaces/CsmSymKeyWrapSym/CSM_E_NOT_OK</POSSIBLE-ERROR-REF>
                    <POSSIBLE-ERROR-REF DEST="APPLICATION-ERROR">/AUTOSAR_Csm/PortInterfaces/CsmSymKeyWrapSym/CSM_E_BUSY</POSSIBLE-ERROR-REF>
                  </POSSIBLE-ERROR-REFS>
                </CLIENT-SERVER-OPERATION>
                <CLIENT-SERVER-OPERATION>
                  <SHORT-NAME>SymKeyWrapSymUpdate</SHORT-NAME>
                  <ARGUMENTS>
                    <ARGUMENT-DATA-PROTOTYPE>
                      <SHORT-NAME>dataBuffer</SHORT-NAME>
                      <TYPE-TREF DEST="IMPLEMENTATION-DATA-TYPE">/AUTOSAR_Csm/ImplementationDataTypes/SymKeyWrapSymDataBuffer</TYPE-TREF>
                      <DIRECTION>OUT</DIRECTION>
                    </ARGUMENT-DATA-PROTOTYPE>
                    <ARGUMENT-DATA-PROTOTYPE>
                      <SHORT-NAME>dataLength</SHORT-NAME>
                      <TYPE-TREF DEST="IMPLEMENTATION-DATA-TYPE">/AUTOSAR_Platform/ImplementationDataTypes/uint32</TYPE-TREF>
                      <DIRECTION>INOUT</DIRECTION>
                    </ARGUMENT-DATA-PROTOTYPE>
                  </ARGUMENTS>
                  <POSSIBLE-ERROR-REFS>
                    <POSSIBLE-ERROR-REF DEST="APPLICATION-ERROR">/AUTOSAR_Csm/PortInterfaces/CsmSymKeyWrapSym/CSM_E_NOT_OK</POSSIBLE-ERROR-REF>
                    <POSSIBLE-ERROR-REF DEST="APPLICATION-ERROR">/AUTOSAR_Csm/PortInterfaces/CsmSymKeyWrapSym/CSM_E_BUSY</POSSIBLE-ERROR-REF>
                  </POSSIBLE-ERROR-REFS>
                </CLIENT-SERVER-OPERATION>
                <CLIENT-SERVER-OPERATION>
                  <SHORT-NAME>SymKeyWrapSymFinish</SHORT-NAME>
                  <ARGUMENTS>
                  </ARGUMENTS>
                  <POSSIBLE-ERROR-REFS>
                    <POSSIBLE-ERROR-REF DEST="APPLICATION-ERROR">/AUTOSAR_Csm/PortInterfaces/CsmSymKeyWrapSym/CSM_E_NOT_OK</POSSIBLE-ERROR-REF>
                    <POSSIBLE-ERROR-REF DEST="APPLICATION-ERROR">/AUTOSAR_Csm/PortInterfaces/CsmSymKeyWrapSym/CSM_E_BUSY</POSSIBLE-ERROR-REF>
                  </POSSIBLE-ERROR-REFS>
                </CLIENT-SERVER-OPERATION>
              </OPERATIONS>
              <POSSIBLE-ERRORS>
                <APPLICATION-ERROR>
                  <SHORT-NAME>CSM_E_NOT_OK</SHORT-NAME>
                  <ERROR-CODE>1</ERROR-CODE>
                </APPLICATION-ERROR>
                <APPLICATION-ERROR>
                  <SHORT-NAME>CSM_E_BUSY</SHORT-NAME>
                  <ERROR-CODE>2</ERROR-CODE>
                </APPLICATION-ERROR>
              </POSSIBLE-ERRORS>
            </CLIENT-SERVER-INTERFACE>
[!ENDIF!][!//
[!IF "CsmGeneral/CsmUseSyncJobProcessing = 'false'"!][!//
            <!-- !LINKSTO CSM0801, 1 -->
            <CLIENT-SERVER-INTERFACE>
              <SHORT-NAME>CsmCallback</SHORT-NAME>
              <IS-SERVICE>true</IS-SERVICE>
              <OPERATIONS>
                <CLIENT-SERVER-OPERATION>
                  <SHORT-NAME>JobFinished</SHORT-NAME>
                  <ARGUMENTS>
                    <ARGUMENT-DATA-PROTOTYPE>
                      <SHORT-NAME>retVal</SHORT-NAME>
                      <TYPE-TREF DEST="IMPLEMENTATION-DATA-TYPE">/AUTOSAR_Csm/ImplementationDataTypes/Csm_ReturnType</TYPE-TREF>
                      <DIRECTION>IN</DIRECTION>
                    </ARGUMENT-DATA-PROTOTYPE>
                  </ARGUMENTS>
                  <POSSIBLE-ERROR-REFS>
                    <POSSIBLE-ERROR-REF DEST="APPLICATION-ERROR">/AUTOSAR_Csm/PortInterfaces/CsmCallback/CSM_E_NOT_OK</POSSIBLE-ERROR-REF>
                  </POSSIBLE-ERROR-REFS>
                </CLIENT-SERVER-OPERATION>
              </OPERATIONS>
              <POSSIBLE-ERRORS>
                <APPLICATION-ERROR>
                  <SHORT-NAME>CSM_E_NOT_OK</SHORT-NAME>
                  <ERROR-CODE>1</ERROR-CODE>
                </APPLICATION-ERROR>
              </POSSIBLE-ERRORS>
            </CLIENT-SERVER-INTERFACE>
[!ENDIF!][!//
          </ELEMENTS>
        </AR-PACKAGE>
      </AR-PACKAGES>
    </AR-PACKAGE>
  </AR-PACKAGES>
</AUTOSAR>
[!ENDIF!][!//
