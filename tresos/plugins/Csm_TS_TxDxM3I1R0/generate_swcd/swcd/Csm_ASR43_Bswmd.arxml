[part 1 of 3]
[!/* ====================================================================================== */!][!//
[!/* ====================================================================================== */!][!//
[!INCLUDE "Csm_Macros.m"!][!//
[!/* ====================================================================================== */!][!//
[!//
[!AUTOSPACING!][!//
[!//
<?xml version="1.0" encoding="ISO-8859-1"?>
[!//
<AUTOSAR xmlns="http://autosar.org/schema/r4.0"
         xmlns:xsi="http://www.w3.org/2001/XMLSchema-instance"
         xsi:schemaLocation="http://autosar.org/schema/r4.0 AUTOSAR_4-0-3.xsd">
  <AR-PACKAGES>
    <AR-PACKAGE>
      <SHORT-NAME>AUTOSAR_Csm</SHORT-NAME>
      <ELEMENTS/>

      <AR-PACKAGES>
[!IF "$Csm_Rte_Enabled_All != 'true'"!][!//
        <AR-PACKAGE>
          <SHORT-NAME>CompuMethods</SHORT-NAME>
          <ELEMENTS>
  [!IF "node:value(as:modconf('Csm')/CsmEbGeneral/CsmEbMisc/CsmEbEnhancementApiCsmKeyGetStatus) = 'true'"!][!//
            <COMPU-METHOD>
              <SHORT-NAME>CM_Crypto_KeyStatusType</SHORT-NAME>
              <CATEGORY>TEXTTABLE</CATEGORY>
              <COMPU-INTERNAL-TO-PHYS>
                <COMPU-SCALES>
                  <COMPU-SCALE>
                    <LOWER-LIMIT INTERVAL-TYPE="CLOSED">0</LOWER-LIMIT>
                    <UPPER-LIMIT INTERVAL-TYPE="CLOSED">0</UPPER-LIMIT>
                    <COMPU-CONST>
                      <VT>CRYPTO_KEYSTATUS_INVALID</VT>
                    </COMPU-CONST>
                  </COMPU-SCALE>
                  <COMPU-SCALE>
                    <LOWER-LIMIT INTERVAL-TYPE="CLOSED">1</LOWER-LIMIT>
                    <UPPER-LIMIT INTERVAL-TYPE="CLOSED">1</UPPER-LIMIT>
                    <COMPU-CONST>
                      <VT>CRYPTO_KEYSTATUS_VALID</VT>
                    </COMPU-CONST>
                  </COMPU-SCALE>
                </COMPU-SCALES>
              </COMPU-INTERNAL-TO-PHYS>
            </COMPU-METHOD>
  [!ENDIF!][!//
            <COMPU-METHOD>
              <SHORT-NAME>CM_Crypto_OperationModeType</SHORT-NAME>
              <CATEGORY>TEXTTABLE</CATEGORY>
              <COMPU-INTERNAL-TO-PHYS>
                <COMPU-SCALES>
                  <COMPU-SCALE>
                    <LOWER-LIMIT INTERVAL-TYPE="CLOSED">1</LOWER-LIMIT>
                    <UPPER-LIMIT INTERVAL-TYPE="CLOSED">1</UPPER-LIMIT>
                    <COMPU-CONST>
                      <VT>CRYPTO_OPERATIONMODE_START</VT>
                    </COMPU-CONST>
                  </COMPU-SCALE>
                  <COMPU-SCALE>
                    <LOWER-LIMIT INTERVAL-TYPE="CLOSED">2</LOWER-LIMIT>
                    <UPPER-LIMIT INTERVAL-TYPE="CLOSED">2</UPPER-LIMIT>
                    <COMPU-CONST>
                      <VT>CRYPTO_OPERATIONMODE_UPDATE</VT>
                    </COMPU-CONST>
                  </COMPU-SCALE>
                  <COMPU-SCALE>
                    <LOWER-LIMIT INTERVAL-TYPE="CLOSED">3</LOWER-LIMIT>
                    <UPPER-LIMIT INTERVAL-TYPE="CLOSED">3</UPPER-LIMIT>
                    <COMPU-CONST>
                      <VT>CRYPTO_OPERATIONMODE_STREAMSTART</VT>
                    </COMPU-CONST>
                  </COMPU-SCALE>
                  <COMPU-SCALE>
                    <LOWER-LIMIT INTERVAL-TYPE="CLOSED">4</LOWER-LIMIT>
                    <UPPER-LIMIT INTERVAL-TYPE="CLOSED">4</UPPER-LIMIT>
                    <COMPU-CONST>
                      <VT>CRYPTO_OPERATIONMODE_FINISH</VT>
                    </COMPU-CONST>
                  </COMPU-SCALE>
                  <COMPU-SCALE>
                    <LOWER-LIMIT INTERVAL-TYPE="CLOSED">7</LOWER-LIMIT>
                    <UPPER-LIMIT INTERVAL-TYPE="CLOSED">7</UPPER-LIMIT>
                    <COMPU-CONST>
                      <VT>CRYPTO_OPERATIONMODE_SINGLECALL</VT>
                    </COMPU-CONST>
                  </COMPU-SCALE>
                </COMPU-SCALES>
              </COMPU-INTERNAL-TO-PHYS>
            </COMPU-METHOD>
            <COMPU-METHOD>
              <SHORT-NAME>CM_Crypto_VerifyResultType</SHORT-NAME>
              <CATEGORY>TEXTTABLE</CATEGORY>
              <COMPU-INTERNAL-TO-PHYS>
                <COMPU-SCALES>
                  <COMPU-SCALE>
                    <LOWER-LIMIT INTERVAL-TYPE="CLOSED">0</LOWER-LIMIT>
                    <UPPER-LIMIT INTERVAL-TYPE="CLOSED">0</UPPER-LIMIT>
                    <COMPU-CONST>
                      <VT>CRYPTO_E_VER_OK</VT>
                    </COMPU-CONST>
                  </COMPU-SCALE>
                  <COMPU-SCALE>
                    <LOWER-LIMIT INTERVAL-TYPE="CLOSED">1</LOWER-LIMIT>
                    <UPPER-LIMIT INTERVAL-TYPE="CLOSED">1</UPPER-LIMIT>
                    <COMPU-CONST>
                      <VT>CRYPTO_E_VER_NOT_OK</VT>
                    </COMPU-CONST>
                  </COMPU-SCALE>
                </COMPU-SCALES>
              </COMPU-INTERNAL-TO-PHYS>
            </COMPU-METHOD>
          </ELEMENTS>
        </AR-PACKAGE>

        <AR-PACKAGE>
          <SHORT-NAME>DataConstraints</SHORT-NAME>
          <ELEMENTS>
  [!IF "node:value(as:modconf('Csm')/CsmEbGeneral/CsmEbMisc/CsmEbEnhancementApiCsmKeyGetStatus) = 'true'"!][!//
            <DATA-CONSTR>
              <SHORT-NAME>DC_Crypto_KeyStatusType</SHORT-NAME>
              <DATA-CONSTR-RULES>
                <DATA-CONSTR-RULE>
                  <INTERNAL-CONSTRS>
                    <LOWER-LIMIT INTERVAL-TYPE="CLOSED">0</LOWER-LIMIT>
                    <UPPER-LIMIT INTERVAL-TYPE="CLOSED">1</UPPER-LIMIT>
                  </INTERNAL-CONSTRS>
                </DATA-CONSTR-RULE>
              </DATA-CONSTR-RULES>
            </DATA-CONSTR>
  [!ENDIF!][!//
            <DATA-CONSTR>
              <SHORT-NAME>DC_Crypto_OperationModeType</SHORT-NAME>
              <DATA-CONSTR-RULES>
                <DATA-CONSTR-RULE>
                  <INTERNAL-CONSTRS>
                    <LOWER-LIMIT INTERVAL-TYPE="CLOSED">1</LOWER-LIMIT>
                    <UPPER-LIMIT INTERVAL-TYPE="CLOSED">7</UPPER-LIMIT>
                  </INTERNAL-CONSTRS>
                </DATA-CONSTR-RULE>
              </DATA-CONSTR-RULES>
            </DATA-CONSTR>
            <DATA-CONSTR>
              <SHORT-NAME>DC_Crypto_VerifyResultType</SHORT-NAME>
              <DATA-CONSTR-RULES>
                <DATA-CONSTR-RULE>
                  <INTERNAL-CONSTRS>
                    <LOWER-LIMIT INTERVAL-TYPE="CLOSED">0</LOWER-LIMIT>
                    <UPPER-LIMIT INTERVAL-TYPE="CLOSED">1</UPPER-LIMIT>
                  </INTERNAL-CONSTRS>
                </DATA-CONSTR-RULE>
              </DATA-CONSTR-RULES>
            </DATA-CONSTR>
          </ELEMENTS>
        </AR-PACKAGE>

[!ENDIF!][!//
        <AR-PACKAGE>
          <SHORT-NAME>ImplementationDataTypes</SHORT-NAME>
          <ELEMENTS>
            <IMPLEMENTATION-DATA-TYPE>
              <SHORT-NAME>Uint8Ptr2Const</SHORT-NAME>
              <CATEGORY>ARRAY</CATEGORY>
              <SUB-ELEMENTS>
                <IMPLEMENTATION-DATA-TYPE-ELEMENT>
                  <SHORT-NAME>AuxCsm_Uint8Ptr2Const</SHORT-NAME>
                  <CATEGORY>TYPE_REFERENCE</CATEGORY>
                  <ARRAY-SIZE>1</ARRAY-SIZE>
                  <ARRAY-SIZE-SEMANTICS>FIXED-SIZE</ARRAY-SIZE-SEMANTICS>
                  <SW-DATA-DEF-PROPS>
                    <SW-DATA-DEF-PROPS-VARIANTS>
                      <SW-DATA-DEF-PROPS-CONDITIONAL>
                        <IMPLEMENTATION-DATA-TYPE-REF DEST="IMPLEMENTATION-DATA-TYPE">/AUTOSAR_Platform/ImplementationDataTypes/uint8</IMPLEMENTATION-DATA-TYPE-REF>
                      </SW-DATA-DEF-PROPS-CONDITIONAL>
                    </SW-DATA-DEF-PROPS-VARIANTS>
                  </SW-DATA-DEF-PROPS>
                </IMPLEMENTATION-DATA-TYPE-ELEMENT>
              </SUB-ELEMENTS>
              <TYPE-EMITTER>BSW</TYPE-EMITTER>
            </IMPLEMENTATION-DATA-TYPE>
[!IF "$Csm_Rte_Enabled_All != 'true'"!][!//
  [!IF "node:value(as:modconf('Csm')/CsmEbGeneral/CsmEbMisc/CsmEbEnhancementApiCsmKeyGetStatus) = 'true'"!][!//
            <!-- ~~~~~~~~~~~~~~~~~~~~~~~~~~~~~~~~~~~~~~~~~~~~~~~~~~~~~~~~~~~~~~~~~~~~~~~~~~~~~~~ -->
            <!-- !LINKSTO CSM.Dsn.SWS_Csm_91102,1 -->
            <IMPLEMENTATION-DATA-TYPE>
              <SHORT-NAME>Crypto_KeyStatusType</SHORT-NAME>
              <CATEGORY>TYPE_REFERENCE</CATEGORY>
              <SW-DATA-DEF-PROPS>
                <SW-DATA-DEF-PROPS-VARIANTS>
                  <SW-DATA-DEF-PROPS-CONDITIONAL>
                    <COMPU-METHOD-REF DEST="COMPU-METHOD">/AUTOSAR_Csm/CompuMethods/CM_Crypto_KeyStatusType</COMPU-METHOD-REF>
                    <DATA-CONSTR-REF DEST="DATA-CONSTR">/AUTOSAR_Csm/DataConstraints/DC_Crypto_KeyStatusType</DATA-CONSTR-REF>
                    <IMPLEMENTATION-DATA-TYPE-REF DEST="IMPLEMENTATION-DATA-TYPE">/AUTOSAR_Platform/ImplementationDataTypes/uint8</IMPLEMENTATION-DATA-TYPE-REF>
                  </SW-DATA-DEF-PROPS-CONDITIONAL>
                </SW-DATA-DEF-PROPS-VARIANTS>
              </SW-DATA-DEF-PROPS>
              <TYPE-EMITTER>BSW</TYPE-EMITTER>
            </IMPLEMENTATION-DATA-TYPE>
  [!ENDIF!][!//
            <!-- ~~~~~~~~~~~~~~~~~~~~~~~~~~~~~~~~~~~~~~~~~~~~~~~~~~~~~~~~~~~~~~~~~~~~~~~~~~~~~~~ -->
            <!-- !LINKSTO CSM.Dsn.SWS_Csm_01029,1 -->
            <IMPLEMENTATION-DATA-TYPE>
              <SHORT-NAME>Crypto_OperationModeType</SHORT-NAME>
              <CATEGORY>TYPE_REFERENCE</CATEGORY>
              <SW-DATA-DEF-PROPS>
                <SW-DATA-DEF-PROPS-VARIANTS>
                  <SW-DATA-DEF-PROPS-CONDITIONAL>
                    <COMPU-METHOD-REF DEST="COMPU-METHOD">/AUTOSAR_Csm/CompuMethods/CM_Crypto_OperationModeType</COMPU-METHOD-REF>
                    <DATA-CONSTR-REF DEST="DATA-CONSTR">/AUTOSAR_Csm/DataConstraints/DC_Crypto_OperationModeType</DATA-CONSTR-REF>
                    <IMPLEMENTATION-DATA-TYPE-REF DEST="IMPLEMENTATION-DATA-TYPE">/AUTOSAR_Platform/ImplementationDataTypes/uint8</IMPLEMENTATION-DATA-TYPE-REF>
                  </SW-DATA-DEF-PROPS-CONDITIONAL>
                </SW-DATA-DEF-PROPS-VARIANTS>
              </SW-DATA-DEF-PROPS>
              <TYPE-EMITTER>BSW</TYPE-EMITTER>
            </IMPLEMENTATION-DATA-TYPE>
            <!-- ~~~~~~~~~~~~~~~~~~~~~~~~~~~~~~~~~~~~~~~~~~~~~~~~~~~~~~~~~~~~~~~~~~~~~~~~~~~~~~~ -->
            <!-- !LINKSTO CSM.Dsn.SWS_Csm_01024,1 -->
            <IMPLEMENTATION-DATA-TYPE>
              <SHORT-NAME>Crypto_VerifyResultType</SHORT-NAME>
              <CATEGORY>TYPE_REFERENCE</CATEGORY>
              <SW-DATA-DEF-PROPS>
                <SW-DATA-DEF-PROPS-VARIANTS>
                  <SW-DATA-DEF-PROPS-CONDITIONAL>
                    <COMPU-METHOD-REF DEST="COMPU-METHOD">/AUTOSAR_Csm/CompuMethods/CM_Crypto_VerifyResultType</COMPU-METHOD-REF>
                    <DATA-CONSTR-REF DEST="DATA-CONSTR">/AUTOSAR_Csm/DataConstraints/DC_Crypto_VerifyResultType</DATA-CONSTR-REF>
                    <IMPLEMENTATION-DATA-TYPE-REF DEST="IMPLEMENTATION-DATA-TYPE">/AUTOSAR_Platform/ImplementationDataTypes/uint8</IMPLEMENTATION-DATA-TYPE-REF>
                  </SW-DATA-DEF-PROPS-CONDITIONAL>
                </SW-DATA-DEF-PROPS-VARIANTS>
              </SW-DATA-DEF-PROPS>
              <TYPE-EMITTER>BSW</TYPE-EMITTER>
            </IMPLEMENTATION-DATA-TYPE>
[!ENDIF!][!//
          </ELEMENTS>
        </AR-PACKAGE>

[!IF "$Csm_Rte_Enabled_All = 'true'"!][!//
        <AR-PACKAGE>
          <SHORT-NAME>SwcBswMappings</SHORT-NAME>
          <ELEMENTS>
  [!IF "num:i(0) = num:i(count(as:modconf('Csm')/CsmMainFunction/*))"!][!//
            <SWC-BSW-MAPPING>
              <SHORT-NAME>SwcBswMapping_0</SHORT-NAME>
              <BSW-BEHAVIOR-REF DEST="BSW-INTERNAL-BEHAVIOR">/AUTOSAR_Csm/BswModuleDescriptions/Csm/InternalBehavior_0</BSW-BEHAVIOR-REF>
              <RUNNABLE-MAPPINGS>
    [!IF "$Csm_Flg_Async = 'true'"!][!//
                <SWC-BSW-RUNNABLE-MAPPING>
                  <BSW-ENTITY-REF DEST="BSW-SCHEDULABLE-ENTITY">/AUTOSAR_Csm/BswModuleDescriptions/Csm/InternalBehavior_0/Csm_MainFunction</BSW-ENTITY-REF>
                  <SWC-RUNNABLE-REF DEST="RUNNABLE-ENTITY">/AUTOSAR_Csm/SwComponentTypes/Csm/CsmIntBeh/RE_MainFunction</SWC-RUNNABLE-REF>
                </SWC-BSW-RUNNABLE-MAPPING>
    [!ENDIF!][!//
    [!IF "num:i(0) != num:i(count(as:modconf('Csm')/CsmKeys/CsmKey/*[CsmKeyUsePort = 'true']))"!][!//
                <SWC-BSW-RUNNABLE-MAPPING>
                  <BSW-ENTITY-REF DEST="BSW-CALLED-ENTITY">/AUTOSAR_Csm/BswModuleDescriptions/Csm/InternalBehavior_0/CE_Key_CertificateParse</BSW-ENTITY-REF>
                  <SWC-RUNNABLE-REF DEST="RUNNABLE-ENTITY">/AUTOSAR_Csm/SwComponentTypes/Csm/CsmIntBeh/RE_Key_CertificateParse</SWC-RUNNABLE-REF>
                </SWC-BSW-RUNNABLE-MAPPING>
                <SWC-BSW-RUNNABLE-MAPPING>
                  <BSW-ENTITY-REF DEST="BSW-CALLED-ENTITY">/AUTOSAR_Csm/BswModuleDescriptions/Csm/InternalBehavior_0/CE_Key_CertificateVerify</BSW-ENTITY-REF>
                  <SWC-RUNNABLE-REF DEST="RUNNABLE-ENTITY">/AUTOSAR_Csm/SwComponentTypes/Csm/CsmIntBeh/RE_Key_CertificateVerify</SWC-RUNNABLE-REF>
                </SWC-BSW-RUNNABLE-MAPPING>
                <SWC-BSW-RUNNABLE-MAPPING>
                  <BSW-ENTITY-REF DEST="BSW-CALLED-ENTITY">/AUTOSAR_Csm/BswModuleDescriptions/Csm/InternalBehavior_0/CE_Key_KeyCopy</BSW-ENTITY-REF>
                  <SWC-RUNNABLE-REF DEST="RUNNABLE-ENTITY">/AUTOSAR_Csm/SwComponentTypes/Csm/CsmIntBeh/RE_Key_KeyCopy</SWC-RUNNABLE-REF>
                </SWC-BSW-RUNNABLE-MAPPING>
                <SWC-BSW-RUNNABLE-MAPPING>
                  <BSW-ENTITY-REF DEST="BSW-CALLED-ENTITY">/AUTOSAR_Csm/BswModuleDescriptions/Csm/InternalBehavior_0/CE_Key_KeyDerive</BSW-ENTITY-REF>
                  <SWC-RUNNABLE-REF DEST="RUNNABLE-ENTITY">/AUTOSAR_Csm/SwComponentTypes/Csm/CsmIntBeh/RE_Key_KeyDerive</SWC-RUNNABLE-REF>
                </SWC-BSW-RUNNABLE-MAPPING>
                <SWC-BSW-RUNNABLE-MAPPING>
                  <BSW-ENTITY-REF DEST="BSW-CALLED-ENTITY">/AUTOSAR_Csm/BswModuleDescriptions/Csm/InternalBehavior_0/CE_Key_KeyElementCopy</BSW-ENTITY-REF>
                  <SWC-RUNNABLE-REF DEST="RUNNABLE-ENTITY">/AUTOSAR_Csm/SwComponentTypes/Csm/CsmIntBeh/RE_Key_KeyElementCopy</SWC-RUNNABLE-REF>
                </SWC-BSW-RUNNABLE-MAPPING>
                <SWC-BSW-RUNNABLE-MAPPING>
                  <BSW-ENTITY-REF DEST="BSW-CALLED-ENTITY">/AUTOSAR_Csm/BswModuleDescriptions/Csm/InternalBehavior_0/CE_Key_KeyElementGet</BSW-ENTITY-REF>
                  <SWC-RUNNABLE-REF DEST="RUNNABLE-ENTITY">/AUTOSAR_Csm/SwComponentTypes/Csm/CsmIntBeh/RE_Key_KeyElementGet</SWC-RUNNABLE-REF>
                </SWC-BSW-RUNNABLE-MAPPING>
                <SWC-BSW-RUNNABLE-MAPPING>
                  <BSW-ENTITY-REF DEST="BSW-CALLED-ENTITY">/AUTOSAR_Csm/BswModuleDescriptions/Csm/InternalBehavior_0/CE_Key_KeyElementSet</BSW-ENTITY-REF>
                  <SWC-RUNNABLE-REF DEST="RUNNABLE-ENTITY">/AUTOSAR_Csm/SwComponentTypes/Csm/CsmIntBeh/RE_Key_KeyElementSet</SWC-RUNNABLE-REF>
                </SWC-BSW-RUNNABLE-MAPPING>
                <SWC-BSW-RUNNABLE-MAPPING>
                  <BSW-ENTITY-REF DEST="BSW-CALLED-ENTITY">/AUTOSAR_Csm/BswModuleDescriptions/Csm/InternalBehavior_0/CE_Key_KeyExchangeCalcPubVal</BSW-ENTITY-REF>
                  <SWC-RUNNABLE-REF DEST="RUNNABLE-ENTITY">/AUTOSAR_Csm/SwComponentTypes/Csm/CsmIntBeh/RE_Key_KeyExchangeCalcPubVal</SWC-RUNNABLE-REF>
                </SWC-BSW-RUNNABLE-MAPPING>
                <SWC-BSW-RUNNABLE-MAPPING>
                  <BSW-ENTITY-REF DEST="BSW-CALLED-ENTITY">/AUTOSAR_Csm/BswModuleDescriptions/Csm/InternalBehavior_0/CE_Key_KeyExchangeCalcSecret</BSW-ENTITY-REF>
                  <SWC-RUNNABLE-REF DEST="RUNNABLE-ENTITY">/AUTOSAR_Csm/SwComponentTypes/Csm/CsmIntBeh/RE_Key_KeyExchangeCalcSecret</SWC-RUNNABLE-REF>
                </SWC-BSW-RUNNABLE-MAPPING>
                <SWC-BSW-RUNNABLE-MAPPING>
                  <BSW-ENTITY-REF DEST="BSW-CALLED-ENTITY">/AUTOSAR_Csm/BswModuleDescriptions/Csm/InternalBehavior_0/CE_Key_KeyGenerate</BSW-ENTITY-REF>
                  <SWC-RUNNABLE-REF DEST="RUNNABLE-ENTITY">/AUTOSAR_Csm/SwComponentTypes/Csm/CsmIntBeh/RE_Key_KeyGenerate</SWC-RUNNABLE-REF>
                </SWC-BSW-RUNNABLE-MAPPING>
                <SWC-BSW-RUNNABLE-MAPPING>
                  <BSW-ENTITY-REF DEST="BSW-CALLED-ENTITY">/AUTOSAR_Csm/BswModuleDescriptions/Csm/InternalBehavior_0/CE_Key_KeySetValid</BSW-ENTITY-REF>
                  <SWC-RUNNABLE-REF DEST="RUNNABLE-ENTITY">/AUTOSAR_Csm/SwComponentTypes/Csm/CsmIntBeh/RE_Key_KeySetValid</SWC-RUNNABLE-REF>
                </SWC-BSW-RUNNABLE-MAPPING>
  [!IF "node:value(as:modconf('Csm')/CsmEbGeneral/CsmEbMisc/CsmEbEnhancementApiCsmKeySetInvalid) = 'true'"!][!//
                <SWC-BSW-RUNNABLE-MAPPING>
                  <BSW-ENTITY-REF DEST="BSW-CALLED-ENTITY">/AUTOSAR_Csm/BswModuleDescriptions/Csm/InternalBehavior_0/CE_Key_KeySetInvalid</BSW-ENTITY-REF>
                  <SWC-RUNNABLE-REF DEST="RUNNABLE-ENTITY">/AUTOSAR_Csm/SwComponentTypes/Csm/CsmIntBeh/RE_Key_KeySetInvalid</SWC-RUNNABLE-REF>
                </SWC-BSW-RUNNABLE-MAPPING>
  [!ENDIF!][!//
  [!IF "node:value(as:modconf('Csm')/CsmEbGeneral/CsmEbMisc/CsmEbEnhancementApiCsmKeyGetStatus) = 'true'"!][!//
                <SWC-BSW-RUNNABLE-MAPPING>
                  <BSW-ENTITY-REF DEST="BSW-CALLED-ENTITY">/AUTOSAR_Csm/BswModuleDescriptions/Csm/InternalBehavior_0/CE_Key_KeyGetStatus</BSW-ENTITY-REF>
                  <SWC-RUNNABLE-REF DEST="RUNNABLE-ENTITY">/AUTOSAR_Csm/SwComponentTypes/Csm/CsmIntBeh/RE_Key_KeyGetStatus</SWC-RUNNABLE-REF>
                </SWC-BSW-RUNNABLE-MAPPING>
  [!ENDIF!][!//
                <SWC-BSW-RUNNABLE-MAPPING>
                  <BSW-ENTITY-REF DEST="BSW-CALLED-ENTITY">/AUTOSAR_Csm/BswModuleDescriptions/Csm/InternalBehavior_0/CE_Key_RandomSeed</BSW-ENTITY-REF>
                  <SWC-RUNNABLE-REF DEST="RUNNABLE-ENTITY">/AUTOSAR_Csm/SwComponentTypes/Csm/CsmIntBeh/RE_Key_RandomSeed</SWC-RUNNABLE-REF>
                </SWC-BSW-RUNNABLE-MAPPING>
    [!ENDIF!][!//
    [!IF "num:i(0) != num:i(count(node:refs(as:modconf('Csm')/CsmJobs/CsmJob/*[CsmJobUsePort = 'true']/CsmJobPrimitiveRef)/CsmAEADDecrypt)) and
       (node:value(as:modconf('Csm')/CsmEbGeneral/CsmEbMisc/CsmEbCorrectionCsmAsyncJobInterfaceUseDataReferences) = 'false' or
       num:i(0) != num:i(count(node:refs(as:modconf('Csm')/CsmJobs/CsmJob/*[CsmJobUsePort = 'true']/CsmJobPrimitiveRef)/CsmAEADDecrypt/*/*[contains(node:name(.),'Processing') and node:value(.) = 'CSM_SYNCHRONOUS'])))"!][!//
                <SWC-BSW-RUNNABLE-MAPPING>
                  <BSW-ENTITY-REF DEST="BSW-CALLED-ENTITY">/AUTOSAR_Csm/BswModuleDescriptions/Csm/InternalBehavior_0/CE_Job_AEADDecrypt</BSW-ENTITY-REF>
                  <SWC-RUNNABLE-REF DEST="RUNNABLE-ENTITY">/AUTOSAR_Csm/SwComponentTypes/Csm/CsmIntBeh/RE_Job_AEADDecrypt</SWC-RUNNABLE-REF>
                </SWC-BSW-RUNNABLE-MAPPING>
    [!ENDIF!][!//
    [!IF "num:i(0) != num:i(count(node:refs(as:modconf('Csm')/CsmJobs/CsmJob/*[CsmJobUsePort = 'true']/CsmJobPrimitiveRef)/CsmAEADEncrypt)) and
       (node:value(as:modconf('Csm')/CsmEbGeneral/CsmEbMisc/CsmEbCorrectionCsmAsyncJobInterfaceUseDataReferences) = 'false' or
       num:i(0) != num:i(count(node:refs(as:modconf('Csm')/CsmJobs/CsmJob/*[CsmJobUsePort = 'true']/CsmJobPrimitiveRef)/CsmAEADEncrypt/*/*[contains(node:name(.),'Processing') and node:value(.) = 'CSM_SYNCHRONOUS'])))"!][!//
                <SWC-BSW-RUNNABLE-MAPPING>
                  <BSW-ENTITY-REF DEST="BSW-CALLED-ENTITY">/AUTOSAR_Csm/BswModuleDescriptions/Csm/InternalBehavior_0/CE_Job_AEADEncrypt</BSW-ENTITY-REF>
                  <SWC-RUNNABLE-REF DEST="RUNNABLE-ENTITY">/AUTOSAR_Csm/SwComponentTypes/Csm/CsmIntBeh/RE_Job_AEADEncrypt</SWC-RUNNABLE-REF>
                </SWC-BSW-RUNNABLE-MAPPING>
    [!ENDIF!][!//
    [!IF "num:i(0) != num:i(count(node:refs(as:modconf('Csm')/CsmJobs/CsmJob/*[CsmJobUsePort = 'true']/CsmJobPrimitiveRef)/CsmDecrypt)) and
       (node:value(as:modconf('Csm')/CsmEbGeneral/CsmEbMisc/CsmEbCorrectionCsmAsyncJobInterfaceUseDataReferences) = 'false' or
       num:i(0) != num:i(count(node:refs(as:modconf('Csm')/CsmJobs/CsmJob/*[CsmJobUsePort = 'true']/CsmJobPrimitiveRef)/CsmDecrypt/*/*[contains(node:name(.),'Processing') and node:value(.) = 'CSM_SYNCHRONOUS'])))"!][!//
                <SWC-BSW-RUNNABLE-MAPPING>
                  <BSW-ENTITY-REF DEST="BSW-CALLED-ENTITY">/AUTOSAR_Csm/BswModuleDescriptions/Csm/InternalBehavior_0/CE_Job_Decrypt</BSW-ENTITY-REF>
                  <SWC-RUNNABLE-REF DEST="RUNNABLE-ENTITY">/AUTOSAR_Csm/SwComponentTypes/Csm/CsmIntBeh/RE_Job_Decrypt</SWC-RUNNABLE-REF>
                </SWC-BSW-RUNNABLE-MAPPING>
    [!ENDIF!][!//
    [!IF "num:i(0) != num:i(count(node:refs(as:modconf('Csm')/CsmJobs/CsmJob/*[CsmJobUsePort = 'true']/CsmJobPrimitiveRef)/CsmEncrypt)) and
       (node:value(as:modconf('Csm')/CsmEbGeneral/CsmEbMisc/CsmEbCorrectionCsmAsyncJobInterfaceUseDataReferences) = 'false' or
       num:i(0) != num:i(count(node:refs(as:modconf('Csm')/CsmJobs/CsmJob/*[CsmJobUsePort = 'true']/CsmJobPrimitiveRef)/CsmEncrypt/*/*[contains(node:name(.),'Processing') and node:value(.) = 'CSM_SYNCHRONOUS'])))"!][!//
                <SWC-BSW-RUNNABLE-MAPPING>
                  <BSW-ENTITY-REF DEST="BSW-CALLED-ENTITY">/AUTOSAR_Csm/BswModuleDescriptions/Csm/InternalBehavior_0/CE_Job_Encrypt</BSW-ENTITY-REF>
                  <SWC-RUNNABLE-REF DEST="RUNNABLE-ENTITY">/AUTOSAR_Csm/SwComponentTypes/Csm/CsmIntBeh/RE_Job_Encrypt</SWC-RUNNABLE-REF>
                </SWC-BSW-RUNNABLE-MAPPING>
    [!ENDIF!][!//
    [!IF "num:i(0) != num:i(count(node:refs(as:modconf('Csm')/CsmJobs/CsmJob/*[CsmJobUsePort = 'true']/CsmJobPrimitiveRef)/CsmHash)) and
       (node:value(as:modconf('Csm')/CsmEbGeneral/CsmEbMisc/CsmEbCorrectionCsmAsyncJobInterfaceUseDataReferences) = 'false' or
       num:i(0) != num:i(count(node:refs(as:modconf('Csm')/CsmJobs/CsmJob/*[CsmJobUsePort = 'true']/CsmJobPrimitiveRef)/CsmHash/*/*[contains(node:name(.),'Processing') and node:value(.) = 'CSM_SYNCHRONOUS'])))"!][!//
                <SWC-BSW-RUNNABLE-MAPPING>
                  <BSW-ENTITY-REF DEST="BSW-CALLED-ENTITY">/AUTOSAR_Csm/BswModuleDescriptions/Csm/InternalBehavior_0/CE_Job_Hash</BSW-ENTITY-REF>
                  <SWC-RUNNABLE-REF DEST="RUNNABLE-ENTITY">/AUTOSAR_Csm/SwComponentTypes/Csm/CsmIntBeh/RE_Job_Hash</SWC-RUNNABLE-REF>
                </SWC-BSW-RUNNABLE-MAPPING>
    [!ENDIF!][!//
    [!IF "num:i(0) != num:i(count(node:refs(as:modconf('Csm')/CsmJobs/CsmJob/*[CsmJobUsePort = 'true']/CsmJobPrimitiveRef)/CsmMacGenerate)) and
       (node:value(as:modconf('Csm')/CsmEbGeneral/CsmEbMisc/CsmEbCorrectionCsmAsyncJobInterfaceUseDataReferences) = 'false' or
       num:i(0) != num:i(count(node:refs(as:modconf('Csm')/CsmJobs/CsmJob/*[CsmJobUsePort = 'true']/CsmJobPrimitiveRef)/CsmMacGenerate/*/*[contains(node:name(.),'Processing') and node:value(.) = 'CSM_SYNCHRONOUS'])))"!][!//
                <SWC-BSW-RUNNABLE-MAPPING>
                  <BSW-ENTITY-REF DEST="BSW-CALLED-ENTITY">/AUTOSAR_Csm/BswModuleDescriptions/Csm/InternalBehavior_0/CE_Job_MacGenerate</BSW-ENTITY-REF>
                  <SWC-RUNNABLE-REF DEST="RUNNABLE-ENTITY">/AUTOSAR_Csm/SwComponentTypes/Csm/CsmIntBeh/RE_Job_MacGenerate</SWC-RUNNABLE-REF>
                </SWC-BSW-RUNNABLE-MAPPING>
    [!ENDIF!][!//
    [!IF "num:i(0) != num:i(count(node:refs(as:modconf('Csm')/CsmJobs/CsmJob/*[CsmJobUsePort = 'true']/CsmJobPrimitiveRef)/CsmMacVerify)) and
       (node:value(as:modconf('Csm')/CsmEbGeneral/CsmEbMisc/CsmEbCorrectionCsmAsyncJobInterfaceUseDataReferences) = 'false' or
       num:i(0) != num:i(count(node:refs(as:modconf('Csm')/CsmJobs/CsmJob/*[CsmJobUsePort = 'true']/CsmJobPrimitiveRef)/CsmMacVerify/*/*[contains(node:name(.),'Processing') and node:value(.) = 'CSM_SYNCHRONOUS'])))"!][!//
                <SWC-BSW-RUNNABLE-MAPPING>
                  <BSW-ENTITY-REF DEST="BSW-CALLED-ENTITY">/AUTOSAR_Csm/BswModuleDescriptions/Csm/InternalBehavior_0/CE_Job_MacVerify</BSW-ENTITY-REF>
                  <SWC-RUNNABLE-REF DEST="RUNNABLE-ENTITY">/AUTOSAR_Csm/SwComponentTypes/Csm/CsmIntBeh/RE_Job_MacVerify</SWC-RUNNABLE-REF>
                </SWC-BSW-RUNNABLE-MAPPING>
    [!ENDIF!][!//
    [!IF "num:i(0) != num:i(count(node:refs(as:modconf('Csm')/CsmJobs/CsmJob/*[CsmJobUsePort = 'true']/CsmJobPrimitiveRef)/CsmSignatureGenerate)) and
       (node:value(as:modconf('Csm')/CsmEbGeneral/CsmEbMisc/CsmEbCorrectionCsmAsyncJobInterfaceUseDataReferences) = 'false' or
       num:i(0) != num:i(count(node:refs(as:modconf('Csm')/CsmJobs/CsmJob/*[CsmJobUsePort = 'true']/CsmJobPrimitiveRef)/CsmSignatureGenerate/*/*[contains(node:name(.),'Processing') and node:value(.) = 'CSM_SYNCHRONOUS'])))"!][!//
                <SWC-BSW-RUNNABLE-MAPPING>
                  <BSW-ENTITY-REF DEST="BSW-CALLED-ENTITY">/AUTOSAR_Csm/BswModuleDescriptions/Csm/InternalBehavior_0/CE_Job_SignatureGenerate</BSW-ENTITY-REF>
                  <SWC-RUNNABLE-REF DEST="RUNNABLE-ENTITY">/AUTOSAR_Csm/SwComponentTypes/Csm/CsmIntBeh/RE_Job_SignatureGenerate</SWC-RUNNABLE-REF>
                </SWC-BSW-RUNNABLE-MAPPING>
    [!ENDIF!][!//
    [!IF "num:i(0) != num:i(count(node:refs(as:modconf('Csm')/CsmJobs/CsmJob/*[CsmJobUsePort = 'true']/CsmJobPrimitiveRef)/CsmSignatureVerify)) and
       (node:value(as:modconf('Csm')/CsmEbGeneral/CsmEbMisc/CsmEbCorrectionCsmAsyncJobInterfaceUseDataReferences) = 'false' or
       num:i(0) != num:i(count(node:refs(as:modconf('Csm')/CsmJobs/CsmJob/*[CsmJobUsePort = 'true']/CsmJobPrimitiveRef)/CsmSignatureVerify/*/*[contains(node:name(.),'Processing') and node:value(.) = 'CSM_SYNCHRONOUS'])))"!][!//
                <SWC-BSW-RUNNABLE-MAPPING>
                  <BSW-ENTITY-REF DEST="BSW-CALLED-ENTITY">/AUTOSAR_Csm/BswModuleDescriptions/Csm/InternalBehavior_0/CE_Job_SignatureVerify</BSW-ENTITY-REF>
                  <SWC-RUNNABLE-REF DEST="RUNNABLE-ENTITY">/AUTOSAR_Csm/SwComponentTypes/Csm/CsmIntBeh/RE_Job_SignatureVerify</SWC-RUNNABLE-REF>
                </SWC-BSW-RUNNABLE-MAPPING>
    [!ENDIF!][!//
    [!IF "num:i(0) != num:i(count(node:refs(as:modconf('Csm')/CsmJobs/CsmJob/*[CsmJobUsePort = 'true']/CsmJobPrimitiveRef)/CsmRandomGenerate)) and
       (node:value(as:modconf('Csm')/CsmEbGeneral/CsmEbMisc/CsmEbCorrectionCsmAsyncJobInterfaceUseDataReferences) = 'false' or
       num:i(0) != num:i(count(node:refs(as:modconf('Csm')/CsmJobs/CsmJob/*[CsmJobUsePort = 'true']/CsmJobPrimitiveRef)/CsmRandomGenerate/*/*[contains(node:name(.),'Processing') and node:value(.) = 'CSM_SYNCHRONOUS'])))"!][!//
                <SWC-BSW-RUNNABLE-MAPPING>
                  <BSW-ENTITY-REF DEST="BSW-CALLED-ENTITY">/AUTOSAR_Csm/BswModuleDescriptions/Csm/InternalBehavior_0/CE_Job_RandomGenerate</BSW-ENTITY-REF>
                  <SWC-RUNNABLE-REF DEST="RUNNABLE-ENTITY">/AUTOSAR_Csm/SwComponentTypes/Csm/CsmIntBeh/RE_Job_RandomGenerate</SWC-RUNNABLE-REF>
                </SWC-BSW-RUNNABLE-MAPPING>
    [!ENDIF!][!//
    [!IF "node:value(as:modconf('Csm')/CsmEbGeneral/CsmEbMisc/CsmEbCorrectionCsmAsyncJobInterfaceUseDataReferences) = 'true' and num:i(0) != num:i(count(node:refs(as:modconf('Csm')/CsmJobs/CsmJob/*[CsmJobUsePort = 'true']/CsmJobPrimitiveRef)/CsmAEADDecrypt/*/*[contains(node:name(.),'Processing') and node:value(.) = 'CSM_ASYNCHRONOUS']))"!][!//
                <SWC-BSW-RUNNABLE-MAPPING>
                  <BSW-ENTITY-REF DEST="BSW-CALLED-ENTITY">/AUTOSAR_Csm/BswModuleDescriptions/Csm/InternalBehavior_0/CE_Job_AEADDecrypt_OAW</BSW-ENTITY-REF>
                  <SWC-RUNNABLE-REF DEST="RUNNABLE-ENTITY">/AUTOSAR_Csm/SwComponentTypes/Csm/CsmIntBeh/RE_Job_AEADDecrypt_OAW</SWC-RUNNABLE-REF>
                </SWC-BSW-RUNNABLE-MAPPING>
    [!ENDIF!][!//
    [!IF "node:value(as:modconf('Csm')/CsmEbGeneral/CsmEbMisc/CsmEbCorrectionCsmAsyncJobInterfaceUseDataReferences) = 'true' and num:i(0) != num:i(count(node:refs(as:modconf('Csm')/CsmJobs/CsmJob/*[CsmJobUsePort = 'true']/CsmJobPrimitiveRef)/CsmAEADEncrypt/*/*[contains(node:name(.),'Processing') and node:value(.) = 'CSM_ASYNCHRONOUS']))"!][!//
                <SWC-BSW-RUNNABLE-MAPPING>
                  <BSW-ENTITY-REF DEST="BSW-CALLED-ENTITY">/AUTOSAR_Csm/BswModuleDescriptions/Csm/InternalBehavior_0/CE_Job_AEADEncrypt_OAW</BSW-ENTITY-REF>
                  <SWC-RUNNABLE-REF DEST="RUNNABLE-ENTITY">/AUTOSAR_Csm/SwComponentTypes/Csm/CsmIntBeh/RE_Job_AEADEncrypt_OAW</SWC-RUNNABLE-REF>
                </SWC-BSW-RUNNABLE-MAPPING>
    [!ENDIF!][!//
    [!IF "node:value(as:modconf('Csm')/CsmEbGeneral/CsmEbMisc/CsmEbCorrectionCsmAsyncJobInterfaceUseDataReferences) = 'true' and num:i(0) != num:i(count(node:refs(as:modconf('Csm')/CsmJobs/CsmJob/*[CsmJobUsePort = 'true']/CsmJobPrimitiveRef)/CsmDecrypt/*/*[contains(node:name(.),'Processing') and node:value(.) = 'CSM_ASYNCHRONOUS']))"!][!//
                <SWC-BSW-RUNNABLE-MAPPING>
                  <BSW-ENTITY-REF DEST="BSW-CALLED-ENTITY">/AUTOSAR_Csm/BswModuleDescriptions/Csm/InternalBehavior_0/CE_Job_Decrypt_OAW</BSW-ENTITY-REF>
                  <SWC-RUNNABLE-REF DEST="RUNNABLE-ENTITY">/AUTOSAR_Csm/SwComponentTypes/Csm/CsmIntBeh/RE_Job_Decrypt_OAW</SWC-RUNNABLE-REF>
                </SWC-BSW-RUNNABLE-MAPPING>
    [!ENDIF!][!//
    [!IF "node:value(as:modconf('Csm')/CsmEbGeneral/CsmEbMisc/CsmEbCorrectionCsmAsyncJobInterfaceUseDataReferences) = 'true' and num:i(0) != num:i(count(node:refs(as:modconf('Csm')/CsmJobs/CsmJob/*[CsmJobUsePort = 'true']/CsmJobPrimitiveRef)/CsmEncrypt/*/*[contains(node:name(.),'Processing') and node:value(.) = 'CSM_ASYNCHRONOUS']))"!][!//
                <SWC-BSW-RUNNABLE-MAPPING>
                  <BSW-ENTITY-REF DEST="BSW-CALLED-ENTITY">/AUTOSAR_Csm/BswModuleDescriptions/Csm/InternalBehavior_0/CE_Job_Encrypt_OAW</BSW-ENTITY-REF>
                  <SWC-RUNNABLE-REF DEST="RUNNABLE-ENTITY">/AUTOSAR_Csm/SwComponentTypes/Csm/CsmIntBeh/RE_Job_Encrypt_OAW</SWC-RUNNABLE-REF>
                </SWC-BSW-RUNNABLE-MAPPING>
    [!ENDIF!][!//
    [!IF "node:value(as:modconf('Csm')/CsmEbGeneral/CsmEbMisc/CsmEbCorrectionCsmAsyncJobInterfaceUseDataReferences) = 'true' and num:i(0) != num:i(count(node:refs(as:modconf('Csm')/CsmJobs/CsmJob/*[CsmJobUsePort = 'true']/CsmJobPrimitiveRef)/CsmHash/*/*[contains(node:name(.),'Processing') and node:value(.) = 'CSM_ASYNCHRONOUS']))"!][!//
                <SWC-BSW-RUNNABLE-MAPPING>
                  <BSW-ENTITY-REF DEST="BSW-CALLED-ENTITY">/AUTOSAR_Csm/BswModuleDescriptions/Csm/InternalBehavior_0/CE_Job_Hash_OAW</BSW-ENTITY-REF>
                  <SWC-RUNNABLE-REF DEST="RUNNABLE-ENTITY">/AUTOSAR_Csm/SwComponentTypes/Csm/CsmIntBeh/RE_Job_Hash_OAW</SWC-RUNNABLE-REF>
                </SWC-BSW-RUNNABLE-MAPPING>
    [!ENDIF!][!//
    [!IF "node:value(as:modconf('Csm')/CsmEbGeneral/CsmEbMisc/CsmEbCorrectionCsmAsyncJobInterfaceUseDataReferences) = 'true' and num:i(0) != num:i(count(node:refs(as:modconf('Csm')/CsmJobs/CsmJob/*[CsmJobUsePort = 'true']/CsmJobPrimitiveRef)/CsmMacGenerate/*/*[contains(node:name(.),'Processing') and node:value(.) = 'CSM_ASYNCHRONOUS']))"!][!//
                <SWC-BSW-RUNNABLE-MAPPING>
                  <BSW-ENTITY-REF DEST="BSW-CALLED-ENTITY">/AUTOSAR_Csm/BswModuleDescriptions/Csm/InternalBehavior_0/CE_Job_MacGenerate_OAW</BSW-ENTITY-REF>
                  <SWC-RUNNABLE-REF DEST="RUNNABLE-ENTITY">/AUTOSAR_Csm/SwComponentTypes/Csm/CsmIntBeh/RE_Job_MacGenerate_OAW</SWC-RUNNABLE-REF>
                </SWC-BSW-RUNNABLE-MAPPING>
    [!ENDIF!][!//
    [!IF "node:value(as:modconf('Csm')/CsmEbGeneral/CsmEbMisc/CsmEbCorrectionCsmAsyncJobInterfaceUseDataReferences) = 'true' and num:i(0) != num:i(count(node:refs(as:modconf('Csm')/CsmJobs/CsmJob/*[CsmJobUsePort = 'true']/CsmJobPrimitiveRef)/CsmMacVerify/*/*[contains(node:name(.),'Processing') and node:value(.) = 'CSM_ASYNCHRONOUS']))"!][!//
                <SWC-BSW-RUNNABLE-MAPPING>
                  <BSW-ENTITY-REF DEST="BSW-CALLED-ENTITY">/AUTOSAR_Csm/BswModuleDescriptions/Csm/InternalBehavior_0/CE_Job_MacVerify_OAW</BSW-ENTITY-REF>
                  <SWC-RUNNABLE-REF DEST="RUNNABLE-ENTITY">/AUTOSAR_Csm/SwComponentTypes/Csm/CsmIntBeh/RE_Job_MacVerify_OAW</SWC-RUNNABLE-REF>
                </SWC-BSW-RUNNABLE-MAPPING>
    [!ENDIF!][!//
    [!IF "node:value(as:modconf('Csm')/CsmEbGeneral/CsmEbMisc/CsmEbCorrectionCsmAsyncJobInterfaceUseDataReferences) = 'true' and num:i(0) != num:i(count(node:refs(as:modconf('Csm')/CsmJobs/CsmJob/*[CsmJobUsePort = 'true']/CsmJobPrimitiveRef)/CsmSignatureGenerate/*/*[contains(node:name(.),'Processing') and node:value(.) = 'CSM_ASYNCHRONOUS']))"!][!//
                <SWC-BSW-RUNNABLE-MAPPING>
                  <BSW-ENTITY-REF DEST="BSW-CALLED-ENTITY">/AUTOSAR_Csm/BswModuleDescriptions/Csm/InternalBehavior_0/CE_Job_SignatureGenerate_OAW</BSW-ENTITY-REF>
                  <SWC-RUNNABLE-REF DEST="RUNNABLE-ENTITY">/AUTOSAR_Csm/SwComponentTypes/Csm/CsmIntBeh/RE_Job_SignatureGenerate_OAW</SWC-RUNNABLE-REF>
                </SWC-BSW-RUNNABLE-MAPPING>
    [!ENDIF!][!//
    [!IF "node:value(as:modconf('Csm')/CsmEbGeneral/CsmEbMisc/CsmEbCorrectionCsmAsyncJobInterfaceUseDataReferences) = 'true' and num:i(0) != num:i(count(node:refs(as:modconf('Csm')/CsmJobs/CsmJob/*[CsmJobUsePort = 'true']/CsmJobPrimitiveRef)/CsmSignatureVerify/*/*[contains(node:name(.),'Processing') and node:value(.) = 'CSM_ASYNCHRONOUS']))"!][!//
                <SWC-BSW-RUNNABLE-MAPPING>
                  <BSW-ENTITY-REF DEST="BSW-CALLED-ENTITY">/AUTOSAR_Csm/BswModuleDescriptions/Csm/InternalBehavior_0/CE_Job_SignatureVerify_OAW</BSW-ENTITY-REF>
                  <SWC-RUNNABLE-REF DEST="RUNNABLE-ENTITY">/AUTOSAR_Csm/SwComponentTypes/Csm/CsmIntBeh/RE_Job_SignatureVerify_OAW</SWC-RUNNABLE-REF>
                </SWC-BSW-RUNNABLE-MAPPING>
    [!ENDIF!][!//
    [!IF "node:value(as:modconf('Csm')/CsmEbGeneral/CsmEbMisc/CsmEbCorrectionCsmAsyncJobInterfaceUseDataReferences) = 'true' and num:i(0) != num:i(count(node:refs(as:modconf('Csm')/CsmJobs/CsmJob/*[CsmJobUsePort = 'true']/CsmJobPrimitiveRef)/CsmRandomGenerate/*/*[contains(node:name(.),'Processing') and node:value(.) = 'CSM_ASYNCHRONOUS']))"!][!//
                <SWC-BSW-RUNNABLE-MAPPING>
                  <BSW-ENTITY-REF DEST="BSW-CALLED-ENTITY">/AUTOSAR_Csm/BswModuleDescriptions/Csm/InternalBehavior_0/CE_Job_RandomGenerate_OAW</BSW-ENTITY-REF>
                  <SWC-RUNNABLE-REF DEST="RUNNABLE-ENTITY">/AUTOSAR_Csm/SwComponentTypes/Csm/CsmIntBeh/RE_Job_RandomGenerate_OAW</SWC-RUNNABLE-REF>
                </SWC-BSW-RUNNABLE-MAPPING>
    [!ENDIF!][!//
    [!IF "num:i(0) != (num:i(count(node:refs(as:modconf('Csm')/CsmJobs/CsmJob/*[CsmJobUsePort = 'true']/CsmJobPrimitiveRef)/*)) - num:i(count(node:refs(as:modconf('Csm')/CsmJobs/CsmJob/*[CsmJobUsePort = 'true']/CsmJobPrimitiveRef)/CsmRandomGenerate))) or
        (node:value(as:modconf('Csm')/CsmEbGeneral/CsmEbMisc/CsmEbCorrectionCsmAsyncJobInterfaceUseDataReferences) = 'true' and num:i(0) != num:i(count(node:refs(as:modconf('Csm')/CsmJobs/CsmJob/*[CsmJobUsePort = 'true']/CsmJobPrimitiveRef)/*/*/*[contains(node:name(.),'Processing') and node:value(.) = 'CSM_ASYNCHRONOUS'])))"!][!//
                <SWC-BSW-RUNNABLE-MAPPING>
                  <BSW-ENTITY-REF DEST="BSW-CALLED-ENTITY">/AUTOSAR_Csm/BswModuleDescriptions/Csm/InternalBehavior_0/CE_Job_CancelJob</BSW-ENTITY-REF>
                  <SWC-RUNNABLE-REF DEST="RUNNABLE-ENTITY">/AUTOSAR_Csm/SwComponentTypes/Csm/CsmIntBeh/RE_Job_CancelJob</SWC-RUNNABLE-REF>
                </SWC-BSW-RUNNABLE-MAPPING>
    [!ENDIF!][!//
    [!IF "node:value(as:modconf('Csm')/CsmEbGeneral/CsmEbMisc/CsmEbCorrectionCsmAsyncJobInterfaceUseDataReferences) = 'true' and num:i(0) != num:i(count(node:refs(as:modconf('Csm')/CsmJobs/CsmJob/*[CsmJobUsePort = 'true']/CsmJobPrimitiveRef)/*/*/*[contains(node:name(.),'Processing') and node:value(.) = 'CSM_ASYNCHRONOUS']))"!][!//
                <SWC-BSW-RUNNABLE-MAPPING>
                  <BSW-ENTITY-REF DEST="BSW-CALLED-ENTITY">/AUTOSAR_Csm/BswModuleDescriptions/Csm/InternalBehavior_0/CE_Job_CancelJob_OAW</BSW-ENTITY-REF>
                  <SWC-RUNNABLE-REF DEST="RUNNABLE-ENTITY">/AUTOSAR_Csm/SwComponentTypes/Csm/CsmIntBeh/RE_Job_CancelJob_OAW</SWC-RUNNABLE-REF>
                </SWC-BSW-RUNNABLE-MAPPING>
    [!ENDIF!][!//
    [!IF "node:value(as:modconf('Csm')/CsmEbGeneral/CsmEbMisc/CsmEbCorrectionCsmJobBasedCallbacknotificationPorts) = 'false'"!][!//
      [!LOOP "as:modconf('Csm')/CsmCallbacks/CsmCallback/*[node:empty(./CsmCallbackFunc)]"!][!//
        [!VAR "vCbk" = "node:name(.)"!][!//
                <SWC-BSW-RUNNABLE-MAPPING>
                  <BSW-ENTITY-REF DEST="BSW-SCHEDULABLE-ENTITY">/AUTOSAR_Csm/BswModuleDescriptions/Csm/InternalBehavior_0/SE_[!"$vCbk"!]_CallbackNotification</BSW-ENTITY-REF>
                  <SWC-RUNNABLE-REF DEST="RUNNABLE-ENTITY">/AUTOSAR_Csm/SwComponentTypes/Csm/CsmIntBeh/RE_[!"$vCbk"!]_CallbackNotification</SWC-RUNNABLE-REF>
                </SWC-BSW-RUNNABLE-MAPPING>
      [!ENDLOOP!][!//
    [!ELSE!][!//
      [!LOOP "as:modconf('Csm')/CsmJobs/CsmJob/*[CsmJobUsePort = 'true']"!][!//
        [!IF "node:exists(node:ref(./CsmJobPrimitiveRef)/*) = 'true' and node:value(node:ref(./CsmJobPrimitiveRef)/*/*/*[contains(node:name(.),'Processing')]) = 'CSM_ASYNCHRONOUS'"!][!//
            [!VAR "vJob" = "node:name(.)"!][!//
                <SWC-BSW-RUNNABLE-MAPPING>
                  <BSW-ENTITY-REF DEST="BSW-SCHEDULABLE-ENTITY">/AUTOSAR_Csm/BswModuleDescriptions/Csm/InternalBehavior_0/SE_CallbackNotification_[!"$vJob"!]</BSW-ENTITY-REF>
                  <SWC-RUNNABLE-REF DEST="RUNNABLE-ENTITY">/AUTOSAR_Csm/SwComponentTypes/Csm/CsmIntBeh/RE_CallbackNotification_[!"$vJob"!]</SWC-RUNNABLE-REF>
                </SWC-BSW-RUNNABLE-MAPPING>
        [!ENDIF!][!//
      [!ENDLOOP!][!//
    [!ENDIF!][!//
              </RUNNABLE-MAPPINGS>
              <SWC-BEHAVIOR-REF DEST="SWC-INTERNAL-BEHAVIOR">/AUTOSAR_Csm/SwComponentTypes/Csm/CsmIntBeh</SWC-BEHAVIOR-REF>
            </SWC-BSW-MAPPING>
  [!ENDIF!][!//
  [!LOOP "node:refs(as:modconf('Csm')/CsmMainFunction/*/CsmMainFunctionPartitionRef)"!][!//
    [!VAR "vEcucPartition" = "node:name(.)"!]
    [!IF "num:i(0) != num:i(count(as:modconf('Csm')/CsmJobs/CsmJob/*[CsmJobUsePort = 'true' and node:name(node:ref(node:ref(node:ref(./CsmJobQueueRef)/CsmQueueMainFunctionRef)/CsmMainFunctionPartitionRef)) = $vEcucPartition]))"!][!//
            <SWC-BSW-MAPPING>
              <SHORT-NAME>SwcBswMapping_[!"$vEcucPartition"!]</SHORT-NAME>
              <BSW-BEHAVIOR-REF DEST="BSW-INTERNAL-BEHAVIOR">/AUTOSAR_Csm/BswModuleDescriptions/Csm/InternalBehavior_[!"$vEcucPartition"!]</BSW-BEHAVIOR-REF>
              <RUNNABLE-MAPPINGS>
      [!LOOP "as:modconf('Csm')/CsmMainFunction/*[node:name(node:ref(./CsmMainFunctionPartitionRef)) = $vEcucPartition]"!][!//
        [!VAR "vMainFunction" = "node:name(.)"!][!//
        [!IF "num:i(0) < num:i(count(node:refs(as:modconf('Csm')/CsmJobs/CsmJob/*[node:name(node:ref(node:ref(./CsmJobQueueRef)/CsmQueueMainFunctionRef)) = $vMainFunction]/CsmJobPrimitiveRef)/*/*/*[contains(node:name(.),'Processing') and node:value(.) = 'CSM_ASYNCHRONOUS']))"!][!//
                <SWC-BSW-RUNNABLE-MAPPING>
                  <BSW-ENTITY-REF DEST="BSW-SCHEDULABLE-ENTITY">/AUTOSAR_Csm/BswModuleDescriptions/Csm/InternalBehavior_[!"$vEcucPartition"!]/Csm_MainFunction_[!"node:name(.)"!]</BSW-ENTITY-REF>
                  <SWC-RUNNABLE-REF DEST="RUNNABLE-ENTITY">/AUTOSAR_Csm/SwComponentTypes/Csm_[!"$vEcucPartition"!]/CsmIntBeh_[!"$vEcucPartition"!]/RE_MainFunction_[!"node:name(.)"!]</SWC-RUNNABLE-REF>
                </SWC-BSW-RUNNABLE-MAPPING>
        [!ENDIF!][!//
      [!ENDLOOP!][!//
      [!IF "count(as:modconf('Csm')/CsmJobs/CsmJob/*[node:name(node:ref(node:ref(node:ref(./CsmJobQueueRef)/CsmQueueMainFunctionRef)/CsmMainFunctionPartitionRef)) = $vEcucPartition and node:ref(./CsmJobKeyRef)/CsmKeyUsePort = 'true']) > 0"!][!//
                <SWC-BSW-RUNNABLE-MAPPING>
                  <BSW-ENTITY-REF DEST="BSW-CALLED-ENTITY">/AUTOSAR_Csm/BswModuleDescriptions/Csm/InternalBehavior_[!"$vEcucPartition"!]/CE_Key_CertificateParse_[!"$vEcucPartition"!]</BSW-ENTITY-REF>
                  <SWC-RUNNABLE-REF DEST="RUNNABLE-ENTITY">/AUTOSAR_Csm/SwComponentTypes/Csm_[!"$vEcucPartition"!]/CsmIntBeh_[!"$vEcucPartition"!]/RE_Key_CertificateParse_[!"$vEcucPartition"!]</SWC-RUNNABLE-REF>
                </SWC-BSW-RUNNABLE-MAPPING>
                <SWC-BSW-RUNNABLE-MAPPING>
                  <BSW-ENTITY-REF DEST="BSW-CALLED-ENTITY">/AUTOSAR_Csm/BswModuleDescriptions/Csm/InternalBehavior_[!"$vEcucPartition"!]/CE_Key_CertificateVerify_[!"$vEcucPartition"!]</BSW-ENTITY-REF>
                  <SWC-RUNNABLE-REF DEST="RUNNABLE-ENTITY">/AUTOSAR_Csm/SwComponentTypes/Csm_[!"$vEcucPartition"!]/CsmIntBeh_[!"$vEcucPartition"!]/RE_Key_CertificateVerify_[!"$vEcucPartition"!]</SWC-RUNNABLE-REF>
                </SWC-BSW-RUNNABLE-MAPPING>
                <SWC-BSW-RUNNABLE-MAPPING>
                  <BSW-ENTITY-REF DEST="BSW-CALLED-ENTITY">/AUTOSAR_Csm/BswModuleDescriptions/Csm/InternalBehavior_[!"$vEcucPartition"!]/CE_Key_KeyCopy_[!"$vEcucPartition"!]</BSW-ENTITY-REF>
                  <SWC-RUNNABLE-REF DEST="RUNNABLE-ENTITY">/AUTOSAR_Csm/SwComponentTypes/Csm_[!"$vEcucPartition"!]/CsmIntBeh_[!"$vEcucPartition"!]/RE_Key_KeyCopy_[!"$vEcucPartition"!]</SWC-RUNNABLE-REF>
                </SWC-BSW-RUNNABLE-MAPPING>
                <SWC-BSW-RUNNABLE-MAPPING>
                  <BSW-ENTITY-REF DEST="BSW-CALLED-ENTITY">/AUTOSAR_Csm/BswModuleDescriptions/Csm/InternalBehavior_[!"$vEcucPartition"!]/CE_Key_KeyDerive_[!"$vEcucPartition"!]</BSW-ENTITY-REF>
                  <SWC-RUNNABLE-REF DEST="RUNNABLE-ENTITY">/AUTOSAR_Csm/SwComponentTypes/Csm_[!"$vEcucPartition"!]/CsmIntBeh_[!"$vEcucPartition"!]/RE_Key_KeyDerive_[!"$vEcucPartition"!]</SWC-RUNNABLE-REF>
                </SWC-BSW-RUNNABLE-MAPPING>
                <SWC-BSW-RUNNABLE-MAPPING>
                  <BSW-ENTITY-REF DEST="BSW-CALLED-ENTITY">/AUTOSAR_Csm/BswModuleDescriptions/Csm/InternalBehavior_[!"$vEcucPartition"!]/CE_Key_KeyElementCopy_[!"$vEcucPartition"!]</BSW-ENTITY-REF>
                  <SWC-RUNNABLE-REF DEST="RUNNABLE-ENTITY">/AUTOSAR_Csm/SwComponentTypes/Csm_[!"$vEcucPartition"!]/CsmIntBeh_[!"$vEcucPartition"!]/RE_Key_KeyElementCopy_[!"$vEcucPartition"!]</SWC-RUNNABLE-REF>
                </SWC-BSW-RUNNABLE-MAPPING>
                <SWC-BSW-RUNNABLE-MAPPING>
                  <BSW-ENTITY-REF DEST="BSW-CALLED-ENTITY">/AUTOSAR_Csm/BswModuleDescriptions/Csm/InternalBehavior_[!"$vEcucPartition"!]/CE_Key_KeyElementGet_[!"$vEcucPartition"!]</BSW-ENTITY-REF>
                  <SWC-RUNNABLE-REF DEST="RUNNABLE-ENTITY">/AUTOSAR_Csm/SwComponentTypes/Csm_[!"$vEcucPartition"!]/CsmIntBeh_[!"$vEcucPartition"!]/RE_Key_KeyElementGet_[!"$vEcucPartition"!]</SWC-RUNNABLE-REF>
                </SWC-BSW-RUNNABLE-MAPPING>
                <SWC-BSW-RUNNABLE-MAPPING>
                  <BSW-ENTITY-REF DEST="BSW-CALLED-ENTITY">/AUTOSAR_Csm/BswModuleDescriptions/Csm/InternalBehavior_[!"$vEcucPartition"!]/CE_Key_KeyElementSet_[!"$vEcucPartition"!]</BSW-ENTITY-REF>
                  <SWC-RUNNABLE-REF DEST="RUNNABLE-ENTITY">/AUTOSAR_Csm/SwComponentTypes/Csm_[!"$vEcucPartition"!]/CsmIntBeh_[!"$vEcucPartition"!]/RE_Key_KeyElementSet_[!"$vEcucPartition"!]</SWC-RUNNABLE-REF>
                </SWC-BSW-RUNNABLE-MAPPING>
                <SWC-BSW-RUNNABLE-MAPPING>
                  <BSW-ENTITY-REF DEST="BSW-CALLED-ENTITY">/AUTOSAR_Csm/BswModuleDescriptions/Csm/InternalBehavior_[!"$vEcucPartition"!]/CE_Key_KeyExchangeCalcPubVal_[!"$vEcucPartition"!]</BSW-ENTITY-REF>
                  <SWC-RUNNABLE-REF DEST="RUNNABLE-ENTITY">/AUTOSAR_Csm/SwComponentTypes/Csm_[!"$vEcucPartition"!]/CsmIntBeh_[!"$vEcucPartition"!]/RE_Key_KeyExchangeCalcPubVal_[!"$vEcucPartition"!]</SWC-RUNNABLE-REF>
                </SWC-BSW-RUNNABLE-MAPPING>
                <SWC-BSW-RUNNABLE-MAPPING>
                  <BSW-ENTITY-REF DEST="BSW-CALLED-ENTITY">/AUTOSAR_Csm/BswModuleDescriptions/Csm/InternalBehavior_[!"$vEcucPartition"!]/CE_Key_KeyExchangeCalcSecret_[!"$vEcucPartition"!]</BSW-ENTITY-REF>
                  <SWC-RUNNABLE-REF DEST="RUNNABLE-ENTITY">/AUTOSAR_Csm/SwComponentTypes/Csm_[!"$vEcucPartition"!]/CsmIntBeh_[!"$vEcucPartition"!]/RE_Key_KeyExchangeCalcSecret_[!"$vEcucPartition"!]</SWC-RUNNABLE-REF>
                </SWC-BSW-RUNNABLE-MAPPING>
                <SWC-BSW-RUNNABLE-MAPPING>
                  <BSW-ENTITY-REF DEST="BSW-CALLED-ENTITY">/AUTOSAR_Csm/BswModuleDescriptions/Csm/InternalBehavior_[!"$vEcucPartition"!]/CE_Key_KeyGenerate_[!"$vEcucPartition"!]</BSW-ENTITY-REF>
                  <SWC-RUNNABLE-REF DEST="RUNNABLE-ENTITY">/AUTOSAR_Csm/SwComponentTypes/Csm_[!"$vEcucPartition"!]/CsmIntBeh_[!"$vEcucPartition"!]/RE_Key_KeyGenerate_[!"$vEcucPartition"!]</SWC-RUNNABLE-REF>
                </SWC-BSW-RUNNABLE-MAPPING>
                <SWC-BSW-RUNNABLE-MAPPING>
                  <BSW-ENTITY-REF DEST="BSW-CALLED-ENTITY">/AUTOSAR_Csm/BswModuleDescriptions/Csm/InternalBehavior_[!"$vEcucPartition"!]/CE_Key_KeySetValid_[!"$vEcucPartition"!]</BSW-ENTITY-REF>
                  <SWC-RUNNABLE-REF DEST="RUNNABLE-ENTITY">/AUTOSAR_Csm/SwComponentTypes/Csm_[!"$vEcucPartition"!]/CsmIntBeh_[!"$vEcucPartition"!]/RE_Key_KeySetValid_[!"$vEcucPartition"!]</SWC-RUNNABLE-REF>
                </SWC-BSW-RUNNABLE-MAPPING>
  [!IF "node:value(as:modconf('Csm')/CsmEbGeneral/CsmEbMisc/CsmEbEnhancementApiCsmKeySetInvalid) = 'true'"!][!//
                <SWC-BSW-RUNNABLE-MAPPING>
                  <BSW-ENTITY-REF DEST="BSW-CALLED-ENTITY">/AUTOSAR_Csm/BswModuleDescriptions/Csm/InternalBehavior_[!"$vEcucPartition"!]/CE_Key_KeySetInvalid_[!"$vEcucPartition"!]</BSW-ENTITY-REF>
                  <SWC-RUNNABLE-REF DEST="RUNNABLE-ENTITY">/AUTOSAR_Csm/SwComponentTypes/Csm_[!"$vEcucPartition"!]/CsmIntBeh_[!"$vEcucPartition"!]/RE_Key_KeySetInvalid_[!"$vEcucPartition"!]</SWC-RUNNABLE-REF>
                </SWC-BSW-RUNNABLE-MAPPING>
  [!ENDIF!][!//
  [!IF "node:value(as:modconf('Csm')/CsmEbGeneral/CsmEbMisc/CsmEbEnhancementApiCsmKeyGetStatus) = 'true'"!][!//
                <SWC-BSW-RUNNABLE-MAPPING>
                  <BSW-ENTITY-REF DEST="BSW-CALLED-ENTITY">/AUTOSAR_Csm/BswModuleDescriptions/Csm/InternalBehavior_[!"$vEcucPartition"!]/CE_Key_KeyGetStatus_[!"$vEcucPartition"!]</BSW-ENTITY-REF>
                  <SWC-RUNNABLE-REF DEST="RUNNABLE-ENTITY">/AUTOSAR_Csm/SwComponentTypes/Csm_[!"$vEcucPartition"!]/CsmIntBeh_[!"$vEcucPartition"!]/RE_Key_KeyGetStatus_[!"$vEcucPartition"!]</SWC-RUNNABLE-REF>
                </SWC-BSW-RUNNABLE-MAPPING>
  [!ENDIF!][!//
                <SWC-BSW-RUNNABLE-MAPPING>
                  <BSW-ENTITY-REF DEST="BSW-CALLED-ENTITY">/AUTOSAR_Csm/BswModuleDescriptions/Csm/InternalBehavior_[!"$vEcucPartition"!]/CE_Key_RandomSeed_[!"$vEcucPartition"!]</BSW-ENTITY-REF>
                  <SWC-RUNNABLE-REF DEST="RUNNABLE-ENTITY">/AUTOSAR_Csm/SwComponentTypes/Csm_[!"$vEcucPartition"!]/CsmIntBeh_[!"$vEcucPartition"!]/RE_Key_RandomSeed_[!"$vEcucPartition"!]</SWC-RUNNABLE-REF>
                </SWC-BSW-RUNNABLE-MAPPING>
      [!ENDIF!][!//
      [!IF "num:i(0) != num:i(count(node:refs(as:modconf('Csm')/CsmJobs/CsmJob/*[CsmJobUsePort = 'true'  and node:name(node:ref(node:ref(node:ref(./CsmJobQueueRef)/CsmQueueMainFunctionRef)/CsmMainFunctionPartitionRef)) = $vEcucPartition]/CsmJobPrimitiveRef)/CsmAEADDecrypt)) and
          (node:value(as:modconf('Csm')/CsmEbGeneral/CsmEbMisc/CsmEbCorrectionCsmAsyncJobInterfaceUseDataReferences) = 'false' or
          num:i(0) != num:i(count(node:refs(as:modconf('Csm')/CsmJobs/CsmJob/*[CsmJobUsePort = 'true'  and node:name(node:ref(node:ref(node:ref(./CsmJobQueueRef)/CsmQueueMainFunctionRef)/CsmMainFunctionPartitionRef)) = $vEcucPartition]/CsmJobPrimitiveRef)/CsmAEADDecrypt/*/*[contains(node:name(.),'Processing') and node:value(.) = 'CSM_SYNCHRONOUS'])))"!][!//
                  <SWC-BSW-RUNNABLE-MAPPING>
                  <BSW-ENTITY-REF DEST="BSW-CALLED-ENTITY">/AUTOSAR_Csm/BswModuleDescriptions/Csm/InternalBehavior_[!"$vEcucPartition"!]/CE_Job_AEADDecrypt_[!"$vEcucPartition"!]</BSW-ENTITY-REF>
                  <SWC-RUNNABLE-REF DEST="RUNNABLE-ENTITY">/AUTOSAR_Csm/SwComponentTypes/Csm_[!"$vEcucPartition"!]/CsmIntBeh_[!"$vEcucPartition"!]/RE_Job_AEADDecrypt_[!"$vEcucPartition"!]</SWC-RUNNABLE-REF>
                </SWC-BSW-RUNNABLE-MAPPING>
      [!ENDIF!][!//
      [!IF "num:i(0) != num:i(count(node:refs(as:modconf('Csm')/CsmJobs/CsmJob/*[CsmJobUsePort = 'true'  and node:name(node:ref(node:ref(node:ref(./CsmJobQueueRef)/CsmQueueMainFunctionRef)/CsmMainFunctionPartitionRef)) = $vEcucPartition]/CsmJobPrimitiveRef)/CsmAEADEncrypt)) and
          (node:value(as:modconf('Csm')/CsmEbGeneral/CsmEbMisc/CsmEbCorrectionCsmAsyncJobInterfaceUseDataReferences) = 'false' or
          num:i(0) != num:i(count(node:refs(as:modconf('Csm')/CsmJobs/CsmJob/*[CsmJobUsePort = 'true'  and node:name(node:ref(node:ref(node:ref(./CsmJobQueueRef)/CsmQueueMainFunctionRef)/CsmMainFunctionPartitionRef)) = $vEcucPartition]/CsmJobPrimitiveRef)/CsmAEADEncrypt/*/*[contains(node:name(.),'Processing') and node:value(.) = 'CSM_SYNCHRONOUS'])))"!][!//
                  <SWC-BSW-RUNNABLE-MAPPING>
                  <BSW-ENTITY-REF DEST="BSW-CALLED-ENTITY">/AUTOSAR_Csm/BswModuleDescriptions/Csm/InternalBehavior_[!"$vEcucPartition"!]/CE_Job_AEADEncrypt_[!"$vEcucPartition"!]</BSW-ENTITY-REF>
                  <SWC-RUNNABLE-REF DEST="RUNNABLE-ENTITY">/AUTOSAR_Csm/SwComponentTypes/Csm_[!"$vEcucPartition"!]/CsmIntBeh_[!"$vEcucPartition"!]/RE_Job_AEADEncrypt_[!"$vEcucPartition"!]</SWC-RUNNABLE-REF>
                </SWC-BSW-RUNNABLE-MAPPING>
      [!ENDIF!][!//
      [!IF "num:i(0) != num:i(count(node:refs(as:modconf('Csm')/CsmJobs/CsmJob/*[CsmJobUsePort = 'true'  and node:name(node:ref(node:ref(node:ref(./CsmJobQueueRef)/CsmQueueMainFunctionRef)/CsmMainFunctionPartitionRef)) = $vEcucPartition]/CsmJobPrimitiveRef)/CsmDecrypt)) and
          (node:value(as:modconf('Csm')/CsmEbGeneral/CsmEbMisc/CsmEbCorrectionCsmAsyncJobInterfaceUseDataReferences) = 'false' or
          num:i(0) != num:i(count(node:refs(as:modconf('Csm')/CsmJobs/CsmJob/*[CsmJobUsePort = 'true'  and node:name(node:ref(node:ref(node:ref(./CsmJobQueueRef)/CsmQueueMainFunctionRef)/CsmMainFunctionPartitionRef)) = $vEcucPartition]/CsmJobPrimitiveRef)/CsmDecrypt/*/*[contains(node:name(.),'Processing') and node:value(.) = 'CSM_SYNCHRONOUS'])))"!][!//
                  <SWC-BSW-RUNNABLE-MAPPING>
                  <BSW-ENTITY-REF DEST="BSW-CALLED-ENTITY">/AUTOSAR_Csm/BswModuleDescriptions/Csm/InternalBehavior_[!"$vEcucPartition"!]/CE_Job_Decrypt_[!"$vEcucPartition"!]</BSW-ENTITY-REF>
                  <SWC-RUNNABLE-REF DEST="RUNNABLE-ENTITY">/AUTOSAR_Csm/SwComponentTypes/Csm_[!"$vEcucPartition"!]/CsmIntBeh_[!"$vEcucPartition"!]/RE_Job_Decrypt_[!"$vEcucPartition"!]</SWC-RUNNABLE-REF>
                </SWC-BSW-RUNNABLE-MAPPING>
      [!ENDIF!][!//
      [!IF "num:i(0) != num:i(count(node:refs(as:modconf('Csm')/CsmJobs/CsmJob/*[CsmJobUsePort = 'true'  and node:name(node:ref(node:ref(node:ref(./CsmJobQueueRef)/CsmQueueMainFunctionRef)/CsmMainFunctionPartitionRef)) = $vEcucPartition]/CsmJobPrimitiveRef)/CsmEncrypt)) and
          (node:value(as:modconf('Csm')/CsmEbGeneral/CsmEbMisc/CsmEbCorrectionCsmAsyncJobInterfaceUseDataReferences) = 'false' or
          num:i(0) != num:i(count(node:refs(as:modconf('Csm')/CsmJobs/CsmJob/*[CsmJobUsePort = 'true'  and node:name(node:ref(node:ref(node:ref(./CsmJobQueueRef)/CsmQueueMainFunctionRef)/CsmMainFunctionPartitionRef)) = $vEcucPartition]/CsmJobPrimitiveRef)/CsmEncrypt/*/*[contains(node:name(.),'Processing') and node:value(.) = 'CSM_SYNCHRONOUS'])))"!][!//
                  <SWC-BSW-RUNNABLE-MAPPING>
                  <BSW-ENTITY-REF DEST="BSW-CALLED-ENTITY">/AUTOSAR_Csm/BswModuleDescriptions/Csm/InternalBehavior_[!"$vEcucPartition"!]/CE_Job_Encrypt_[!"$vEcucPartition"!]</BSW-ENTITY-REF>
                  <SWC-RUNNABLE-REF DEST="RUNNABLE-ENTITY">/AUTOSAR_Csm/SwComponentTypes/Csm_[!"$vEcucPartition"!]/CsmIntBeh_[!"$vEcucPartition"!]/RE_Job_Encrypt_[!"$vEcucPartition"!]</SWC-RUNNABLE-REF>
                </SWC-BSW-RUNNABLE-MAPPING>
      [!ENDIF!][!//
      [!IF "num:i(0) != num:i(count(node:refs(as:modconf('Csm')/CsmJobs/CsmJob/*[CsmJobUsePort = 'true'  and node:name(node:ref(node:ref(node:ref(./CsmJobQueueRef)/CsmQueueMainFunctionRef)/CsmMainFunctionPartitionRef)) = $vEcucPartition]/CsmJobPrimitiveRef)/CsmHash)) and
          (node:value(as:modconf('Csm')/CsmEbGeneral/CsmEbMisc/CsmEbCorrectionCsmAsyncJobInterfaceUseDataReferences) = 'false' or
          num:i(0) != num:i(count(node:refs(as:modconf('Csm')/CsmJobs/CsmJob/*[CsmJobUsePort = 'true'  and node:name(node:ref(node:ref(node:ref(./CsmJobQueueRef)/CsmQueueMainFunctionRef)/CsmMainFunctionPartitionRef)) = $vEcucPartition]/CsmJobPrimitiveRef)/CsmHash/*/*[contains(node:name(.),'Processing') and node:value(.) = 'CSM_SYNCHRONOUS'])))"!][!//
                  <SWC-BSW-RUNNABLE-MAPPING>
                  <BSW-ENTITY-REF DEST="BSW-CALLED-ENTITY">/AUTOSAR_Csm/BswModuleDescriptions/Csm/InternalBehavior_[!"$vEcucPartition"!]/CE_Job_Hash_[!"$vEcucPartition"!]</BSW-ENTITY-REF>
                  <SWC-RUNNABLE-REF DEST="RUNNABLE-ENTITY">/AUTOSAR_Csm/SwComponentTypes/Csm_[!"$vEcucPartition"!]/CsmIntBeh_[!"$vEcucPartition"!]/RE_Job_Hash_[!"$vEcucPartition"!]</SWC-RUNNABLE-REF>
                </SWC-BSW-RUNNABLE-MAPPING>
      [!ENDIF!][!//
      [!IF "num:i(0) != num:i(count(node:refs(as:modconf('Csm')/CsmJobs/CsmJob/*[CsmJobUsePort = 'true'  and node:name(node:ref(node:ref(node:ref(./CsmJobQueueRef)/CsmQueueMainFunctionRef)/CsmMainFunctionPartitionRef)) = $vEcucPartition]/CsmJobPrimitiveRef)/CsmMacGenerate)) and
          (node:value(as:modconf('Csm')/CsmEbGeneral/CsmEbMisc/CsmEbCorrectionCsmAsyncJobInterfaceUseDataReferences) = 'false' or
          num:i(0) != num:i(count(node:refs(as:modconf('Csm')/CsmJobs/CsmJob/*[CsmJobUsePort = 'true'  and node:name(node:ref(node:ref(node:ref(./CsmJobQueueRef)/CsmQueueMainFunctionRef)/CsmMainFunctionPartitionRef)) = $vEcucPartition]/CsmJobPrimitiveRef)/CsmMacGenerate/*/*[contains(node:name(.),'Processing') and node:value(.) = 'CSM_SYNCHRONOUS'])))"!][!//
                  <SWC-BSW-RUNNABLE-MAPPING>
                  <BSW-ENTITY-REF DEST="BSW-CALLED-ENTITY">/AUTOSAR_Csm/BswModuleDescriptions/Csm/InternalBehavior_[!"$vEcucPartition"!]/CE_Job_MacGenerate_[!"$vEcucPartition"!]</BSW-ENTITY-REF>
                  <SWC-RUNNABLE-REF DEST="RUNNABLE-ENTITY">/AUTOSAR_Csm/SwComponentTypes/Csm_[!"$vEcucPartition"!]/CsmIntBeh_[!"$vEcucPartition"!]/RE_Job_MacGenerate_[!"$vEcucPartition"!]</SWC-RUNNABLE-REF>
                </SWC-BSW-RUNNABLE-MAPPING>
      [!ENDIF!][!//
      [!IF "num:i(0) != num:i(count(node:refs(as:modconf('Csm')/CsmJobs/CsmJob/*[CsmJobUsePort = 'true'  and node:name(node:ref(node:ref(node:ref(./CsmJobQueueRef)/CsmQueueMainFunctionRef)/CsmMainFunctionPartitionRef)) = $vEcucPartition]/CsmJobPrimitiveRef)/CsmMacVerify)) and
          (node:value(as:modconf('Csm')/CsmEbGeneral/CsmEbMisc/CsmEbCorrectionCsmAsyncJobInterfaceUseDataReferences) = 'false' or
          num:i(0) != num:i(count(node:refs(as:modconf('Csm')/CsmJobs/CsmJob/*[CsmJobUsePort = 'true'  and node:name(node:ref(node:ref(node:ref(./CsmJobQueueRef)/CsmQueueMainFunctionRef)/CsmMainFunctionPartitionRef)) = $vEcucPartition]/CsmJobPrimitiveRef)/CsmMacVerify/*/*[contains(node:name(.),'Processing') and node:value(.) = 'CSM_SYNCHRONOUS'])))"!][!//
                  <SWC-BSW-RUNNABLE-MAPPING>
                  <BSW-ENTITY-REF DEST="BSW-CALLED-ENTITY">/AUTOSAR_Csm/BswModuleDescriptions/Csm/InternalBehavior_[!"$vEcucPartition"!]/CE_Job_MacVerify_[!"$vEcucPartition"!]</BSW-ENTITY-REF>
                  <SWC-RUNNABLE-REF DEST="RUNNABLE-ENTITY">/AUTOSAR_Csm/SwComponentTypes/Csm_[!"$vEcucPartition"!]/CsmIntBeh_[!"$vEcucPartition"!]/RE_Job_MacVerify_[!"$vEcucPartition"!]</SWC-RUNNABLE-REF>
                </SWC-BSW-RUNNABLE-MAPPING>
      [!ENDIF!][!//
      [!IF "num:i(0) != num:i(count(node:refs(as:modconf('Csm')/CsmJobs/CsmJob/*[CsmJobUsePort = 'true'  and node:name(node:ref(node:ref(node:ref(./CsmJobQueueRef)/CsmQueueMainFunctionRef)/CsmMainFunctionPartitionRef)) = $vEcucPartition]/CsmJobPrimitiveRef)/CsmSignatureGenerate)) and
          (node:value(as:modconf('Csm')/CsmEbGeneral/CsmEbMisc/CsmEbCorrectionCsmAsyncJobInterfaceUseDataReferences) = 'false' or
          num:i(0) != num:i(count(node:refs(as:modconf('Csm')/CsmJobs/CsmJob/*[CsmJobUsePort = 'true'  and node:name(node:ref(node:ref(node:ref(./CsmJobQueueRef)/CsmQueueMainFunctionRef)/CsmMainFunctionPartitionRef)) = $vEcucPartition]/CsmJobPrimitiveRef)/CsmSignatureGenerate/*/*[contains(node:name(.),'Processing') and node:value(.) = 'CSM_SYNCHRONOUS'])))"!][!//
                  <SWC-BSW-RUNNABLE-MAPPING>
                  <BSW-ENTITY-REF DEST="BSW-CALLED-ENTITY">/AUTOSAR_Csm/BswModuleDescriptions/Csm/InternalBehavior_[!"$vEcucPartition"!]/CE_Job_SignatureGenerate_[!"$vEcucPartition"!]</BSW-ENTITY-REF>
                  <SWC-RUNNABLE-REF DEST="RUNNABLE-ENTITY">/AUTOSAR_Csm/SwComponentTypes/Csm_[!"$vEcucPartition"!]/CsmIntBeh_[!"$vEcucPartition"!]/RE_Job_SignatureGenerate_[!"$vEcucPartition"!]</SWC-RUNNABLE-REF>
                </SWC-BSW-RUNNABLE-MAPPING>
      [!ENDIF!][!//
      [!IF "num:i(0) != num:i(count(node:refs(as:modconf('Csm')/CsmJobs/CsmJob/*[CsmJobUsePort = 'true'  and node:name(node:ref(node:ref(node:ref(./CsmJobQueueRef)/CsmQueueMainFunctionRef)/CsmMainFunctionPartitionRef)) = $vEcucPartition]/CsmJobPrimitiveRef)/CsmSignatureVerify)) and
          (node:value(as:modconf('Csm')/CsmEbGeneral/CsmEbMisc/CsmEbCorrectionCsmAsyncJobInterfaceUseDataReferences) = 'false' or
          num:i(0) != num:i(count(node:refs(as:modconf('Csm')/CsmJobs/CsmJob/*[CsmJobUsePort = 'true'  and node:name(node:ref(node:ref(node:ref(./CsmJobQueueRef)/CsmQueueMainFunctionRef)/CsmMainFunctionPartitionRef)) = $vEcucPartition]/CsmJobPrimitiveRef)/CsmSignatureVerify/*/*[contains(node:name(.),'Processing') and node:value(.) = 'CSM_SYNCHRONOUS'])))"!][!//
                  <SWC-BSW-RUNNABLE-MAPPING>
                  <BSW-ENTITY-REF DEST="BSW-CALLED-ENTITY">/AUTOSAR_Csm/BswModuleDescriptions/Csm/InternalBehavior_[!"$vEcucPartition"!]/CE_Job_SignatureVerify_[!"$vEcucPartition"!]</BSW-ENTITY-REF>
                  <SWC-RUNNABLE-REF DEST="RUNNABLE-ENTITY">/AUTOSAR_Csm/SwComponentTypes/Csm_[!"$vEcucPartition"!]/CsmIntBeh_[!"$vEcucPartition"!]/RE_Job_SignatureVerify_[!"$vEcucPartition"!]</SWC-RUNNABLE-REF>
                </SWC-BSW-RUNNABLE-MAPPING>
      [!ENDIF!][!//
      [!IF "num:i(0) != num:i(count(node:refs(as:modconf('Csm')/CsmJobs/CsmJob/*[CsmJobUsePort = 'true'  and node:name(node:ref(node:ref(node:ref(./CsmJobQueueRef)/CsmQueueMainFunctionRef)/CsmMainFunctionPartitionRef)) = $vEcucPartition]/CsmJobPrimitiveRef)/CsmRandomGenerate)) and
          (node:value(as:modconf('Csm')/CsmEbGeneral/CsmEbMisc/CsmEbCorrectionCsmAsyncJobInterfaceUseDataReferences) = 'false' or
          num:i(0) != num:i(count(node:refs(as:modconf('Csm')/CsmJobs/CsmJob/*[CsmJobUsePort = 'true'  and node:name(node:ref(node:ref(node:ref(./CsmJobQueueRef)/CsmQueueMainFunctionRef)/CsmMainFunctionPartitionRef)) = $vEcucPartition]/CsmJobPrimitiveRef)/CsmRandomGenerate/*/*[contains(node:name(.),'Processing') and node:value(.) = 'CSM_SYNCHRONOUS'])))"!][!//
                  <SWC-BSW-RUNNABLE-MAPPING>
                  <BSW-ENTITY-REF DEST="BSW-CALLED-ENTITY">/AUTOSAR_Csm/BswModuleDescriptions/Csm/InternalBehavior_[!"$vEcucPartition"!]/CE_Job_RandomGenerate_[!"$vEcucPartition"!]</BSW-ENTITY-REF>
                  <SWC-RUNNABLE-REF DEST="RUNNABLE-ENTITY">/AUTOSAR_Csm/SwComponentTypes/Csm_[!"$vEcucPartition"!]/CsmIntBeh_[!"$vEcucPartition"!]/RE_Job_RandomGenerate_[!"$vEcucPartition"!]</SWC-RUNNABLE-REF>
                </SWC-BSW-RUNNABLE-MAPPING>
      [!ENDIF!][!//
      [!IF "node:value(as:modconf('Csm')/CsmEbGeneral/CsmEbMisc/CsmEbCorrectionCsmAsyncJobInterfaceUseDataReferences) = 'true' and num:i(0) != num:i(count(node:refs(as:modconf('Csm')/CsmJobs/CsmJob/*[CsmJobUsePort = 'true' and node:name(node:ref(node:ref(node:ref(./CsmJobQueueRef)/CsmQueueMainFunctionRef)/CsmMainFunctionPartitionRef)) = $vEcucPartition]/CsmJobPrimitiveRef)/CsmAEADDecrypt/*/*[contains(node:name(.),'Processing') and node:value(.) = 'CSM_ASYNCHRONOUS']))"!][!//
                <SWC-BSW-RUNNABLE-MAPPING>
                  <BSW-ENTITY-REF DEST="BSW-CALLED-ENTITY">/AUTOSAR_Csm/BswModuleDescriptions/Csm/InternalBehavior_[!"$vEcucPartition"!]/CE_Job_AEADDecrypt_OAW_[!"$vEcucPartition"!]</BSW-ENTITY-REF>
                  <SWC-RUNNABLE-REF DEST="RUNNABLE-ENTITY">/AUTOSAR_Csm/SwComponentTypes/Csm_[!"$vEcucPartition"!]/CsmIntBeh_[!"$vEcucPartition"!]/RE_Job_AEADDecrypt_OAW_[!"$vEcucPartition"!]</SWC-RUNNABLE-REF>
                </SWC-BSW-RUNNABLE-MAPPING>
      [!ENDIF!][!//
      [!IF "node:value(as:modconf('Csm')/CsmEbGeneral/CsmEbMisc/CsmEbCorrectionCsmAsyncJobInterfaceUseDataReferences) = 'true' and num:i(0) != num:i(count(node:refs(as:modconf('Csm')/CsmJobs/CsmJob/*[CsmJobUsePort = 'true' and node:name(node:ref(node:ref(node:ref(./CsmJobQueueRef)/CsmQueueMainFunctionRef)/CsmMainFunctionPartitionRef)) = $vEcucPartition]/CsmJobPrimitiveRef)/CsmAEADEncrypt/*/*[contains(node:name(.),'Processing') and node:value(.) = 'CSM_ASYNCHRONOUS']))"!][!//
                <SWC-BSW-RUNNABLE-MAPPING>
                  <BSW-ENTITY-REF DEST="BSW-CALLED-ENTITY">/AUTOSAR_Csm/BswModuleDescriptions/Csm/InternalBehavior_[!"$vEcucPartition"!]/CE_Job_AEADEncrypt_OAW_[!"$vEcucPartition"!]</BSW-ENTITY-REF>
                  <SWC-RUNNABLE-REF DEST="RUNNABLE-ENTITY">/AUTOSAR_Csm/SwComponentTypes/Csm_[!"$vEcucPartition"!]/CsmIntBeh_[!"$vEcucPartition"!]/RE_Job_AEADEncrypt_OAW_[!"$vEcucPartition"!]</SWC-RUNNABLE-REF>
                </SWC-BSW-RUNNABLE-MAPPING>
      [!ENDIF!][!//
      [!IF "node:value(as:modconf('Csm')/CsmEbGeneral/CsmEbMisc/CsmEbCorrectionCsmAsyncJobInterfaceUseDataReferences) = 'true' and num:i(0) != num:i(count(node:refs(as:modconf('Csm')/CsmJobs/CsmJob/*[CsmJobUsePort = 'true' and node:name(node:ref(node:ref(node:ref(./CsmJobQueueRef)/CsmQueueMainFunctionRef)/CsmMainFunctionPartitionRef)) = $vEcucPartition]/CsmJobPrimitiveRef)/CsmDecrypt/*/*[contains(node:name(.),'Processing') and node:value(.) = 'CSM_ASYNCHRONOUS']))"!][!//
                <SWC-BSW-RUNNABLE-MAPPING>
                  <BSW-ENTITY-REF DEST="BSW-CALLED-ENTITY">/AUTOSAR_Csm/BswModuleDescriptions/Csm/InternalBehavior_[!"$vEcucPartition"!]/CE_Job_Decrypt_OAW_[!"$vEcucPartition"!]</BSW-ENTITY-REF>
                  <SWC-RUNNABLE-REF DEST="RUNNABLE-ENTITY">/AUTOSAR_Csm/SwComponentTypes/Csm_[!"$vEcucPartition"!]/CsmIntBeh_[!"$vEcucPartition"!]/RE_Job_Decrypt_OAW_[!"$vEcucPartition"!]</SWC-RUNNABLE-REF>
                </SWC-BSW-RUNNABLE-MAPPING>
      [!ENDIF!][!//
      [!IF "node:value(as:modconf('Csm')/CsmEbGeneral/CsmEbMisc/CsmEbCorrectionCsmAsyncJobInterfaceUseDataReferences) = 'true' and num:i(0) != num:i(count(node:refs(as:modconf('Csm')/CsmJobs/CsmJob/*[CsmJobUsePort = 'true' and node:name(node:ref(node:ref(node:ref(./CsmJobQueueRef)/CsmQueueMainFunctionRef)/CsmMainFunctionPartitionRef)) = $vEcucPartition]/CsmJobPrimitiveRef)/CsmEncrypt/*/*[contains(node:name(.),'Processing') and node:value(.) = 'CSM_ASYNCHRONOUS']))"!][!//
                <SWC-BSW-RUNNABLE-MAPPING>
                  <BSW-ENTITY-REF DEST="BSW-CALLED-ENTITY">/AUTOSAR_Csm/BswModuleDescriptions/Csm/InternalBehavior_[!"$vEcucPartition"!]/CE_Job_Encrypt_OAW_[!"$vEcucPartition"!]</BSW-ENTITY-REF>
                  <SWC-RUNNABLE-REF DEST="RUNNABLE-ENTITY">/AUTOSAR_Csm/SwComponentTypes/Csm_[!"$vEcucPartition"!]/CsmIntBeh_[!"$vEcucPartition"!]/RE_Job_Encrypt_OAW_[!"$vEcucPartition"!]</SWC-RUNNABLE-REF>
                </SWC-BSW-RUNNABLE-MAPPING>
      [!ENDIF!][!//
      [!IF "node:value(as:modconf('Csm')/CsmEbGeneral/CsmEbMisc/CsmEbCorrectionCsmAsyncJobInterfaceUseDataReferences) = 'true' and num:i(0) != num:i(count(node:refs(as:modconf('Csm')/CsmJobs/CsmJob/*[CsmJobUsePort = 'true' and node:name(node:ref(node:ref(node:ref(./CsmJobQueueRef)/CsmQueueMainFunctionRef)/CsmMainFunctionPartitionRef)) = $vEcucPartition]/CsmJobPrimitiveRef)/CsmHash/*/*[contains(node:name(.),'Processing') and node:value(.) = 'CSM_ASYNCHRONOUS']))"!][!//
                <SWC-BSW-RUNNABLE-MAPPING>
                  <BSW-ENTITY-REF DEST="BSW-CALLED-ENTITY">/AUTOSAR_Csm/BswModuleDescriptions/Csm/InternalBehavior_[!"$vEcucPartition"!]/CE_Job_Hash_OAW_[!"$vEcucPartition"!]</BSW-ENTITY-REF>
                  <SWC-RUNNABLE-REF DEST="RUNNABLE-ENTITY">/AUTOSAR_Csm/SwComponentTypes/Csm_[!"$vEcucPartition"!]/CsmIntBeh_[!"$vEcucPartition"!]/RE_Job_Hash_OAW_[!"$vEcucPartition"!]</SWC-RUNNABLE-REF>
                </SWC-BSW-RUNNABLE-MAPPING>
      [!ENDIF!][!//
      [!IF "node:value(as:modconf('Csm')/CsmEbGeneral/CsmEbMisc/CsmEbCorrectionCsmAsyncJobInterfaceUseDataReferences) = 'true' and num:i(0) != num:i(count(node:refs(as:modconf('Csm')/CsmJobs/CsmJob/*[CsmJobUsePort = 'true' and node:name(node:ref(node:ref(node:ref(./CsmJobQueueRef)/CsmQueueMainFunctionRef)/CsmMainFunctionPartitionRef)) = $vEcucPartition]/CsmJobPrimitiveRef)/CsmMacGenerate/*/*[contains(node:name(.),'Processing') and node:value(.) = 'CSM_ASYNCHRONOUS']))"!][!//
                <SWC-BSW-RUNNABLE-MAPPING>
                  <BSW-ENTITY-REF DEST="BSW-CALLED-ENTITY">/AUTOSAR_Csm/BswModuleDescriptions/Csm/InternalBehavior_[!"$vEcucPartition"!]/CE_Job_MacGenerate_OAW_[!"$vEcucPartition"!]</BSW-ENTITY-REF>
                  <SWC-RUNNABLE-REF DEST="RUNNABLE-ENTITY">/AUTOSAR_Csm/SwComponentTypes/Csm_[!"$vEcucPartition"!]/CsmIntBeh_[!"$vEcucPartition"!]/RE_Job_MacGenerate_OAW_[!"$vEcucPartition"!]</SWC-RUNNABLE-REF>
                </SWC-BSW-RUNNABLE-MAPPING>
      [!ENDIF!][!//
      [!IF "node:value(as:modconf('Csm')/CsmEbGeneral/CsmEbMisc/CsmEbCorrectionCsmAsyncJobInterfaceUseDataReferences) = 'true' and num:i(0) != num:i(count(node:refs(as:modconf('Csm')/CsmJobs/CsmJob/*[CsmJobUsePort = 'true' and node:name(node:ref(node:ref(node:ref(./CsmJobQueueRef)/CsmQueueMainFunctionRef)/CsmMainFunctionPartitionRef)) = $vEcucPartition]/CsmJobPrimitiveRef)/CsmMacVerify/*/*[contains(node:name(.),'Processing') and node:value(.) = 'CSM_ASYNCHRONOUS']))"!][!//
                <SWC-BSW-RUNNABLE-MAPPING>
                  <BSW-ENTITY-REF DEST="BSW-CALLED-ENTITY">/AUTOSAR_Csm/BswModuleDescriptions/Csm/InternalBehavior_[!"$vEcucPartition"!]/CE_Job_MacVerify_OAW_[!"$vEcucPartition"!]</BSW-ENTITY-REF>
                  <SWC-RUNNABLE-REF DEST="RUNNABLE-ENTITY">/AUTOSAR_Csm/SwComponentTypes/Csm_[!"$vEcucPartition"!]/CsmIntBeh_[!"$vEcucPartition"!]/RE_Job_MacVerify_OAW_[!"$vEcucPartition"!]</SWC-RUNNABLE-REF>
                </SWC-BSW-RUNNABLE-MAPPING>
      [!ENDIF!][!//
      [!IF "node:value(as:modconf('Csm')/CsmEbGeneral/CsmEbMisc/CsmEbCorrectionCsmAsyncJobInterfaceUseDataReferences) = 'true' and num:i(0) != num:i(count(node:refs(as:modconf('Csm')/CsmJobs/CsmJob/*[CsmJobUsePort = 'true' and node:name(node:ref(node:ref(node:ref(./CsmJobQueueRef)/CsmQueueMainFunctionRef)/CsmMainFunctionPartitionRef)) = $vEcucPartition]/CsmJobPrimitiveRef)/CsmSignatureGenerate/*/*[contains(node:name(.),'Processing') and node:value(.) = 'CSM_ASYNCHRONOUS']))"!][!//
                <SWC-BSW-RUNNABLE-MAPPING>
                  <BSW-ENTITY-REF DEST="BSW-CALLED-ENTITY">/AUTOSAR_Csm/BswModuleDescriptions/Csm/InternalBehavior_[!"$vEcucPartition"!]/CE_Job_SignatureGenerate_OAW_[!"$vEcucPartition"!]</BSW-ENTITY-REF>
                  <SWC-RUNNABLE-REF DEST="RUNNABLE-ENTITY">/AUTOSAR_Csm/SwComponentTypes/Csm_[!"$vEcucPartition"!]/CsmIntBeh_[!"$vEcucPartition"!]/RE_Job_SignatureGenerate_OAW_[!"$vEcucPartition"!]</SWC-RUNNABLE-REF>
                </SWC-BSW-RUNNABLE-MAPPING>
      [!ENDIF!][!//
      [!IF "node:value(as:modconf('Csm')/CsmEbGeneral/CsmEbMisc/CsmEbCorrectionCsmAsyncJobInterfaceUseDataReferences) = 'true' and num:i(0) != num:i(count(node:refs(as:modconf('Csm')/CsmJobs/CsmJob/*[CsmJobUsePort = 'true' and node:name(node:ref(node:ref(node:ref(./CsmJobQueueRef)/CsmQueueMainFunctionRef)/CsmMainFunctionPartitionRef)) = $vEcucPartition]/CsmJobPrimitiveRef)/CsmSignatureVerify/*/*[contains(node:name(.),'Processing') and node:value(.) = 'CSM_ASYNCHRONOUS']))"!][!//
                <SWC-BSW-RUNNABLE-MAPPING>
                  <BSW-ENTITY-REF DEST="BSW-CALLED-ENTITY">/AUTOSAR_Csm/BswModuleDescriptions/Csm/InternalBehavior_[!"$vEcucPartition"!]/CE_Job_SignatureVerify_OAW_[!"$vEcucPartition"!]</BSW-ENTITY-REF>
                  <SWC-RUNNABLE-REF DEST="RUNNABLE-ENTITY">/AUTOSAR_Csm/SwComponentTypes/Csm_[!"$vEcucPartition"!]/CsmIntBeh_[!"$vEcucPartition"!]/RE_Job_SignatureVerify_OAW_[!"$vEcucPartition"!]</SWC-RUNNABLE-REF>
                </SWC-BSW-RUNNABLE-MAPPING>
      [!ENDIF!][!//
      [!IF "node:value(as:modconf('Csm')/CsmEbGeneral/CsmEbMisc/CsmEbCorrectionCsmAsyncJobInterfaceUseDataReferences) = 'true' and num:i(0) != num:i(count(node:refs(as:modconf('Csm')/CsmJobs/CsmJob/*[CsmJobUsePort = 'true' and node:name(node:ref(node:ref(node:ref(./CsmJobQueueRef)/CsmQueueMainFunctionRef)/CsmMainFunctionPartitionRef)) = $vEcucPartition]/CsmJobPrimitiveRef)/CsmRandomGenerate/*/*[contains(node:name(.),'Processing') and node:value(.) = 'CSM_ASYNCHRONOUS']))"!][!//
                <SWC-BSW-RUNNABLE-MAPPING>
                  <BSW-ENTITY-REF DEST="BSW-CALLED-ENTITY">/AUTOSAR_Csm/BswModuleDescriptions/Csm/InternalBehavior_[!"$vEcucPartition"!]/CE_Job_RandomGenerate_OAW_[!"$vEcucPartition"!]</BSW-ENTITY-REF>
                  <SWC-RUNNABLE-REF DEST="RUNNABLE-ENTITY">/AUTOSAR_Csm/SwComponentTypes/Csm_[!"$vEcucPartition"!]/CsmIntBeh_[!"$vEcucPartition"!]/RE_Job_RandomGenerate_OAW_[!"$vEcucPartition"!]</SWC-RUNNABLE-REF>
                </SWC-BSW-RUNNABLE-MAPPING>
      [!ENDIF!][!//
      [!IF "num:i(0) != (num:i(count(node:refs(as:modconf('Csm')/CsmJobs/CsmJob/*[CsmJobUsePort = 'true' and node:name(node:ref(node:ref(node:ref(./CsmJobQueueRef)/CsmQueueMainFunctionRef)/CsmMainFunctionPartitionRef)) = $vEcucPartition]/CsmJobPrimitiveRef)/*)) - num:i(count(node:refs(as:modconf('Csm')/CsmJobs/CsmJob/*[CsmJobUsePort = 'true' and node:name(node:ref(node:ref(node:ref(./CsmJobQueueRef)/CsmQueueMainFunctionRef)/CsmMainFunctionPartitionRef)) = $vEcucPartition]/CsmJobPrimitiveRef)/CsmRandomGenerate))) or
        (node:value(as:modconf('Csm')/CsmEbGeneral/CsmEbMisc/CsmEbCorrectionCsmAsyncJobInterfaceUseDataReferences) = 'true' and num:i(0) != num:i(count(node:refs(as:modconf('Csm')/CsmJobs/CsmJob/*[CsmJobUsePort = 'true' and node:name(node:ref(node:ref(node:ref(./CsmJobQueueRef)/CsmQueueMainFunctionRef)/CsmMainFunctionPartitionRef)) = $vEcucPartition]/CsmJobPrimitiveRef)/*/*/*[contains(node:name(.),'Processing') and node:value(.) = 'CSM_ASYNCHRONOUS'])))"!][!//
                <SWC-BSW-RUNNABLE-MAPPING>
                  <BSW-ENTITY-REF DEST="BSW-CALLED-ENTITY">/AUTOSAR_Csm/BswModuleDescriptions/Csm/InternalBehavior_[!"$vEcucPartition"!]/CE_Job_CancelJob_[!"$vEcucPartition"!]</BSW-ENTITY-REF>
                  <SWC-RUNNABLE-REF DEST="RUNNABLE-ENTITY">/AUTOSAR_Csm/SwComponentTypes/Csm_[!"$vEcucPartition"!]/CsmIntBeh_[!"$vEcucPartition"!]/RE_Job_CancelJob_[!"$vEcucPartition"!]</SWC-RUNNABLE-REF>
                </SWC-BSW-RUNNABLE-MAPPING>
      [!ENDIF!][!//
      [!IF "node:value(as:modconf('Csm')/CsmEbGeneral/CsmEbMisc/CsmEbCorrectionCsmAsyncJobInterfaceUseDataReferences) = 'true' and num:i(0) != num:i(count(node:refs(as:modconf('Csm')/CsmJobs/CsmJob/*[CsmJobUsePort = 'true' and node:name(node:ref(node:ref(node:ref(./CsmJobQueueRef)/CsmQueueMainFunctionRef)/CsmMainFunctionPartitionRef)) = $vEcucPartition]/CsmJobPrimitiveRef)/*/*/*[contains(node:name(.),'Processing') and node:value(.) = 'CSM_ASYNCHRONOUS']))"!][!//
                <SWC-BSW-RUNNABLE-MAPPING>
                  <BSW-ENTITY-REF DEST="BSW-CALLED-ENTITY">/AUTOSAR_Csm/BswModuleDescriptions/Csm/InternalBehavior_[!"$vEcucPartition"!]/CE_Job_CancelJob_OAW_[!"$vEcucPartition"!]</BSW-ENTITY-REF>
                  <SWC-RUNNABLE-REF DEST="RUNNABLE-ENTITY">/AUTOSAR_Csm/SwComponentTypes/Csm_[!"$vEcucPartition"!]/CsmIntBeh_[!"$vEcucPartition"!]/RE_Job_CancelJob_OAW_[!"$vEcucPartition"!]</SWC-RUNNABLE-REF>
                </SWC-BSW-RUNNABLE-MAPPING>
      [!ENDIF!][!//
      [!IF "node:value(as:modconf('Csm')/CsmEbGeneral/CsmEbMisc/CsmEbCorrectionCsmJobBasedCallbacknotificationPorts) = 'false'"!][!//
        [!LOOP "as:modconf('Csm')/CsmCallbacks/CsmCallback/*[node:empty(./CsmCallbackFunc)][node:containsValue(node:refs(../../../CsmJobs/CsmJob/*[node:name(node:ref(node:ref(node:ref(CsmJobQueueRef)/CsmQueueMainFunctionRef)/CsmMainFunctionPartitionRef)) = $vEcucPartition]/CsmJobPrimitiveCallbackRef)/CsmCallbackId, node:value(./CsmCallbackId))]"!][!//
          [!VAR "vCbk" = "node:name(.)"!][!//
                <SWC-BSW-RUNNABLE-MAPPING>
                  <BSW-ENTITY-REF DEST="BSW-SCHEDULABLE-ENTITY">/AUTOSAR_Csm/BswModuleDescriptions/Csm/InternalBehavior_[!"$vEcucPartition"!]/SE_[!"$vCbk"!]_CallbackNotification_[!"$vEcucPartition"!]</BSW-ENTITY-REF>
                  <SWC-RUNNABLE-REF DEST="RUNNABLE-ENTITY">/AUTOSAR_Csm/SwComponentTypes/Csm_[!"$vEcucPartition"!]/CsmIntBeh_[!"$vEcucPartition"!]/RE_[!"$vCbk"!]_CallbackNotification_[!"$vEcucPartition"!]</SWC-RUNNABLE-REF>
                </SWC-BSW-RUNNABLE-MAPPING>
        [!ENDLOOP!][!//
      [!ELSE!][!//
        [!LOOP "as:modconf('Csm')/CsmJobs/CsmJob/*[CsmJobUsePort = 'true' and node:name(node:ref(node:ref(node:ref(./CsmJobQueueRef)/CsmQueueMainFunctionRef)/CsmMainFunctionPartitionRef)) = $vEcucPartition]"!][!//
          [!IF "node:exists(node:ref(./CsmJobPrimitiveRef)/*) = 'true' and node:value(node:ref(./CsmJobPrimitiveRef)/*/*/*[contains(node:name(.),'Processing')]) = 'CSM_ASYNCHRONOUS'"!][!//
            [!VAR "vJob" = "node:name(.)"!][!//
                <SWC-BSW-RUNNABLE-MAPPING>
                  <BSW-ENTITY-REF DEST="BSW-SCHEDULABLE-ENTITY">/AUTOSAR_Csm/BswModuleDescriptions/Csm/InternalBehavior_[!"$vEcucPartition"!]/SE_CallbackNotification_[!"$vJob"!]_[!"$vEcucPartition"!]</BSW-ENTITY-REF>
                  <SWC-RUNNABLE-REF DEST="RUNNABLE-ENTITY">/AUTOSAR_Csm/SwComponentTypes/Csm_[!"$vEcucPartition"!]/CsmIntBeh_[!"$vEcucPartition"!]/RE_CallbackNotification_[!"$vJob"!]_[!"$vEcucPartition"!]</SWC-RUNNABLE-REF>
                </SWC-BSW-RUNNABLE-MAPPING>
          [!ENDIF!][!//
        [!ENDLOOP!][!//
      [!ENDIF!][!//
              </RUNNABLE-MAPPINGS>
              <SWC-BEHAVIOR-REF DEST="SWC-INTERNAL-BEHAVIOR">/AUTOSAR_Csm/SwComponentTypes/Csm_[!"$vEcucPartition"!]/CsmIntBeh_[!"$vEcucPartition"!]</SWC-BEHAVIOR-REF>
            </SWC-BSW-MAPPING>
    [!ENDIF!][!//
  [!ENDLOOP!][!//
          </ELEMENTS>
        </AR-PACKAGE>
[!ENDIF!][!//

        <AR-PACKAGE>
          <SHORT-NAME>BswModuleDescriptions</SHORT-NAME>
          <ELEMENTS>
            <BSW-MODULE-DESCRIPTION>
              <SHORT-NAME>Csm</SHORT-NAME>
              <MODULE-ID>110</MODULE-ID>
              <PROVIDED-ENTRYS>
[!IF "num:i(0) = num:i(count(as:modconf('Csm')/CsmMainFunction/*))"!][!//
                <BSW-MODULE-ENTRY-REF-CONDITIONAL>
                  <BSW-MODULE-ENTRY-REF DEST="BSW-MODULE-ENTRY">/AUTOSAR_Csm/BswModuleEntrys/Csm_Init</BSW-MODULE-ENTRY-REF>
                </BSW-MODULE-ENTRY-REF-CONDITIONAL>
  [!IF "$Csm_Flg_Async = 'true'"!][!//
                <BSW-MODULE-ENTRY-REF-CONDITIONAL>
                  <BSW-MODULE-ENTRY-REF DEST="BSW-MODULE-ENTRY">/AUTOSAR_Csm/BswModuleEntrys/Csm_MainFunction</BSW-MODULE-ENTRY-REF>
                </BSW-MODULE-ENTRY-REF-CONDITIONAL>
  [!ENDIF!][!//
  [!IF "$Csm_Api_Enabled_KeyMngmnt = 'true'"!][!//
                <BSW-MODULE-ENTRY-REF-CONDITIONAL>
                  <BSW-MODULE-ENTRY-REF DEST="BSW-MODULE-ENTRY">/AUTOSAR_Csm/BswModuleEntrys/Csm_CertificateParse</BSW-MODULE-ENTRY-REF>
                </BSW-MODULE-ENTRY-REF-CONDITIONAL>
                <BSW-MODULE-ENTRY-REF-CONDITIONAL>
                  <BSW-MODULE-ENTRY-REF DEST="BSW-MODULE-ENTRY">/AUTOSAR_Csm/BswModuleEntrys/Csm_CertificateVerify</BSW-MODULE-ENTRY-REF>
                </BSW-MODULE-ENTRY-REF-CONDITIONAL>
                <BSW-MODULE-ENTRY-REF-CONDITIONAL>
                  <BSW-MODULE-ENTRY-REF DEST="BSW-MODULE-ENTRY">/AUTOSAR_Csm/BswModuleEntrys/Csm_KeyCopy</BSW-MODULE-ENTRY-REF>
                </BSW-MODULE-ENTRY-REF-CONDITIONAL>
                <BSW-MODULE-ENTRY-REF-CONDITIONAL>
                  <BSW-MODULE-ENTRY-REF DEST="BSW-MODULE-ENTRY">/AUTOSAR_Csm/BswModuleEntrys/Csm_KeyDerive</BSW-MODULE-ENTRY-REF>
                </BSW-MODULE-ENTRY-REF-CONDITIONAL>
                <BSW-MODULE-ENTRY-REF-CONDITIONAL>
                  <BSW-MODULE-ENTRY-REF DEST="BSW-MODULE-ENTRY">/AUTOSAR_Csm/BswModuleEntrys/Csm_KeyElementCopy</BSW-MODULE-ENTRY-REF>
                </BSW-MODULE-ENTRY-REF-CONDITIONAL>
                <BSW-MODULE-ENTRY-REF-CONDITIONAL>
                  <BSW-MODULE-ENTRY-REF DEST="BSW-MODULE-ENTRY">/AUTOSAR_Csm/BswModuleEntrys/Csm_KeyElementGet</BSW-MODULE-ENTRY-REF>
                </BSW-MODULE-ENTRY-REF-CONDITIONAL>
                <BSW-MODULE-ENTRY-REF-CONDITIONAL>
                  <BSW-MODULE-ENTRY-REF DEST="BSW-MODULE-ENTRY">/AUTOSAR_Csm/BswModuleEntrys/Csm_KeyElementSet</BSW-MODULE-ENTRY-REF>
                </BSW-MODULE-ENTRY-REF-CONDITIONAL>
                <BSW-MODULE-ENTRY-REF-CONDITIONAL>
                  <BSW-MODULE-ENTRY-REF DEST="BSW-MODULE-ENTRY">/AUTOSAR_Csm/BswModuleEntrys/Csm_KeyExchangeCalcPubVal</BSW-MODULE-ENTRY-REF>
                </BSW-MODULE-ENTRY-REF-CONDITIONAL>
                <BSW-MODULE-ENTRY-REF-CONDITIONAL>
                  <BSW-MODULE-ENTRY-REF DEST="BSW-MODULE-ENTRY">/AUTOSAR_Csm/BswModuleEntrys/Csm_KeyExchangeCalcSecret</BSW-MODULE-ENTRY-REF>
                </BSW-MODULE-ENTRY-REF-CONDITIONAL>
                <BSW-MODULE-ENTRY-REF-CONDITIONAL>
                  <BSW-MODULE-ENTRY-REF DEST="BSW-MODULE-ENTRY">/AUTOSAR_Csm/BswModuleEntrys/Csm_KeyGenerate</BSW-MODULE-ENTRY-REF>
                </BSW-MODULE-ENTRY-REF-CONDITIONAL>
                <BSW-MODULE-ENTRY-REF-CONDITIONAL>
                  <BSW-MODULE-ENTRY-REF DEST="BSW-MODULE-ENTRY">/AUTOSAR_Csm/BswModuleEntrys/Csm_KeySetValid</BSW-MODULE-ENTRY-REF>
                </BSW-MODULE-ENTRY-REF-CONDITIONAL>
  [!IF "node:value(as:modconf('Csm')/CsmEbGeneral/CsmEbMisc/CsmEbEnhancementApiCsmKeySetInvalid) = 'true'"!][!//
                <BSW-MODULE-ENTRY-REF-CONDITIONAL>
                  <BSW-MODULE-ENTRY-REF DEST="BSW-MODULE-ENTRY">/AUTOSAR_Csm/BswModuleEntrys/Csm_KeySetInvalid</BSW-MODULE-ENTRY-REF>
                </BSW-MODULE-ENTRY-REF-CONDITIONAL>
  [!ENDIF!][!//
  [!IF "node:value(as:modconf('Csm')/CsmEbGeneral/CsmEbMisc/CsmEbEnhancementApiCsmKeyGetStatus) = 'true'"!][!//
                <BSW-MODULE-ENTRY-REF-CONDITIONAL>
                  <BSW-MODULE-ENTRY-REF DEST="BSW-MODULE-ENTRY">/AUTOSAR_Csm/BswModuleEntrys/Csm_KeyGetStatus</BSW-MODULE-ENTRY-REF>
                </BSW-MODULE-ENTRY-REF-CONDITIONAL>
  [!ENDIF!][!//
                <BSW-MODULE-ENTRY-REF-CONDITIONAL>
                  <BSW-MODULE-ENTRY-REF DEST="BSW-MODULE-ENTRY">/AUTOSAR_Csm/BswModuleEntrys/Csm_RandomSeed</BSW-MODULE-ENTRY-REF>
                </BSW-MODULE-ENTRY-REF-CONDITIONAL>
  [!ENDIF!][!//
  [!IF "$Csm_Api_Enabled_AEADDecrypt = 'true'"!][!//
                <BSW-MODULE-ENTRY-REF-CONDITIONAL>
                  <BSW-MODULE-ENTRY-REF DEST="BSW-MODULE-ENTRY">/AUTOSAR_Csm/BswModuleEntrys/Csm_AEADDecrypt</BSW-MODULE-ENTRY-REF>
                </BSW-MODULE-ENTRY-REF-CONDITIONAL>
  [!ENDIF!][!//
  [!IF "$Csm_Api_Enabled_AEADEncrypt = 'true'"!][!//
                <BSW-MODULE-ENTRY-REF-CONDITIONAL>
                  <BSW-MODULE-ENTRY-REF DEST="BSW-MODULE-ENTRY">/AUTOSAR_Csm/BswModuleEntrys/Csm_AEADEncrypt</BSW-MODULE-ENTRY-REF>
                </BSW-MODULE-ENTRY-REF-CONDITIONAL>
  [!ENDIF!][!//
  [!IF "$Csm_Api_Enabled_Decrypt = 'true'"!][!//
                <BSW-MODULE-ENTRY-REF-CONDITIONAL>
                  <BSW-MODULE-ENTRY-REF DEST="BSW-MODULE-ENTRY">/AUTOSAR_Csm/BswModuleEntrys/Csm_Decrypt</BSW-MODULE-ENTRY-REF>
                </BSW-MODULE-ENTRY-REF-CONDITIONAL>
  [!ENDIF!][!//
  [!IF "$Csm_Api_Enabled_Encrypt = 'true'"!][!//
                <BSW-MODULE-ENTRY-REF-CONDITIONAL>
                  <BSW-MODULE-ENTRY-REF DEST="BSW-MODULE-ENTRY">/AUTOSAR_Csm/BswModuleEntrys/Csm_Encrypt</BSW-MODULE-ENTRY-REF>
                </BSW-MODULE-ENTRY-REF-CONDITIONAL>
  [!ENDIF!][!//
  [!IF "$Csm_Api_Enabled_Hash = 'true'"!][!//
                <BSW-MODULE-ENTRY-REF-CONDITIONAL>
                  <BSW-MODULE-ENTRY-REF DEST="BSW-MODULE-ENTRY">/AUTOSAR_Csm/BswModuleEntrys/Csm_Hash</BSW-MODULE-ENTRY-REF>
                </BSW-MODULE-ENTRY-REF-CONDITIONAL>
  [!ENDIF!][!//
  [!IF "$Csm_Api_Enabled_MacGenerate = 'true'"!][!//
                <BSW-MODULE-ENTRY-REF-CONDITIONAL>
                  <BSW-MODULE-ENTRY-REF DEST="BSW-MODULE-ENTRY">/AUTOSAR_Csm/BswModuleEntrys/Csm_MacGenerate</BSW-MODULE-ENTRY-REF>
                </BSW-MODULE-ENTRY-REF-CONDITIONAL>
  [!ENDIF!][!//
  [!IF "$Csm_Api_Enabled_MacVerify = 'true'"!][!//
                <BSW-MODULE-ENTRY-REF-CONDITIONAL>
                  <BSW-MODULE-ENTRY-REF DEST="BSW-MODULE-ENTRY">/AUTOSAR_Csm/BswModuleEntrys/Csm_MacVerify</BSW-MODULE-ENTRY-REF>
                </BSW-MODULE-ENTRY-REF-CONDITIONAL>
  [!ENDIF!][!//
  [!IF "$Csm_Api_Enabled_SignatureGenerate = 'true'"!][!//
                <BSW-MODULE-ENTRY-REF-CONDITIONAL>
                  <BSW-MODULE-ENTRY-REF DEST="BSW-MODULE-ENTRY">/AUTOSAR_Csm/BswModuleEntrys/Csm_SignatureGenerate</BSW-MODULE-ENTRY-REF>
                </BSW-MODULE-ENTRY-REF-CONDITIONAL>
  [!ENDIF!][!//
  [!IF "$Csm_Api_Enabled_SignatureVerify = 'true'"!][!//
                <BSW-MODULE-ENTRY-REF-CONDITIONAL>
                  <BSW-MODULE-ENTRY-REF DEST="BSW-MODULE-ENTRY">/AUTOSAR_Csm/BswModuleEntrys/Csm_SignatureVerify</BSW-MODULE-ENTRY-REF>
                </BSW-MODULE-ENTRY-REF-CONDITIONAL>
  [!ENDIF!][!//
  [!IF "$Csm_Api_Enabled_RandomGenerate = 'true'"!][!//
                <BSW-MODULE-ENTRY-REF-CONDITIONAL>
                  <BSW-MODULE-ENTRY-REF DEST="BSW-MODULE-ENTRY">/AUTOSAR_Csm/BswModuleEntrys/Csm_RandomGenerate</BSW-MODULE-ENTRY-REF>
                </BSW-MODULE-ENTRY-REF-CONDITIONAL>
  [!ENDIF!][!//
  [!IF "node:value(as:modconf('Csm')/CsmEbGeneral/CsmEbMisc/CsmEbCorrectionCsmAsyncJobInterfaceUseDataReferences) = 'true' and num:i(0) != num:i(count(node:refs(as:modconf('Csm')/CsmJobs/CsmJob/*[CsmJobUsePort = 'true']/CsmJobPrimitiveRef)/CsmAEADDecrypt/*/*[contains(node:name(.),'Processing') and node:value(.) = 'CSM_ASYNCHRONOUS']))"!][!//
                <BSW-MODULE-ENTRY-REF-CONDITIONAL>
                  <BSW-MODULE-ENTRY-REF DEST="BSW-MODULE-ENTRY">/AUTOSAR_Csm/BswModuleEntrys/Csm_AEADDecrypt_OAW</BSW-MODULE-ENTRY-REF>
                </BSW-MODULE-ENTRY-REF-CONDITIONAL>
  [!ENDIF!][!//
  [!IF "node:value(as:modconf('Csm')/CsmEbGeneral/CsmEbMisc/CsmEbCorrectionCsmAsyncJobInterfaceUseDataReferences) = 'true' and num:i(0) != num:i(count(node:refs(as:modconf('Csm')/CsmJobs/CsmJob/*[CsmJobUsePort = 'true']/CsmJobPrimitiveRef)/CsmAEADEncrypt/*/*[contains(node:name(.),'Processing') and node:value(.) = 'CSM_ASYNCHRONOUS']))"!][!//
                <BSW-MODULE-ENTRY-REF-CONDITIONAL>
                  <BSW-MODULE-ENTRY-REF DEST="BSW-MODULE-ENTRY">/AUTOSAR_Csm/BswModuleEntrys/Csm_AEADEncrypt_OAW</BSW-MODULE-ENTRY-REF>
                </BSW-MODULE-ENTRY-REF-CONDITIONAL>
  [!ENDIF!][!//
  [!IF "node:value(as:modconf('Csm')/CsmEbGeneral/CsmEbMisc/CsmEbCorrectionCsmAsyncJobInterfaceUseDataReferences) = 'true' and num:i(0) != num:i(count(node:refs(as:modconf('Csm')/CsmJobs/CsmJob/*[CsmJobUsePort = 'true']/CsmJobPrimitiveRef)/CsmDecrypt/*/*[contains(node:name(.),'Processing') and node:value(.) = 'CSM_ASYNCHRONOUS']))"!][!//
                <BSW-MODULE-ENTRY-REF-CONDITIONAL>
                  <BSW-MODULE-ENTRY-REF DEST="BSW-MODULE-ENTRY">/AUTOSAR_Csm/BswModuleEntrys/Csm_Decrypt_OAW</BSW-MODULE-ENTRY-REF>
                </BSW-MODULE-ENTRY-REF-CONDITIONAL>
  [!ENDIF!][!//
  [!IF "node:value(as:modconf('Csm')/CsmEbGeneral/CsmEbMisc/CsmEbCorrectionCsmAsyncJobInterfaceUseDataReferences) = 'true' and num:i(0) != num:i(count(node:refs(as:modconf('Csm')/CsmJobs/CsmJob/*[CsmJobUsePort = 'true']/CsmJobPrimitiveRef)/CsmEncrypt/*/*[contains(node:name(.),'Processing') and node:value(.) = 'CSM_ASYNCHRONOUS']))"!][!//
                <BSW-MODULE-ENTRY-REF-CONDITIONAL>
                  <BSW-MODULE-ENTRY-REF DEST="BSW-MODULE-ENTRY">/AUTOSAR_Csm/BswModuleEntrys/Csm_Encrypt_OAW</BSW-MODULE-ENTRY-REF>
                </BSW-MODULE-ENTRY-REF-CONDITIONAL>
  [!ENDIF!][!//
  [!IF "node:value(as:modconf('Csm')/CsmEbGeneral/CsmEbMisc/CsmEbCorrectionCsmAsyncJobInterfaceUseDataReferences) = 'true' and num:i(0) != num:i(count(node:refs(as:modconf('Csm')/CsmJobs/CsmJob/*[CsmJobUsePort = 'true']/CsmJobPrimitiveRef)/CsmHash/*/*[contains(node:name(.),'Processing') and node:value(.) = 'CSM_ASYNCHRONOUS']))"!][!//
                <BSW-MODULE-ENTRY-REF-CONDITIONAL>
                  <BSW-MODULE-ENTRY-REF DEST="BSW-MODULE-ENTRY">/AUTOSAR_Csm/BswModuleEntrys/Csm_Hash_OAW</BSW-MODULE-ENTRY-REF>
                </BSW-MODULE-ENTRY-REF-CONDITIONAL>
  [!ENDIF!][!//
  [!IF "node:value(as:modconf('Csm')/CsmEbGeneral/CsmEbMisc/CsmEbCorrectionCsmAsyncJobInterfaceUseDataReferences) = 'true' and num:i(0) != num:i(count(node:refs(as:modconf('Csm')/CsmJobs/CsmJob/*[CsmJobUsePort = 'true']/CsmJobPrimitiveRef)/CsmMacGenerate/*/*[contains(node:name(.),'Processing') and node:value(.) = 'CSM_ASYNCHRONOUS']))"!][!//
                <BSW-MODULE-ENTRY-REF-CONDITIONAL>
                  <BSW-MODULE-ENTRY-REF DEST="BSW-MODULE-ENTRY">/AUTOSAR_Csm/BswModuleEntrys/Csm_MacGenerate_OAW</BSW-MODULE-ENTRY-REF>
                </BSW-MODULE-ENTRY-REF-CONDITIONAL>
  [!ENDIF!][!//
  [!IF "node:value(as:modconf('Csm')/CsmEbGeneral/CsmEbMisc/CsmEbCorrectionCsmAsyncJobInterfaceUseDataReferences) = 'true' and num:i(0) != num:i(count(node:refs(as:modconf('Csm')/CsmJobs/CsmJob/*[CsmJobUsePort = 'true']/CsmJobPrimitiveRef)/CsmMacVerify/*/*[contains(node:name(.),'Processing') and node:value(.) = 'CSM_ASYNCHRONOUS']))"!][!//
                <BSW-MODULE-ENTRY-REF-CONDITIONAL>
                  <BSW-MODULE-ENTRY-REF DEST="BSW-MODULE-ENTRY">/AUTOSAR_Csm/BswModuleEntrys/Csm_MacVerify_OAW</BSW-MODULE-ENTRY-REF>
                </BSW-MODULE-ENTRY-REF-CONDITIONAL>
  [!ENDIF!][!//
  [!IF "node:value(as:modconf('Csm')/CsmEbGeneral/CsmEbMisc/CsmEbCorrectionCsmAsyncJobInterfaceUseDataReferences) = 'true' and num:i(0) != num:i(count(node:refs(as:modconf('Csm')/CsmJobs/CsmJob/*[CsmJobUsePort = 'true']/CsmJobPrimitiveRef)/CsmSignatureGenerate/*/*[contains(node:name(.),'Processing') and node:value(.) = 'CSM_ASYNCHRONOUS']))"!][!//
                <BSW-MODULE-ENTRY-REF-CONDITIONAL>
                  <BSW-MODULE-ENTRY-REF DEST="BSW-MODULE-ENTRY">/AUTOSAR_Csm/BswModuleEntrys/Csm_SignatureGenerate_OAW</BSW-MODULE-ENTRY-REF>
                </BSW-MODULE-ENTRY-REF-CONDITIONAL>
  [!ENDIF!][!//
  [!IF "node:value(as:modconf('Csm')/CsmEbGeneral/CsmEbMisc/CsmEbCorrectionCsmAsyncJobInterfaceUseDataReferences) = 'true' and num:i(0) != num:i(count(node:refs(as:modconf('Csm')/CsmJobs/CsmJob/*[CsmJobUsePort = 'true']/CsmJobPrimitiveRef)/CsmSignatureVerify/*/*[contains(node:name(.),'Processing') and node:value(.) = 'CSM_ASYNCHRONOUS']))"!][!//
                <BSW-MODULE-ENTRY-REF-CONDITIONAL>
                  <BSW-MODULE-ENTRY-REF DEST="BSW-MODULE-ENTRY">/AUTOSAR_Csm/BswModuleEntrys/Csm_SignatureVerify_OAW</BSW-MODULE-ENTRY-REF>
                </BSW-MODULE-ENTRY-REF-CONDITIONAL>
  [!ENDIF!][!//
  [!IF "node:value(as:modconf('Csm')/CsmEbGeneral/CsmEbMisc/CsmEbCorrectionCsmAsyncJobInterfaceUseDataReferences) = 'true' and num:i(0) != num:i(count(node:refs(as:modconf('Csm')/CsmJobs/CsmJob/*[CsmJobUsePort = 'true']/CsmJobPrimitiveRef)/CsmRandomGenerate/*/*[contains(node:name(.),'Processing') and node:value(.) = 'CSM_ASYNCHRONOUS']))"!][!//
                <BSW-MODULE-ENTRY-REF-CONDITIONAL>
                  <BSW-MODULE-ENTRY-REF DEST="BSW-MODULE-ENTRY">/AUTOSAR_Csm/BswModuleEntrys/Csm_RandomGenerate_OAW</BSW-MODULE-ENTRY-REF>
                </BSW-MODULE-ENTRY-REF-CONDITIONAL>
  [!ENDIF!][!//
  [!IF "$Csm_Api_Enabled_Srv = 'true'"!][!//
                <BSW-MODULE-ENTRY-REF-CONDITIONAL>
                  <BSW-MODULE-ENTRY-REF DEST="BSW-MODULE-ENTRY">/AUTOSAR_Csm/BswModuleEntrys/Csm_CancelJob</BSW-MODULE-ENTRY-REF>
                </BSW-MODULE-ENTRY-REF-CONDITIONAL>
  [!ENDIF!][!//
  [!IF "node:value(as:modconf('Csm')/CsmEbGeneral/CsmEbMisc/CsmEbCorrectionCsmAsyncJobInterfaceUseDataReferences) = 'true' and num:i(0) != num:i(count(node:refs(as:modconf('Csm')/CsmJobs/CsmJob/*[CsmJobUsePort = 'true']/CsmJobPrimitiveRef)/*/*/*[contains(node:name(.),'Processing') and node:value(.) = 'CSM_ASYNCHRONOUS']))"!][!//
                <BSW-MODULE-ENTRY-REF-CONDITIONAL>
                  <BSW-MODULE-ENTRY-REF DEST="BSW-MODULE-ENTRY">/AUTOSAR_Csm/BswModuleEntrys/Csm_CancelJob_OAW</BSW-MODULE-ENTRY-REF>
                </BSW-MODULE-ENTRY-REF-CONDITIONAL>
  [!ENDIF!][!//
  [!IF "node:value(as:modconf('Csm')/CsmEbGeneral/CsmEbMisc/CsmEbCorrectionCsmJobBasedCallbacknotificationPorts) = 'false'"!][!//
    [!IF "$Csm_Rte_Enabled_Callback = 'true'"!][!//
                <BSW-MODULE-ENTRY-REF-CONDITIONAL>
                  <BSW-MODULE-ENTRY-REF DEST="BSW-MODULE-ENTRY">/AUTOSAR_Csm/BswModuleEntrys/Csm_CallbackNotification</BSW-MODULE-ENTRY-REF>
                </BSW-MODULE-ENTRY-REF-CONDITIONAL>
      [!LOOP "as:modconf('Csm')/CsmCallbacks/CsmCallback/*[node:empty(./CsmCallbackFunc)]"!][!//
        [!VAR "vCbk" = "node:name(.)"!][!//
                <BSW-MODULE-ENTRY-REF-CONDITIONAL>
                  <BSW-MODULE-ENTRY-REF DEST="BSW-MODULE-ENTRY">/AUTOSAR_Csm/BswModuleEntrys/Csm_[!"$vCbk"!]_CallbackNotification</BSW-MODULE-ENTRY-REF>
                </BSW-MODULE-ENTRY-REF-CONDITIONAL>
      [!ENDLOOP!][!//
    [!ENDIF!][!//
  [!ELSE!][!//
    [!IF "$Csm_Rte_Enabled_CallbackR2011 = 'true'"!][!//
                <BSW-MODULE-ENTRY-REF-CONDITIONAL>
                  <BSW-MODULE-ENTRY-REF DEST="BSW-MODULE-ENTRY">/AUTOSAR_Csm/BswModuleEntrys/Csm_CallbackNotification</BSW-MODULE-ENTRY-REF>
                </BSW-MODULE-ENTRY-REF-CONDITIONAL>
      [!LOOP "as:modconf('Csm')/CsmJobs/CsmJob/*[CsmJobUsePort = 'true']"!][!//
        [!IF "node:exists(node:ref(./CsmJobPrimitiveRef)/*) = 'true' and node:value(node:ref(./CsmJobPrimitiveRef)/*/*/*[contains(node:name(.),'Processing')]) = 'CSM_ASYNCHRONOUS'"!][!//
            [!VAR "vJob" = "node:name(.)"!][!//
                <BSW-MODULE-ENTRY-REF-CONDITIONAL>
                  <BSW-MODULE-ENTRY-REF DEST="BSW-MODULE-ENTRY">/AUTOSAR_Csm/BswModuleEntrys/Csm_CallbackNotification_[!"$vJob"!]</BSW-MODULE-ENTRY-REF>
                </BSW-MODULE-ENTRY-REF-CONDITIONAL>
        [!ENDIF!][!//
      [!ENDLOOP!][!//
    [!ENDIF!][!//
  [!ENDIF!][!//
[!ENDIF!][!//


[!LOOP "as:modconf('Csm')/CsmMainFunction/*"!][!//
                <BSW-MODULE-ENTRY-REF-CONDITIONAL>
                  <BSW-MODULE-ENTRY-REF DEST="BSW-MODULE-ENTRY">/AUTOSAR_Csm/BswModuleEntrys/Csm_MainFunction_[!"node:name(.)"!]</BSW-MODULE-ENTRY-REF>
                </BSW-MODULE-ENTRY-REF-CONDITIONAL>
[!ENDLOOP!][!//
[!LOOP "node:refs(as:modconf('Csm')/CsmMainFunction/*/CsmMainFunctionPartitionRef)"!][!//
  [!VAR "vEcucPartition" = "node:name(.)"!]
                <BSW-MODULE-ENTRY-REF-CONDITIONAL>
                  <BSW-MODULE-ENTRY-REF DEST="BSW-MODULE-ENTRY">/AUTOSAR_Csm/BswModuleEntrys/Csm_Init_[!"$vEcucPartition"!]</BSW-MODULE-ENTRY-REF>
                </BSW-MODULE-ENTRY-REF-CONDITIONAL>
  [!IF "num:i(0) != num:i(count(as:modconf('Csm')/CsmJobs/CsmJob/*[CsmJobUsePort = 'true' and node:name(node:ref(node:ref(node:ref(./CsmJobQueueRef)/CsmQueueMainFunctionRef)/CsmMainFunctionPartitionRef)) = $vEcucPartition]))"!][!//
                <BSW-MODULE-ENTRY-REF-CONDITIONAL>
                  <BSW-MODULE-ENTRY-REF DEST="BSW-MODULE-ENTRY">/AUTOSAR_Csm/BswModuleEntrys/Csm_[!"$vEcucPartition"!]_CertificateParse</BSW-MODULE-ENTRY-REF>
                </BSW-MODULE-ENTRY-REF-CONDITIONAL>
                <BSW-MODULE-ENTRY-REF-CONDITIONAL>
                  <BSW-MODULE-ENTRY-REF DEST="BSW-MODULE-ENTRY">/AUTOSAR_Csm/BswModuleEntrys/Csm_[!"$vEcucPartition"!]_CertificateVerify</BSW-MODULE-ENTRY-REF>
                </BSW-MODULE-ENTRY-REF-CONDITIONAL>
                <BSW-MODULE-ENTRY-REF-CONDITIONAL>
                  <BSW-MODULE-ENTRY-REF DEST="BSW-MODULE-ENTRY">/AUTOSAR_Csm/BswModuleEntrys/Csm_[!"$vEcucPartition"!]_KeyCopy</BSW-MODULE-ENTRY-REF>
                </BSW-MODULE-ENTRY-REF-CONDITIONAL>
                <BSW-MODULE-ENTRY-REF-CONDITIONAL>
                  <BSW-MODULE-ENTRY-REF DEST="BSW-MODULE-ENTRY">/AUTOSAR_Csm/BswModuleEntrys/Csm_[!"$vEcucPartition"!]_KeyDerive</BSW-MODULE-ENTRY-REF>
                </BSW-MODULE-ENTRY-REF-CONDITIONAL>
                <BSW-MODULE-ENTRY-REF-CONDITIONAL>
                  <BSW-MODULE-ENTRY-REF DEST="BSW-MODULE-ENTRY">/AUTOSAR_Csm/BswModuleEntrys/Csm_[!"$vEcucPartition"!]_KeyElementCopy</BSW-MODULE-ENTRY-REF>
                </BSW-MODULE-ENTRY-REF-CONDITIONAL>
                <BSW-MODULE-ENTRY-REF-CONDITIONAL>
                  <BSW-MODULE-ENTRY-REF DEST="BSW-MODULE-ENTRY">/AUTOSAR_Csm/BswModuleEntrys/Csm_[!"$vEcucPartition"!]_KeyElementGet</BSW-MODULE-ENTRY-REF>
                </BSW-MODULE-ENTRY-REF-CONDITIONAL>
                <BSW-MODULE-ENTRY-REF-CONDITIONAL>
                  <BSW-MODULE-ENTRY-REF DEST="BSW-MODULE-ENTRY">/AUTOSAR_Csm/BswModuleEntrys/Csm_[!"$vEcucPartition"!]_KeyElementSet</BSW-MODULE-ENTRY-REF>
                </BSW-MODULE-ENTRY-REF-CONDITIONAL>
                <BSW-MODULE-ENTRY-REF-CONDITIONAL>
                  <BSW-MODULE-ENTRY-REF DEST="BSW-MODULE-ENTRY">/AUTOSAR_Csm/BswModuleEntrys/Csm_[!"$vEcucPartition"!]_KeyExchangeCalcPubVal</BSW-MODULE-ENTRY-REF>
                </BSW-MODULE-ENTRY-REF-CONDITIONAL>
                <BSW-MODULE-ENTRY-REF-CONDITIONAL>
                  <BSW-MODULE-ENTRY-REF DEST="BSW-MODULE-ENTRY">/AUTOSAR_Csm/BswModuleEntrys/Csm_[!"$vEcucPartition"!]_KeyExchangeCalcSecret</BSW-MODULE-ENTRY-REF>
                </BSW-MODULE-ENTRY-REF-CONDITIONAL>
                <BSW-MODULE-ENTRY-REF-CONDITIONAL>
                  <BSW-MODULE-ENTRY-REF DEST="BSW-MODULE-ENTRY">/AUTOSAR_Csm/BswModuleEntrys/Csm_[!"$vEcucPartition"!]_KeyGenerate</BSW-MODULE-ENTRY-REF>
                </BSW-MODULE-ENTRY-REF-CONDITIONAL>
                <BSW-MODULE-ENTRY-REF-CONDITIONAL>
                  <BSW-MODULE-ENTRY-REF DEST="BSW-MODULE-ENTRY">/AUTOSAR_Csm/BswModuleEntrys/Csm_[!"$vEcucPartition"!]_KeySetValid</BSW-MODULE-ENTRY-REF>
                </BSW-MODULE-ENTRY-REF-CONDITIONAL>
  [!IF "node:value(as:modconf('Csm')/CsmEbGeneral/CsmEbMisc/CsmEbEnhancementApiCsmKeySetInvalid) = 'true'"!][!//
                <BSW-MODULE-ENTRY-REF-CONDITIONAL>
                  <BSW-MODULE-ENTRY-REF DEST="BSW-MODULE-ENTRY">/AUTOSAR_Csm/BswModuleEntrys/Csm_[!"$vEcucPartition"!]_KeySetInvalid</BSW-MODULE-ENTRY-REF>
                </BSW-MODULE-ENTRY-REF-CONDITIONAL>
  [!ENDIF!][!//
  [!IF "node:value(as:modconf('Csm')/CsmEbGeneral/CsmEbMisc/CsmEbEnhancementApiCsmKeyGetStatus) = 'true'"!][!//
                <BSW-MODULE-ENTRY-REF-CONDITIONAL>
                  <BSW-MODULE-ENTRY-REF DEST="BSW-MODULE-ENTRY">/AUTOSAR_Csm/BswModuleEntrys/Csm_[!"$vEcucPartition"!]_KeyGetStatus</BSW-MODULE-ENTRY-REF>
                </BSW-MODULE-ENTRY-REF-CONDITIONAL>
  [!ENDIF!][!//
                <BSW-MODULE-ENTRY-REF-CONDITIONAL>
                  <BSW-MODULE-ENTRY-REF DEST="BSW-MODULE-ENTRY">/AUTOSAR_Csm/BswModuleEntrys/Csm_[!"$vEcucPartition"!]_RandomSeed</BSW-MODULE-ENTRY-REF>
                </BSW-MODULE-ENTRY-REF-CONDITIONAL>
  [!ENDIF!][!//
  [!IF "num:i(0) != num:i(count(node:refs(as:modconf('Csm')/CsmJobs/CsmJob/*[CsmJobUsePort = 'true' and node:name(node:ref(node:ref(node:ref(./CsmJobQueueRef)/CsmQueueMainFunctionRef)/CsmMainFunctionPartitionRef)) = $vEcucPartition]/CsmJobPrimitiveRef)/CsmAEADDecrypt))"!][!//
                <BSW-MODULE-ENTRY-REF-CONDITIONAL>
                  <BSW-MODULE-ENTRY-REF DEST="BSW-MODULE-ENTRY">/AUTOSAR_Csm/BswModuleEntrys/Csm_[!"$vEcucPartition"!]_AEADDecrypt</BSW-MODULE-ENTRY-REF>
                </BSW-MODULE-ENTRY-REF-CONDITIONAL>
  [!ENDIF!][!//
  [!IF "num:i(0) != num:i(count(node:refs(as:modconf('Csm')/CsmJobs/CsmJob/*[CsmJobUsePort = 'true' and node:name(node:ref(node:ref(node:ref(./CsmJobQueueRef)/CsmQueueMainFunctionRef)/CsmMainFunctionPartitionRef)) = $vEcucPartition]/CsmJobPrimitiveRef)/CsmAEADEncrypt))"!][!//
                <BSW-MODULE-ENTRY-REF-CONDITIONAL>
                  <BSW-MODULE-ENTRY-REF DEST="BSW-MODULE-ENTRY">/AUTOSAR_Csm/BswModuleEntrys/Csm_[!"$vEcucPartition"!]_AEADEncrypt</BSW-MODULE-ENTRY-REF>
                </BSW-MODULE-ENTRY-REF-CONDITIONAL>
  [!ENDIF!][!//
  [!IF "num:i(0) != num:i(count(node:refs(as:modconf('Csm')/CsmJobs/CsmJob/*[CsmJobUsePort = 'true' and node:name(node:ref(node:ref(node:ref(./CsmJobQueueRef)/CsmQueueMainFunctionRef)/CsmMainFunctionPartitionRef)) = $vEcucPartition]/CsmJobPrimitiveRef)/CsmDecrypt))"!][!//
                <BSW-MODULE-ENTRY-REF-CONDITIONAL>
                  <BSW-MODULE-ENTRY-REF DEST="BSW-MODULE-ENTRY">/AUTOSAR_Csm/BswModuleEntrys/Csm_[!"$vEcucPartition"!]_Decrypt</BSW-MODULE-ENTRY-REF>
                </BSW-MODULE-ENTRY-REF-CONDITIONAL>
  [!ENDIF!][!//
  [!IF "num:i(0) != num:i(count(node:refs(as:modconf('Csm')/CsmJobs/CsmJob/*[CsmJobUsePort = 'true' and node:name(node:ref(node:ref(node:ref(./CsmJobQueueRef)/CsmQueueMainFunctionRef)/CsmMainFunctionPartitionRef)) = $vEcucPartition]/CsmJobPrimitiveRef)/CsmEncrypt))"!][!//
                <BSW-MODULE-ENTRY-REF-CONDITIONAL>
                  <BSW-MODULE-ENTRY-REF DEST="BSW-MODULE-ENTRY">/AUTOSAR_Csm/BswModuleEntrys/Csm_[!"$vEcucPartition"!]_Encrypt</BSW-MODULE-ENTRY-REF>
                </BSW-MODULE-ENTRY-REF-CONDITIONAL>
  [!ENDIF!][!//
  [!IF "num:i(0) != num:i(count(node:refs(as:modconf('Csm')/CsmJobs/CsmJob/*[CsmJobUsePort = 'true' and node:name(node:ref(node:ref(node:ref(./CsmJobQueueRef)/CsmQueueMainFunctionRef)/CsmMainFunctionPartitionRef)) = $vEcucPartition]/CsmJobPrimitiveRef)/CsmHash))"!][!//
                <BSW-MODULE-ENTRY-REF-CONDITIONAL>
                  <BSW-MODULE-ENTRY-REF DEST="BSW-MODULE-ENTRY">/AUTOSAR_Csm/BswModuleEntrys/Csm_[!"$vEcucPartition"!]_Hash</BSW-MODULE-ENTRY-REF>
                </BSW-MODULE-ENTRY-REF-CONDITIONAL>
  [!ENDIF!][!//
  [!IF "num:i(0) != num:i(count(node:refs(as:modconf('Csm')/CsmJobs/CsmJob/*[CsmJobUsePort = 'true' and node:name(node:ref(node:ref(node:ref(./CsmJobQueueRef)/CsmQueueMainFunctionRef)/CsmMainFunctionPartitionRef)) = $vEcucPartition]/CsmJobPrimitiveRef)/CsmMacGenerate))"!][!//
                <BSW-MODULE-ENTRY-REF-CONDITIONAL>
                  <BSW-MODULE-ENTRY-REF DEST="BSW-MODULE-ENTRY">/AUTOSAR_Csm/BswModuleEntrys/Csm_[!"$vEcucPartition"!]_MacGenerate</BSW-MODULE-ENTRY-REF>
                </BSW-MODULE-ENTRY-REF-CONDITIONAL>
  [!ENDIF!][!//
  [!IF "num:i(0) != num:i(count(node:refs(as:modconf('Csm')/CsmJobs/CsmJob/*[CsmJobUsePort = 'true' and node:name(node:ref(node:ref(node:ref(./CsmJobQueueRef)/CsmQueueMainFunctionRef)/CsmMainFunctionPartitionRef)) = $vEcucPartition]/CsmJobPrimitiveRef)/CsmMacVerify))"!][!//
                <BSW-MODULE-ENTRY-REF-CONDITIONAL>
                  <BSW-MODULE-ENTRY-REF DEST="BSW-MODULE-ENTRY">/AUTOSAR_Csm/BswModuleEntrys/Csm_[!"$vEcucPartition"!]_MacVerify</BSW-MODULE-ENTRY-REF>
                </BSW-MODULE-ENTRY-REF-CONDITIONAL>
  [!ENDIF!][!//
  [!IF "num:i(0) != num:i(count(node:refs(as:modconf('Csm')/CsmJobs/CsmJob/*[CsmJobUsePort = 'true' and node:name(node:ref(node:ref(node:ref(./CsmJobQueueRef)/CsmQueueMainFunctionRef)/CsmMainFunctionPartitionRef)) = $vEcucPartition]/CsmJobPrimitiveRef)/CsmSignatureGenerate))"!][!//
                <BSW-MODULE-ENTRY-REF-CONDITIONAL>
                  <BSW-MODULE-ENTRY-REF DEST="BSW-MODULE-ENTRY">/AUTOSAR_Csm/BswModuleEntrys/Csm_[!"$vEcucPartition"!]_SignatureGenerate</BSW-MODULE-ENTRY-REF>
                </BSW-MODULE-ENTRY-REF-CONDITIONAL>
  [!ENDIF!][!//
  [!IF "num:i(0) != num:i(count(node:refs(as:modconf('Csm')/CsmJobs/CsmJob/*[CsmJobUsePort = 'true' and node:name(node:ref(node:ref(node:ref(./CsmJobQueueRef)/CsmQueueMainFunctionRef)/CsmMainFunctionPartitionRef)) = $vEcucPartition]/CsmJobPrimitiveRef)/CsmSignatureVerify))"!][!//
                <BSW-MODULE-ENTRY-REF-CONDITIONAL>
                  <BSW-MODULE-ENTRY-REF DEST="BSW-MODULE-ENTRY">/AUTOSAR_Csm/BswModuleEntrys/Csm_[!"$vEcucPartition"!]_SignatureVerify</BSW-MODULE-ENTRY-REF>
                </BSW-MODULE-ENTRY-REF-CONDITIONAL>
  [!ENDIF!][!//
  [!IF "num:i(0) != num:i(count(node:refs(as:modconf('Csm')/CsmJobs/CsmJob/*[CsmJobUsePort = 'true' and node:name(node:ref(node:ref(node:ref(./CsmJobQueueRef)/CsmQueueMainFunctionRef)/CsmMainFunctionPartitionRef)) = $vEcucPartition]/CsmJobPrimitiveRef)/CsmRandomGenerate))"!][!//
                <BSW-MODULE-ENTRY-REF-CONDITIONAL>
                  <BSW-MODULE-ENTRY-REF DEST="BSW-MODULE-ENTRY">/AUTOSAR_Csm/BswModuleEntrys/Csm_[!"$vEcucPartition"!]_RandomGenerate</BSW-MODULE-ENTRY-REF>
                </BSW-MODULE-ENTRY-REF-CONDITIONAL>
  [!ENDIF!][!//
  [!IF "node:value(as:modconf('Csm')/CsmEbGeneral/CsmEbMisc/CsmEbCorrectionCsmAsyncJobInterfaceUseDataReferences) = 'true' and num:i(0) != num:i(count(node:refs(as:modconf('Csm')/CsmJobs/CsmJob/*[CsmJobUsePort = 'true' and node:name(node:ref(node:ref(node:ref(./CsmJobQueueRef)/CsmQueueMainFunctionRef)/CsmMainFunctionPartitionRef)) = $vEcucPartition]/CsmJobPrimitiveRef)/CsmAEADDecrypt/*/*[contains(node:name(.),'Processing') and node:value(.) = 'CSM_ASYNCHRONOUS']))"!][!//
                <BSW-MODULE-ENTRY-REF-CONDITIONAL>
                  <BSW-MODULE-ENTRY-REF DEST="BSW-MODULE-ENTRY">/AUTOSAR_Csm/BswModuleEntrys/Csm_[!"$vEcucPartition"!]_AEADDecrypt_OAW</BSW-MODULE-ENTRY-REF>
                </BSW-MODULE-ENTRY-REF-CONDITIONAL>
  [!ENDIF!][!//
  [!IF "node:value(as:modconf('Csm')/CsmEbGeneral/CsmEbMisc/CsmEbCorrectionCsmAsyncJobInterfaceUseDataReferences) = 'true' and num:i(0) != num:i(count(node:refs(as:modconf('Csm')/CsmJobs/CsmJob/*[CsmJobUsePort = 'true' and node:name(node:ref(node:ref(node:ref(./CsmJobQueueRef)/CsmQueueMainFunctionRef)/CsmMainFunctionPartitionRef)) = $vEcucPartition]/CsmJobPrimitiveRef)/CsmAEADEncrypt/*/*[contains(node:name(.),'Processing') and node:value(.) = 'CSM_ASYNCHRONOUS']))"!][!//
                <BSW-MODULE-ENTRY-REF-CONDITIONAL>
                  <BSW-MODULE-ENTRY-REF DEST="BSW-MODULE-ENTRY">/AUTOSAR_Csm/BswModuleEntrys/Csm_[!"$vEcucPartition"!]_AEADEncrypt_OAW</BSW-MODULE-ENTRY-REF>
                </BSW-MODULE-ENTRY-REF-CONDITIONAL>
  [!ENDIF!][!//
  [!IF "node:value(as:modconf('Csm')/CsmEbGeneral/CsmEbMisc/CsmEbCorrectionCsmAsyncJobInterfaceUseDataReferences) = 'true' and num:i(0) != num:i(count(node:refs(as:modconf('Csm')/CsmJobs/CsmJob/*[CsmJobUsePort = 'true' and node:name(node:ref(node:ref(node:ref(./CsmJobQueueRef)/CsmQueueMainFunctionRef)/CsmMainFunctionPartitionRef)) = $vEcucPartition]/CsmJobPrimitiveRef)/CsmDecrypt/*/*[contains(node:name(.),'Processing') and node:value(.) = 'CSM_ASYNCHRONOUS']))"!][!//
                <BSW-MODULE-ENTRY-REF-CONDITIONAL>
                  <BSW-MODULE-ENTRY-REF DEST="BSW-MODULE-ENTRY">/AUTOSAR_Csm/BswModuleEntrys/Csm_[!"$vEcucPartition"!]_Decrypt_OAW</BSW-MODULE-ENTRY-REF>
                </BSW-MODULE-ENTRY-REF-CONDITIONAL>
  [!ENDIF!][!//
  [!IF "node:value(as:modconf('Csm')/CsmEbGeneral/CsmEbMisc/CsmEbCorrectionCsmAsyncJobInterfaceUseDataReferences) = 'true' and num:i(0) != num:i(count(node:refs(as:modconf('Csm')/CsmJobs/CsmJob/*[CsmJobUsePort = 'true' and node:name(node:ref(node:ref(node:ref(./CsmJobQueueRef)/CsmQueueMainFunctionRef)/CsmMainFunctionPartitionRef)) = $vEcucPartition]/CsmJobPrimitiveRef)/CsmEncrypt/*/*[contains(node:name(.),'Processing') and node:value(.) = 'CSM_ASYNCHRONOUS']))"!][!//
                <BSW-MODULE-ENTRY-REF-CONDITIONAL>
                  <BSW-MODULE-ENTRY-REF DEST="BSW-MODULE-ENTRY">/AUTOSAR_Csm/BswModuleEntrys/Csm_[!"$vEcucPartition"!]_Encrypt_OAW</BSW-MODULE-ENTRY-REF>
                </BSW-MODULE-ENTRY-REF-CONDITIONAL>
  [!ENDIF!][!//
  [!IF "node:value(as:modconf('Csm')/CsmEbGeneral/CsmEbMisc/CsmEbCorrectionCsmAsyncJobInterfaceUseDataReferences) = 'true' and num:i(0) != num:i(count(node:refs(as:modconf('Csm')/CsmJobs/CsmJob/*[CsmJobUsePort = 'true' and node:name(node:ref(node:ref(node:ref(./CsmJobQueueRef)/CsmQueueMainFunctionRef)/CsmMainFunctionPartitionRef)) = $vEcucPartition]/CsmJobPrimitiveRef)/CsmHash/*/*[contains(node:name(.),'Processing') and node:value(.) = 'CSM_ASYNCHRONOUS']))"!][!//
                <BSW-MODULE-ENTRY-REF-CONDITIONAL>
                  <BSW-MODULE-ENTRY-REF DEST="BSW-MODULE-ENTRY">/AUTOSAR_Csm/BswModuleEntrys/Csm_[!"$vEcucPartition"!]_Hash_OAW</BSW-MODULE-ENTRY-REF>
                </BSW-MODULE-ENTRY-REF-CONDITIONAL>
  [!ENDIF!][!//
  [!IF "node:value(as:modconf('Csm')/CsmEbGeneral/CsmEbMisc/CsmEbCorrectionCsmAsyncJobInterfaceUseDataReferences) = 'true' and num:i(0) != num:i(count(node:refs(as:modconf('Csm')/CsmJobs/CsmJob/*[CsmJobUsePort = 'true' and node:name(node:ref(node:ref(node:ref(./CsmJobQueueRef)/CsmQueueMainFunctionRef)/CsmMainFunctionPartitionRef)) = $vEcucPartition]/CsmJobPrimitiveRef)/CsmMacGenerate/*/*[contains(node:name(.),'Processing') and node:value(.) = 'CSM_ASYNCHRONOUS']))"!][!//
                <BSW-MODULE-ENTRY-REF-CONDITIONAL>
                  <BSW-MODULE-ENTRY-REF DEST="BSW-MODULE-ENTRY">/AUTOSAR_Csm/BswModuleEntrys/Csm_[!"$vEcucPartition"!]_MacGenerate_OAW</BSW-MODULE-ENTRY-REF>
                </BSW-MODULE-ENTRY-REF-CONDITIONAL>
  [!ENDIF!][!//
  [!IF "node:value(as:modconf('Csm')/CsmEbGeneral/CsmEbMisc/CsmEbCorrectionCsmAsyncJobInterfaceUseDataReferences) = 'true' and num:i(0) != num:i(count(node:refs(as:modconf('Csm')/CsmJobs/CsmJob/*[CsmJobUsePort = 'true' and node:name(node:ref(node:ref(node:ref(./CsmJobQueueRef)/CsmQueueMainFunctionRef)/CsmMainFunctionPartitionRef)) = $vEcucPartition]/CsmJobPrimitiveRef)/CsmMacVerify/*/*[contains(node:name(.),'Processing') and node:value(.) = 'CSM_ASYNCHRONOUS']))"!][!//
                <BSW-MODULE-ENTRY-REF-CONDITIONAL>
                  <BSW-MODULE-ENTRY-REF DEST="BSW-MODULE-ENTRY">/AUTOSAR_Csm/BswModuleEntrys/Csm_[!"$vEcucPartition"!]_MacVerify_OAW</BSW-MODULE-ENTRY-REF>
                </BSW-MODULE-ENTRY-REF-CONDITIONAL>
  [!ENDIF!][!//
  [!IF "node:value(as:modconf('Csm')/CsmEbGeneral/CsmEbMisc/CsmEbCorrectionCsmAsyncJobInterfaceUseDataReferences) = 'true' and num:i(0) != num:i(count(node:refs(as:modconf('Csm')/CsmJobs/CsmJob/*[CsmJobUsePort = 'true' and node:name(node:ref(node:ref(node:ref(./CsmJobQueueRef)/CsmQueueMainFunctionRef)/CsmMainFunctionPartitionRef)) = $vEcucPartition]/CsmJobPrimitiveRef)/CsmSignatureGenerate/*/*[contains(node:name(.),'Processing') and node:value(.) = 'CSM_ASYNCHRONOUS']))"!][!//
                <BSW-MODULE-ENTRY-REF-CONDITIONAL>
                  <BSW-MODULE-ENTRY-REF DEST="BSW-MODULE-ENTRY">/AUTOSAR_Csm/BswModuleEntrys/Csm_[!"$vEcucPartition"!]_SignatureGenerate_OAW</BSW-MODULE-ENTRY-REF>
                </BSW-MODULE-ENTRY-REF-CONDITIONAL>
  [!ENDIF!][!//
  [!IF "node:value(as:modconf('Csm')/CsmEbGeneral/CsmEbMisc/CsmEbCorrectionCsmAsyncJobInterfaceUseDataReferences) = 'true' and num:i(0) != num:i(count(node:refs(as:modconf('Csm')/CsmJobs/CsmJob/*[CsmJobUsePort = 'true' and node:name(node:ref(node:ref(node:ref(./CsmJobQueueRef)/CsmQueueMainFunctionRef)/CsmMainFunctionPartitionRef)) = $vEcucPartition]/CsmJobPrimitiveRef)/CsmSignatureVerify/*/*[contains(node:name(.),'Processing') and node:value(.) = 'CSM_ASYNCHRONOUS']))"!][!//
                <BSW-MODULE-ENTRY-REF-CONDITIONAL>
                  <BSW-MODULE-ENTRY-REF DEST="BSW-MODULE-ENTRY">/AUTOSAR_Csm/BswModuleEntrys/Csm_[!"$vEcucPartition"!]_SignatureVerify_OAW</BSW-MODULE-ENTRY-REF>
                </BSW-MODULE-ENTRY-REF-CONDITIONAL>
  [!ENDIF!][!//
  [!IF "node:value(as:modconf('Csm')/CsmEbGeneral/CsmEbMisc/CsmEbCorrectionCsmAsyncJobInterfaceUseDataReferences) = 'true' and num:i(0) != num:i(count(node:refs(as:modconf('Csm')/CsmJobs/CsmJob/*[CsmJobUsePort = 'true' and node:name(node:ref(node:ref(node:ref(./CsmJobQueueRef)/CsmQueueMainFunctionRef)/CsmMainFunctionPartitionRef)) = $vEcucPartition]/CsmJobPrimitiveRef)/CsmRandomGenerate/*/*[contains(node:name(.),'Processing') and node:value(.) = 'CSM_ASYNCHRONOUS']))"!][!//
                <BSW-MODULE-ENTRY-REF-CONDITIONAL>
                  <BSW-MODULE-ENTRY-REF DEST="BSW-MODULE-ENTRY">/AUTOSAR_Csm/BswModuleEntrys/Csm_[!"$vEcucPartition"!]_RandomGenerate_OAW</BSW-MODULE-ENTRY-REF>
                </BSW-MODULE-ENTRY-REF-CONDITIONAL>
  [!ENDIF!][!//
  [!IF "num:i(0) != (num:i(count(node:refs(as:modconf('Csm')/CsmJobs/CsmJob/*[CsmJobUsePort = 'true' and node:name(node:ref(node:ref(node:ref(./CsmJobQueueRef)/CsmQueueMainFunctionRef)/CsmMainFunctionPartitionRef)) = $vEcucPartition]/CsmJobPrimitiveRef)/*)) - num:i(count(node:refs(as:modconf('Csm')/CsmJobs/CsmJob/*[CsmJobUsePort = 'true' and node:name(node:ref(node:ref(node:ref(./CsmJobQueueRef)/CsmQueueMainFunctionRef)/CsmMainFunctionPartitionRef)) = $vEcucPartition]/CsmJobPrimitiveRef)/CsmRandomGenerate)))"!][!//
                <BSW-MODULE-ENTRY-REF-CONDITIONAL>
                  <BSW-MODULE-ENTRY-REF DEST="BSW-MODULE-ENTRY">/AUTOSAR_Csm/BswModuleEntrys/Csm_[!"$vEcucPartition"!]_CancelJob</BSW-MODULE-ENTRY-REF>
                </BSW-MODULE-ENTRY-REF-CONDITIONAL>
  [!ENDIF!][!//
  [!IF "node:value(as:modconf('Csm')/CsmEbGeneral/CsmEbMisc/CsmEbCorrectionCsmAsyncJobInterfaceUseDataReferences) = 'true' and num:i(0) != num:i(count(node:refs(as:modconf('Csm')/CsmJobs/CsmJob/*[CsmJobUsePort = 'true' and node:name(node:ref(node:ref(node:ref(./CsmJobQueueRef)/CsmQueueMainFunctionRef)/CsmMainFunctionPartitionRef)) = $vEcucPartition]/CsmJobPrimitiveRef)/*/*/*[contains(node:name(.),'Processing') and node:value(.) = 'CSM_ASYNCHRONOUS']))"!][!//
                <BSW-MODULE-ENTRY-REF-CONDITIONAL>
                  <BSW-MODULE-ENTRY-REF DEST="BSW-MODULE-ENTRY">/AUTOSAR_Csm/BswModuleEntrys/Csm_[!"$vEcucPartition"!]_CancelJob_OAW</BSW-MODULE-ENTRY-REF>
                </BSW-MODULE-ENTRY-REF-CONDITIONAL>
  [!ENDIF!][!//
  [!IF "node:value(as:modconf('Csm')/CsmEbGeneral/CsmEbMisc/CsmEbCorrectionCsmJobBasedCallbacknotificationPorts) = 'false'"!][!//
    [!IF "$Csm_Rte_Enabled_Callback = 'true'"!][!//
                <BSW-MODULE-ENTRY-REF-CONDITIONAL>
                  <BSW-MODULE-ENTRY-REF DEST="BSW-MODULE-ENTRY">/AUTOSAR_Csm/BswModuleEntrys/Csm_CallbackNotification</BSW-MODULE-ENTRY-REF>
                </BSW-MODULE-ENTRY-REF-CONDITIONAL>
      [!LOOP "as:modconf('Csm')/CsmCallbacks/CsmCallback/*[node:empty(./CsmCallbackFunc)]"!][!//
        [!VAR "vCbk" = "node:name(.)"!][!//
                <BSW-MODULE-ENTRY-REF-CONDITIONAL>
                  <BSW-MODULE-ENTRY-REF DEST="BSW-MODULE-ENTRY">/AUTOSAR_Csm/BswModuleEntrys/Csm_[!"$vCbk"!]_CallbackNotification</BSW-MODULE-ENTRY-REF>
                </BSW-MODULE-ENTRY-REF-CONDITIONAL>
      [!ENDLOOP!][!//
    [!ENDIF!][!//
  [!ELSE!][!//
    [!IF "$Csm_Rte_Enabled_CallbackR2011 = 'true'"!][!//
                <BSW-MODULE-ENTRY-REF-CONDITIONAL>
                  <BSW-MODULE-ENTRY-REF DEST="BSW-MODULE-ENTRY">/AUTOSAR_Csm/BswModuleEntrys/Csm_CallbackNotification</BSW-MODULE-ENTRY-REF>
                </BSW-MODULE-ENTRY-REF-CONDITIONAL>
      [!LOOP "as:modconf('Csm')/CsmJobs/CsmJob/*[CsmJobUsePort = 'true']"!][!//
        [!IF "node:exists(node:ref(./CsmJobPrimitiveRef)/*) = 'true' and node:value(node:ref(./CsmJobPrimitiveRef)/*/*/*[contains(node:name(.),'Processing')]) = 'CSM_ASYNCHRONOUS'"!][!//
            [!VAR "vJob" = "node:name(.)"!][!//
                <BSW-MODULE-ENTRY-REF-CONDITIONAL>
                  <BSW-MODULE-ENTRY-REF DEST="BSW-MODULE-ENTRY">/AUTOSAR_Csm/BswModuleEntrys/Csm_CallbackNotification_[!"$vJob"!]</BSW-MODULE-ENTRY-REF>
                </BSW-MODULE-ENTRY-REF-CONDITIONAL>
        [!ENDIF!][!//
      [!ENDLOOP!][!//
    [!ENDIF!][!//
  [!ENDIF!][!//
[!ENDLOOP!][!//





              </PROVIDED-ENTRYS>
              <INTERNAL-BEHAVIORS>
[!IF "num:i(0) = num:i(count(as:modconf('Csm')/CsmMainFunction/*))"!][!//
                <BSW-INTERNAL-BEHAVIOR>
                  <SHORT-NAME>InternalBehavior_0</SHORT-NAME>
                  <EXCLUSIVE-AREAS>
                    <EXCLUSIVE-AREA>
                      <SHORT-NAME>SCHM_CSM_EXCLUSIVE_AREA_0</SHORT-NAME>
                    </EXCLUSIVE-AREA>
                  </EXCLUSIVE-AREAS>
  [!IF "node:value(as:modconf('Csm')/CsmEbGeneral/CsmEbMisc/CsmEbCorrectionCsmJobBasedCallbacknotificationPorts) = 'false'"!][!//
    [!IF "$Csm_Rte_Enabled_Callback = 'true'"!][!//
                  <INTERNAL-TRIGGERING-POINTS>
      [!LOOP "as:modconf('Csm')/CsmCallbacks/CsmCallback/*[node:empty(./CsmCallbackFunc)]"!][!//
        [!VAR "vCbk" = "node:name(.)"!][!//
                    <BSW-INTERNAL-TRIGGERING-POINT>
                      <SHORT-NAME>[!"$vCbk"!]_InternalTriggerForCallback</SHORT-NAME>
                    </BSW-INTERNAL-TRIGGERING-POINT>
      [!ENDLOOP!][!//
                  </INTERNAL-TRIGGERING-POINTS>
    [!ENDIF!][!//
  [!ELSE!][!//
    [!IF "$Csm_Rte_Enabled_CallbackR2011 = 'true'"!][!//
                  <INTERNAL-TRIGGERING-POINTS>
      [!LOOP "as:modconf('Csm')/CsmJobs/CsmJob/*[CsmJobUsePort = 'true']"!][!//
        [!IF "node:exists(node:ref(./CsmJobPrimitiveRef)/*) = 'true' and node:value(node:ref(./CsmJobPrimitiveRef)/*/*/*[contains(node:name(.),'Processing')]) = 'CSM_ASYNCHRONOUS'"!][!//
            [!VAR "vJob" = "node:name(.)"!][!//
                    <BSW-INTERNAL-TRIGGERING-POINT>
                      <SHORT-NAME>InternalTriggerForCallback_[!"$vJob"!]</SHORT-NAME>
                    </BSW-INTERNAL-TRIGGERING-POINT>
        [!ENDIF!][!//
      [!ENDLOOP!][!//
                  </INTERNAL-TRIGGERING-POINTS>
    [!ENDIF!][!//
  [!ENDIF!][!//
                  <ENTITYS>
                    <BSW-CALLED-ENTITY>
                      <SHORT-NAME>Csm_Init</SHORT-NAME>
                      <MINIMUM-START-INTERVAL>0.0</MINIMUM-START-INTERVAL>
                      <IMPLEMENTED-ENTRY-REF DEST="BSW-MODULE-ENTRY">/AUTOSAR_Csm/BswModuleEntrys/Csm_Init</IMPLEMENTED-ENTRY-REF>
                    </BSW-CALLED-ENTITY>
  [!IF "$Csm_Flg_Async = 'true'"!][!//
                    <BSW-SCHEDULABLE-ENTITY>
                      <SHORT-NAME>Csm_MainFunction</SHORT-NAME>
                      <CAN-ENTER-EXCLUSIVE-AREA-REFS>
                        <CAN-ENTER-EXCLUSIVE-AREA-REF DEST="EXCLUSIVE-AREA">/AUTOSAR_Csm/BswModuleDescriptions/Csm/InternalBehavior_0/SCHM_CSM_EXCLUSIVE_AREA_0</CAN-ENTER-EXCLUSIVE-AREA-REF>
                      </CAN-ENTER-EXCLUSIVE-AREA-REFS>
                      <MINIMUM-START-INTERVAL>0.0</MINIMUM-START-INTERVAL>
                      <IMPLEMENTED-ENTRY-REF DEST="BSW-MODULE-ENTRY">/AUTOSAR_Csm/BswModuleEntrys/Csm_MainFunction</IMPLEMENTED-ENTRY-REF>
                    </BSW-SCHEDULABLE-ENTITY>
  [!ENDIF!][!//
  [!IF "$Csm_Api_Enabled_KeyMngmnt = 'true'"!][!//
                    <BSW-CALLED-ENTITY>
                      <SHORT-NAME>CE_Key_CertificateParse</SHORT-NAME>
                      <MINIMUM-START-INTERVAL>0.0</MINIMUM-START-INTERVAL>
                      <IMPLEMENTED-ENTRY-REF DEST="BSW-MODULE-ENTRY">/AUTOSAR_Csm/BswModuleEntrys/Csm_CertificateParse</IMPLEMENTED-ENTRY-REF>
                    </BSW-CALLED-ENTITY>
                    <BSW-CALLED-ENTITY>
                      <SHORT-NAME>CE_Key_CertificateVerify</SHORT-NAME>
                      <MINIMUM-START-INTERVAL>0.0</MINIMUM-START-INTERVAL>
                      <IMPLEMENTED-ENTRY-REF DEST="BSW-MODULE-ENTRY">/AUTOSAR_Csm/BswModuleEntrys/Csm_CertificateVerify</IMPLEMENTED-ENTRY-REF>
                    </BSW-CALLED-ENTITY>
                    <BSW-CALLED-ENTITY>
                      <SHORT-NAME>CE_Key_KeyCopy</SHORT-NAME>
                      <MINIMUM-START-INTERVAL>0.0</MINIMUM-START-INTERVAL>
                      <IMPLEMENTED-ENTRY-REF DEST="BSW-MODULE-ENTRY">/AUTOSAR_Csm/BswModuleEntrys/Csm_KeyCopy</IMPLEMENTED-ENTRY-REF>
                    </BSW-CALLED-ENTITY>
                    <BSW-CALLED-ENTITY>
                      <SHORT-NAME>CE_Key_KeyDerive</SHORT-NAME>
                      <MINIMUM-START-INTERVAL>0.0</MINIMUM-START-INTERVAL>
                      <IMPLEMENTED-ENTRY-REF DEST="BSW-MODULE-ENTRY">/AUTOSAR_Csm/BswModuleEntrys/Csm_KeyDerive</IMPLEMENTED-ENTRY-REF>
                    </BSW-CALLED-ENTITY>
                    <BSW-CALLED-ENTITY>
                      <SHORT-NAME>CE_Key_KeyElementCopy</SHORT-NAME>
                      <MINIMUM-START-INTERVAL>0.0</MINIMUM-START-INTERVAL>
                      <IMPLEMENTED-ENTRY-REF DEST="BSW-MODULE-ENTRY">/AUTOSAR_Csm/BswModuleEntrys/Csm_KeyElementCopy</IMPLEMENTED-ENTRY-REF>
                    </BSW-CALLED-ENTITY>
                    <BSW-CALLED-ENTITY>
                      <SHORT-NAME>CE_Key_KeyElementGet</SHORT-NAME>
                      <MINIMUM-START-INTERVAL>0.0</MINIMUM-START-INTERVAL>
                      <IMPLEMENTED-ENTRY-REF DEST="BSW-MODULE-ENTRY">/AUTOSAR_Csm/BswModuleEntrys/Csm_KeyElementGet</IMPLEMENTED-ENTRY-REF>
                    </BSW-CALLED-ENTITY>
                    <BSW-CALLED-ENTITY>
                      <SHORT-NAME>CE_Key_KeyElementSet</SHORT-NAME>
                      <MINIMUM-START-INTERVAL>0.0</MINIMUM-START-INTERVAL>
                      <IMPLEMENTED-ENTRY-REF DEST="BSW-MODULE-ENTRY">/AUTOSAR_Csm/BswModuleEntrys/Csm_KeyElementSet</IMPLEMENTED-ENTRY-REF>
                    </BSW-CALLED-ENTITY>
                    <BSW-CALLED-ENTITY>
                      <SHORT-NAME>CE_Key_KeyExchangeCalcPubVal</SHORT-NAME>
                      <MINIMUM-START-INTERVAL>0.0</MINIMUM-START-INTERVAL>
                      <IMPLEMENTED-ENTRY-REF DEST="BSW-MODULE-ENTRY">/AUTOSAR_Csm/BswModuleEntrys/Csm_KeyExchangeCalcPubVal</IMPLEMENTED-ENTRY-REF>
                    </BSW-CALLED-ENTITY>
                    <BSW-CALLED-ENTITY>
                      <SHORT-NAME>CE_Key_KeyExchangeCalcSecret</SHORT-NAME>
                      <MINIMUM-START-INTERVAL>0.0</MINIMUM-START-INTERVAL>
                      <IMPLEMENTED-ENTRY-REF DEST="BSW-MODULE-ENTRY">/AUTOSAR_Csm/BswModuleEntrys/Csm_KeyExchangeCalcSecret</IMPLEMENTED-ENTRY-REF>
                    </BSW-CALLED-ENTITY>
                    <BSW-CALLED-ENTITY>
                      <SHORT-NAME>CE_Key_KeyGenerate</SHORT-NAME>
                      <MINIMUM-START-INTERVAL>0.0</MINIMUM-START-INTERVAL>
                      <IMPLEMENTED-ENTRY-REF DEST="BSW-MODULE-ENTRY">/AUTOSAR_Csm/BswModuleEntrys/Csm_KeyGenerate</IMPLEMENTED-ENTRY-REF>
                    </BSW-CALLED-ENTITY>
                    <BSW-CALLED-ENTITY>
                      <SHORT-NAME>CE_Key_KeySetValid</SHORT-NAME>
                      <MINIMUM-START-INTERVAL>0.0</MINIMUM-START-INTERVAL>
                      <IMPLEMENTED-ENTRY-REF DEST="BSW-MODULE-ENTRY">/AUTOSAR_Csm/BswModuleEntrys/Csm_KeySetValid</IMPLEMENTED-ENTRY-REF>
                    </BSW-CALLED-ENTITY>
  [!IF "node:value(as:modconf('Csm')/CsmEbGeneral/CsmEbMisc/CsmEbEnhancementApiCsmKeySetInvalid) = 'true'"!][!//
                    <BSW-CALLED-ENTITY>
                      <SHORT-NAME>CE_Key_KeySetInvalid</SHORT-NAME>
                      <MINIMUM-START-INTERVAL>0.0</MINIMUM-START-INTERVAL>
                      <IMPLEMENTED-ENTRY-REF DEST="BSW-MODULE-ENTRY">/AUTOSAR_Csm/BswModuleEntrys/Csm_KeySetInvalid</IMPLEMENTED-ENTRY-REF>
                    </BSW-CALLED-ENTITY>
  [!ENDIF!][!//
  [!IF "node:value(as:modconf('Csm')/CsmEbGeneral/CsmEbMisc/CsmEbEnhancementApiCsmKeyGetStatus) = 'true'"!][!//
                    <BSW-CALLED-ENTITY>
                      <SHORT-NAME>CE_Key_KeyGetStatus</SHORT-NAME>
                      <MINIMUM-START-INTERVAL>0.0</MINIMUM-START-INTERVAL>
                      <IMPLEMENTED-ENTRY-REF DEST="BSW-MODULE-ENTRY">/AUTOSAR_Csm/BswModuleEntrys/Csm_KeyGetStatus</IMPLEMENTED-ENTRY-REF>
                    </BSW-CALLED-ENTITY>
  [!ENDIF!][!//
                    <BSW-CALLED-ENTITY>
                      <SHORT-NAME>CE_Key_RandomSeed</SHORT-NAME>
                      <MINIMUM-START-INTERVAL>0.0</MINIMUM-START-INTERVAL>
                      <IMPLEMENTED-ENTRY-REF DEST="BSW-MODULE-ENTRY">/AUTOSAR_Csm/BswModuleEntrys/Csm_RandomSeed</IMPLEMENTED-ENTRY-REF>
                    </BSW-CALLED-ENTITY>
  [!ENDIF!][!//
  [!IF "$Csm_Api_Enabled_AEADDecrypt = 'true'"!][!//
                    <BSW-CALLED-ENTITY>
                      <SHORT-NAME>CE_Job_AEADDecrypt</SHORT-NAME>
                      <CAN-ENTER-EXCLUSIVE-AREA-REFS>
                        <CAN-ENTER-EXCLUSIVE-AREA-REF DEST="EXCLUSIVE-AREA">/AUTOSAR_Csm/BswModuleDescriptions/Csm/InternalBehavior_0/SCHM_CSM_EXCLUSIVE_AREA_0</CAN-ENTER-EXCLUSIVE-AREA-REF>
                      </CAN-ENTER-EXCLUSIVE-AREA-REFS>
                      <MINIMUM-START-INTERVAL>0.0</MINIMUM-START-INTERVAL>
                      <IMPLEMENTED-ENTRY-REF DEST="BSW-MODULE-ENTRY">/AUTOSAR_Csm/BswModuleEntrys/Csm_AEADDecrypt</IMPLEMENTED-ENTRY-REF>
                    </BSW-CALLED-ENTITY>
  [!ENDIF!][!//
  [!IF "$Csm_Api_Enabled_AEADEncrypt = 'true'"!][!//
                    <BSW-CALLED-ENTITY>
                      <SHORT-NAME>CE_Job_AEADEncrypt</SHORT-NAME>
                      <CAN-ENTER-EXCLUSIVE-AREA-REFS>
                        <CAN-ENTER-EXCLUSIVE-AREA-REF DEST="EXCLUSIVE-AREA">/AUTOSAR_Csm/BswModuleDescriptions/Csm/InternalBehavior_0/SCHM_CSM_EXCLUSIVE_AREA_0</CAN-ENTER-EXCLUSIVE-AREA-REF>
                      </CAN-ENTER-EXCLUSIVE-AREA-REFS>
                      <MINIMUM-START-INTERVAL>0.0</MINIMUM-START-INTERVAL>
                      <IMPLEMENTED-ENTRY-REF DEST="BSW-MODULE-ENTRY">/AUTOSAR_Csm/BswModuleEntrys/Csm_AEADEncrypt</IMPLEMENTED-ENTRY-REF>
                    </BSW-CALLED-ENTITY>
  [!ENDIF!][!//
  [!IF "$Csm_Api_Enabled_Decrypt = 'true'"!][!//
                    <BSW-CALLED-ENTITY>
                      <SHORT-NAME>CE_Job_Decrypt</SHORT-NAME>
                      <CAN-ENTER-EXCLUSIVE-AREA-REFS>
                        <CAN-ENTER-EXCLUSIVE-AREA-REF DEST="EXCLUSIVE-AREA">/AUTOSAR_Csm/BswModuleDescriptions/Csm/InternalBehavior_0/SCHM_CSM_EXCLUSIVE_AREA_0</CAN-ENTER-EXCLUSIVE-AREA-REF>
                      </CAN-ENTER-EXCLUSIVE-AREA-REFS>
                      <MINIMUM-START-INTERVAL>0.0</MINIMUM-START-INTERVAL>
                      <IMPLEMENTED-ENTRY-REF DEST="BSW-MODULE-ENTRY">/AUTOSAR_Csm/BswModuleEntrys/Csm_Decrypt</IMPLEMENTED-ENTRY-REF>
                    </BSW-CALLED-ENTITY>
  [!ENDIF!][!//
  [!IF "$Csm_Api_Enabled_Encrypt = 'true'"!][!//
                    <BSW-CALLED-ENTITY>
                      <SHORT-NAME>CE_Job_Encrypt</SHORT-NAME>
                      <CAN-ENTER-EXCLUSIVE-AREA-REFS>
                        <CAN-ENTER-EXCLUSIVE-AREA-REF DEST="EXCLUSIVE-AREA">/AUTOSAR_Csm/BswModuleDescriptions/Csm/InternalBehavior_0/SCHM_CSM_EXCLUSIVE_AREA_0</CAN-ENTER-EXCLUSIVE-AREA-REF>
                      </CAN-ENTER-EXCLUSIVE-AREA-REFS>
                      <MINIMUM-START-INTERVAL>0.0</MINIMUM-START-INTERVAL>
                      <IMPLEMENTED-ENTRY-REF DEST="BSW-MODULE-ENTRY">/AUTOSAR_Csm/BswModuleEntrys/Csm_Encrypt</IMPLEMENTED-ENTRY-REF>
                    </BSW-CALLED-ENTITY>
  [!ENDIF!][!//
  [!IF "$Csm_Api_Enabled_Hash = 'true'"!][!//
                    <BSW-CALLED-ENTITY>
                      <SHORT-NAME>CE_Job_Hash</SHORT-NAME>
                      <CAN-ENTER-EXCLUSIVE-AREA-REFS>
                        <CAN-ENTER-EXCLUSIVE-AREA-REF DEST="EXCLUSIVE-AREA">/AUTOSAR_Csm/BswModuleDescriptions/Csm/InternalBehavior_0/SCHM_CSM_EXCLUSIVE_AREA_0</CAN-ENTER-EXCLUSIVE-AREA-REF>
                      </CAN-ENTER-EXCLUSIVE-AREA-REFS>
                      <MINIMUM-START-INTERVAL>0.0</MINIMUM-START-INTERVAL>
                      <IMPLEMENTED-ENTRY-REF DEST="BSW-MODULE-ENTRY">/AUTOSAR_Csm/BswModuleEntrys/Csm_Hash</IMPLEMENTED-ENTRY-REF>
                    </BSW-CALLED-ENTITY>
  [!ENDIF!][!//
  [!IF "$Csm_Api_Enabled_MacGenerate = 'true'"!][!//
                    <BSW-CALLED-ENTITY>
                      <SHORT-NAME>CE_Job_MacGenerate</SHORT-NAME>
                      <CAN-ENTER-EXCLUSIVE-AREA-REFS>
                        <CAN-ENTER-EXCLUSIVE-AREA-REF DEST="EXCLUSIVE-AREA">/AUTOSAR_Csm/BswModuleDescriptions/Csm/InternalBehavior_0/SCHM_CSM_EXCLUSIVE_AREA_0</CAN-ENTER-EXCLUSIVE-AREA-REF>
                      </CAN-ENTER-EXCLUSIVE-AREA-REFS>
                      <MINIMUM-START-INTERVAL>0.0</MINIMUM-START-INTERVAL>
                      <IMPLEMENTED-ENTRY-REF DEST="BSW-MODULE-ENTRY">/AUTOSAR_Csm/BswModuleEntrys/Csm_MacGenerate</IMPLEMENTED-ENTRY-REF>
                    </BSW-CALLED-ENTITY>
  [!ENDIF!][!//
  [!IF "$Csm_Api_Enabled_MacVerify = 'true'"!][!//
                    <BSW-CALLED-ENTITY>
                      <SHORT-NAME>CE_Job_MacVerify</SHORT-NAME>
                      <CAN-ENTER-EXCLUSIVE-AREA-REFS>
                        <CAN-ENTER-EXCLUSIVE-AREA-REF DEST="EXCLUSIVE-AREA">/AUTOSAR_Csm/BswModuleDescriptions/Csm/InternalBehavior_0/SCHM_CSM_EXCLUSIVE_AREA_0</CAN-ENTER-EXCLUSIVE-AREA-REF>
                      </CAN-ENTER-EXCLUSIVE-AREA-REFS>
                      <MINIMUM-START-INTERVAL>0.0</MINIMUM-START-INTERVAL>
                      <IMPLEMENTED-ENTRY-REF DEST="BSW-MODULE-ENTRY">/AUTOSAR_Csm/BswModuleEntrys/Csm_MacVerify</IMPLEMENTED-ENTRY-REF>
                    </BSW-CALLED-ENTITY>
  [!ENDIF!][!//
  [!IF "$Csm_Api_Enabled_SignatureGenerate = 'true'"!][!//
                    <BSW-CALLED-ENTITY>
                      <SHORT-NAME>CE_Job_SignatureGenerate</SHORT-NAME>
                      <CAN-ENTER-EXCLUSIVE-AREA-REFS>
                        <CAN-ENTER-EXCLUSIVE-AREA-REF DEST="EXCLUSIVE-AREA">/AUTOSAR_Csm/BswModuleDescriptions/Csm/InternalBehavior_0/SCHM_CSM_EXCLUSIVE_AREA_0</CAN-ENTER-EXCLUSIVE-AREA-REF>
                      </CAN-ENTER-EXCLUSIVE-AREA-REFS>
                      <MINIMUM-START-INTERVAL>0.0</MINIMUM-START-INTERVAL>
                      <IMPLEMENTED-ENTRY-REF DEST="BSW-MODULE-ENTRY">/AUTOSAR_Csm/BswModuleEntrys/Csm_SignatureGenerate</IMPLEMENTED-ENTRY-REF>
                    </BSW-CALLED-ENTITY>
  [!ENDIF!][!//
  [!IF "$Csm_Api_Enabled_SignatureVerify = 'true'"!][!//
                    <BSW-CALLED-ENTITY>
                      <SHORT-NAME>CE_Job_SignatureVerify</SHORT-NAME>
                      <CAN-ENTER-EXCLUSIVE-AREA-REFS>
                        <CAN-ENTER-EXCLUSIVE-AREA-REF DEST="EXCLUSIVE-AREA">/AUTOSAR_Csm/BswModuleDescriptions/Csm/InternalBehavior_0/SCHM_CSM_EXCLUSIVE_AREA_0</CAN-ENTER-EXCLUSIVE-AREA-REF>
                      </CAN-ENTER-EXCLUSIVE-AREA-REFS>
                      <MINIMUM-START-INTERVAL>0.0</MINIMUM-START-INTERVAL>
                      <IMPLEMENTED-ENTRY-REF DEST="BSW-MODULE-ENTRY">/AUTOSAR_Csm/BswModuleEntrys/Csm_SignatureVerify</IMPLEMENTED-ENTRY-REF>
                    </BSW-CALLED-ENTITY>
  [!ENDIF!][!//
  [!IF "$Csm_Api_Enabled_RandomGenerate = 'true'"!][!//
                    <BSW-CALLED-ENTITY>
                      <SHORT-NAME>CE_Job_RandomGenerate</SHORT-NAME>
                      <CAN-ENTER-EXCLUSIVE-AREA-REFS>
                        <CAN-ENTER-EXCLUSIVE-AREA-REF DEST="EXCLUSIVE-AREA">/AUTOSAR_Csm/BswModuleDescriptions/Csm/InternalBehavior_0/SCHM_CSM_EXCLUSIVE_AREA_0</CAN-ENTER-EXCLUSIVE-AREA-REF>
                      </CAN-ENTER-EXCLUSIVE-AREA-REFS>
                      <MINIMUM-START-INTERVAL>0.0</MINIMUM-START-INTERVAL>
                      <IMPLEMENTED-ENTRY-REF DEST="BSW-MODULE-ENTRY">/AUTOSAR_Csm/BswModuleEntrys/Csm_RandomGenerate</IMPLEMENTED-ENTRY-REF>
                    </BSW-CALLED-ENTITY>
  [!ENDIF!][!//
  [!IF "node:value(as:modconf('Csm')/CsmEbGeneral/CsmEbMisc/CsmEbCorrectionCsmAsyncJobInterfaceUseDataReferences) = 'true' and num:i(0) != num:i(count(node:refs(as:modconf('Csm')/CsmJobs/CsmJob/*[CsmJobUsePort = 'true']/CsmJobPrimitiveRef)/CsmAEADDecrypt/*/*[contains(node:name(.),'Processing') and node:value(.) = 'CSM_ASYNCHRONOUS']))"!][!//
                    <BSW-CALLED-ENTITY>
                      <SHORT-NAME>CE_Job_AEADDecrypt_OAW</SHORT-NAME>
                      <CAN-ENTER-EXCLUSIVE-AREA-REFS>
                        <CAN-ENTER-EXCLUSIVE-AREA-REF DEST="EXCLUSIVE-AREA">/AUTOSAR_Csm/BswModuleDescriptions/Csm/InternalBehavior_0/SCHM_CSM_EXCLUSIVE_AREA_0</CAN-ENTER-EXCLUSIVE-AREA-REF>
                      </CAN-ENTER-EXCLUSIVE-AREA-REFS>
                      <MINIMUM-START-INTERVAL>0.0</MINIMUM-START-INTERVAL>
                      <IMPLEMENTED-ENTRY-REF DEST="BSW-MODULE-ENTRY">/AUTOSAR_Csm/BswModuleEntrys/Csm_AEADDecrypt_OAW</IMPLEMENTED-ENTRY-REF>
                    </BSW-CALLED-ENTITY>
  [!ENDIF!][!//
  [!IF "node:value(as:modconf('Csm')/CsmEbGeneral/CsmEbMisc/CsmEbCorrectionCsmAsyncJobInterfaceUseDataReferences) = 'true' and num:i(0) != num:i(count(node:refs(as:modconf('Csm')/CsmJobs/CsmJob/*[CsmJobUsePort = 'true']/CsmJobPrimitiveRef)/CsmAEADEncrypt/*/*[contains(node:name(.),'Processing') and node:value(.) = 'CSM_ASYNCHRONOUS']))"!][!//
                    <BSW-CALLED-ENTITY>
                      <SHORT-NAME>CE_Job_AEADEncrypt_OAW</SHORT-NAME>
                      <CAN-ENTER-EXCLUSIVE-AREA-REFS>
                        <CAN-ENTER-EXCLUSIVE-AREA-REF DEST="EXCLUSIVE-AREA">/AUTOSAR_Csm/BswModuleDescriptions/Csm/InternalBehavior_0/SCHM_CSM_EXCLUSIVE_AREA_0</CAN-ENTER-EXCLUSIVE-AREA-REF>
                      </CAN-ENTER-EXCLUSIVE-AREA-REFS>
                      <MINIMUM-START-INTERVAL>0.0</MINIMUM-START-INTERVAL>
                      <IMPLEMENTED-ENTRY-REF DEST="BSW-MODULE-ENTRY">/AUTOSAR_Csm/BswModuleEntrys/Csm_AEADEncrypt_OAW</IMPLEMENTED-ENTRY-REF>
                    </BSW-CALLED-ENTITY>
  [!ENDIF!][!//
  [!IF "node:value(as:modconf('Csm')/CsmEbGeneral/CsmEbMisc/CsmEbCorrectionCsmAsyncJobInterfaceUseDataReferences) = 'true' and num:i(0) != num:i(count(node:refs(as:modconf('Csm')/CsmJobs/CsmJob/*[CsmJobUsePort = 'true']/CsmJobPrimitiveRef)/CsmDecrypt/*/*[contains(node:name(.),'Processing') and node:value(.) = 'CSM_ASYNCHRONOUS']))"!][!//
                    <BSW-CALLED-ENTITY>
                      <SHORT-NAME>CE_Job_Decrypt_OAW</SHORT-NAME>
                      <CAN-ENTER-EXCLUSIVE-AREA-REFS>
                        <CAN-ENTER-EXCLUSIVE-AREA-REF DEST="EXCLUSIVE-AREA">/AUTOSAR_Csm/BswModuleDescriptions/Csm/InternalBehavior_0/SCHM_CSM_EXCLUSIVE_AREA_0</CAN-ENTER-EXCLUSIVE-AREA-REF>
                      </CAN-ENTER-EXCLUSIVE-AREA-REFS>
                      <MINIMUM-START-INTERVAL>0.0</MINIMUM-START-INTERVAL>
                      <IMPLEMENTED-ENTRY-REF DEST="BSW-MODULE-ENTRY">/AUTOSAR_Csm/BswModuleEntrys/Csm_Decrypt_OAW</IMPLEMENTED-ENTRY-REF>
                    </BSW-CALLED-ENTITY>
  [!ENDIF!][!//
  [!IF "node:value(as:modconf('Csm')/CsmEbGeneral/CsmEbMisc/CsmEbCorrectionCsmAsyncJobInterfaceUseDataReferences) = 'true' and num:i(0) != num:i(count(node:refs(as:modconf('Csm')/CsmJobs/CsmJob/*[CsmJobUsePort = 'true']/CsmJobPrimitiveRef)/CsmEncrypt/*/*[contains(node:name(.),'Processing') and node:value(.) = 'CSM_ASYNCHRONOUS']))"!][!//
                    <BSW-CALLED-ENTITY>
                      <SHORT-NAME>CE_Job_Encrypt_OAW</SHORT-NAME>
                      <CAN-ENTER-EXCLUSIVE-AREA-REFS>
                        <CAN-ENTER-EXCLUSIVE-AREA-REF DEST="EXCLUSIVE-AREA">/AUTOSAR_Csm/BswModuleDescriptions/Csm/InternalBehavior_0/SCHM_CSM_EXCLUSIVE_AREA_0</CAN-ENTER-EXCLUSIVE-AREA-REF>
                      </CAN-ENTER-EXCLUSIVE-AREA-REFS>
                      <MINIMUM-START-INTERVAL>0.0</MINIMUM-START-INTERVAL>
                      <IMPLEMENTED-ENTRY-REF DEST="BSW-MODULE-ENTRY">/AUTOSAR_Csm/BswModuleEntrys/Csm_Encrypt_OAW</IMPLEMENTED-ENTRY-REF>
                    </BSW-CALLED-ENTITY>
  [!ENDIF!][!//
  [!IF "node:value(as:modconf('Csm')/CsmEbGeneral/CsmEbMisc/CsmEbCorrectionCsmAsyncJobInterfaceUseDataReferences) = 'true' and num:i(0) != num:i(count(node:refs(as:modconf('Csm')/CsmJobs/CsmJob/*[CsmJobUsePort = 'true']/CsmJobPrimitiveRef)/CsmHash/*/*[contains(node:name(.),'Processing') and node:value(.) = 'CSM_ASYNCHRONOUS']))"!][!//
                    <BSW-CALLED-ENTITY>
                      <SHORT-NAME>CE_Job_Hash_OAW</SHORT-NAME>
                      <CAN-ENTER-EXCLUSIVE-AREA-REFS>
                        <CAN-ENTER-EXCLUSIVE-AREA-REF DEST="EXCLUSIVE-AREA">/AUTOSAR_Csm/BswModuleDescriptions/Csm/InternalBehavior_0/SCHM_CSM_EXCLUSIVE_AREA_0</CAN-ENTER-EXCLUSIVE-AREA-REF>
                      </CAN-ENTER-EXCLUSIVE-AREA-REFS>
                      <MINIMUM-START-INTERVAL>0.0</MINIMUM-START-INTERVAL>
                      <IMPLEMENTED-ENTRY-REF DEST="BSW-MODULE-ENTRY">/AUTOSAR_Csm/BswModuleEntrys/Csm_Hash_OAW</IMPLEMENTED-ENTRY-REF>
                    </BSW-CALLED-ENTITY>
  [!ENDIF!][!//
  [!IF "node:value(as:modconf('Csm')/CsmEbGeneral/CsmEbMisc/CsmEbCorrectionCsmAsyncJobInterfaceUseDataReferences) = 'true' and num:i(0) != num:i(count(node:refs(as:modconf('Csm')/CsmJobs/CsmJob/*[CsmJobUsePort = 'true']/CsmJobPrimitiveRef)/CsmMacGenerate/*/*[contains(node:name(.),'Processing') and node:value(.) = 'CSM_ASYNCHRONOUS']))"!][!//
                    <BSW-CALLED-ENTITY>
                      <SHORT-NAME>CE_Job_MacGenerate_OAW</SHORT-NAME>
                      <CAN-ENTER-EXCLUSIVE-AREA-REFS>
                        <CAN-ENTER-EXCLUSIVE-AREA-REF DEST="EXCLUSIVE-AREA">/AUTOSAR_Csm/BswModuleDescriptions/Csm/InternalBehavior_0/SCHM_CSM_EXCLUSIVE_AREA_0</CAN-ENTER-EXCLUSIVE-AREA-REF>
                      </CAN-ENTER-EXCLUSIVE-AREA-REFS>
                      <MINIMUM-START-INTERVAL>0.0</MINIMUM-START-INTERVAL>
                      <IMPLEMENTED-ENTRY-REF DEST="BSW-MODULE-ENTRY">/AUTOSAR_Csm/BswModuleEntrys/Csm_MacGenerate_OAW</IMPLEMENTED-ENTRY-REF>
                    </BSW-CALLED-ENTITY>
  [!ENDIF!][!//
  [!IF "node:value(as:modconf('Csm')/CsmEbGeneral/CsmEbMisc/CsmEbCorrectionCsmAsyncJobInterfaceUseDataReferences) = 'true' and num:i(0) != num:i(count(node:refs(as:modconf('Csm')/CsmJobs/CsmJob/*[CsmJobUsePort = 'true']/CsmJobPrimitiveRef)/CsmMacVerify/*/*[contains(node:name(.),'Processing') and node:value(.) = 'CSM_ASYNCHRONOUS']))"!][!//
                    <BSW-CALLED-ENTITY>
                      <SHORT-NAME>CE_Job_MacVerify_OAW</SHORT-NAME>
                      <CAN-ENTER-EXCLUSIVE-AREA-REFS>
                        <CAN-ENTER-EXCLUSIVE-AREA-REF DEST="EXCLUSIVE-AREA">/AUTOSAR_Csm/BswModuleDescriptions/Csm/InternalBehavior_0/SCHM_CSM_EXCLUSIVE_AREA_0</CAN-ENTER-EXCLUSIVE-AREA-REF>
                      </CAN-ENTER-EXCLUSIVE-AREA-REFS>
                      <MINIMUM-START-INTERVAL>0.0</MINIMUM-START-INTERVAL>
                      <IMPLEMENTED-ENTRY-REF DEST="BSW-MODULE-ENTRY">/AUTOSAR_Csm/BswModuleEntrys/Csm_MacVerify_OAW</IMPLEMENTED-ENTRY-REF>
                    </BSW-CALLED-ENTITY>
  [!ENDIF!][!//
  [!IF "node:value(as:modconf('Csm')/CsmEbGeneral/CsmEbMisc/CsmEbCorrectionCsmAsyncJobInterfaceUseDataReferences) = 'true' and num:i(0) != num:i(count(node:refs(as:modconf('Csm')/CsmJobs/CsmJob/*[CsmJobUsePort = 'true']/CsmJobPrimitiveRef)/CsmSignatureGenerate/*/*[contains(node:name(.),'Processing') and node:value(.) = 'CSM_ASYNCHRONOUS']))"!][!//
                    <BSW-CALLED-ENTITY>
                      <SHORT-NAME>CE_Job_SignatureGenerate_OAW</SHORT-NAME>
                      <CAN-ENTER-EXCLUSIVE-AREA-REFS>
                        <CAN-ENTER-EXCLUSIVE-AREA-REF DEST="EXCLUSIVE-AREA">/AUTOSAR_Csm/BswModuleDescriptions/Csm/InternalBehavior_0/SCHM_CSM_EXCLUSIVE_AREA_0</CAN-ENTER-EXCLUSIVE-AREA-REF>
                      </CAN-ENTER-EXCLUSIVE-AREA-REFS>
                      <MINIMUM-START-INTERVAL>0.0</MINIMUM-START-INTERVAL>
                      <IMPLEMENTED-ENTRY-REF DEST="BSW-MODULE-ENTRY">/AUTOSAR_Csm/BswModuleEntrys/Csm_SignatureGenerate_OAW</IMPLEMENTED-ENTRY-REF>
                    </BSW-CALLED-ENTITY>
  [!ENDIF!][!//
  [!IF "node:value(as:modconf('Csm')/CsmEbGeneral/CsmEbMisc/CsmEbCorrectionCsmAsyncJobInterfaceUseDataReferences) = 'true' and num:i(0) != num:i(count(node:refs(as:modconf('Csm')/CsmJobs/CsmJob/*[CsmJobUsePort = 'true']/CsmJobPrimitiveRef)/CsmSignatureVerify/*/*[contains(node:name(.),'Processing') and node:value(.) = 'CSM_ASYNCHRONOUS']))"!][!//
                    <BSW-CALLED-ENTITY>
                      <SHORT-NAME>CE_Job_SignatureVerify_OAW</SHORT-NAME>
                      <CAN-ENTER-EXCLUSIVE-AREA-REFS>
                        <CAN-ENTER-EXCLUSIVE-AREA-REF DEST="EXCLUSIVE-AREA">/AUTOSAR_Csm/BswModuleDescriptions/Csm/InternalBehavior_0/SCHM_CSM_EXCLUSIVE_AREA_0</CAN-ENTER-EXCLUSIVE-AREA-REF>
                      </CAN-ENTER-EXCLUSIVE-AREA-REFS>
                      <MINIMUM-START-INTERVAL>0.0</MINIMUM-START-INTERVAL>
                      <IMPLEMENTED-ENTRY-REF DEST="BSW-MODULE-ENTRY">/AUTOSAR_Csm/BswModuleEntrys/Csm_SignatureVerify_OAW</IMPLEMENTED-ENTRY-REF>
                    </BSW-CALLED-ENTITY>
  [!ENDIF!][!//
  [!IF "node:value(as:modconf('Csm')/CsmEbGeneral/CsmEbMisc/CsmEbCorrectionCsmAsyncJobInterfaceUseDataReferences) = 'true' and num:i(0) != num:i(count(node:refs(as:modconf('Csm')/CsmJobs/CsmJob/*[CsmJobUsePort = 'true']/CsmJobPrimitiveRef)/CsmRandomGenerate/*/*[contains(node:name(.),'Processing') and node:value(.) = 'CSM_ASYNCHRONOUS']))"!][!//
                    <BSW-CALLED-ENTITY>
                      <SHORT-NAME>CE_Job_RandomGenerate_OAW</SHORT-NAME>
                      <CAN-ENTER-EXCLUSIVE-AREA-REFS>
                        <CAN-ENTER-EXCLUSIVE-AREA-REF DEST="EXCLUSIVE-AREA">/AUTOSAR_Csm/BswModuleDescriptions/Csm/InternalBehavior_0/SCHM_CSM_EXCLUSIVE_AREA_0</CAN-ENTER-EXCLUSIVE-AREA-REF>
                      </CAN-ENTER-EXCLUSIVE-AREA-REFS>
                      <MINIMUM-START-INTERVAL>0.0</MINIMUM-START-INTERVAL>
                      <IMPLEMENTED-ENTRY-REF DEST="BSW-MODULE-ENTRY">/AUTOSAR_Csm/BswModuleEntrys/Csm_RandomGenerate_OAW</IMPLEMENTED-ENTRY-REF>
                    </BSW-CALLED-ENTITY>
  [!ENDIF!][!//
  [!IF "$Csm_Api_Enabled_Srv = 'true'"!][!//
                    <BSW-CALLED-ENTITY>
                      <SHORT-NAME>CE_Job_CancelJob</SHORT-NAME>
                      <CAN-ENTER-EXCLUSIVE-AREA-REFS>
                        <CAN-ENTER-EXCLUSIVE-AREA-REF DEST="EXCLUSIVE-AREA">/AUTOSAR_Csm/BswModuleDescriptions/Csm/InternalBehavior_0/SCHM_CSM_EXCLUSIVE_AREA_0</CAN-ENTER-EXCLUSIVE-AREA-REF>
                      </CAN-ENTER-EXCLUSIVE-AREA-REFS>
                      <MINIMUM-START-INTERVAL>0.0</MINIMUM-START-INTERVAL>
                      <IMPLEMENTED-ENTRY-REF DEST="BSW-MODULE-ENTRY">/AUTOSAR_Csm/BswModuleEntrys/Csm_CancelJob</IMPLEMENTED-ENTRY-REF>
                    </BSW-CALLED-ENTITY>
  [!ENDIF!][!//
  [!IF "node:value(as:modconf('Csm')/CsmEbGeneral/CsmEbMisc/CsmEbCorrectionCsmAsyncJobInterfaceUseDataReferences) = 'true' and num:i(0) != num:i(count(node:refs(as:modconf('Csm')/CsmJobs/CsmJob/*[CsmJobUsePort = 'true']/CsmJobPrimitiveRef)/*/*/*[contains(node:name(.),'Processing') and node:value(.) = 'CSM_ASYNCHRONOUS']))"!][!//
                    <BSW-CALLED-ENTITY>
                      <SHORT-NAME>CE_Job_CancelJob_OAW</SHORT-NAME>
                      <CAN-ENTER-EXCLUSIVE-AREA-REFS>
                        <CAN-ENTER-EXCLUSIVE-AREA-REF DEST="EXCLUSIVE-AREA">/AUTOSAR_Csm/BswModuleDescriptions/Csm/InternalBehavior_0/SCHM_CSM_EXCLUSIVE_AREA_0</CAN-ENTER-EXCLUSIVE-AREA-REF>
                      </CAN-ENTER-EXCLUSIVE-AREA-REFS>
                      <MINIMUM-START-INTERVAL>0.0</MINIMUM-START-INTERVAL>
                      <IMPLEMENTED-ENTRY-REF DEST="BSW-MODULE-ENTRY">/AUTOSAR_Csm/BswModuleEntrys/Csm_CancelJob_OAW</IMPLEMENTED-ENTRY-REF>
                    </BSW-CALLED-ENTITY>
  [!ENDIF!][!//
  [!IF "node:value(as:modconf('Csm')/CsmEbGeneral/CsmEbMisc/CsmEbCorrectionCsmJobBasedCallbacknotificationPorts) = 'false'"!][!//
    [!IF "$Csm_Rte_Enabled_Callback = 'true'"!][!//
                    <BSW-CALLED-ENTITY>
                      <SHORT-NAME>CE_CallbackNotification</SHORT-NAME>
                      <MINIMUM-START-INTERVAL>0.0</MINIMUM-START-INTERVAL>
                      <IMPLEMENTED-ENTRY-REF DEST="BSW-MODULE-ENTRY">/AUTOSAR_Csm/BswModuleEntrys/Csm_CallbackNotification</IMPLEMENTED-ENTRY-REF>
                    </BSW-CALLED-ENTITY>
      [!LOOP "as:modconf('Csm')/CsmCallbacks/CsmCallback/*[node:empty(./CsmCallbackFunc)]"!][!//
        [!VAR "vCbk" = "node:name(.)"!][!//
                    <BSW-SCHEDULABLE-ENTITY>
                      <SHORT-NAME>SE_[!"$vCbk"!]_CallbackNotification</SHORT-NAME>
                      <MINIMUM-START-INTERVAL>0.0</MINIMUM-START-INTERVAL>
                      <ACTIVATION-POINTS>
                        <BSW-INTERNAL-TRIGGERING-POINT-REF-CONDITIONAL>
                          <BSW-INTERNAL-TRIGGERING-POINT-REF DEST="BSW-INTERNAL-TRIGGERING-POINT">/AUTOSAR_Csm/BswModuleDescriptions/Csm/InternalBehavior_0/[!"$vCbk"!]_InternalTriggerForCallback</BSW-INTERNAL-TRIGGERING-POINT-REF>
                        </BSW-INTERNAL-TRIGGERING-POINT-REF-CONDITIONAL>
                      </ACTIVATION-POINTS>
                      <IMPLEMENTED-ENTRY-REF DEST="BSW-MODULE-ENTRY">/AUTOSAR_Csm/BswModuleEntrys/Csm_[!"$vCbk"!]_CallbackNotification</IMPLEMENTED-ENTRY-REF>
                    </BSW-SCHEDULABLE-ENTITY>
      [!ENDLOOP!][!//
    [!ENDIF!][!//
  [!ELSE!][!//
    [!IF "$Csm_Rte_Enabled_CallbackR2011 = 'true'"!][!//
                    <BSW-CALLED-ENTITY>
                      <SHORT-NAME>CE_CallbackNotification</SHORT-NAME>
                      <MINIMUM-START-INTERVAL>0.0</MINIMUM-START-INTERVAL>
                      <IMPLEMENTED-ENTRY-REF DEST="BSW-MODULE-ENTRY">/AUTOSAR_Csm/BswModuleEntrys/Csm_CallbackNotification</IMPLEMENTED-ENTRY-REF>
                    </BSW-CALLED-ENTITY>
      [!LOOP "as:modconf('Csm')/CsmJobs/CsmJob/*[CsmJobUsePort = 'true']"!][!//
        [!IF "node:exists(node:ref(./CsmJobPrimitiveRef)/*) = 'true' and node:value(node:ref(./CsmJobPrimitiveRef)/*/*/*[contains(node:name(.),'Processing')]) = 'CSM_ASYNCHRONOUS'"!][!//
            [!VAR "vJob" = "node:name(.)"!][!//
                    <BSW-SCHEDULABLE-ENTITY>
                      <SHORT-NAME>SE_CallbackNotification_[!"$vJob"!]</SHORT-NAME>
                      <MINIMUM-START-INTERVAL>0.0</MINIMUM-START-INTERVAL>
                      <ACTIVATION-POINTS>
                        <BSW-INTERNAL-TRIGGERING-POINT-REF-CONDITIONAL>
                          <BSW-INTERNAL-TRIGGERING-POINT-REF DEST="BSW-INTERNAL-TRIGGERING-POINT">/AUTOSAR_Csm/BswModuleDescriptions/Csm/InternalBehavior_0/InternalTriggerForCallback_[!"$vJob"!]</BSW-INTERNAL-TRIGGERING-POINT-REF>
                        </BSW-INTERNAL-TRIGGERING-POINT-REF-CONDITIONAL>
                      </ACTIVATION-POINTS>
                      <IMPLEMENTED-ENTRY-REF DEST="BSW-MODULE-ENTRY">/AUTOSAR_Csm/BswModuleEntrys/Csm_CallbackNotification_[!"$vJob"!]</IMPLEMENTED-ENTRY-REF>
                    </BSW-SCHEDULABLE-ENTITY>
        [!ENDIF!][!//
      [!ENDLOOP!][!//
    [!ENDIF!][!//
  [!ENDIF!][!//
                  </ENTITYS>
  [!IF "$Csm_Flg_Async = 'true'"!][!//
                  <EVENTS>
    [!IF "node:value(as:modconf('Csm')/CsmEbGeneral/CsmEbMisc/CsmEbCorrectionCsmJobBasedCallbacknotificationPorts) = 'false'"!][!//
      [!LOOP "as:modconf('Csm')/CsmCallbacks/CsmCallback/*[node:empty(./CsmCallbackFunc)]"!][!//
        [!VAR "vCbk" = "node:name(.)"!][!//
                    <BSW-INTERNAL-TRIGGER-OCCURRED-EVENT>
                      <SHORT-NAME>BswInternalTriggerOccurredEvent_[!"$vCbk"!]</SHORT-NAME>
                      <STARTS-ON-EVENT-REF DEST="BSW-SCHEDULABLE-ENTITY">/AUTOSAR_Csm/BswModuleDescriptions/Csm/InternalBehavior_0/SE_[!"$vCbk"!]_CallbackNotification</STARTS-ON-EVENT-REF>
                      <EVENT-SOURCE-REF DEST="BSW-INTERNAL-TRIGGERING-POINT">/AUTOSAR_Csm/BswModuleDescriptions/Csm/InternalBehavior_0/[!"$vCbk"!]_InternalTriggerForCallback</EVENT-SOURCE-REF>
                    </BSW-INTERNAL-TRIGGER-OCCURRED-EVENT>
      [!ENDLOOP!][!//
    [!ELSE!][!//
      [!LOOP "as:modconf('Csm')/CsmJobs/CsmJob/*[CsmJobUsePort = 'true']"!][!//
        [!IF "node:exists(node:ref(./CsmJobPrimitiveRef)/*) = 'true' and node:value(node:ref(./CsmJobPrimitiveRef)/*/*/*[contains(node:name(.),'Processing')]) = 'CSM_ASYNCHRONOUS'"!][!//
            [!VAR "vJob" = "node:name(.)"!][!//
                    <BSW-INTERNAL-TRIGGER-OCCURRED-EVENT>
                      <SHORT-NAME>BswInternalTriggerOccurredEvent_[!"$vJob"!]</SHORT-NAME>
                      <STARTS-ON-EVENT-REF DEST="BSW-SCHEDULABLE-ENTITY">/AUTOSAR_Csm/BswModuleDescriptions/Csm/InternalBehavior_0/SE_CallbackNotification_[!"$vJob"!]</STARTS-ON-EVENT-REF>
                      <EVENT-SOURCE-REF DEST="BSW-INTERNAL-TRIGGERING-POINT">/AUTOSAR_Csm/BswModuleDescriptions/Csm/InternalBehavior_0/InternalTriggerForCallback_[!"$vJob"!]</EVENT-SOURCE-REF>
                    </BSW-INTERNAL-TRIGGER-OCCURRED-EVENT>
        [!ENDIF!][!//
      [!ENDLOOP!][!//
    [!ENDIF!][!//
                    <BSW-TIMING-EVENT>
                      <SHORT-NAME>TimingEvent_MainFunction</SHORT-NAME>
                      <STARTS-ON-EVENT-REF DEST="BSW-SCHEDULABLE-ENTITY">/AUTOSAR_Csm/BswModuleDescriptions/Csm/InternalBehavior_0/Csm_MainFunction</STARTS-ON-EVENT-REF>
                      <PERIOD>[!"CsmGeneral/CsmMainFunctionPeriod"!]</PERIOD>
                    </BSW-TIMING-EVENT>
                  </EVENTS>
  [!ENDIF!][!//
                </BSW-INTERNAL-BEHAVIOR>
[!ENDIF!][!//
[!LOOP "node:refs(as:modconf('Csm')/CsmMainFunction/*/CsmMainFunctionPartitionRef)"!][!//
  [!VAR "vEcucPartition" = "node:name(.)"!]
  [!IF "num:i(0) != num:i(count(as:modconf('Csm')/CsmJobs/CsmJob/*[node:name(node:ref(node:ref(node:ref(./CsmJobQueueRef)/CsmQueueMainFunctionRef)/CsmMainFunctionPartitionRef)) = $vEcucPartition]))"!][!//
                <!-- !LINKSTO CSM.Req.Arxml/CsmMulticore/Bswmd/00001,1 -->
                <BSW-INTERNAL-BEHAVIOR>
                  <SHORT-NAME>InternalBehavior_[!"$vEcucPartition"!]</SHORT-NAME>
                  <EXCLUSIVE-AREAS>
                    <EXCLUSIVE-AREA>
                      <SHORT-NAME>SCHM_CSM_EXCLUSIVE_AREA_0</SHORT-NAME>
                    </EXCLUSIVE-AREA>
                  </EXCLUSIVE-AREAS>
    [!IF "node:value(as:modconf('Csm')/CsmEbGeneral/CsmEbMisc/CsmEbCorrectionCsmJobBasedCallbacknotificationPorts) = 'false'"!][!//
      [!IF "$Csm_Rte_Enabled_Callback = 'true'"!][!//
                  <INTERNAL-TRIGGERING-POINTS>
        [!LOOP "as:modconf('Csm')/CsmCallbacks/CsmCallback/*[node:empty(./CsmCallbackFunc)][node:containsValue(node:refs(../../../CsmJobs/CsmJob/*[node:name(node:ref(node:ref(node:ref(CsmJobQueueRef)/CsmQueueMainFunctionRef)/CsmMainFunctionPartitionRef)) = $vEcucPartition]/CsmJobPrimitiveCallbackRef)/CsmCallbackId, node:value(./CsmCallbackId))]"!][!//
          [!VAR "vCbk" = "node:name(.)"!][!//
                    <BSW-INTERNAL-TRIGGERING-POINT>
                      <SHORT-NAME>[!"$vCbk"!]_InternalTriggerForCallback</SHORT-NAME>
                    </BSW-INTERNAL-TRIGGERING-POINT>
        [!ENDLOOP!][!//
                  </INTERNAL-TRIGGERING-POINTS>
      [!ENDIF!][!//
    [!ELSE!][!//
      [!IF "$Csm_Rte_Enabled_CallbackR2011 = 'true'"!][!//
                  <INTERNAL-TRIGGERING-POINTS>
        [!LOOP "as:modconf('Csm')/CsmJobs/CsmJob/*[CsmJobUsePort = 'true' and node:name(node:ref(node:ref(node:ref(./CsmJobQueueRef)/CsmQueueMainFunctionRef)/CsmMainFunctionPartitionRef)) = $vEcucPartition]"!][!//
          [!IF "node:exists(node:ref(./CsmJobPrimitiveRef)/*) = 'true' and node:value(node:ref(./CsmJobPrimitiveRef)/*/*/*[contains(node:name(.),'Processing')]) = 'CSM_ASYNCHRONOUS'"!][!//
            [!VAR "vJob" = "node:name(.)"!][!//
                    <BSW-INTERNAL-TRIGGERING-POINT>
                      <SHORT-NAME>InternalTriggerForCallback_[!"$vJob"!]</SHORT-NAME>
                    </BSW-INTERNAL-TRIGGERING-POINT>
          [!ENDIF!][!//
        [!ENDLOOP!][!//
                  </INTERNAL-TRIGGERING-POINTS>
      [!ENDIF!][!//
    [!ENDIF!][!//
                  <ENTITYS>
                    <BSW-CALLED-ENTITY>
                      <SHORT-NAME>Csm_Init_[!"$vEcucPartition"!]</SHORT-NAME>
                      <MINIMUM-START-INTERVAL>0.0</MINIMUM-START-INTERVAL>
                      <IMPLEMENTED-ENTRY-REF DEST="BSW-MODULE-ENTRY">/AUTOSAR_Csm/BswModuleEntrys/Csm_Init_[!"$vEcucPartition"!]</IMPLEMENTED-ENTRY-REF>
                    </BSW-CALLED-ENTITY>
    [!LOOP "as:modconf('Csm')/CsmMainFunction/*[node:name(node:ref(./CsmMainFunctionPartitionRef)) = $vEcucPartition]"!][!//
      [!VAR "vMainFunction" = "node:name(.)"!][!//
      [!IF "num:i(0) < num:i(count(node:refs(as:modconf('Csm')/CsmJobs/CsmJob/*[node:name(node:ref(node:ref(./CsmJobQueueRef)/CsmQueueMainFunctionRef)) = $vMainFunction]/CsmJobPrimitiveRef)/*/*/*[contains(node:name(.),'Processing') and node:value(.) = 'CSM_ASYNCHRONOUS']))"!][!//
                    <BSW-SCHEDULABLE-ENTITY>
                      <SHORT-NAME>Csm_MainFunction_[!"node:name(.)"!]</SHORT-NAME>
                      <CAN-ENTER-EXCLUSIVE-AREA-REFS>
                        <CAN-ENTER-EXCLUSIVE-AREA-REF DEST="EXCLUSIVE-AREA">/AUTOSAR_Csm/BswModuleDescriptions/Csm/InternalBehavior_[!"$vEcucPartition"!]/SCHM_CSM_EXCLUSIVE_AREA_0</CAN-ENTER-EXCLUSIVE-AREA-REF>
                      </CAN-ENTER-EXCLUSIVE-AREA-REFS>
                      <MINIMUM-START-INTERVAL>0.0</MINIMUM-START-INTERVAL>
                      <IMPLEMENTED-ENTRY-REF DEST="BSW-MODULE-ENTRY">/AUTOSAR_Csm/BswModuleEntrys/Csm_MainFunction_[!"node:name(.)"!]</IMPLEMENTED-ENTRY-REF>
                    </BSW-SCHEDULABLE-ENTITY>
      [!ENDIF!][!//
    [!ENDLOOP!][!//
    [!IF "count(as:modconf('Csm')/CsmJobs/CsmJob/*[CsmJobUsePort = 'true' and node:name(node:ref(node:ref(node:ref(./CsmJobQueueRef)/CsmQueueMainFunctionRef)/CsmMainFunctionPartitionRef)) = $vEcucPartition]) > 0"!][!//
                    <BSW-CALLED-ENTITY>
                      <SHORT-NAME>CE_Key_CertificateParse_[!"$vEcucPartition"!]</SHORT-NAME>
                      <MINIMUM-START-INTERVAL>0.0</MINIMUM-START-INTERVAL>
                      <IMPLEMENTED-ENTRY-REF DEST="BSW-MODULE-ENTRY">/AUTOSAR_Csm/BswModuleEntrys/Csm_[!"$vEcucPartition"!]_CertificateParse</IMPLEMENTED-ENTRY-REF>
                    </BSW-CALLED-ENTITY>
                    <BSW-CALLED-ENTITY>
                      <SHORT-NAME>CE_Key_CertificateVerify_[!"$vEcucPartition"!]</SHORT-NAME>
                      <MINIMUM-START-INTERVAL>0.0</MINIMUM-START-INTERVAL>
                      <IMPLEMENTED-ENTRY-REF DEST="BSW-MODULE-ENTRY">/AUTOSAR_Csm/BswModuleEntrys/Csm_[!"$vEcucPartition"!]_CertificateVerify</IMPLEMENTED-ENTRY-REF>
                    </BSW-CALLED-ENTITY>
                    <BSW-CALLED-ENTITY>
                      <SHORT-NAME>CE_Key_KeyCopy_[!"$vEcucPartition"!]</SHORT-NAME>
                      <MINIMUM-START-INTERVAL>0.0</MINIMUM-START-INTERVAL>
                      <IMPLEMENTED-ENTRY-REF DEST="BSW-MODULE-ENTRY">/AUTOSAR_Csm/BswModuleEntrys/Csm_[!"$vEcucPartition"!]_KeyCopy</IMPLEMENTED-ENTRY-REF>
                    </BSW-CALLED-ENTITY>
                    <BSW-CALLED-ENTITY>
                      <SHORT-NAME>CE_Key_KeyDerive_[!"$vEcucPartition"!]</SHORT-NAME>
                      <MINIMUM-START-INTERVAL>0.0</MINIMUM-START-INTERVAL>
                      <IMPLEMENTED-ENTRY-REF DEST="BSW-MODULE-ENTRY">/AUTOSAR_Csm/BswModuleEntrys/Csm_[!"$vEcucPartition"!]_KeyDerive</IMPLEMENTED-ENTRY-REF>
                    </BSW-CALLED-ENTITY>
                    <BSW-CALLED-ENTITY>
                      <SHORT-NAME>CE_Key_KeyElementCopy_[!"$vEcucPartition"!]</SHORT-NAME>
                      <MINIMUM-START-INTERVAL>0.0</MINIMUM-START-INTERVAL>
                      <IMPLEMENTED-ENTRY-REF DEST="BSW-MODULE-ENTRY">/AUTOSAR_Csm/BswModuleEntrys/Csm_[!"$vEcucPartition"!]_KeyElementCopy</IMPLEMENTED-ENTRY-REF>
                    </BSW-CALLED-ENTITY>
                    <BSW-CALLED-ENTITY>
                      <SHORT-NAME>CE_Key_KeyElementGet_[!"$vEcucPartition"!]</SHORT-NAME>
                      <MINIMUM-START-INTERVAL>0.0</MINIMUM-START-INTERVAL>
                      <IMPLEMENTED-ENTRY-REF DEST="BSW-MODULE-ENTRY">/AUTOSAR_Csm/BswModuleEntrys/Csm_[!"$vEcucPartition"!]_KeyElementGet</IMPLEMENTED-ENTRY-REF>
                    </BSW-CALLED-ENTITY>
                    <BSW-CALLED-ENTITY>
                      <SHORT-NAME>CE_Key_KeyElementSet_[!"$vEcucPartition"!]</SHORT-NAME>
                      <MINIMUM-START-INTERVAL>0.0</MINIMUM-START-INTERVAL>
                      <IMPLEMENTED-ENTRY-REF DEST="BSW-MODULE-ENTRY">/AUTOSAR_Csm/BswModuleEntrys/Csm_[!"$vEcucPartition"!]_KeyElementSet</IMPLEMENTED-ENTRY-REF>
                    </BSW-CALLED-ENTITY>
                    <BSW-CALLED-ENTITY>
                      <SHORT-NAME>CE_Key_KeyExchangeCalcPubVal_[!"$vEcucPartition"!]</SHORT-NAME>
                      <MINIMUM-START-INTERVAL>0.0</MINIMUM-START-INTERVAL>
                      <IMPLEMENTED-ENTRY-REF DEST="BSW-MODULE-ENTRY">/AUTOSAR_Csm/BswModuleEntrys/Csm_[!"$vEcucPartition"!]_KeyExchangeCalcPubVal</IMPLEMENTED-ENTRY-REF>
                    </BSW-CALLED-ENTITY>
                    <BSW-CALLED-ENTITY>
                      <SHORT-NAME>CE_Key_KeyExchangeCalcSecret_[!"$vEcucPartition"!]</SHORT-NAME>
                      <MINIMUM-START-INTERVAL>0.0</MINIMUM-START-INTERVAL>
                      <IMPLEMENTED-ENTRY-REF DEST="BSW-MODULE-ENTRY">/AUTOSAR_Csm/BswModuleEntrys/Csm_[!"$vEcucPartition"!]_KeyExchangeCalcSecret</IMPLEMENTED-ENTRY-REF>
                    </BSW-CALLED-ENTITY>
                    <BSW-CALLED-ENTITY>
                      <SHORT-NAME>CE_Key_KeyGenerate_[!"$vEcucPartition"!]</SHORT-NAME>
                      <MINIMUM-START-INTERVAL>0.0</MINIMUM-START-INTERVAL>
                      <IMPLEMENTED-ENTRY-REF DEST="BSW-MODULE-ENTRY">/AUTOSAR_Csm/BswModuleEntrys/Csm_[!"$vEcucPartition"!]_KeyGenerate</IMPLEMENTED-ENTRY-REF>
                    </BSW-CALLED-ENTITY>
                    <BSW-CALLED-ENTITY>
                      <SHORT-NAME>CE_Key_KeySetValid_[!"$vEcucPartition"!]</SHORT-NAME>
                      <MINIMUM-START-INTERVAL>0.0</MINIMUM-START-INTERVAL>
                      <IMPLEMENTED-ENTRY-REF DEST="BSW-MODULE-ENTRY">/AUTOSAR_Csm/BswModuleEntrys/Csm_[!"$vEcucPartition"!]_KeySetValid</IMPLEMENTED-ENTRY-REF>
                    </BSW-CALLED-ENTITY>
  [!IF "node:value(as:modconf('Csm')/CsmEbGeneral/CsmEbMisc/CsmEbEnhancementApiCsmKeySetInvalid) = 'true'"!][!//
                    <BSW-CALLED-ENTITY>
                      <SHORT-NAME>CE_Key_KeySetInvalid_[!"$vEcucPartition"!]</SHORT-NAME>
                      <MINIMUM-START-INTERVAL>0.0</MINIMUM-START-INTERVAL>
                      <IMPLEMENTED-ENTRY-REF DEST="BSW-MODULE-ENTRY">/AUTOSAR_Csm/BswModuleEntrys/Csm_[!"$vEcucPartition"!]_KeySetInvalid</IMPLEMENTED-ENTRY-REF>
                    </BSW-CALLED-ENTITY>
  [!ENDIF!][!//
  [!IF "node:value(as:modconf('Csm')/CsmEbGeneral/CsmEbMisc/CsmEbEnhancementApiCsmKeyGetStatus) = 'true'"!][!//
                    <BSW-CALLED-ENTITY>
                      <SHORT-NAME>CE_Key_KeyGetStatus_[!"$vEcucPartition"!]</SHORT-NAME>
                      <MINIMUM-START-INTERVAL>0.0</MINIMUM-START-INTERVAL>
                      <IMPLEMENTED-ENTRY-REF DEST="BSW-MODULE-ENTRY">/AUTOSAR_Csm/BswModuleEntrys/Csm_[!"$vEcucPartition"!]_KeyGetStatus</IMPLEMENTED-ENTRY-REF>
                    </BSW-CALLED-ENTITY>
  [!ENDIF!][!//
                    <BSW-CALLED-ENTITY>
                      <SHORT-NAME>CE_Key_RandomSeed_[!"$vEcucPartition"!]</SHORT-NAME>
                      <MINIMUM-START-INTERVAL>0.0</MINIMUM-START-INTERVAL>
                      <IMPLEMENTED-ENTRY-REF DEST="BSW-MODULE-ENTRY">/AUTOSAR_Csm/BswModuleEntrys/Csm_[!"$vEcucPartition"!]_RandomSeed</IMPLEMENTED-ENTRY-REF>
                    </BSW-CALLED-ENTITY>
    [!ENDIF!][!//
    [!IF "num:i(0) != num:i(count(node:refs(as:modconf('Csm')/CsmJobs/CsmJob/*[CsmJobUsePort = 'true' and node:name(node:ref(node:ref(node:ref(./CsmJobQueueRef)/CsmQueueMainFunctionRef)/CsmMainFunctionPartitionRef)) = $vEcucPartition]/CsmJobPrimitiveRef)/CsmAEADDecrypt))"!][!//
                    <BSW-CALLED-ENTITY>
                      <SHORT-NAME>CE_Job_AEADDecrypt_[!"$vEcucPartition"!]</SHORT-NAME>
                      <CAN-ENTER-EXCLUSIVE-AREA-REFS>
                        <CAN-ENTER-EXCLUSIVE-AREA-REF DEST="EXCLUSIVE-AREA">/AUTOSAR_Csm/BswModuleDescriptions/Csm/InternalBehavior_[!"$vEcucPartition"!]/SCHM_CSM_EXCLUSIVE_AREA_0</CAN-ENTER-EXCLUSIVE-AREA-REF>
                      </CAN-ENTER-EXCLUSIVE-AREA-REFS>
                      <MINIMUM-START-INTERVAL>0.0</MINIMUM-START-INTERVAL>
                      <IMPLEMENTED-ENTRY-REF DEST="BSW-MODULE-ENTRY">/AUTOSAR_Csm/BswModuleEntrys/Csm_[!"$vEcucPartition"!]_AEADDecrypt</IMPLEMENTED-ENTRY-REF>
                    </BSW-CALLED-ENTITY>
    [!ENDIF!][!//
    [!IF "num:i(0) != num:i(count(node:refs(as:modconf('Csm')/CsmJobs/CsmJob/*[CsmJobUsePort = 'true' and node:name(node:ref(node:ref(node:ref(./CsmJobQueueRef)/CsmQueueMainFunctionRef)/CsmMainFunctionPartitionRef)) = $vEcucPartition]/CsmJobPrimitiveRef)/CsmAEADEncrypt))"!][!//
                    <BSW-CALLED-ENTITY>
                      <SHORT-NAME>CE_Job_AEADEncrypt_[!"$vEcucPartition"!]</SHORT-NAME>
                      <CAN-ENTER-EXCLUSIVE-AREA-REFS>
                        <CAN-ENTER-EXCLUSIVE-AREA-REF DEST="EXCLUSIVE-AREA">/AUTOSAR_Csm/BswModuleDescriptions/Csm/InternalBehavior_[!"$vEcucPartition"!]/SCHM_CSM_EXCLUSIVE_AREA_0</CAN-ENTER-EXCLUSIVE-AREA-REF>
                      </CAN-ENTER-EXCLUSIVE-AREA-REFS>
                      <MINIMUM-START-INTERVAL>0.0</MINIMUM-START-INTERVAL>
                      <IMPLEMENTED-ENTRY-REF DEST="BSW-MODULE-ENTRY">/AUTOSAR_Csm/BswModuleEntrys/Csm_[!"$vEcucPartition"!]_AEADEncrypt</IMPLEMENTED-ENTRY-REF>
                    </BSW-CALLED-ENTITY>
    [!ENDIF!][!//
    [!IF "num:i(0) != num:i(count(node:refs(as:modconf('Csm')/CsmJobs/CsmJob/*[CsmJobUsePort = 'true' and node:name(node:ref(node:ref(node:ref(./CsmJobQueueRef)/CsmQueueMainFunctionRef)/CsmMainFunctionPartitionRef)) = $vEcucPartition]/CsmJobPrimitiveRef)/CsmDecrypt))"!][!//
                    <BSW-CALLED-ENTITY>
                      <SHORT-NAME>CE_Job_Decrypt_[!"$vEcucPartition"!]</SHORT-NAME>
                      <CAN-ENTER-EXCLUSIVE-AREA-REFS>
                        <CAN-ENTER-EXCLUSIVE-AREA-REF DEST="EXCLUSIVE-AREA">/AUTOSAR_Csm/BswModuleDescriptions/Csm/InternalBehavior_[!"$vEcucPartition"!]/SCHM_CSM_EXCLUSIVE_AREA_0</CAN-ENTER-EXCLUSIVE-AREA-REF>
                      </CAN-ENTER-EXCLUSIVE-AREA-REFS>
                      <MINIMUM-START-INTERVAL>0.0</MINIMUM-START-INTERVAL>
                      <IMPLEMENTED-ENTRY-REF DEST="BSW-MODULE-ENTRY">/AUTOSAR_Csm/BswModuleEntrys/Csm_[!"$vEcucPartition"!]_Decrypt</IMPLEMENTED-ENTRY-REF>
                    </BSW-CALLED-ENTITY>
    [!ENDIF!][!//
    [!IF "num:i(0) != num:i(count(node:refs(as:modconf('Csm')/CsmJobs/CsmJob/*[CsmJobUsePort = 'true' and node:name(node:ref(node:ref(node:ref(./CsmJobQueueRef)/CsmQueueMainFunctionRef)/CsmMainFunctionPartitionRef)) = $vEcucPartition]/CsmJobPrimitiveRef)/CsmEncrypt))"!][!//
                    <BSW-CALLED-ENTITY>
                      <SHORT-NAME>CE_Job_Encrypt_[!"$vEcucPartition"!]</SHORT-NAME>
                      <CAN-ENTER-EXCLUSIVE-AREA-REFS>
                        <CAN-ENTER-EXCLUSIVE-AREA-REF DEST="EXCLUSIVE-AREA">/AUTOSAR_Csm/BswModuleDescriptions/Csm/InternalBehavior_[!"$vEcucPartition"!]/SCHM_CSM_EXCLUSIVE_AREA_0</CAN-ENTER-EXCLUSIVE-AREA-REF>
                      </CAN-ENTER-EXCLUSIVE-AREA-REFS>
                      <MINIMUM-START-INTERVAL>0.0</MINIMUM-START-INTERVAL>
                      <IMPLEMENTED-ENTRY-REF DEST="BSW-MODULE-ENTRY">/AUTOSAR_Csm/BswModuleEntrys/Csm_[!"$vEcucPartition"!]_Encrypt</IMPLEMENTED-ENTRY-REF>
                    </BSW-CALLED-ENTITY>
    [!ENDIF!][!//
    [!IF "num:i(0) != num:i(count(node:refs(as:modconf('Csm')/CsmJobs/CsmJob/*[CsmJobUsePort = 'true' and node:name(node:ref(node:ref(node:ref(./CsmJobQueueRef)/CsmQueueMainFunctionRef)/CsmMainFunctionPartitionRef)) = $vEcucPartition]/CsmJobPrimitiveRef)/CsmHash))"!][!//
                    <BSW-CALLED-ENTITY>
                      <SHORT-NAME>CE_Job_Hash_[!"$vEcucPartition"!]</SHORT-NAME>
                      <CAN-ENTER-EXCLUSIVE-AREA-REFS>
                        <CAN-ENTER-EXCLUSIVE-AREA-REF DEST="EXCLUSIVE-AREA">/AUTOSAR_Csm/BswModuleDescriptions/Csm/InternalBehavior_[!"$vEcucPartition"!]/SCHM_CSM_EXCLUSIVE_AREA_0</CAN-ENTER-EXCLUSIVE-AREA-REF>
                      </CAN-ENTER-EXCLUSIVE-AREA-REFS>
                      <MINIMUM-START-INTERVAL>0.0</MINIMUM-START-INTERVAL>
                      <IMPLEMENTED-ENTRY-REF DEST="BSW-MODULE-ENTRY">/AUTOSAR_Csm/BswModuleEntrys/Csm_[!"$vEcucPartition"!]_Hash</IMPLEMENTED-ENTRY-REF>
                    </BSW-CALLED-ENTITY>
    [!ENDIF!][!//
    [!IF "num:i(0) != num:i(count(node:refs(as:modconf('Csm')/CsmJobs/CsmJob/*[CsmJobUsePort = 'true' and node:name(node:ref(node:ref(node:ref(./CsmJobQueueRef)/CsmQueueMainFunctionRef)/CsmMainFunctionPartitionRef)) = $vEcucPartition]/CsmJobPrimitiveRef)/CsmMacGenerate))"!][!//
                    <BSW-CALLED-ENTITY>
                      <SHORT-NAME>CE_Job_MacGenerate_[!"$vEcucPartition"!]</SHORT-NAME>
                      <CAN-ENTER-EXCLUSIVE-AREA-REFS>
                        <CAN-ENTER-EXCLUSIVE-AREA-REF DEST="EXCLUSIVE-AREA">/AUTOSAR_Csm/BswModuleDescriptions/Csm/InternalBehavior_[!"$vEcucPartition"!]/SCHM_CSM_EXCLUSIVE_AREA_0</CAN-ENTER-EXCLUSIVE-AREA-REF>
                      </CAN-ENTER-EXCLUSIVE-AREA-REFS>
                      <MINIMUM-START-INTERVAL>0.0</MINIMUM-START-INTERVAL>
                      <IMPLEMENTED-ENTRY-REF DEST="BSW-MODULE-ENTRY">/AUTOSAR_Csm/BswModuleEntrys/Csm_[!"$vEcucPartition"!]_MacGenerate</IMPLEMENTED-ENTRY-REF>
                    </BSW-CALLED-ENTITY>
    [!ENDIF!][!//
    [!IF "num:i(0) != num:i(count(node:refs(as:modconf('Csm')/CsmJobs/CsmJob/*[CsmJobUsePort = 'true' and node:name(node:ref(node:ref(node:ref(./CsmJobQueueRef)/CsmQueueMainFunctionRef)/CsmMainFunctionPartitionRef)) = $vEcucPartition]/CsmJobPrimitiveRef)/CsmMacVerify))"!][!//
                    <BSW-CALLED-ENTITY>
                      <SHORT-NAME>CE_Job_MacVerify_[!"$vEcucPartition"!]</SHORT-NAME>
                      <CAN-ENTER-EXCLUSIVE-AREA-REFS>
                        <CAN-ENTER-EXCLUSIVE-AREA-REF DEST="EXCLUSIVE-AREA">/AUTOSAR_Csm/BswModuleDescriptions/Csm/InternalBehavior_[!"$vEcucPartition"!]/SCHM_CSM_EXCLUSIVE_AREA_0</CAN-ENTER-EXCLUSIVE-AREA-REF>
                      </CAN-ENTER-EXCLUSIVE-AREA-REFS>
                      <MINIMUM-START-INTERVAL>0.0</MINIMUM-START-INTERVAL>
                      <IMPLEMENTED-ENTRY-REF DEST="BSW-MODULE-ENTRY">/AUTOSAR_Csm/BswModuleEntrys/Csm_[!"$vEcucPartition"!]_MacVerify</IMPLEMENTED-ENTRY-REF>
                    </BSW-CALLED-ENTITY>
    [!ENDIF!][!//
    [!IF "num:i(0) != num:i(count(node:refs(as:modconf('Csm')/CsmJobs/CsmJob/*[CsmJobUsePort = 'true' and node:name(node:ref(node:ref(node:ref(./CsmJobQueueRef)/CsmQueueMainFunctionRef)/CsmMainFunctionPartitionRef)) = $vEcucPartition]/CsmJobPrimitiveRef)/CsmSignatureGenerate))"!][!//
                    <BSW-CALLED-ENTITY>
                      <SHORT-NAME>CE_Job_SignatureGenerate_[!"$vEcucPartition"!]</SHORT-NAME>
                      <CAN-ENTER-EXCLUSIVE-AREA-REFS>
                        <CAN-ENTER-EXCLUSIVE-AREA-REF DEST="EXCLUSIVE-AREA">/AUTOSAR_Csm/BswModuleDescriptions/Csm/InternalBehavior_[!"$vEcucPartition"!]/SCHM_CSM_EXCLUSIVE_AREA_0</CAN-ENTER-EXCLUSIVE-AREA-REF>
                      </CAN-ENTER-EXCLUSIVE-AREA-REFS>
                      <MINIMUM-START-INTERVAL>0.0</MINIMUM-START-INTERVAL>
                      <IMPLEMENTED-ENTRY-REF DEST="BSW-MODULE-ENTRY">/AUTOSAR_Csm/BswModuleEntrys/Csm_[!"$vEcucPartition"!]_SignatureGenerate</IMPLEMENTED-ENTRY-REF>
                    </BSW-CALLED-ENTITY>
    [!ENDIF!][!//
    [!IF "num:i(0) != num:i(count(node:refs(as:modconf('Csm')/CsmJobs/CsmJob/*[CsmJobUsePort = 'true' and node:name(node:ref(node:ref(node:ref(./CsmJobQueueRef)/CsmQueueMainFunctionRef)/CsmMainFunctionPartitionRef)) = $vEcucPartition]/CsmJobPrimitiveRef)/CsmSignatureVerify))"!][!//
                    <BSW-CALLED-ENTITY>
                      <SHORT-NAME>CE_Job_SignatureVerify_[!"$vEcucPartition"!]</SHORT-NAME>
                      <CAN-ENTER-EXCLUSIVE-AREA-REFS>
                        <CAN-ENTER-EXCLUSIVE-AREA-REF DEST="EXCLUSIVE-AREA">/AUTOSAR_Csm/BswModuleDescriptions/Csm/InternalBehavior_[!"$vEcucPartition"!]/SCHM_CSM_EXCLUSIVE_AREA_0</CAN-ENTER-EXCLUSIVE-AREA-REF>
                      </CAN-ENTER-EXCLUSIVE-AREA-REFS>
                      <MINIMUM-START-INTERVAL>0.0</MINIMUM-START-INTERVAL>
                      <IMPLEMENTED-ENTRY-REF DEST="BSW-MODULE-ENTRY">/AUTOSAR_Csm/BswModuleEntrys/Csm_[!"$vEcucPartition"!]_SignatureVerify</IMPLEMENTED-ENTRY-REF>
                    </BSW-CALLED-ENTITY>
    [!ENDIF!][!//
    [!IF "num:i(0) != num:i(count(node:refs(as:modconf('Csm')/CsmJobs/CsmJob/*[CsmJobUsePort = 'true' and node:name(node:ref(node:ref(node:ref(./CsmJobQueueRef)/CsmQueueMainFunctionRef)/CsmMainFunctionPartitionRef)) = $vEcucPartition]/CsmJobPrimitiveRef)/CsmRandomGenerate))"!][!//
                    <BSW-CALLED-ENTITY>
                      <SHORT-NAME>CE_Job_RandomGenerate_[!"$vEcucPartition"!]</SHORT-NAME>
                      <CAN-ENTER-EXCLUSIVE-AREA-REFS>
                        <CAN-ENTER-EXCLUSIVE-AREA-REF DEST="EXCLUSIVE-AREA">/AUTOSAR_Csm/BswModuleDescriptions/Csm/InternalBehavior_[!"$vEcucPartition"!]/SCHM_CSM_EXCLUSIVE_AREA_0</CAN-ENTER-EXCLUSIVE-AREA-REF>
                      </CAN-ENTER-EXCLUSIVE-AREA-REFS>
                      <MINIMUM-START-INTERVAL>0.0</MINIMUM-START-INTERVAL>
                      <IMPLEMENTED-ENTRY-REF DEST="BSW-MODULE-ENTRY">/AUTOSAR_Csm/BswModuleEntrys/Csm_[!"$vEcucPartition"!]_RandomGenerate</IMPLEMENTED-ENTRY-REF>
                    </BSW-CALLED-ENTITY>
    [!ENDIF!][!//
    [!IF "node:value(as:modconf('Csm')/CsmEbGeneral/CsmEbMisc/CsmEbCorrectionCsmAsyncJobInterfaceUseDataReferences) = 'true' and num:i(0) != num:i(count(node:refs(as:modconf('Csm')/CsmJobs/CsmJob/*[CsmJobUsePort = 'true' and node:name(node:ref(node:ref(node:ref(./CsmJobQueueRef)/CsmQueueMainFunctionRef)/CsmMainFunctionPartitionRef)) = $vEcucPartition]/CsmJobPrimitiveRef)/CsmAEADDecrypt/*/*[contains(node:name(.),'Processing') and node:value(.) = 'CSM_ASYNCHRONOUS']))"!][!//
                    <BSW-CALLED-ENTITY>
                      <SHORT-NAME>CE_Job_AEADDecrypt_OAW_[!"$vEcucPartition"!]</SHORT-NAME>
                      <CAN-ENTER-EXCLUSIVE-AREA-REFS>
                        <CAN-ENTER-EXCLUSIVE-AREA-REF DEST="EXCLUSIVE-AREA">/AUTOSAR_Csm/BswModuleDescriptions/Csm/InternalBehavior_[!"$vEcucPartition"!]/SCHM_CSM_EXCLUSIVE_AREA_0</CAN-ENTER-EXCLUSIVE-AREA-REF>
                      </CAN-ENTER-EXCLUSIVE-AREA-REFS>
                      <MINIMUM-START-INTERVAL>0.0</MINIMUM-START-INTERVAL>
                      <IMPLEMENTED-ENTRY-REF DEST="BSW-MODULE-ENTRY">/AUTOSAR_Csm/BswModuleEntrys/Csm_[!"$vEcucPartition"!]_AEADDecrypt_OAW</IMPLEMENTED-ENTRY-REF>
                    </BSW-CALLED-ENTITY>
    [!ENDIF!][!//
    [!IF "node:value(as:modconf('Csm')/CsmEbGeneral/CsmEbMisc/CsmEbCorrectionCsmAsyncJobInterfaceUseDataReferences) = 'true' and num:i(0) != num:i(count(node:refs(as:modconf('Csm')/CsmJobs/CsmJob/*[CsmJobUsePort = 'true' and node:name(node:ref(node:ref(node:ref(./CsmJobQueueRef)/CsmQueueMainFunctionRef)/CsmMainFunctionPartitionRef)) = $vEcucPartition]/CsmJobPrimitiveRef)/CsmAEADEncrypt/*/*[contains(node:name(.),'Processing') and node:value(.) = 'CSM_ASYNCHRONOUS']))"!][!//
                    <BSW-CALLED-ENTITY>
                      <SHORT-NAME>CE_Job_AEADEncrypt_OAW_[!"$vEcucPartition"!]</SHORT-NAME>
                      <CAN-ENTER-EXCLUSIVE-AREA-REFS>
                        <CAN-ENTER-EXCLUSIVE-AREA-REF DEST="EXCLUSIVE-AREA">/AUTOSAR_Csm/BswModuleDescriptions/Csm/InternalBehavior_[!"$vEcucPartition"!]/SCHM_CSM_EXCLUSIVE_AREA_0</CAN-ENTER-EXCLUSIVE-AREA-REF>
                      </CAN-ENTER-EXCLUSIVE-AREA-REFS>
                      <MINIMUM-START-INTERVAL>0.0</MINIMUM-START-INTERVAL>
                      <IMPLEMENTED-ENTRY-REF DEST="BSW-MODULE-ENTRY">/AUTOSAR_Csm/BswModuleEntrys/Csm_[!"$vEcucPartition"!]_AEADEncrypt_OAW</IMPLEMENTED-ENTRY-REF>
                    </BSW-CALLED-ENTITY>
    [!ENDIF!][!//
    [!IF "node:value(as:modconf('Csm')/CsmEbGeneral/CsmEbMisc/CsmEbCorrectionCsmAsyncJobInterfaceUseDataReferences) = 'true' and num:i(0) != num:i(count(node:refs(as:modconf('Csm')/CsmJobs/CsmJob/*[CsmJobUsePort = 'true' and node:name(node:ref(node:ref(node:ref(./CsmJobQueueRef)/CsmQueueMainFunctionRef)/CsmMainFunctionPartitionRef)) = $vEcucPartition]/CsmJobPrimitiveRef)/CsmDecrypt/*/*[contains(node:name(.),'Processing') and node:value(.) = 'CSM_ASYNCHRONOUS']))"!][!//
                    <BSW-CALLED-ENTITY>
                      <SHORT-NAME>CE_Job_Decrypt_OAW_[!"$vEcucPartition"!]</SHORT-NAME>
                      <CAN-ENTER-EXCLUSIVE-AREA-REFS>
                        <CAN-ENTER-EXCLUSIVE-AREA-REF DEST="EXCLUSIVE-AREA">/AUTOSAR_Csm/BswModuleDescriptions/Csm/InternalBehavior_[!"$vEcucPartition"!]/SCHM_CSM_EXCLUSIVE_AREA_0</CAN-ENTER-EXCLUSIVE-AREA-REF>
                      </CAN-ENTER-EXCLUSIVE-AREA-REFS>
                      <MINIMUM-START-INTERVAL>0.0</MINIMUM-START-INTERVAL>
                      <IMPLEMENTED-ENTRY-REF DEST="BSW-MODULE-ENTRY">/AUTOSAR_Csm/BswModuleEntrys/Csm_[!"$vEcucPartition"!]_Decrypt_OAW</IMPLEMENTED-ENTRY-REF>
                    </BSW-CALLED-ENTITY>
    [!ENDIF!][!//
    [!IF "node:value(as:modconf('Csm')/CsmEbGeneral/CsmEbMisc/CsmEbCorrectionCsmAsyncJobInterfaceUseDataReferences) = 'true' and num:i(0) != num:i(count(node:refs(as:modconf('Csm')/CsmJobs/CsmJob/*[CsmJobUsePort = 'true' and node:name(node:ref(node:ref(node:ref(./CsmJobQueueRef)/CsmQueueMainFunctionRef)/CsmMainFunctionPartitionRef)) = $vEcucPartition]/CsmJobPrimitiveRef)/CsmEncrypt/*/*[contains(node:name(.),'Processing') and node:value(.) = 'CSM_ASYNCHRONOUS']))"!][!//
                    <BSW-CALLED-ENTITY>
                      <SHORT-NAME>CE_Job_Encrypt_OAW_[!"$vEcucPartition"!]</SHORT-NAME>
                      <CAN-ENTER-EXCLUSIVE-AREA-REFS>
                        <CAN-ENTER-EXCLUSIVE-AREA-REF DEST="EXCLUSIVE-AREA">/AUTOSAR_Csm/BswModuleDescriptions/Csm/InternalBehavior_[!"$vEcucPartition"!]/SCHM_CSM_EXCLUSIVE_AREA_0</CAN-ENTER-EXCLUSIVE-AREA-REF>
                      </CAN-ENTER-EXCLUSIVE-AREA-REFS>
                      <MINIMUM-START-INTERVAL>0.0</MINIMUM-START-INTERVAL>
                      <IMPLEMENTED-ENTRY-REF DEST="BSW-MODULE-ENTRY">/AUTOSAR_Csm/BswModuleEntrys/Csm_[!"$vEcucPartition"!]_Encrypt_OAW</IMPLEMENTED-ENTRY-REF>
                    </BSW-CALLED-ENTITY>
    [!ENDIF!][!//
    [!IF "node:value(as:modconf('Csm')/CsmEbGeneral/CsmEbMisc/CsmEbCorrectionCsmAsyncJobInterfaceUseDataReferences) = 'true' and num:i(0) != num:i(count(node:refs(as:modconf('Csm')/CsmJobs/CsmJob/*[CsmJobUsePort = 'true' and node:name(node:ref(node:ref(node:ref(./CsmJobQueueRef)/CsmQueueMainFunctionRef)/CsmMainFunctionPartitionRef)) = $vEcucPartition]/CsmJobPrimitiveRef)/CsmHash/*/*[contains(node:name(.),'Processing') and node:value(.) = 'CSM_ASYNCHRONOUS']))"!][!//
                    <BSW-CALLED-ENTITY>
                      <SHORT-NAME>CE_Job_Hash_OAW_[!"$vEcucPartition"!]</SHORT-NAME>
                      <CAN-ENTER-EXCLUSIVE-AREA-REFS>
                        <CAN-ENTER-EXCLUSIVE-AREA-REF DEST="EXCLUSIVE-AREA">/AUTOSAR_Csm/BswModuleDescriptions/Csm/InternalBehavior_[!"$vEcucPartition"!]/SCHM_CSM_EXCLUSIVE_AREA_0</CAN-ENTER-EXCLUSIVE-AREA-REF>
                      </CAN-ENTER-EXCLUSIVE-AREA-REFS>
                      <MINIMUM-START-INTERVAL>0.0</MINIMUM-START-INTERVAL>
                      <IMPLEMENTED-ENTRY-REF DEST="BSW-MODULE-ENTRY">/AUTOSAR_Csm/BswModuleEntrys/Csm_[!"$vEcucPartition"!]_Hash_OAW</IMPLEMENTED-ENTRY-REF>
                    </BSW-CALLED-ENTITY>
    [!ENDIF!][!//
    [!IF "node:value(as:modconf('Csm')/CsmEbGeneral/CsmEbMisc/CsmEbCorrectionCsmAsyncJobInterfaceUseDataReferences) = 'true' and num:i(0) != num:i(count(node:refs(as:modconf('Csm')/CsmJobs/CsmJob/*[CsmJobUsePort = 'true' and node:name(node:ref(node:ref(node:ref(./CsmJobQueueRef)/CsmQueueMainFunctionRef)/CsmMainFunctionPartitionRef)) = $vEcucPartition]/CsmJobPrimitiveRef)/CsmMacGenerate/*/*[contains(node:name(.),'Processing') and node:value(.) = 'CSM_ASYNCHRONOUS']))"!][!//
                    <BSW-CALLED-ENTITY>
                      <SHORT-NAME>CE_Job_MacGenerate_OAW_[!"$vEcucPartition"!]</SHORT-NAME>
                      <CAN-ENTER-EXCLUSIVE-AREA-REFS>
                        <CAN-ENTER-EXCLUSIVE-AREA-REF DEST="EXCLUSIVE-AREA">/AUTOSAR_Csm/BswModuleDescriptions/Csm/InternalBehavior_[!"$vEcucPartition"!]/SCHM_CSM_EXCLUSIVE_AREA_0</CAN-ENTER-EXCLUSIVE-AREA-REF>
                      </CAN-ENTER-EXCLUSIVE-AREA-REFS>
                      <MINIMUM-START-INTERVAL>0.0</MINIMUM-START-INTERVAL>
                      <IMPLEMENTED-ENTRY-REF DEST="BSW-MODULE-ENTRY">/AUTOSAR_Csm/BswModuleEntrys/Csm_[!"$vEcucPartition"!]_MacGenerate_OAW</IMPLEMENTED-ENTRY-REF>
                    </BSW-CALLED-ENTITY>
    [!ENDIF!][!//
    [!IF "node:value(as:modconf('Csm')/CsmEbGeneral/CsmEbMisc/CsmEbCorrectionCsmAsyncJobInterfaceUseDataReferences) = 'true' and num:i(0) != num:i(count(node:refs(as:modconf('Csm')/CsmJobs/CsmJob/*[CsmJobUsePort = 'true' and node:name(node:ref(node:ref(node:ref(./CsmJobQueueRef)/CsmQueueMainFunctionRef)/CsmMainFunctionPartitionRef)) = $vEcucPartition]/CsmJobPrimitiveRef)/CsmMacVerify/*/*[contains(node:name(.),'Processing') and node:value(.) = 'CSM_ASYNCHRONOUS']))"!][!//
                    <BSW-CALLED-ENTITY>
                      <SHORT-NAME>CE_Job_MacVerify_OAW_[!"$vEcucPartition"!]</SHORT-NAME>
                      <CAN-ENTER-EXCLUSIVE-AREA-REFS>
                        <CAN-ENTER-EXCLUSIVE-AREA-REF DEST="EXCLUSIVE-AREA">/AUTOSAR_Csm/BswModuleDescriptions/Csm/InternalBehavior_[!"$vEcucPartition"!]/SCHM_CSM_EXCLUSIVE_AREA_0</CAN-ENTER-EXCLUSIVE-AREA-REF>
                      </CAN-ENTER-EXCLUSIVE-AREA-REFS>
                      <MINIMUM-START-INTERVAL>0.0</MINIMUM-START-INTERVAL>
                      <IMPLEMENTED-ENTRY-REF DEST="BSW-MODULE-ENTRY">/AUTOSAR_Csm/BswModuleEntrys/Csm_[!"$vEcucPartition"!]_MacVerify_OAW</IMPLEMENTED-ENTRY-REF>
                    </BSW-CALLED-ENTITY>
    [!ENDIF!][!//
    [!IF "node:value(as:modconf('Csm')/CsmEbGeneral/CsmEbMisc/CsmEbCorrectionCsmAsyncJobInterfaceUseDataReferences) = 'true' and num:i(0) != num:i(count(node:refs(as:modconf('Csm')/CsmJobs/CsmJob/*[CsmJobUsePort = 'true' and node:name(node:ref(node:ref(node:ref(./CsmJobQueueRef)/CsmQueueMainFunctionRef)/CsmMainFunctionPartitionRef)) = $vEcucPartition]/CsmJobPrimitiveRef)/CsmSignatureGenerate/*/*[contains(node:name(.),'Processing') and node:value(.) = 'CSM_ASYNCHRONOUS']))"!][!//
                    <BSW-CALLED-ENTITY>
                      <SHORT-NAME>CE_Job_SignatureGenerate_OAW_[!"$vEcucPartition"!]</SHORT-NAME>
                      <CAN-ENTER-EXCLUSIVE-AREA-REFS>
                        <CAN-ENTER-EXCLUSIVE-AREA-REF DEST="EXCLUSIVE-AREA">/AUTOSAR_Csm/BswModuleDescriptions/Csm/InternalBehavior_[!"$vEcucPartition"!]/SCHM_CSM_EXCLUSIVE_AREA_0</CAN-ENTER-EXCLUSIVE-AREA-REF>
                      </CAN-ENTER-EXCLUSIVE-AREA-REFS>
                      <MINIMUM-START-INTERVAL>0.0</MINIMUM-START-INTERVAL>
                      <IMPLEMENTED-ENTRY-REF DEST="BSW-MODULE-ENTRY">/AUTOSAR_Csm/BswModuleEntrys/Csm_[!"$vEcucPartition"!]_SignatureGenerate_OAW</IMPLEMENTED-ENTRY-REF>
                    </BSW-CALLED-ENTITY>
    [!ENDIF!][!//
    [!IF "node:value(as:modconf('Csm')/CsmEbGeneral/CsmEbMisc/CsmEbCorrectionCsmAsyncJobInterfaceUseDataReferences) = 'true' and num:i(0) != num:i(count(node:refs(as:modconf('Csm')/CsmJobs/CsmJob/*[CsmJobUsePort = 'true' and node:name(node:ref(node:ref(node:ref(./CsmJobQueueRef)/CsmQueueMainFunctionRef)/CsmMainFunctionPartitionRef)) = $vEcucPartition]/CsmJobPrimitiveRef)/CsmSignatureVerify/*/*[contains(node:name(.),'Processing') and node:value(.) = 'CSM_ASYNCHRONOUS']))"!][!//
                    <BSW-CALLED-ENTITY>
                      <SHORT-NAME>CE_Job_SignatureVerify_OAW_[!"$vEcucPartition"!]</SHORT-NAME>
                      <CAN-ENTER-EXCLUSIVE-AREA-REFS>
                        <CAN-ENTER-EXCLUSIVE-AREA-REF DEST="EXCLUSIVE-AREA">/AUTOSAR_Csm/BswModuleDescriptions/Csm/InternalBehavior_[!"$vEcucPartition"!]/SCHM_CSM_EXCLUSIVE_AREA_0</CAN-ENTER-EXCLUSIVE-AREA-REF>
                      </CAN-ENTER-EXCLUSIVE-AREA-REFS>
                      <MINIMUM-START-INTERVAL>0.0</MINIMUM-START-INTERVAL>
                      <IMPLEMENTED-ENTRY-REF DEST="BSW-MODULE-ENTRY">/AUTOSAR_Csm/BswModuleEntrys/Csm_[!"$vEcucPartition"!]_SignatureVerify_OAW</IMPLEMENTED-ENTRY-REF>
                    </BSW-CALLED-ENTITY>
    [!ENDIF!][!//
    [!IF "node:value(as:modconf('Csm')/CsmEbGeneral/CsmEbMisc/CsmEbCorrectionCsmAsyncJobInterfaceUseDataReferences) = 'true' and num:i(0) != num:i(count(node:refs(as:modconf('Csm')/CsmJobs/CsmJob/*[CsmJobUsePort = 'true' and node:name(node:ref(node:ref(node:ref(./CsmJobQueueRef)/CsmQueueMainFunctionRef)/CsmMainFunctionPartitionRef)) = $vEcucPartition]/CsmJobPrimitiveRef)/CsmRandomGenerate/*/*[contains(node:name(.),'Processing') and node:value(.) = 'CSM_ASYNCHRONOUS']))"!][!//
                    <BSW-CALLED-ENTITY>
                      <SHORT-NAME>CE_Job_RandomGenerate_OAW_[!"$vEcucPartition"!]</SHORT-NAME>
                      <CAN-ENTER-EXCLUSIVE-AREA-REFS>
                        <CAN-ENTER-EXCLUSIVE-AREA-REF DEST="EXCLUSIVE-AREA">/AUTOSAR_Csm/BswModuleDescriptions/Csm/InternalBehavior_[!"$vEcucPartition"!]/SCHM_CSM_EXCLUSIVE_AREA_0</CAN-ENTER-EXCLUSIVE-AREA-REF>
                      </CAN-ENTER-EXCLUSIVE-AREA-REFS>
                      <MINIMUM-START-INTERVAL>0.0</MINIMUM-START-INTERVAL>
                      <IMPLEMENTED-ENTRY-REF DEST="BSW-MODULE-ENTRY">/AUTOSAR_Csm/BswModuleEntrys/Csm_[!"$vEcucPartition"!]_RandomGenerate_OAW</IMPLEMENTED-ENTRY-REF>
                    </BSW-CALLED-ENTITY>
    [!ENDIF!][!//
    [!IF "num:i(0) != (num:i(count(node:refs(as:modconf('Csm')/CsmJobs/CsmJob/*[CsmJobUsePort = 'true' and node:name(node:ref(node:ref(node:ref(./CsmJobQueueRef)/CsmQueueMainFunctionRef)/CsmMainFunctionPartitionRef)) = $vEcucPartition]/CsmJobPrimitiveRef)/*)) - num:i(count(node:refs(as:modconf('Csm')/CsmJobs/CsmJob/*[CsmJobUsePort = 'true' and node:name(node:ref(node:ref(node:ref(./CsmJobQueueRef)/CsmQueueMainFunctionRef)/CsmMainFunctionPartitionRef)) = $vEcucPartition]/CsmJobPrimitiveRef)/CsmRandomGenerate)))"!][!//
                    <BSW-CALLED-ENTITY>
                      <SHORT-NAME>CE_Job_CancelJob_[!"$vEcucPartition"!]</SHORT-NAME>
                      <CAN-ENTER-EXCLUSIVE-AREA-REFS>
                        <CAN-ENTER-EXCLUSIVE-AREA-REF DEST="EXCLUSIVE-AREA">/AUTOSAR_Csm/BswModuleDescriptions/Csm/InternalBehavior_[!"$vEcucPartition"!]/SCHM_CSM_EXCLUSIVE_AREA_0</CAN-ENTER-EXCLUSIVE-AREA-REF>
                      </CAN-ENTER-EXCLUSIVE-AREA-REFS>
                      <MINIMUM-START-INTERVAL>0.0</MINIMUM-START-INTERVAL>
                      <IMPLEMENTED-ENTRY-REF DEST="BSW-MODULE-ENTRY">/AUTOSAR_Csm/BswModuleEntrys/Csm_[!"$vEcucPartition"!]_CancelJob</IMPLEMENTED-ENTRY-REF>
                    </BSW-CALLED-ENTITY>
    [!ENDIF!][!//
    [!IF "node:value(as:modconf('Csm')/CsmEbGeneral/CsmEbMisc/CsmEbCorrectionCsmAsyncJobInterfaceUseDataReferences) = 'true' and num:i(0) != num:i(count(node:refs(as:modconf('Csm')/CsmJobs/CsmJob/*[CsmJobUsePort = 'true' and node:name(node:ref(node:ref(node:ref(./CsmJobQueueRef)/CsmQueueMainFunctionRef)/CsmMainFunctionPartitionRef)) = $vEcucPartition]/CsmJobPrimitiveRef)/*/*/*[contains(node:name(.),'Processing') and node:value(.) = 'CSM_ASYNCHRONOUS']))"!][!//
                    <BSW-CALLED-ENTITY>
                      <SHORT-NAME>CE_Job_CancelJob_OAW_[!"$vEcucPartition"!]</SHORT-NAME>
                      <CAN-ENTER-EXCLUSIVE-AREA-REFS>
                        <CAN-ENTER-EXCLUSIVE-AREA-REF DEST="EXCLUSIVE-AREA">/AUTOSAR_Csm/BswModuleDescriptions/Csm/InternalBehavior_[!"$vEcucPartition"!]/SCHM_CSM_EXCLUSIVE_AREA_0</CAN-ENTER-EXCLUSIVE-AREA-REF>
                      </CAN-ENTER-EXCLUSIVE-AREA-REFS>
                      <MINIMUM-START-INTERVAL>0.0</MINIMUM-START-INTERVAL>
                      <IMPLEMENTED-ENTRY-REF DEST="BSW-MODULE-ENTRY">/AUTOSAR_Csm/BswModuleEntrys/Csm_[!"$vEcucPartition"!]_CancelJob_OAW</IMPLEMENTED-ENTRY-REF>
                    </BSW-CALLED-ENTITY>
    [!ENDIF!][!//
    [!IF "node:value(as:modconf('Csm')/CsmEbGeneral/CsmEbMisc/CsmEbCorrectionCsmJobBasedCallbacknotificationPorts) = 'false'"!][!//
      [!IF "$Csm_Rte_Enabled_Callback = 'true'"!][!//
                    <BSW-CALLED-ENTITY>
                      <SHORT-NAME>CE_CallbackNotification_[!"$vEcucPartition"!]</SHORT-NAME>
                      <MINIMUM-START-INTERVAL>0.0</MINIMUM-START-INTERVAL>
                      <IMPLEMENTED-ENTRY-REF DEST="BSW-MODULE-ENTRY">/AUTOSAR_Csm/BswModuleEntrys/Csm_CallbackNotification</IMPLEMENTED-ENTRY-REF>
                    </BSW-CALLED-ENTITY>
        [!LOOP "as:modconf('Csm')/CsmCallbacks/CsmCallback/*[node:empty(./CsmCallbackFunc)][node:containsValue(node:refs(../../../CsmJobs/CsmJob/*[node:name(node:ref(node:ref(node:ref(CsmJobQueueRef)/CsmQueueMainFunctionRef)/CsmMainFunctionPartitionRef)) = $vEcucPartition]/CsmJobPrimitiveCallbackRef)/CsmCallbackId, node:value(./CsmCallbackId))]"!][!//
          [!VAR "vCbk" = "node:name(.)"!][!//
                    <BSW-SCHEDULABLE-ENTITY>
                      <SHORT-NAME>SE_[!"$vCbk"!]_CallbackNotification_[!"$vEcucPartition"!]</SHORT-NAME>
                      <MINIMUM-START-INTERVAL>0.0</MINIMUM-START-INTERVAL>
                      <ACTIVATION-POINTS>
                        <BSW-INTERNAL-TRIGGERING-POINT-REF-CONDITIONAL>
                          <BSW-INTERNAL-TRIGGERING-POINT-REF DEST="BSW-INTERNAL-TRIGGERING-POINT">/AUTOSAR_Csm/BswModuleDescriptions/Csm/InternalBehavior_[!"$vEcucPartition"!]/[!"$vCbk"!]_InternalTriggerForCallback</BSW-INTERNAL-TRIGGERING-POINT-REF>
                        </BSW-INTERNAL-TRIGGERING-POINT-REF-CONDITIONAL>
                      </ACTIVATION-POINTS>
                      <IMPLEMENTED-ENTRY-REF DEST="BSW-MODULE-ENTRY">/AUTOSAR_Csm/BswModuleEntrys/Csm_[!"$vCbk"!]_CallbackNotification</IMPLEMENTED-ENTRY-REF>
                    </BSW-SCHEDULABLE-ENTITY>
        [!ENDLOOP!][!//
      [!ENDIF!][!//
    [!ELSE!][!//
      [!IF "$Csm_Rte_Enabled_CallbackR2011 = 'true'"!][!//
                    <BSW-CALLED-ENTITY>
                      <SHORT-NAME>CE_CallbackNotification_[!"$vEcucPartition"!]</SHORT-NAME>
                      <MINIMUM-START-INTERVAL>0.0</MINIMUM-START-INTERVAL>
                      <IMPLEMENTED-ENTRY-REF DEST="BSW-MODULE-ENTRY">/AUTOSAR_Csm/BswModuleEntrys/Csm_CallbackNotification</IMPLEMENTED-ENTRY-REF>
                    </BSW-CALLED-ENTITY>
        [!LOOP "as:modconf('Csm')/CsmJobs/CsmJob/*[CsmJobUsePort = 'true' and node:name(node:ref(node:ref(node:ref(./CsmJobQueueRef)/CsmQueueMainFunctionRef)/CsmMainFunctionPartitionRef)) = $vEcucPartition]"!][!//
          [!IF "node:exists(node:ref(./CsmJobPrimitiveRef)/*) = 'true' and node:value(node:ref(./CsmJobPrimitiveRef)/*/*/*[contains(node:name(.),'Processing')]) = 'CSM_ASYNCHRONOUS'"!][!//
            [!VAR "vJob" = "node:name(.)"!][!//
                    <BSW-SCHEDULABLE-ENTITY>
                      <SHORT-NAME>SE_CallbackNotification_[!"$vJob"!]_[!"$vEcucPartition"!]</SHORT-NAME>
                      <MINIMUM-START-INTERVAL>0.0</MINIMUM-START-INTERVAL>
                      <ACTIVATION-POINTS>
                        <BSW-INTERNAL-TRIGGERING-POINT-REF-CONDITIONAL>
                          <BSW-INTERNAL-TRIGGERING-POINT-REF DEST="BSW-INTERNAL-TRIGGERING-POINT">/AUTOSAR_Csm/BswModuleDescriptions/Csm/InternalBehavior_[!"$vEcucPartition"!]/InternalTriggerForCallback_[!"$vJob"!]</BSW-INTERNAL-TRIGGERING-POINT-REF>
                        </BSW-INTERNAL-TRIGGERING-POINT-REF-CONDITIONAL>
                      </ACTIVATION-POINTS>
                      <IMPLEMENTED-ENTRY-REF DEST="BSW-MODULE-ENTRY">/AUTOSAR_Csm/BswModuleEntrys/Csm_CallbackNotification_[!"$vJob"!]</IMPLEMENTED-ENTRY-REF>
                    </BSW-SCHEDULABLE-ENTITY>
          [!ENDIF!][!//
        [!ENDLOOP!][!//
      [!ENDIF!][!//
    [!ENDIF!][!//
                  </ENTITYS>
                  <EVENTS>
    [!IF "node:value(as:modconf('Csm')/CsmEbGeneral/CsmEbMisc/CsmEbCorrectionCsmJobBasedCallbacknotificationPorts) = 'false'"!][!//
      [!LOOP "as:modconf('Csm')/CsmCallbacks/CsmCallback/*[node:empty(./CsmCallbackFunc)][node:containsValue(node:refs(../../../CsmJobs/CsmJob/*[node:name(node:ref(node:ref(node:ref(CsmJobQueueRef)/CsmQueueMainFunctionRef)/CsmMainFunctionPartitionRef)) = $vEcucPartition]/CsmJobPrimitiveCallbackRef)/CsmCallbackId, node:value(./CsmCallbackId))]"!][!//
        [!VAR "vCbk" = "node:name(.)"!][!//
                    <BSW-INTERNAL-TRIGGER-OCCURRED-EVENT>
                      <SHORT-NAME>BswInternalTriggerOccurredEvent_[!"$vCbk"!]</SHORT-NAME>
                      <STARTS-ON-EVENT-REF DEST="BSW-SCHEDULABLE-ENTITY">/AUTOSAR_Csm/BswModuleDescriptions/Csm/InternalBehavior_[!"$vEcucPartition"!]/SE_[!"$vCbk"!]_CallbackNotification_[!"$vEcucPartition"!]</STARTS-ON-EVENT-REF>
                      <EVENT-SOURCE-REF DEST="BSW-INTERNAL-TRIGGERING-POINT">/AUTOSAR_Csm/BswModuleDescriptions/Csm/InternalBehavior_[!"$vEcucPartition"!]/[!"$vCbk"!]_InternalTriggerForCallback</EVENT-SOURCE-REF>
                    </BSW-INTERNAL-TRIGGER-OCCURRED-EVENT>
      [!ENDLOOP!][!//
    [!ELSE!][!//
      [!LOOP "as:modconf('Csm')/CsmJobs/CsmJob/*[CsmJobUsePort = 'true' and node:name(node:ref(node:ref(node:ref(./CsmJobQueueRef)/CsmQueueMainFunctionRef)/CsmMainFunctionPartitionRef)) = $vEcucPartition]"!][!//
        [!IF "node:exists(node:ref(./CsmJobPrimitiveRef)/*) = 'true' and node:value(node:ref(./CsmJobPrimitiveRef)/*/*/*[contains(node:name(.),'Processing')]) = 'CSM_ASYNCHRONOUS'"!][!//
          [!VAR "vJob" = "node:name(.)"!][!//
                    <BSW-INTERNAL-TRIGGER-OCCURRED-EVENT>
                      <SHORT-NAME>BswInternalTriggerOccurredEvent_[!"$vJob"!]</SHORT-NAME>
                      <STARTS-ON-EVENT-REF DEST="BSW-SCHEDULABLE-ENTITY">/AUTOSAR_Csm/BswModuleDescriptions/Csm/InternalBehavior_[!"$vEcucPartition"!]/SE_CallbackNotification_[!"$vJob"!]_[!"$vEcucPartition"!]</STARTS-ON-EVENT-REF>
                      <EVENT-SOURCE-REF DEST="BSW-INTERNAL-TRIGGERING-POINT">/AUTOSAR_Csm/BswModuleDescriptions/Csm/InternalBehavior_[!"$vEcucPartition"!]/InternalTriggerForCallback_[!"$vJob"!]</EVENT-SOURCE-REF>
                    </BSW-INTERNAL-TRIGGER-OCCURRED-EVENT>
        [!ENDIF!][!//
      [!ENDLOOP!][!//
    [!ENDIF!][!//
    [!LOOP "as:modconf('Csm')/CsmMainFunction/*[node:name(node:ref(./CsmMainFunctionPartitionRef)) = $vEcucPartition]"!][!//
      [!VAR "vMainFunction" = "node:name(.)"!][!//
      [!IF "num:i(0) < num:i(count(node:refs(as:modconf('Csm')/CsmJobs/CsmJob/*[node:name(node:ref(node:ref(./CsmJobQueueRef)/CsmQueueMainFunctionRef)) = $vMainFunction]/CsmJobPrimitiveRef)/*/*/*[contains(node:name(.),'Processing') and node:value(.) = 'CSM_ASYNCHRONOUS']))"!][!//
                    <BSW-TIMING-EVENT>
                      <SHORT-NAME>TimingEvent_MainFunction_[!"node:name(.)"!]</SHORT-NAME>
                      <STARTS-ON-EVENT-REF DEST="BSW-SCHEDULABLE-ENTITY">/AUTOSAR_Csm/BswModuleDescriptions/Csm/InternalBehavior_[!"$vEcucPartition"!]/Csm_MainFunction_[!"node:name(.)"!]</STARTS-ON-EVENT-REF>
                      <PERIOD>[!"./CsmMainFunctionPeriod"!]</PERIOD>
                    </BSW-TIMING-EVENT>
      [!ENDIF!][!//
    [!ENDLOOP!][!//
                  </EVENTS>
                </BSW-INTERNAL-BEHAVIOR>
  [!ENDIF!][!//
[!ENDLOOP!][!//
              </INTERNAL-BEHAVIORS>
            </BSW-MODULE-DESCRIPTION>
          </ELEMENTS>
        </AR-PACKAGE>

        <AR-PACKAGE>
          <SHORT-NAME>BswModuleEntrys</SHORT-NAME>
          <ELEMENTS>
