[part 2 of 2]
[!ENDIF!][!//
                <IMPLEMENTATION-DATA-TYPE-ELEMENT>
                  <SHORT-NAME>jobPrimitiveInfo</SHORT-NAME>
                  <CATEGORY>DATA_REFERENCE</CATEGORY>
                  <SW-DATA-DEF-PROPS>
                    <SW-DATA-DEF-PROPS-VARIANTS>
                      <SW-DATA-DEF-PROPS-CONDITIONAL>
                        <SW-POINTER-TARGET-PROPS>
                          <TARGET-CATEGORY>TYPE_REFERENCE</TARGET-CATEGORY>
                          <SW-DATA-DEF-PROPS>
                            <SW-DATA-DEF-PROPS-VARIANTS>
                              <SW-DATA-DEF-PROPS-CONDITIONAL>
                                <IMPLEMENTATION-DATA-TYPE-REF DEST="IMPLEMENTATION-DATA-TYPE">/AUTOSAR_Csm/ImplementationDataTypes/Crypto_JobPrimitiveInfoType</IMPLEMENTATION-DATA-TYPE-REF>
                                <SW-IMPL-POLICY>CONST</SW-IMPL-POLICY>
                              </SW-DATA-DEF-PROPS-CONDITIONAL>
                            </SW-DATA-DEF-PROPS-VARIANTS>
                          </SW-DATA-DEF-PROPS>
                        </SW-POINTER-TARGET-PROPS>
                      </SW-DATA-DEF-PROPS-CONDITIONAL>
                    </SW-DATA-DEF-PROPS-VARIANTS>
                  </SW-DATA-DEF-PROPS>
                </IMPLEMENTATION-DATA-TYPE-ELEMENT>
                <IMPLEMENTATION-DATA-TYPE-ELEMENT>
                  <SHORT-NAME>jobInfo</SHORT-NAME>
                  <CATEGORY>DATA_REFERENCE</CATEGORY>
                  <SW-DATA-DEF-PROPS>
                    <SW-DATA-DEF-PROPS-VARIANTS>
                      <SW-DATA-DEF-PROPS-CONDITIONAL>
                        <SW-POINTER-TARGET-PROPS>
                          <TARGET-CATEGORY>TYPE_REFERENCE</TARGET-CATEGORY>
                          <SW-DATA-DEF-PROPS>
                            <SW-DATA-DEF-PROPS-VARIANTS>
                              <SW-DATA-DEF-PROPS-CONDITIONAL>
                                <IMPLEMENTATION-DATA-TYPE-REF DEST="IMPLEMENTATION-DATA-TYPE">/AUTOSAR_Csm/ImplementationDataTypes/Crypto_JobInfoType</IMPLEMENTATION-DATA-TYPE-REF>
                                <SW-IMPL-POLICY>CONST</SW-IMPL-POLICY>
                              </SW-DATA-DEF-PROPS-CONDITIONAL>
                            </SW-DATA-DEF-PROPS-VARIANTS>
                          </SW-DATA-DEF-PROPS>
                        </SW-POINTER-TARGET-PROPS>
                      </SW-DATA-DEF-PROPS-CONDITIONAL>
                    </SW-DATA-DEF-PROPS-VARIANTS>
                  </SW-DATA-DEF-PROPS>
                </IMPLEMENTATION-DATA-TYPE-ELEMENT>
                <IMPLEMENTATION-DATA-TYPE-ELEMENT>
                  <SHORT-NAME>cryptoKeyId</SHORT-NAME>
                  <CATEGORY>TYPE_REFERENCE</CATEGORY>
                  <SW-DATA-DEF-PROPS>
                    <SW-DATA-DEF-PROPS-VARIANTS>
                      <SW-DATA-DEF-PROPS-CONDITIONAL>
                        <IMPLEMENTATION-DATA-TYPE-REF DEST="IMPLEMENTATION-DATA-TYPE">/AUTOSAR_Platform/ImplementationDataTypes/uint32</IMPLEMENTATION-DATA-TYPE-REF>
                      </SW-DATA-DEF-PROPS-CONDITIONAL>
                    </SW-DATA-DEF-PROPS-VARIANTS>
                  </SW-DATA-DEF-PROPS>
                </IMPLEMENTATION-DATA-TYPE-ELEMENT>
              </SUB-ELEMENTS>
            </IMPLEMENTATION-DATA-TYPE>
            <!-- ~~~~~~~~~~~~~~~~~~~~~~~~~~~~~~~~~~~~~~~~~~~~~~~~~~~~~~~~~~~~~~~~~~~~~~~~~~~~~~~ -->
            <!-- !LINKSTO CSM.Dsn.SWS_Csm_01011,1 -->
            <IMPLEMENTATION-DATA-TYPE>
              <SHORT-NAME>Crypto_PrimitiveInfoType</SHORT-NAME>
              <CATEGORY>STRUCTURE</CATEGORY>
              <SUB-ELEMENTS>
                <IMPLEMENTATION-DATA-TYPE-ELEMENT>
                  <SHORT-NAME>resultLength</SHORT-NAME>
                  <CATEGORY>TYPE_REFERENCE</CATEGORY>
                  <SW-DATA-DEF-PROPS>
                    <SW-DATA-DEF-PROPS-VARIANTS>
                      <SW-DATA-DEF-PROPS-CONDITIONAL>
                        <IMPLEMENTATION-DATA-TYPE-REF DEST="IMPLEMENTATION-DATA-TYPE">/AUTOSAR_Platform/ImplementationDataTypes/uint32</IMPLEMENTATION-DATA-TYPE-REF>
                      </SW-DATA-DEF-PROPS-CONDITIONAL>
                    </SW-DATA-DEF-PROPS-VARIANTS>
                  </SW-DATA-DEF-PROPS>
                </IMPLEMENTATION-DATA-TYPE-ELEMENT>
                <IMPLEMENTATION-DATA-TYPE-ELEMENT>
                  <SHORT-NAME>service</SHORT-NAME>
                  <CATEGORY>TYPE_REFERENCE</CATEGORY>
                  <SW-DATA-DEF-PROPS>
                    <SW-DATA-DEF-PROPS-VARIANTS>
                      <SW-DATA-DEF-PROPS-CONDITIONAL>
                        <IMPLEMENTATION-DATA-TYPE-REF DEST="IMPLEMENTATION-DATA-TYPE">/AUTOSAR_Csm/ImplementationDataTypes/Crypto_ServiceInfoType</IMPLEMENTATION-DATA-TYPE-REF>
                      </SW-DATA-DEF-PROPS-CONDITIONAL>
                    </SW-DATA-DEF-PROPS-VARIANTS>
                  </SW-DATA-DEF-PROPS>
                </IMPLEMENTATION-DATA-TYPE-ELEMENT>
                <IMPLEMENTATION-DATA-TYPE-ELEMENT>
                  <SHORT-NAME>algorithm</SHORT-NAME>
                  <CATEGORY>TYPE_REFERENCE</CATEGORY>
                  <SW-DATA-DEF-PROPS>
                    <SW-DATA-DEF-PROPS-VARIANTS>
                      <SW-DATA-DEF-PROPS-CONDITIONAL>
                        <IMPLEMENTATION-DATA-TYPE-REF DEST="IMPLEMENTATION-DATA-TYPE">/AUTOSAR_Csm/ImplementationDataTypes/Crypto_AlgorithmInfoType</IMPLEMENTATION-DATA-TYPE-REF>
                      </SW-DATA-DEF-PROPS-CONDITIONAL>
                    </SW-DATA-DEF-PROPS-VARIANTS>
                  </SW-DATA-DEF-PROPS>
                </IMPLEMENTATION-DATA-TYPE-ELEMENT>
              </SUB-ELEMENTS>
            </IMPLEMENTATION-DATA-TYPE>
  [!IF "node:exists(as:modconf('Csm')/CsmGeneral/CsmAsymPrivateKeyMaxLength)"!][!//
            <!-- ~~~~~~~~~~~~~~~~~~~~~~~~~~~~~~~~~~~~~~~~~~~~~~~~~~~~~~~~~~~~~~~~~~~~~~~~~~~~~~~ -->
            <!-- !LINKSTO CSM.Req.Correction.SWS_Csm_01080,1 -->
            <IMPLEMENTATION-DATA-TYPE>
              <SHORT-NAME>Csm_AsymPrivateKeyType</SHORT-NAME>
              <CATEGORY>STRUCTURE</CATEGORY>
              <SUB-ELEMENTS>
                <IMPLEMENTATION-DATA-TYPE-ELEMENT>
                  <SHORT-NAME>data</SHORT-NAME>
                  <CATEGORY>TYPE_REFERENCE</CATEGORY>
                  <SW-DATA-DEF-PROPS>
                    <SW-DATA-DEF-PROPS-VARIANTS>
                      <SW-DATA-DEF-PROPS-CONDITIONAL>
                        <IMPLEMENTATION-DATA-TYPE-REF DEST="IMPLEMENTATION-DATA-TYPE">/AUTOSAR_Csm/ImplementationDataTypes/Csm_AsymPrivateKeyArrayType</IMPLEMENTATION-DATA-TYPE-REF>
                      </SW-DATA-DEF-PROPS-CONDITIONAL>
                    </SW-DATA-DEF-PROPS-VARIANTS>
                  </SW-DATA-DEF-PROPS>
                </IMPLEMENTATION-DATA-TYPE-ELEMENT>
                <IMPLEMENTATION-DATA-TYPE-ELEMENT>
                  <SHORT-NAME>length</SHORT-NAME>
                  <CATEGORY>TYPE_REFERENCE</CATEGORY>
                  <SW-DATA-DEF-PROPS>
                    <SW-DATA-DEF-PROPS-VARIANTS>
                      <SW-DATA-DEF-PROPS-CONDITIONAL>
                        <IMPLEMENTATION-DATA-TYPE-REF DEST="IMPLEMENTATION-DATA-TYPE">/AUTOSAR_Platform/ImplementationDataTypes/uint32</IMPLEMENTATION-DATA-TYPE-REF>
                      </SW-DATA-DEF-PROPS-CONDITIONAL>
                    </SW-DATA-DEF-PROPS-VARIANTS>
                  </SW-DATA-DEF-PROPS>
                </IMPLEMENTATION-DATA-TYPE-ELEMENT>
              </SUB-ELEMENTS>
            </IMPLEMENTATION-DATA-TYPE>
  [!ENDIF!][!//
  [!IF "node:exists(as:modconf('Csm')/CsmGeneral/CsmAsymPublicKeyMaxLength)"!][!//
            <!-- ~~~~~~~~~~~~~~~~~~~~~~~~~~~~~~~~~~~~~~~~~~~~~~~~~~~~~~~~~~~~~~~~~~~~~~~~~~~~~~~ -->
            <!-- !LINKSTO SWS_Csm_00076,1 -->
            <IMPLEMENTATION-DATA-TYPE>
              <SHORT-NAME>Csm_AsymPublicKeyType</SHORT-NAME>
              <CATEGORY>STRUCTURE</CATEGORY>
              <SUB-ELEMENTS>
                <IMPLEMENTATION-DATA-TYPE-ELEMENT>
                  <SHORT-NAME>data</SHORT-NAME>
                  <CATEGORY>TYPE_REFERENCE</CATEGORY>
                  <SW-DATA-DEF-PROPS>
                    <SW-DATA-DEF-PROPS-VARIANTS>
                      <SW-DATA-DEF-PROPS-CONDITIONAL>
                        <IMPLEMENTATION-DATA-TYPE-REF DEST="IMPLEMENTATION-DATA-TYPE">/AUTOSAR_Csm/ImplementationDataTypes/Csm_AsymPublicKeyArrayType</IMPLEMENTATION-DATA-TYPE-REF>
                      </SW-DATA-DEF-PROPS-CONDITIONAL>
                    </SW-DATA-DEF-PROPS-VARIANTS>
                  </SW-DATA-DEF-PROPS>
                </IMPLEMENTATION-DATA-TYPE-ELEMENT>
                <IMPLEMENTATION-DATA-TYPE-ELEMENT>
                  <SHORT-NAME>length</SHORT-NAME>
                  <CATEGORY>TYPE_REFERENCE</CATEGORY>
                  <SW-DATA-DEF-PROPS>
                    <SW-DATA-DEF-PROPS-VARIANTS>
                      <SW-DATA-DEF-PROPS-CONDITIONAL>
                        <IMPLEMENTATION-DATA-TYPE-REF DEST="IMPLEMENTATION-DATA-TYPE">/AUTOSAR_Platform/ImplementationDataTypes/uint32</IMPLEMENTATION-DATA-TYPE-REF>
                      </SW-DATA-DEF-PROPS-CONDITIONAL>
                    </SW-DATA-DEF-PROPS-VARIANTS>
                  </SW-DATA-DEF-PROPS>
                </IMPLEMENTATION-DATA-TYPE-ELEMENT>
              </SUB-ELEMENTS>
            </IMPLEMENTATION-DATA-TYPE>
  [!ENDIF!][!//
  [!IF "node:exists(as:modconf('Csm')/CsmGeneral/CsmSymKeyMaxLength)"!][!//
            <!-- ~~~~~~~~~~~~~~~~~~~~~~~~~~~~~~~~~~~~~~~~~~~~~~~~~~~~~~~~~~~~~~~~~~~~~~~~~~~~~~~ -->
            <!-- !LINKSTO SWS_Csm_01082,1 -->
            <IMPLEMENTATION-DATA-TYPE>
              <SHORT-NAME>Csm_SymKeyType</SHORT-NAME>
              <CATEGORY>STRUCTURE</CATEGORY>
              <SUB-ELEMENTS>
                <IMPLEMENTATION-DATA-TYPE-ELEMENT>
                  <SHORT-NAME>data</SHORT-NAME>
                  <CATEGORY>TYPE_REFERENCE</CATEGORY>
                  <SW-DATA-DEF-PROPS>
                    <SW-DATA-DEF-PROPS-VARIANTS>
                      <SW-DATA-DEF-PROPS-CONDITIONAL>
                        <IMPLEMENTATION-DATA-TYPE-REF DEST="IMPLEMENTATION-DATA-TYPE">/AUTOSAR_Csm/ImplementationDataTypes/Csm_SymKeyArrayType</IMPLEMENTATION-DATA-TYPE-REF>
                      </SW-DATA-DEF-PROPS-CONDITIONAL>
                    </SW-DATA-DEF-PROPS-VARIANTS>
                  </SW-DATA-DEF-PROPS>
                </IMPLEMENTATION-DATA-TYPE-ELEMENT>
                <IMPLEMENTATION-DATA-TYPE-ELEMENT>
                  <SHORT-NAME>length</SHORT-NAME>
                  <CATEGORY>TYPE_REFERENCE</CATEGORY>
                  <SW-DATA-DEF-PROPS>
                    <SW-DATA-DEF-PROPS-VARIANTS>
                      <SW-DATA-DEF-PROPS-CONDITIONAL>
                        <IMPLEMENTATION-DATA-TYPE-REF DEST="IMPLEMENTATION-DATA-TYPE">/AUTOSAR_Platform/ImplementationDataTypes/uint32</IMPLEMENTATION-DATA-TYPE-REF>
                      </SW-DATA-DEF-PROPS-CONDITIONAL>
                    </SW-DATA-DEF-PROPS-VARIANTS>
                  </SW-DATA-DEF-PROPS>
                </IMPLEMENTATION-DATA-TYPE-ELEMENT>
              </SUB-ELEMENTS>
            </IMPLEMENTATION-DATA-TYPE>
  [!ENDIF!][!//
  [!IF "node:value(as:modconf('Csm')/CsmEbGeneral/CsmEbMisc/CsmEbCorrectionCsmAsyncJobInterfaceUseDataReferences) = 'true'"!][!//
              <IMPLEMENTATION-DATA-TYPE>
                  <SHORT-NAME>Csm_LengthPtr</SHORT-NAME>
                  <CATEGORY>DATA_REFERENCE</CATEGORY>
                  <SW-DATA-DEF-PROPS>
                      <SW-DATA-DEF-PROPS-VARIANTS>
                          <SW-DATA-DEF-PROPS-CONDITIONAL>
                              <SW-POINTER-TARGET-PROPS>
                                  <TARGET-CATEGORY>TYPE_REFERENCE</TARGET-CATEGORY>
                                  <SW-DATA-DEF-PROPS>
                                      <SW-DATA-DEF-PROPS-VARIANTS>
                                          <SW-DATA-DEF-PROPS-CONDITIONAL>
                                              <IMPLEMENTATION-DATA-TYPE-REF
                                                  DEST="IMPLEMENTATION-DATA-TYPE">/AUTOSAR_Platform/ImplementationDataTypes/uint32</IMPLEMENTATION-DATA-TYPE-REF>
                                          </SW-DATA-DEF-PROPS-CONDITIONAL>
                                      </SW-DATA-DEF-PROPS-VARIANTS>
                                  </SW-DATA-DEF-PROPS>
                              </SW-POINTER-TARGET-PROPS>
                          </SW-DATA-DEF-PROPS-CONDITIONAL>
                      </SW-DATA-DEF-PROPS-VARIANTS>
                  </SW-DATA-DEF-PROPS>
              </IMPLEMENTATION-DATA-TYPE>
              <IMPLEMENTATION-DATA-TYPE>
                  <SHORT-NAME>Csm_VerifyResultPtr</SHORT-NAME>
                  <CATEGORY>DATA_REFERENCE</CATEGORY>
                  <SW-DATA-DEF-PROPS>
                      <SW-DATA-DEF-PROPS-VARIANTS>
                          <SW-DATA-DEF-PROPS-CONDITIONAL>
                              <SW-POINTER-TARGET-PROPS>
                                  <TARGET-CATEGORY>TYPE_REFERENCE</TARGET-CATEGORY>
                                  <SW-DATA-DEF-PROPS>
                                      <SW-DATA-DEF-PROPS-VARIANTS>
                                          <SW-DATA-DEF-PROPS-CONDITIONAL>
                                              <IMPLEMENTATION-DATA-TYPE-REF
                                                  DEST="IMPLEMENTATION-DATA-TYPE">/AUTOSAR_Csm/ImplementationDataTypes/Crypto_VerifyResultType</IMPLEMENTATION-DATA-TYPE-REF>
                                          </SW-DATA-DEF-PROPS-CONDITIONAL>
                                      </SW-DATA-DEF-PROPS-VARIANTS>
                                  </SW-DATA-DEF-PROPS>
                              </SW-POINTER-TARGET-PROPS>
                          </SW-DATA-DEF-PROPS-CONDITIONAL>
                      </SW-DATA-DEF-PROPS-VARIANTS>
                  </SW-DATA-DEF-PROPS>
              </IMPLEMENTATION-DATA-TYPE>
  [!ENDIF!][!//
            <!-- ~~~~~~~~~~~~~~~~~~~~~~~~~~~~~~~~~~~~~~~~~~~~~~~~~~~~~~~~~~~~~~~~~~~~~~~~~~~~~~~ -->
          </ELEMENTS>
        </AR-PACKAGE>

        <!-- === DATACONSTRAINTS =============================================================== -->
        <AR-PACKAGE>
          <SHORT-NAME>DataConstraints</SHORT-NAME>
          <ELEMENTS>
            <!-- ~~~~~~~~~~~~~~~~~~~~~~~~~~~~~~~~~~~~~~~~~~~~~~~~~~~~~~~~~~~~~~~~~~~~~~~~~~~~~~~ -->
            <DATA-CONSTR>
              <SHORT-NAME>DC_Crypto_AlgorithmFamilyType</SHORT-NAME>
              <DATA-CONSTR-RULES>
                <DATA-CONSTR-RULE>
                  <INTERNAL-CONSTRS>
                    <LOWER-LIMIT INTERVAL-TYPE="CLOSED">0</LOWER-LIMIT>
                    <UPPER-LIMIT INTERVAL-TYPE="CLOSED">255</UPPER-LIMIT>
                  </INTERNAL-CONSTRS>
                </DATA-CONSTR-RULE>
              </DATA-CONSTR-RULES>
            </DATA-CONSTR>
            <!-- ~~~~~~~~~~~~~~~~~~~~~~~~~~~~~~~~~~~~~~~~~~~~~~~~~~~~~~~~~~~~~~~~~~~~~~~~~~~~~~~ -->
            <DATA-CONSTR>
              <SHORT-NAME>DC_Crypto_AlgorithmModeType</SHORT-NAME>
              <DATA-CONSTR-RULES>
                <DATA-CONSTR-RULE>
                  <INTERNAL-CONSTRS>
                    <LOWER-LIMIT INTERVAL-TYPE="CLOSED">0</LOWER-LIMIT>
                    <UPPER-LIMIT INTERVAL-TYPE="CLOSED">255</UPPER-LIMIT>
                  </INTERNAL-CONSTRS>
                </DATA-CONSTR-RULE>
              </DATA-CONSTR-RULES>
            </DATA-CONSTR>
            <!-- ~~~~~~~~~~~~~~~~~~~~~~~~~~~~~~~~~~~~~~~~~~~~~~~~~~~~~~~~~~~~~~~~~~~~~~~~~~~~~~~ -->
            <DATA-CONSTR>
              <SHORT-NAME>DC_Crypto_JobStateType</SHORT-NAME>
              <DATA-CONSTR-RULES>
                <DATA-CONSTR-RULE>
                  <INTERNAL-CONSTRS>
                    <LOWER-LIMIT INTERVAL-TYPE="CLOSED">0</LOWER-LIMIT>
                    <UPPER-LIMIT INTERVAL-TYPE="CLOSED">1</UPPER-LIMIT>
                  </INTERNAL-CONSTRS>
                </DATA-CONSTR-RULE>
              </DATA-CONSTR-RULES>
            </DATA-CONSTR>
  [!IF "node:value(as:modconf('Csm')/CsmEbGeneral/CsmEbMisc/CsmEbEnhancementApiCsmKeyGetStatus) = 'true'"!][!//
            <!-- ~~~~~~~~~~~~~~~~~~~~~~~~~~~~~~~~~~~~~~~~~~~~~~~~~~~~~~~~~~~~~~~~~~~~~~~~~~~~~~~ -->
            <DATA-CONSTR>
              <SHORT-NAME>DC_Crypto_KeyStatusType</SHORT-NAME>
              <DATA-CONSTR-RULES>
                <DATA-CONSTR-RULE>
                  <INTERNAL-CONSTRS>
                    <LOWER-LIMIT INTERVAL-TYPE="CLOSED">0</LOWER-LIMIT>
                    <UPPER-LIMIT INTERVAL-TYPE="CLOSED">1</UPPER-LIMIT>
                  </INTERNAL-CONSTRS>
                </DATA-CONSTR-RULE>
              </DATA-CONSTR-RULES>
            </DATA-CONSTR>
  [!ENDIF!][!//
            <!-- ~~~~~~~~~~~~~~~~~~~~~~~~~~~~~~~~~~~~~~~~~~~~~~~~~~~~~~~~~~~~~~~~~~~~~~~~~~~~~~~ -->
            <DATA-CONSTR>
              <SHORT-NAME>DC_Crypto_OperationModeType</SHORT-NAME>
              <DATA-CONSTR-RULES>
                <DATA-CONSTR-RULE>
                  <INTERNAL-CONSTRS>
                    <LOWER-LIMIT INTERVAL-TYPE="CLOSED">1</LOWER-LIMIT>
                    <UPPER-LIMIT INTERVAL-TYPE="CLOSED">7</UPPER-LIMIT>
                  </INTERNAL-CONSTRS>
                </DATA-CONSTR-RULE>
              </DATA-CONSTR-RULES>
            </DATA-CONSTR>
            <!-- ~~~~~~~~~~~~~~~~~~~~~~~~~~~~~~~~~~~~~~~~~~~~~~~~~~~~~~~~~~~~~~~~~~~~~~~~~~~~~~~ -->
            <DATA-CONSTR>
              <SHORT-NAME>DC_Crypto_ProcessingType</SHORT-NAME>
              <DATA-CONSTR-RULES>
                <DATA-CONSTR-RULE>
                  <INTERNAL-CONSTRS>
                    <LOWER-LIMIT INTERVAL-TYPE="CLOSED">0</LOWER-LIMIT>
                    <UPPER-LIMIT INTERVAL-TYPE="CLOSED">1</UPPER-LIMIT>
                  </INTERNAL-CONSTRS>
                </DATA-CONSTR-RULE>
              </DATA-CONSTR-RULES>
            </DATA-CONSTR>
            <!-- ~~~~~~~~~~~~~~~~~~~~~~~~~~~~~~~~~~~~~~~~~~~~~~~~~~~~~~~~~~~~~~~~~~~~~~~~~~~~~~~ -->
            <DATA-CONSTR>
              <SHORT-NAME>DC_Crypto_ServiceInfoType</SHORT-NAME>
              <DATA-CONSTR-RULES>
                <DATA-CONSTR-RULE>
                  <INTERNAL-CONSTRS>
                    <LOWER-LIMIT INTERVAL-TYPE="CLOSED">0</LOWER-LIMIT>
                    <UPPER-LIMIT INTERVAL-TYPE="CLOSED">11</UPPER-LIMIT>
                  </INTERNAL-CONSTRS>
                </DATA-CONSTR-RULE>
              </DATA-CONSTR-RULES>
            </DATA-CONSTR>
            <!-- ~~~~~~~~~~~~~~~~~~~~~~~~~~~~~~~~~~~~~~~~~~~~~~~~~~~~~~~~~~~~~~~~~~~~~~~~~~~~~~~ -->
            <DATA-CONSTR>
              <SHORT-NAME>DC_Crypto_VerifyResultType</SHORT-NAME>
              <DATA-CONSTR-RULES>
                <DATA-CONSTR-RULE>
                  <INTERNAL-CONSTRS>
                    <LOWER-LIMIT INTERVAL-TYPE="CLOSED">0</LOWER-LIMIT>
                    <UPPER-LIMIT INTERVAL-TYPE="CLOSED">1</UPPER-LIMIT>
                  </INTERNAL-CONSTRS>
                </DATA-CONSTR-RULE>
              </DATA-CONSTR-RULES>
            </DATA-CONSTR>
            <!-- ~~~~~~~~~~~~~~~~~~~~~~~~~~~~~~~~~~~~~~~~~~~~~~~~~~~~~~~~~~~~~~~~~~~~~~~~~~~~~~~ -->
            <DATA-CONSTR>
              <SHORT-NAME>DC_Crypto_ResultType</SHORT-NAME>
              <DATA-CONSTR-RULES>
                <DATA-CONSTR-RULE>
                  <INTERNAL-CONSTRS>
                    <LOWER-LIMIT INTERVAL-TYPE="CLOSED">2</LOWER-LIMIT>
                    <UPPER-LIMIT INTERVAL-TYPE="CLOSED">13</UPPER-LIMIT>
                  </INTERNAL-CONSTRS>
                </DATA-CONSTR-RULE>
              </DATA-CONSTR-RULES>
            </DATA-CONSTR>
            <!-- ~~~~~~~~~~~~~~~~~~~~~~~~~~~~~~~~~~~~~~~~~~~~~~~~~~~~~~~~~~~~~~~~~~~~~~~~~~~~~~~ -->
            <DATA-CONSTR>
              <SHORT-NAME>DC_Csm_ResultType</SHORT-NAME>
              <DATA-CONSTR-RULES>
                <DATA-CONSTR-RULE>
                  <INTERNAL-CONSTRS>
                    <LOWER-LIMIT INTERVAL-TYPE="CLOSED">2</LOWER-LIMIT>
                    <UPPER-LIMIT INTERVAL-TYPE="CLOSED">7</UPPER-LIMIT>
                  </INTERNAL-CONSTRS>
                </DATA-CONSTR-RULE>
              </DATA-CONSTR-RULES>
            </DATA-CONSTR>
            <!-- ~~~~~~~~~~~~~~~~~~~~~~~~~~~~~~~~~~~~~~~~~~~~~~~~~~~~~~~~~~~~~~~~~~~~~~~~~~~~~~~ -->
            <DATA-CONSTR>
              <SHORT-NAME>DC_Csm_ConfigIdType</SHORT-NAME>
              <DATA-CONSTR-RULES>
                <DATA-CONSTR-RULE>
                  <INTERNAL-CONSTRS>
                    <LOWER-LIMIT INTERVAL-TYPE="CLOSED">0</LOWER-LIMIT>
                    <UPPER-LIMIT INTERVAL-TYPE="CLOSED">65535</UPPER-LIMIT>
                  </INTERNAL-CONSTRS>
                </DATA-CONSTR-RULE>
              </DATA-CONSTR-RULES>
            </DATA-CONSTR>
            <!-- ~~~~~~~~~~~~~~~~~~~~~~~~~~~~~~~~~~~~~~~~~~~~~~~~~~~~~~~~~~~~~~~~~~~~~~~~~~~~~~~ -->
          </ELEMENTS>
        </AR-PACKAGE>

        <!-- === PORTINTERFACES ================================================================ -->
        <AR-PACKAGE>
          <SHORT-NAME>PortInterfaces</SHORT-NAME>
          <ELEMENTS>
  [!LOOP "as:modconf('Csm')/CsmKeys/CsmKey/*[CsmKeyUsePort = 'true']"!][!//
    [!VAR "vKey" = "node:name(.)"!][!//
            <!-- !LINKSTO CSM.Req.Correction.SWS_Csm_01905,1 -->
            <CLIENT-SERVER-INTERFACE>
              <SHORT-NAME>CsmKeyManagement_[!"$vKey"!]</SHORT-NAME>
              <IS-SERVICE>true</IS-SERVICE>
              <OPERATIONS>
                <CLIENT-SERVER-OPERATION>
                  <SHORT-NAME>CertificateParse</SHORT-NAME>
                  <ARGUMENTS>
                  </ARGUMENTS>
                  <POSSIBLE-ERROR-REFS>
                    <POSSIBLE-ERROR-REF DEST="APPLICATION-ERROR">/AUTOSAR_Csm/PortInterfaces/CsmKeyManagement_[!"$vKey"!]/E_NOT_OK</POSSIBLE-ERROR-REF>
                    <POSSIBLE-ERROR-REF DEST="APPLICATION-ERROR">/AUTOSAR_Csm/PortInterfaces/CsmKeyManagement_[!"$vKey"!]/CSM_E_BUSY</POSSIBLE-ERROR-REF>
                  </POSSIBLE-ERROR-REFS>
                </CLIENT-SERVER-OPERATION>
                <CLIENT-SERVER-OPERATION>
                  <SHORT-NAME>CertificateVerify</SHORT-NAME>
                  <ARGUMENTS>
                    <ARGUMENT-DATA-PROTOTYPE>
                      <SHORT-NAME>verifyKeyId</SHORT-NAME>
                      <TYPE-TREF DEST="IMPLEMENTATION-DATA-TYPE">/AUTOSAR_Platform/ImplementationDataTypes/uint32</TYPE-TREF>
                      <DIRECTION>IN</DIRECTION>
                    </ARGUMENT-DATA-PROTOTYPE>
                    <ARGUMENT-DATA-PROTOTYPE>
                      <SHORT-NAME>verifyPtr</SHORT-NAME>
                      <TYPE-TREF DEST="IMPLEMENTATION-DATA-TYPE">/AUTOSAR_Csm/ImplementationDataTypes/Crypto_VerifyResultType</TYPE-TREF>
                      <DIRECTION>OUT</DIRECTION>
                    </ARGUMENT-DATA-PROTOTYPE>
                  </ARGUMENTS>
                  <POSSIBLE-ERROR-REFS>
                    <POSSIBLE-ERROR-REF DEST="APPLICATION-ERROR">/AUTOSAR_Csm/PortInterfaces/CsmKeyManagement_[!"$vKey"!]/E_NOT_OK</POSSIBLE-ERROR-REF>
                    <POSSIBLE-ERROR-REF DEST="APPLICATION-ERROR">/AUTOSAR_Csm/PortInterfaces/CsmKeyManagement_[!"$vKey"!]/CSM_E_BUSY</POSSIBLE-ERROR-REF>
                  </POSSIBLE-ERROR-REFS>
                </CLIENT-SERVER-OPERATION>
                <CLIENT-SERVER-OPERATION>
                  <SHORT-NAME>KeyCopy</SHORT-NAME>
                  <ARGUMENTS>
                    <ARGUMENT-DATA-PROTOTYPE>
                      <SHORT-NAME>targetKeyId</SHORT-NAME>
                      <TYPE-TREF DEST="IMPLEMENTATION-DATA-TYPE">/AUTOSAR_Platform/ImplementationDataTypes/uint32</TYPE-TREF>
                      <DIRECTION>IN</DIRECTION>
                    </ARGUMENT-DATA-PROTOTYPE>
                  </ARGUMENTS>
                  <POSSIBLE-ERROR-REFS>
                    <POSSIBLE-ERROR-REF DEST="APPLICATION-ERROR">/AUTOSAR_Csm/PortInterfaces/CsmKeyManagement_[!"$vKey"!]/E_NOT_OK</POSSIBLE-ERROR-REF>
                    <POSSIBLE-ERROR-REF DEST="APPLICATION-ERROR">/AUTOSAR_Csm/PortInterfaces/CsmKeyManagement_[!"$vKey"!]/CSM_E_BUSY</POSSIBLE-ERROR-REF>
                    <POSSIBLE-ERROR-REF DEST="APPLICATION-ERROR">/AUTOSAR_Csm/PortInterfaces/CsmKeyManagement_[!"$vKey"!]/CSM_E_SMALL_BUFFER</POSSIBLE-ERROR-REF>
                    <POSSIBLE-ERROR-REF DEST="APPLICATION-ERROR">/AUTOSAR_Csm/PortInterfaces/CsmKeyManagement_[!"$vKey"!]/CSM_E_KEY_READ_FAIL</POSSIBLE-ERROR-REF>
                    <POSSIBLE-ERROR-REF DEST="APPLICATION-ERROR">/AUTOSAR_Csm/PortInterfaces/CsmKeyManagement_[!"$vKey"!]/CSM_E_KEY_WRITE_FAIL</POSSIBLE-ERROR-REF>
                    <POSSIBLE-ERROR-REF DEST="APPLICATION-ERROR">/AUTOSAR_Csm/PortInterfaces/CsmKeyManagement_[!"$vKey"!]/CSM_E_KEY_SIZE_MISMATCH</POSSIBLE-ERROR-REF>
                  </POSSIBLE-ERROR-REFS>
                </CLIENT-SERVER-OPERATION>
                <CLIENT-SERVER-OPERATION>
                  <SHORT-NAME>KeyDerive</SHORT-NAME>
                  <ARGUMENTS>
                    <ARGUMENT-DATA-PROTOTYPE>
                      <SHORT-NAME>targetKeyId</SHORT-NAME>
                      <TYPE-TREF DEST="IMPLEMENTATION-DATA-TYPE">/AUTOSAR_Platform/ImplementationDataTypes/uint32</TYPE-TREF>
                      <DIRECTION>IN</DIRECTION>
                    </ARGUMENT-DATA-PROTOTYPE>
                  </ARGUMENTS>
                  <POSSIBLE-ERROR-REFS>
                    <POSSIBLE-ERROR-REF DEST="APPLICATION-ERROR">/AUTOSAR_Csm/PortInterfaces/CsmKeyManagement_[!"$vKey"!]/E_NOT_OK</POSSIBLE-ERROR-REF>
                  </POSSIBLE-ERROR-REFS>
                </CLIENT-SERVER-OPERATION>
                <CLIENT-SERVER-OPERATION>
                  <SHORT-NAME>KeyElementCopy</SHORT-NAME>
                  <ARGUMENTS>
                    <ARGUMENT-DATA-PROTOTYPE>
                      <SHORT-NAME>keyElementId</SHORT-NAME>
                      <TYPE-TREF DEST="IMPLEMENTATION-DATA-TYPE">/AUTOSAR_Platform/ImplementationDataTypes/uint32</TYPE-TREF>
                      <DIRECTION>IN</DIRECTION>
                    </ARGUMENT-DATA-PROTOTYPE>
                    <ARGUMENT-DATA-PROTOTYPE>
                      <SHORT-NAME>targetKeyId</SHORT-NAME>
                      <TYPE-TREF DEST="IMPLEMENTATION-DATA-TYPE">/AUTOSAR_Platform/ImplementationDataTypes/uint32</TYPE-TREF>
                      <DIRECTION>IN</DIRECTION>
                    </ARGUMENT-DATA-PROTOTYPE>
                    <ARGUMENT-DATA-PROTOTYPE>
                      <SHORT-NAME>targetKeyElementId</SHORT-NAME>
                      <TYPE-TREF DEST="IMPLEMENTATION-DATA-TYPE">/AUTOSAR_Platform/ImplementationDataTypes/uint32</TYPE-TREF>
                      <DIRECTION>IN</DIRECTION>
                    </ARGUMENT-DATA-PROTOTYPE>
                  </ARGUMENTS>
                  <POSSIBLE-ERROR-REFS>
                    <POSSIBLE-ERROR-REF DEST="APPLICATION-ERROR">/AUTOSAR_Csm/PortInterfaces/CsmKeyManagement_[!"$vKey"!]/E_NOT_OK</POSSIBLE-ERROR-REF>
                    <POSSIBLE-ERROR-REF DEST="APPLICATION-ERROR">/AUTOSAR_Csm/PortInterfaces/CsmKeyManagement_[!"$vKey"!]/CSM_E_BUSY</POSSIBLE-ERROR-REF>
                    <POSSIBLE-ERROR-REF DEST="APPLICATION-ERROR">/AUTOSAR_Csm/PortInterfaces/CsmKeyManagement_[!"$vKey"!]/CSM_E_SMALL_BUFFER</POSSIBLE-ERROR-REF>
                    <POSSIBLE-ERROR-REF DEST="APPLICATION-ERROR">/AUTOSAR_Csm/PortInterfaces/CsmKeyManagement_[!"$vKey"!]/CSM_E_KEY_READ_FAIL</POSSIBLE-ERROR-REF>
                    <POSSIBLE-ERROR-REF DEST="APPLICATION-ERROR">/AUTOSAR_Csm/PortInterfaces/CsmKeyManagement_[!"$vKey"!]/CSM_E_KEY_WRITE_FAIL</POSSIBLE-ERROR-REF>
                    <POSSIBLE-ERROR-REF DEST="APPLICATION-ERROR">/AUTOSAR_Csm/PortInterfaces/CsmKeyManagement_[!"$vKey"!]/CSM_E_KEY_SIZE_MISMATCH</POSSIBLE-ERROR-REF>
                  </POSSIBLE-ERROR-REFS>
                </CLIENT-SERVER-OPERATION>
                <CLIENT-SERVER-OPERATION>
                  <SHORT-NAME>KeyElementGet</SHORT-NAME>
                  <ARGUMENTS>
                    <ARGUMENT-DATA-PROTOTYPE>
                      <SHORT-NAME>keyElementId</SHORT-NAME>
                      <TYPE-TREF DEST="IMPLEMENTATION-DATA-TYPE">/AUTOSAR_Platform/ImplementationDataTypes/uint32</TYPE-TREF>
                      <DIRECTION>IN</DIRECTION>
                    </ARGUMENT-DATA-PROTOTYPE>
                    <ARGUMENT-DATA-PROTOTYPE>
                      <SHORT-NAME>keyPtr</SHORT-NAME>
                      <TYPE-TREF DEST="IMPLEMENTATION-DATA-TYPE">/AUTOSAR_Csm/ImplementationDataTypes/Csm_KeyDataType_[!"$vKey"!]</TYPE-TREF>
                      <DIRECTION>OUT</DIRECTION>
                    </ARGUMENT-DATA-PROTOTYPE>
                    <ARGUMENT-DATA-PROTOTYPE>
                      <SHORT-NAME>keyLength</SHORT-NAME>
                      <TYPE-TREF DEST="IMPLEMENTATION-DATA-TYPE">/AUTOSAR_Platform/ImplementationDataTypes/uint32</TYPE-TREF>
[!IF "node:value(as:modconf('Csm')/CsmEbGeneral/CsmEbMisc/CsmEbCorrectionCsiCsmKeyManagementCsoKeyElementGet) = 'true'"!][!//
                      <!-- !LINKSTO Csm.Dsn.Rte/CsiCsmKeyManagementCsoKeyElementGet/General/00001,1 -->
                      <DIRECTION>INOUT</DIRECTION>
[!ELSE!][!//
                      <DIRECTION>OUT</DIRECTION>
[!ENDIF!][!//
                    </ARGUMENT-DATA-PROTOTYPE>
                  </ARGUMENTS>
                  <POSSIBLE-ERROR-REFS>
                    <POSSIBLE-ERROR-REF DEST="APPLICATION-ERROR">/AUTOSAR_Csm/PortInterfaces/CsmKeyManagement_[!"$vKey"!]/E_NOT_OK</POSSIBLE-ERROR-REF>
                    <POSSIBLE-ERROR-REF DEST="APPLICATION-ERROR">/AUTOSAR_Csm/PortInterfaces/CsmKeyManagement_[!"$vKey"!]/CSM_E_BUSY</POSSIBLE-ERROR-REF>
                    <POSSIBLE-ERROR-REF DEST="APPLICATION-ERROR">/AUTOSAR_Csm/PortInterfaces/CsmKeyManagement_[!"$vKey"!]/CSM_E_SMALL_BUFFER</POSSIBLE-ERROR-REF>
                    <POSSIBLE-ERROR-REF DEST="APPLICATION-ERROR">/AUTOSAR_Csm/PortInterfaces/CsmKeyManagement_[!"$vKey"!]/CSM_E_KEY_READ_FAIL</POSSIBLE-ERROR-REF>
                    <POSSIBLE-ERROR-REF DEST="APPLICATION-ERROR">/AUTOSAR_Csm/PortInterfaces/CsmKeyManagement_[!"$vKey"!]/CSM_E_KEY_NOT_AVAILABLE</POSSIBLE-ERROR-REF>
                  </POSSIBLE-ERROR-REFS>
                </CLIENT-SERVER-OPERATION>
                <CLIENT-SERVER-OPERATION>
                  <SHORT-NAME>KeyElementSet</SHORT-NAME>
                  <ARGUMENTS>
                    <ARGUMENT-DATA-PROTOTYPE>
                      <SHORT-NAME>keyElementId</SHORT-NAME>
                      <TYPE-TREF DEST="IMPLEMENTATION-DATA-TYPE">/AUTOSAR_Platform/ImplementationDataTypes/uint32</TYPE-TREF>
                      <DIRECTION>IN</DIRECTION>
                    </ARGUMENT-DATA-PROTOTYPE>
                    <ARGUMENT-DATA-PROTOTYPE>
                      <SHORT-NAME>keyPtr</SHORT-NAME>
                      <TYPE-TREF DEST="IMPLEMENTATION-DATA-TYPE">/AUTOSAR_Csm/ImplementationDataTypes/Csm_KeyDataType_[!"$vKey"!]</TYPE-TREF>
                      <DIRECTION>IN</DIRECTION>
                    </ARGUMENT-DATA-PROTOTYPE>
                    <ARGUMENT-DATA-PROTOTYPE>
                      <SHORT-NAME>keyLength</SHORT-NAME>
                      <TYPE-TREF DEST="IMPLEMENTATION-DATA-TYPE">/AUTOSAR_Platform/ImplementationDataTypes/uint32</TYPE-TREF>
                      <DIRECTION>IN</DIRECTION>
                    </ARGUMENT-DATA-PROTOTYPE>
                  </ARGUMENTS>
                  <POSSIBLE-ERROR-REFS>
                    <POSSIBLE-ERROR-REF DEST="APPLICATION-ERROR">/AUTOSAR_Csm/PortInterfaces/CsmKeyManagement_[!"$vKey"!]/E_NOT_OK</POSSIBLE-ERROR-REF>
                    <POSSIBLE-ERROR-REF DEST="APPLICATION-ERROR">/AUTOSAR_Csm/PortInterfaces/CsmKeyManagement_[!"$vKey"!]/CSM_E_BUSY</POSSIBLE-ERROR-REF>
                    <POSSIBLE-ERROR-REF DEST="APPLICATION-ERROR">/AUTOSAR_Csm/PortInterfaces/CsmKeyManagement_[!"$vKey"!]/CSM_E_SMALL_BUFFER</POSSIBLE-ERROR-REF>
                    <POSSIBLE-ERROR-REF DEST="APPLICATION-ERROR">/AUTOSAR_Csm/PortInterfaces/CsmKeyManagement_[!"$vKey"!]/CSM_E_KEY_WRITE_FAIL</POSSIBLE-ERROR-REF>
                    <POSSIBLE-ERROR-REF DEST="APPLICATION-ERROR">/AUTOSAR_Csm/PortInterfaces/CsmKeyManagement_[!"$vKey"!]/CSM_E_KEY_NOT_AVAILABLE</POSSIBLE-ERROR-REF>
                    <POSSIBLE-ERROR-REF DEST="APPLICATION-ERROR">/AUTOSAR_Csm/PortInterfaces/CsmKeyManagement_[!"$vKey"!]/CSM_E_KEY_SIZE_MISMATCH</POSSIBLE-ERROR-REF>
                  </POSSIBLE-ERROR-REFS>
                </CLIENT-SERVER-OPERATION>
                <CLIENT-SERVER-OPERATION>
                  <SHORT-NAME>KeyExchangeCalcPubVal</SHORT-NAME>
                  <ARGUMENTS>
                    <ARGUMENT-DATA-PROTOTYPE>
                      <SHORT-NAME>publicValuePtr</SHORT-NAME>
                      <TYPE-TREF DEST="IMPLEMENTATION-DATA-TYPE">/AUTOSAR_Csm/ImplementationDataTypes/Csm_PublicValueDataType_[!"$vKey"!]</TYPE-TREF>
                      <DIRECTION>OUT</DIRECTION>
                    </ARGUMENT-DATA-PROTOTYPE>
                    <ARGUMENT-DATA-PROTOTYPE>
                      <SHORT-NAME>publicValueLengthPtr</SHORT-NAME>
                      <TYPE-TREF DEST="IMPLEMENTATION-DATA-TYPE">/AUTOSAR_Platform/ImplementationDataTypes/uint32</TYPE-TREF>
                      <DIRECTION>INOUT</DIRECTION>
                    </ARGUMENT-DATA-PROTOTYPE>
                  </ARGUMENTS>
                  <POSSIBLE-ERROR-REFS>
                    <POSSIBLE-ERROR-REF DEST="APPLICATION-ERROR">/AUTOSAR_Csm/PortInterfaces/CsmKeyManagement_[!"$vKey"!]/E_NOT_OK</POSSIBLE-ERROR-REF>
                    <POSSIBLE-ERROR-REF DEST="APPLICATION-ERROR">/AUTOSAR_Csm/PortInterfaces/CsmKeyManagement_[!"$vKey"!]/CSM_E_BUSY</POSSIBLE-ERROR-REF>
                  </POSSIBLE-ERROR-REFS>
                </CLIENT-SERVER-OPERATION>
                <CLIENT-SERVER-OPERATION>
                  <SHORT-NAME>KeyExchangeCalcSecret</SHORT-NAME>
                  <ARGUMENTS>
                    <ARGUMENT-DATA-PROTOTYPE>
                      <SHORT-NAME>partnerPublicValuePtr</SHORT-NAME>
                      <TYPE-TREF DEST="IMPLEMENTATION-DATA-TYPE">/AUTOSAR_Csm/ImplementationDataTypes/Csm_PublicValueDataType_[!"$vKey"!]</TYPE-TREF>
                      <DIRECTION>IN</DIRECTION>
                    </ARGUMENT-DATA-PROTOTYPE>
                    <ARGUMENT-DATA-PROTOTYPE>
                      <SHORT-NAME>partnerPublicValueLength</SHORT-NAME>
                      <TYPE-TREF DEST="IMPLEMENTATION-DATA-TYPE">/AUTOSAR_Platform/ImplementationDataTypes/uint32</TYPE-TREF>
                      <DIRECTION>IN</DIRECTION>
                    </ARGUMENT-DATA-PROTOTYPE>
                  </ARGUMENTS>
                  <POSSIBLE-ERROR-REFS>
                    <POSSIBLE-ERROR-REF DEST="APPLICATION-ERROR">/AUTOSAR_Csm/PortInterfaces/CsmKeyManagement_[!"$vKey"!]/E_NOT_OK</POSSIBLE-ERROR-REF>
                    <POSSIBLE-ERROR-REF DEST="APPLICATION-ERROR">/AUTOSAR_Csm/PortInterfaces/CsmKeyManagement_[!"$vKey"!]/CSM_E_BUSY</POSSIBLE-ERROR-REF>
                  </POSSIBLE-ERROR-REFS>
                </CLIENT-SERVER-OPERATION>
                <CLIENT-SERVER-OPERATION>
                  <SHORT-NAME>KeyGenerate</SHORT-NAME>
                  <ARGUMENTS>
                  </ARGUMENTS>
                  <POSSIBLE-ERROR-REFS>
                    <POSSIBLE-ERROR-REF DEST="APPLICATION-ERROR">/AUTOSAR_Csm/PortInterfaces/CsmKeyManagement_[!"$vKey"!]/E_NOT_OK</POSSIBLE-ERROR-REF>
                    <POSSIBLE-ERROR-REF DEST="APPLICATION-ERROR">/AUTOSAR_Csm/PortInterfaces/CsmKeyManagement_[!"$vKey"!]/CSM_E_BUSY</POSSIBLE-ERROR-REF>
                  </POSSIBLE-ERROR-REFS>
                </CLIENT-SERVER-OPERATION>
                <CLIENT-SERVER-OPERATION>
                  <SHORT-NAME>KeySetValid</SHORT-NAME>
                  <ARGUMENTS>
                  </ARGUMENTS>
                  <POSSIBLE-ERROR-REFS>
                    <POSSIBLE-ERROR-REF DEST="APPLICATION-ERROR">/AUTOSAR_Csm/PortInterfaces/CsmKeyManagement_[!"$vKey"!]/E_NOT_OK</POSSIBLE-ERROR-REF>
                    <POSSIBLE-ERROR-REF DEST="APPLICATION-ERROR">/AUTOSAR_Csm/PortInterfaces/CsmKeyManagement_[!"$vKey"!]/CSM_E_BUSY</POSSIBLE-ERROR-REF>
                  </POSSIBLE-ERROR-REFS>
                </CLIENT-SERVER-OPERATION>
[!IF "node:value(as:modconf('Csm')/CsmEbGeneral/CsmEbMisc/CsmEbEnhancementApiCsmKeySetInvalid) = 'true'"!][!//
                <CLIENT-SERVER-OPERATION>
                  <SHORT-NAME>KeySetInvalid</SHORT-NAME>
                  <ARGUMENTS>
                  </ARGUMENTS>
                  <POSSIBLE-ERROR-REFS>
                    <POSSIBLE-ERROR-REF DEST="APPLICATION-ERROR">/AUTOSAR_Csm/PortInterfaces/CsmKeyManagement_[!"$vKey"!]/E_NOT_OK</POSSIBLE-ERROR-REF>
                    <POSSIBLE-ERROR-REF DEST="APPLICATION-ERROR">/AUTOSAR_Csm/PortInterfaces/CsmKeyManagement_[!"$vKey"!]/CSM_E_BUSY</POSSIBLE-ERROR-REF>
                  </POSSIBLE-ERROR-REFS>
                </CLIENT-SERVER-OPERATION>
[!ENDIF!][!//
  [!IF "node:value(as:modconf('Csm')/CsmEbGeneral/CsmEbMisc/CsmEbEnhancementApiCsmKeyGetStatus) = 'true'"!][!//
                <CLIENT-SERVER-OPERATION>
                  <SHORT-NAME>KeyGetStatus</SHORT-NAME>
                  <ARGUMENTS>
                    <ARGUMENT-DATA-PROTOTYPE>
                      <SHORT-NAME>keyStatusPtr</SHORT-NAME>
                      <TYPE-TREF DEST="IMPLEMENTATION-DATA-TYPE">/AUTOSAR_Csm/ImplementationDataTypes/Crypto_KeyStatusType</TYPE-TREF>
                      <DIRECTION>OUT</DIRECTION>
                    </ARGUMENT-DATA-PROTOTYPE>
                  </ARGUMENTS>
                  <POSSIBLE-ERROR-REFS>
                    <POSSIBLE-ERROR-REF DEST="APPLICATION-ERROR">/AUTOSAR_Csm/PortInterfaces/CsmKeyManagement_[!"$vKey"!]/E_NOT_OK</POSSIBLE-ERROR-REF>
                  </POSSIBLE-ERROR-REFS>
                </CLIENT-SERVER-OPERATION>
  [!ENDIF!][!//
                <CLIENT-SERVER-OPERATION>
                  <SHORT-NAME>RandomSeed</SHORT-NAME>
                  <ARGUMENTS>
                    <ARGUMENT-DATA-PROTOTYPE>
                      <SHORT-NAME>seedPtr</SHORT-NAME>
                      <TYPE-TREF DEST="IMPLEMENTATION-DATA-TYPE">/AUTOSAR_Csm/ImplementationDataTypes/Csm_SeedDataType_[!"$vKey"!]</TYPE-TREF>
                      <DIRECTION>IN</DIRECTION>
                    </ARGUMENT-DATA-PROTOTYPE>
                    <ARGUMENT-DATA-PROTOTYPE>
                      <SHORT-NAME>seedLength</SHORT-NAME>
                      <TYPE-TREF DEST="IMPLEMENTATION-DATA-TYPE">/AUTOSAR_Platform/ImplementationDataTypes/uint32</TYPE-TREF>
                      <DIRECTION>IN</DIRECTION>
                    </ARGUMENT-DATA-PROTOTYPE>
                  </ARGUMENTS>
                  <POSSIBLE-ERROR-REFS>
                    <POSSIBLE-ERROR-REF DEST="APPLICATION-ERROR">/AUTOSAR_Csm/PortInterfaces/CsmKeyManagement_[!"$vKey"!]/E_NOT_OK</POSSIBLE-ERROR-REF>
                    <POSSIBLE-ERROR-REF DEST="APPLICATION-ERROR">/AUTOSAR_Csm/PortInterfaces/CsmKeyManagement_[!"$vKey"!]/CSM_E_BUSY</POSSIBLE-ERROR-REF>
                  </POSSIBLE-ERROR-REFS>
                </CLIENT-SERVER-OPERATION>
              </OPERATIONS>
              <POSSIBLE-ERRORS>
                <APPLICATION-ERROR>
                  <SHORT-NAME>E_NOT_OK</SHORT-NAME>
                  <ERROR-CODE>1</ERROR-CODE>
                </APPLICATION-ERROR>
                <APPLICATION-ERROR>
                  <SHORT-NAME>CSM_E_BUSY</SHORT-NAME>
                  <ERROR-CODE>2</ERROR-CODE>
                </APPLICATION-ERROR>
                <APPLICATION-ERROR>
                  <SHORT-NAME>CSM_E_SMALL_BUFFER</SHORT-NAME>
                  <ERROR-CODE>3</ERROR-CODE>
                </APPLICATION-ERROR>
                <APPLICATION-ERROR>
                  <SHORT-NAME>CSM_E_KEY_READ_FAIL</SHORT-NAME>
                  <ERROR-CODE>6</ERROR-CODE>
                </APPLICATION-ERROR>
                <APPLICATION-ERROR>
                  <SHORT-NAME>CSM_E_KEY_WRITE_FAIL</SHORT-NAME>
                  <ERROR-CODE>7</ERROR-CODE>
                </APPLICATION-ERROR>
                <APPLICATION-ERROR>
                  <SHORT-NAME>CSM_E_KEY_NOT_AVAILABLE</SHORT-NAME>
                  <ERROR-CODE>8</ERROR-CODE>
                </APPLICATION-ERROR>
                <APPLICATION-ERROR>
                  <SHORT-NAME>CSM_E_KEY_SIZE_MISMATCH</SHORT-NAME>
                  <ERROR-CODE>10</ERROR-CODE>
                </APPLICATION-ERROR>
              </POSSIBLE-ERRORS>
            </CLIENT-SERVER-INTERFACE>
  [!ENDLOOP!][!//
  [!LOOP "node:refs(as:modconf('Csm')/CsmJobs/CsmJob/*[CsmJobUsePort = 'true']/CsmJobPrimitiveRef)/*[@name = 'CsmAEADDecrypt']"!][!//
    [!IF "node:value(as:modconf('Csm')/CsmEbGeneral/CsmEbMisc/CsmEbCorrectionCsmAsyncJobInterfaceUseDataReferences) = 'false' or
    num:i(count(./*[CsmAEADDecryptProcessing = 'CSM_SYNCHRONOUS'])) > 0"!][!//
    [!SELECT "./.."!][!//
            <!-- !LINKSTO CSM.Req.Correction.SWS_Csm_01915,1 -->
            <CLIENT-SERVER-INTERFACE>
              <SHORT-NAME>CsmAEADDecrypt_[!"node:name(.)"!]</SHORT-NAME>
              <IS-SERVICE>true</IS-SERVICE>
              <OPERATIONS>
                <CLIENT-SERVER-OPERATION>
                  <SHORT-NAME>CancelJob</SHORT-NAME>
                  <ARGUMENTS>
                  </ARGUMENTS>
                  <POSSIBLE-ERROR-REFS>
                    <POSSIBLE-ERROR-REF DEST="APPLICATION-ERROR">/AUTOSAR_Csm/PortInterfaces/CsmAEADDecrypt_[!"node:name(.)"!]/E_NOT_OK</POSSIBLE-ERROR-REF>
                  </POSSIBLE-ERROR-REFS>
                </CLIENT-SERVER-OPERATION>
                <CLIENT-SERVER-OPERATION>
                  <SHORT-NAME>AEADDecrypt</SHORT-NAME>
                  <ARGUMENTS>
                    <ARGUMENT-DATA-PROTOTYPE>
                      <SHORT-NAME>cipherBuffer</SHORT-NAME>
                      <TYPE-TREF DEST="IMPLEMENTATION-DATA-TYPE">/AUTOSAR_Csm/ImplementationDataTypes/Csm_AEADDecryptCiphertextType_[!"node:name(.)"!]</TYPE-TREF>
                      <DIRECTION>IN</DIRECTION>
                    </ARGUMENT-DATA-PROTOTYPE>
                    <ARGUMENT-DATA-PROTOTYPE>
                      <SHORT-NAME>ciphertextLength</SHORT-NAME>
                      <TYPE-TREF DEST="IMPLEMENTATION-DATA-TYPE">/AUTOSAR_Platform/ImplementationDataTypes/uint32</TYPE-TREF>
                      <DIRECTION>IN</DIRECTION>
                    </ARGUMENT-DATA-PROTOTYPE>
                    <ARGUMENT-DATA-PROTOTYPE>
                      <SHORT-NAME>associatedDataBuffer</SHORT-NAME>
                      <TYPE-TREF DEST="IMPLEMENTATION-DATA-TYPE">/AUTOSAR_Csm/ImplementationDataTypes/Csm_AEADDecryptAssociatedDataType_[!"node:name(.)"!]</TYPE-TREF>
                      <DIRECTION>IN</DIRECTION>
                    </ARGUMENT-DATA-PROTOTYPE>
                    <ARGUMENT-DATA-PROTOTYPE>
                      <SHORT-NAME>associatedDataLength</SHORT-NAME>
                      <TYPE-TREF DEST="IMPLEMENTATION-DATA-TYPE">/AUTOSAR_Platform/ImplementationDataTypes/uint32</TYPE-TREF>
                      <DIRECTION>IN</DIRECTION>
                    </ARGUMENT-DATA-PROTOTYPE>
                    <ARGUMENT-DATA-PROTOTYPE>
                      <SHORT-NAME>macBuffer</SHORT-NAME>
                      <TYPE-TREF DEST="IMPLEMENTATION-DATA-TYPE">/AUTOSAR_Csm/ImplementationDataTypes/Csm_AEADDecryptMacType_[!"node:name(.)"!]</TYPE-TREF>
                      <DIRECTION>IN</DIRECTION>
                    </ARGUMENT-DATA-PROTOTYPE>
                    <ARGUMENT-DATA-PROTOTYPE>
                      <SHORT-NAME>macLength</SHORT-NAME>
                      <TYPE-TREF DEST="IMPLEMENTATION-DATA-TYPE">/AUTOSAR_Platform/ImplementationDataTypes/uint32</TYPE-TREF>
                      <DIRECTION>IN</DIRECTION>
                    </ARGUMENT-DATA-PROTOTYPE>
                    <ARGUMENT-DATA-PROTOTYPE>
                      <SHORT-NAME>plaintextBuffer</SHORT-NAME>
                      <TYPE-TREF DEST="IMPLEMENTATION-DATA-TYPE">/AUTOSAR_Csm/ImplementationDataTypes/Csm_AEADDecryptPlaintextType_[!"node:name(.)"!]</TYPE-TREF>
                      <DIRECTION>OUT</DIRECTION>
                    </ARGUMENT-DATA-PROTOTYPE>
                    <ARGUMENT-DATA-PROTOTYPE>
                      <SHORT-NAME>plaintextLength</SHORT-NAME>
                      <TYPE-TREF DEST="IMPLEMENTATION-DATA-TYPE">/AUTOSAR_Platform/ImplementationDataTypes/uint32</TYPE-TREF>
                      <DIRECTION>INOUT</DIRECTION>
                    </ARGUMENT-DATA-PROTOTYPE>
                    <ARGUMENT-DATA-PROTOTYPE>
                      <SHORT-NAME>verifyPtr</SHORT-NAME>
                      <TYPE-TREF DEST="IMPLEMENTATION-DATA-TYPE">/AUTOSAR_Csm/ImplementationDataTypes/Crypto_VerifyResultType</TYPE-TREF>
                      <DIRECTION>OUT</DIRECTION>
                    </ARGUMENT-DATA-PROTOTYPE>
                  </ARGUMENTS>
                  <POSSIBLE-ERROR-REFS>
                    <POSSIBLE-ERROR-REF DEST="APPLICATION-ERROR">/AUTOSAR_Csm/PortInterfaces/CsmAEADDecrypt_[!"node:name(.)"!]/E_NOT_OK</POSSIBLE-ERROR-REF>
                    <POSSIBLE-ERROR-REF DEST="APPLICATION-ERROR">/AUTOSAR_Csm/PortInterfaces/CsmAEADDecrypt_[!"node:name(.)"!]/CSM_E_BUSY</POSSIBLE-ERROR-REF>
                    <POSSIBLE-ERROR-REF DEST="APPLICATION-ERROR">/AUTOSAR_Csm/PortInterfaces/CsmAEADDecrypt_[!"node:name(.)"!]/CSM_E_SMALL_BUFFER</POSSIBLE-ERROR-REF>
                  </POSSIBLE-ERROR-REFS>
                </CLIENT-SERVER-OPERATION>
              </OPERATIONS>
              <POSSIBLE-ERRORS>
                <APPLICATION-ERROR>
                  <SHORT-NAME>E_NOT_OK</SHORT-NAME>
                  <ERROR-CODE>1</ERROR-CODE>
                </APPLICATION-ERROR>
                <APPLICATION-ERROR>
                  <SHORT-NAME>CSM_E_BUSY</SHORT-NAME>
                  <ERROR-CODE>2</ERROR-CODE>
                </APPLICATION-ERROR>
                <APPLICATION-ERROR>
                  <SHORT-NAME>CSM_E_SMALL_BUFFER</SHORT-NAME>
                  <ERROR-CODE>3</ERROR-CODE>
                </APPLICATION-ERROR>
              </POSSIBLE-ERRORS>
            </CLIENT-SERVER-INTERFACE>
    [!ENDSELECT!][!//
    [!ENDIF!][!//
  [!ENDLOOP!][!//
  [!LOOP "node:refs(as:modconf('Csm')/CsmJobs/CsmJob/*[CsmJobUsePort = 'true']/CsmJobPrimitiveRef)/*[@name = 'CsmAEADEncrypt']"!][!//
    [!IF "node:value(as:modconf('Csm')/CsmEbGeneral/CsmEbMisc/CsmEbCorrectionCsmAsyncJobInterfaceUseDataReferences) = 'false' or
    num:i(count(./*[CsmAEADEncryptProcessing = 'CSM_SYNCHRONOUS'])) > 0"!][!//
    [!SELECT "./.."!][!//
            <!-- !LINKSTO CSM.Req.Correction.SWS_Csm_01910,1 -->
            <CLIENT-SERVER-INTERFACE>
              <SHORT-NAME>CsmAEADEncrypt_[!"node:name(.)"!]</SHORT-NAME>
              <IS-SERVICE>true</IS-SERVICE>
              <OPERATIONS>
                <CLIENT-SERVER-OPERATION>
                  <SHORT-NAME>CancelJob</SHORT-NAME>
                  <ARGUMENTS>
                  </ARGUMENTS>
                  <POSSIBLE-ERROR-REFS>
                    <POSSIBLE-ERROR-REF DEST="APPLICATION-ERROR">/AUTOSAR_Csm/PortInterfaces/CsmAEADEncrypt_[!"node:name(.)"!]/E_NOT_OK</POSSIBLE-ERROR-REF>
                  </POSSIBLE-ERROR-REFS>
                </CLIENT-SERVER-OPERATION>
                <CLIENT-SERVER-OPERATION>
                  <SHORT-NAME>AEADEncrypt</SHORT-NAME>
                  <ARGUMENTS>
                    <ARGUMENT-DATA-PROTOTYPE>
                      <SHORT-NAME>plaintextBuffer</SHORT-NAME>
                      <TYPE-TREF DEST="IMPLEMENTATION-DATA-TYPE">/AUTOSAR_Csm/ImplementationDataTypes/Csm_AEADEncryptPlaintextType_[!"node:name(.)"!]</TYPE-TREF>
                      <DIRECTION>IN</DIRECTION>
                    </ARGUMENT-DATA-PROTOTYPE>
                    <ARGUMENT-DATA-PROTOTYPE>
                      <SHORT-NAME>plaintextLength</SHORT-NAME>
                      <TYPE-TREF DEST="IMPLEMENTATION-DATA-TYPE">/AUTOSAR_Platform/ImplementationDataTypes/uint32</TYPE-TREF>
                      <DIRECTION>IN</DIRECTION>
                    </ARGUMENT-DATA-PROTOTYPE>
                    <ARGUMENT-DATA-PROTOTYPE>
                      <SHORT-NAME>associatedDataBuffer</SHORT-NAME>
                      <TYPE-TREF DEST="IMPLEMENTATION-DATA-TYPE">/AUTOSAR_Csm/ImplementationDataTypes/Csm_AEADEncryptAssociatedDataType_[!"node:name(.)"!]</TYPE-TREF>
                      <DIRECTION>IN</DIRECTION>
                    </ARGUMENT-DATA-PROTOTYPE>
                    <ARGUMENT-DATA-PROTOTYPE>
                      <SHORT-NAME>associatedDataLength</SHORT-NAME>
                      <TYPE-TREF DEST="IMPLEMENTATION-DATA-TYPE">/AUTOSAR_Platform/ImplementationDataTypes/uint32</TYPE-TREF>
                      <DIRECTION>IN</DIRECTION>
                    </ARGUMENT-DATA-PROTOTYPE>
                    <ARGUMENT-DATA-PROTOTYPE>
                      <SHORT-NAME>cipherBuffer</SHORT-NAME>
                      <TYPE-TREF DEST="IMPLEMENTATION-DATA-TYPE">/AUTOSAR_Csm/ImplementationDataTypes/Csm_AEADEncryptCiphertextType_[!"node:name(.)"!]</TYPE-TREF>
                      <DIRECTION>OUT</DIRECTION>
                    </ARGUMENT-DATA-PROTOTYPE>
                    <ARGUMENT-DATA-PROTOTYPE>
                      <SHORT-NAME>ciphertextLengthPtr</SHORT-NAME>
                      <TYPE-TREF DEST="IMPLEMENTATION-DATA-TYPE">/AUTOSAR_Platform/ImplementationDataTypes/uint32</TYPE-TREF>
                      <DIRECTION>INOUT</DIRECTION>
                    </ARGUMENT-DATA-PROTOTYPE>
                    <ARGUMENT-DATA-PROTOTYPE>
                      <SHORT-NAME>macBuffer</SHORT-NAME>
                      <TYPE-TREF DEST="IMPLEMENTATION-DATA-TYPE">/AUTOSAR_Csm/ImplementationDataTypes/Csm_AEADEncryptMacType_[!"node:name(.)"!]</TYPE-TREF>
                      <DIRECTION>OUT</DIRECTION>
                    </ARGUMENT-DATA-PROTOTYPE>
                    <ARGUMENT-DATA-PROTOTYPE>
                      <SHORT-NAME>macLength</SHORT-NAME>
                      <TYPE-TREF DEST="IMPLEMENTATION-DATA-TYPE">/AUTOSAR_Platform/ImplementationDataTypes/uint32</TYPE-TREF>
                      <DIRECTION>INOUT</DIRECTION>
                    </ARGUMENT-DATA-PROTOTYPE>
                  </ARGUMENTS>
                  <POSSIBLE-ERROR-REFS>
                    <POSSIBLE-ERROR-REF DEST="APPLICATION-ERROR">/AUTOSAR_Csm/PortInterfaces/CsmAEADEncrypt_[!"node:name(.)"!]/E_NOT_OK</POSSIBLE-ERROR-REF>
                    <POSSIBLE-ERROR-REF DEST="APPLICATION-ERROR">/AUTOSAR_Csm/PortInterfaces/CsmAEADEncrypt_[!"node:name(.)"!]/CSM_E_BUSY</POSSIBLE-ERROR-REF>
                    <POSSIBLE-ERROR-REF DEST="APPLICATION-ERROR">/AUTOSAR_Csm/PortInterfaces/CsmAEADEncrypt_[!"node:name(.)"!]/CSM_E_SMALL_BUFFER</POSSIBLE-ERROR-REF>
                  </POSSIBLE-ERROR-REFS>
                </CLIENT-SERVER-OPERATION>
              </OPERATIONS>
              <POSSIBLE-ERRORS>
                <APPLICATION-ERROR>
                  <SHORT-NAME>E_NOT_OK</SHORT-NAME>
                  <ERROR-CODE>1</ERROR-CODE>
                </APPLICATION-ERROR>
                <APPLICATION-ERROR>
                  <SHORT-NAME>CSM_E_BUSY</SHORT-NAME>
                  <ERROR-CODE>2</ERROR-CODE>
                </APPLICATION-ERROR>
                <APPLICATION-ERROR>
                  <SHORT-NAME>CSM_E_SMALL_BUFFER</SHORT-NAME>
                  <ERROR-CODE>3</ERROR-CODE>
                </APPLICATION-ERROR>
              </POSSIBLE-ERRORS>
            </CLIENT-SERVER-INTERFACE>
    [!ENDSELECT!][!//
    [!ENDIF!][!//
  [!ENDLOOP!][!//
  [!LOOP "node:refs(as:modconf('Csm')/CsmJobs/CsmJob/*[CsmJobUsePort = 'true']/CsmJobPrimitiveRef)/*[@name = 'CsmDecrypt']"!][!//
    [!IF "node:value(as:modconf('Csm')/CsmEbGeneral/CsmEbMisc/CsmEbCorrectionCsmAsyncJobInterfaceUseDataReferences) = 'false' or
    num:i(count(./*[CsmDecryptProcessing = 'CSM_SYNCHRONOUS'])) > 0"!][!//
    [!SELECT "./.."!][!//
            <!-- !LINKSTO CSM.Req.Correction.SWS_Csm_01906,1 -->
            <CLIENT-SERVER-INTERFACE>
              <SHORT-NAME>CsmDecrypt_[!"node:name(.)"!]</SHORT-NAME>
              <IS-SERVICE>true</IS-SERVICE>
              <OPERATIONS>
                <CLIENT-SERVER-OPERATION>
                  <SHORT-NAME>CancelJob</SHORT-NAME>
                  <ARGUMENTS>
                  </ARGUMENTS>
                  <POSSIBLE-ERROR-REFS>
                    <POSSIBLE-ERROR-REF DEST="APPLICATION-ERROR">/AUTOSAR_Csm/PortInterfaces/CsmDecrypt_[!"node:name(.)"!]/E_NOT_OK</POSSIBLE-ERROR-REF>
                  </POSSIBLE-ERROR-REFS>
                </CLIENT-SERVER-OPERATION>
                <CLIENT-SERVER-OPERATION>
                  <SHORT-NAME>Decrypt</SHORT-NAME>
                  <ARGUMENTS>
                    <ARGUMENT-DATA-PROTOTYPE>
                      <SHORT-NAME>dataBuffer</SHORT-NAME>
                      <TYPE-TREF DEST="IMPLEMENTATION-DATA-TYPE">/AUTOSAR_Csm/ImplementationDataTypes/Csm_DecryptDataType_[!"node:name(.)"!]</TYPE-TREF>
                      <DIRECTION>IN</DIRECTION>
                    </ARGUMENT-DATA-PROTOTYPE>
                    <ARGUMENT-DATA-PROTOTYPE>
                      <SHORT-NAME>dataLength</SHORT-NAME>
                      <TYPE-TREF DEST="IMPLEMENTATION-DATA-TYPE">/AUTOSAR_Platform/ImplementationDataTypes/uint32</TYPE-TREF>
                      <DIRECTION>IN</DIRECTION>
                    </ARGUMENT-DATA-PROTOTYPE>
                    <ARGUMENT-DATA-PROTOTYPE>
                      <SHORT-NAME>resultBuffer</SHORT-NAME>
                      <TYPE-TREF DEST="IMPLEMENTATION-DATA-TYPE">/AUTOSAR_Csm/ImplementationDataTypes/Csm_DecryptResultType_[!"node:name(.)"!]</TYPE-TREF>
                      <DIRECTION>OUT</DIRECTION>
                    </ARGUMENT-DATA-PROTOTYPE>
                    <ARGUMENT-DATA-PROTOTYPE>
                      <SHORT-NAME>resultLength</SHORT-NAME>
                      <TYPE-TREF DEST="IMPLEMENTATION-DATA-TYPE">/AUTOSAR_Platform/ImplementationDataTypes/uint32</TYPE-TREF>
                      <DIRECTION>INOUT</DIRECTION>
                    </ARGUMENT-DATA-PROTOTYPE>
                  </ARGUMENTS>
                  <POSSIBLE-ERROR-REFS>
                    <POSSIBLE-ERROR-REF DEST="APPLICATION-ERROR">/AUTOSAR_Csm/PortInterfaces/CsmDecrypt_[!"node:name(.)"!]/E_NOT_OK</POSSIBLE-ERROR-REF>
                    <POSSIBLE-ERROR-REF DEST="APPLICATION-ERROR">/AUTOSAR_Csm/PortInterfaces/CsmDecrypt_[!"node:name(.)"!]/CSM_E_BUSY</POSSIBLE-ERROR-REF>
                    <POSSIBLE-ERROR-REF DEST="APPLICATION-ERROR">/AUTOSAR_Csm/PortInterfaces/CsmDecrypt_[!"node:name(.)"!]/CSM_E_SMALL_BUFFER</POSSIBLE-ERROR-REF>
                  </POSSIBLE-ERROR-REFS>
                </CLIENT-SERVER-OPERATION>
              </OPERATIONS>
              <POSSIBLE-ERRORS>
                <APPLICATION-ERROR>
                  <SHORT-NAME>E_NOT_OK</SHORT-NAME>
                  <ERROR-CODE>1</ERROR-CODE>
                </APPLICATION-ERROR>
                <APPLICATION-ERROR>
                  <SHORT-NAME>CSM_E_BUSY</SHORT-NAME>
                  <ERROR-CODE>2</ERROR-CODE>
                </APPLICATION-ERROR>
                <APPLICATION-ERROR>
                  <SHORT-NAME>CSM_E_SMALL_BUFFER</SHORT-NAME>
                  <ERROR-CODE>3</ERROR-CODE>
                </APPLICATION-ERROR>
              </POSSIBLE-ERRORS>
            </CLIENT-SERVER-INTERFACE>
    [!ENDSELECT!][!//
    [!ENDIF!][!//
  [!ENDLOOP!][!//
  [!LOOP "node:refs(as:modconf('Csm')/CsmJobs/CsmJob/*[CsmJobUsePort = 'true']/CsmJobPrimitiveRef)/*[@name = 'CsmEncrypt']"!][!//
    [!IF "node:value(as:modconf('Csm')/CsmEbGeneral/CsmEbMisc/CsmEbCorrectionCsmAsyncJobInterfaceUseDataReferences) = 'false' or
    num:i(count(./*[CsmEncryptProcessing = 'CSM_SYNCHRONOUS'])) > 0"!][!//
    [!SELECT "./.."!][!//
            <!-- !LINKSTO CSM.Req.Correction.SWS_Csm_00947,1 -->
            <CLIENT-SERVER-INTERFACE>
              <SHORT-NAME>CsmEncrypt_[!"node:name(.)"!]</SHORT-NAME>
              <IS-SERVICE>true</IS-SERVICE>
              <OPERATIONS>
                <CLIENT-SERVER-OPERATION>
                  <SHORT-NAME>CancelJob</SHORT-NAME>
                  <ARGUMENTS>
                  </ARGUMENTS>
                  <POSSIBLE-ERROR-REFS>
                    <POSSIBLE-ERROR-REF DEST="APPLICATION-ERROR">/AUTOSAR_Csm/PortInterfaces/CsmEncrypt_[!"node:name(.)"!]/E_NOT_OK</POSSIBLE-ERROR-REF>
                  </POSSIBLE-ERROR-REFS>
                </CLIENT-SERVER-OPERATION>
                <CLIENT-SERVER-OPERATION>
                  <SHORT-NAME>Encrypt</SHORT-NAME>
                  <ARGUMENTS>
                    <ARGUMENT-DATA-PROTOTYPE>
                      <SHORT-NAME>dataBuffer</SHORT-NAME>
                      <TYPE-TREF DEST="IMPLEMENTATION-DATA-TYPE">/AUTOSAR_Csm/ImplementationDataTypes/Csm_EncryptDataType_[!"node:name(.)"!]</TYPE-TREF>
                      <DIRECTION>IN</DIRECTION>
                    </ARGUMENT-DATA-PROTOTYPE>
                    <ARGUMENT-DATA-PROTOTYPE>
                      <SHORT-NAME>dataLength</SHORT-NAME>
                      <TYPE-TREF DEST="IMPLEMENTATION-DATA-TYPE">/AUTOSAR_Platform/ImplementationDataTypes/uint32</TYPE-TREF>
                      <DIRECTION>IN</DIRECTION>
                    </ARGUMENT-DATA-PROTOTYPE>
                    <ARGUMENT-DATA-PROTOTYPE>
                      <SHORT-NAME>resultBuffer</SHORT-NAME>
                      <TYPE-TREF DEST="IMPLEMENTATION-DATA-TYPE">/AUTOSAR_Csm/ImplementationDataTypes/Csm_EncryptResultType_[!"node:name(.)"!]</TYPE-TREF>
                      <DIRECTION>OUT</DIRECTION>
                    </ARGUMENT-DATA-PROTOTYPE>
                    <ARGUMENT-DATA-PROTOTYPE>
                      <SHORT-NAME>resultLength</SHORT-NAME>
                      <TYPE-TREF DEST="IMPLEMENTATION-DATA-TYPE">/AUTOSAR_Platform/ImplementationDataTypes/uint32</TYPE-TREF>
                      <DIRECTION>INOUT</DIRECTION>
                    </ARGUMENT-DATA-PROTOTYPE>
                  </ARGUMENTS>
                  <POSSIBLE-ERROR-REFS>
                    <POSSIBLE-ERROR-REF DEST="APPLICATION-ERROR">/AUTOSAR_Csm/PortInterfaces/CsmEncrypt_[!"node:name(.)"!]/E_NOT_OK</POSSIBLE-ERROR-REF>
                    <POSSIBLE-ERROR-REF DEST="APPLICATION-ERROR">/AUTOSAR_Csm/PortInterfaces/CsmEncrypt_[!"node:name(.)"!]/CSM_E_BUSY</POSSIBLE-ERROR-REF>
                    <POSSIBLE-ERROR-REF DEST="APPLICATION-ERROR">/AUTOSAR_Csm/PortInterfaces/CsmEncrypt_[!"node:name(.)"!]/CSM_E_SMALL_BUFFER</POSSIBLE-ERROR-REF>
                  </POSSIBLE-ERROR-REFS>
                </CLIENT-SERVER-OPERATION>
              </OPERATIONS>
              <POSSIBLE-ERRORS>
                <APPLICATION-ERROR>
                  <SHORT-NAME>E_NOT_OK</SHORT-NAME>
                  <ERROR-CODE>1</ERROR-CODE>
                </APPLICATION-ERROR>
                <APPLICATION-ERROR>
                  <SHORT-NAME>CSM_E_BUSY</SHORT-NAME>
                  <ERROR-CODE>2</ERROR-CODE>
                </APPLICATION-ERROR>
                <APPLICATION-ERROR>
                  <SHORT-NAME>CSM_E_SMALL_BUFFER</SHORT-NAME>
                  <ERROR-CODE>3</ERROR-CODE>
                </APPLICATION-ERROR>
              </POSSIBLE-ERRORS>
            </CLIENT-SERVER-INTERFACE>
    [!ENDSELECT!][!//
    [!ENDIF!][!//
  [!ENDLOOP!][!//
  [!LOOP "node:refs(as:modconf('Csm')/CsmJobs/CsmJob/*[CsmJobUsePort = 'true']/CsmJobPrimitiveRef)/*[@name = 'CsmHash']"!][!//
    [!IF "node:value(as:modconf('Csm')/CsmEbGeneral/CsmEbMisc/CsmEbCorrectionCsmAsyncJobInterfaceUseDataReferences) = 'false' or
    num:i(count(./*[CsmHashProcessing = 'CSM_SYNCHRONOUS'])) > 0"!][!//
    [!SELECT "./.."!][!//
            <!-- !LINKSTO CSM.Req.Correction.SWS_Csm_00946,1 -->
            <CLIENT-SERVER-INTERFACE>
              <SHORT-NAME>CsmHash_[!"node:name(.)"!]</SHORT-NAME>
              <IS-SERVICE>true</IS-SERVICE>
              <OPERATIONS>
                <CLIENT-SERVER-OPERATION>
                  <SHORT-NAME>CancelJob</SHORT-NAME>
                  <ARGUMENTS>
                  </ARGUMENTS>
                  <POSSIBLE-ERROR-REFS>
                    <POSSIBLE-ERROR-REF DEST="APPLICATION-ERROR">/AUTOSAR_Csm/PortInterfaces/CsmHash_[!"node:name(.)"!]/E_NOT_OK</POSSIBLE-ERROR-REF>
                  </POSSIBLE-ERROR-REFS>
                </CLIENT-SERVER-OPERATION>
                <CLIENT-SERVER-OPERATION>
                  <SHORT-NAME>Hash</SHORT-NAME>
                  <ARGUMENTS>
                    <ARGUMENT-DATA-PROTOTYPE>
                      <SHORT-NAME>dataBuffer</SHORT-NAME>
                      <TYPE-TREF DEST="IMPLEMENTATION-DATA-TYPE">/AUTOSAR_Csm/ImplementationDataTypes/Csm_HashDataType_[!"node:name(.)"!]</TYPE-TREF>
                      <DIRECTION>IN</DIRECTION>
                    </ARGUMENT-DATA-PROTOTYPE>
                    <ARGUMENT-DATA-PROTOTYPE>
                      <SHORT-NAME>dataLength</SHORT-NAME>
                      <TYPE-TREF DEST="IMPLEMENTATION-DATA-TYPE">/AUTOSAR_Platform/ImplementationDataTypes/uint32</TYPE-TREF>
                      <DIRECTION>IN</DIRECTION>
                    </ARGUMENT-DATA-PROTOTYPE>
                    <ARGUMENT-DATA-PROTOTYPE>
                      <SHORT-NAME>resultBuffer</SHORT-NAME>
                      <TYPE-TREF DEST="IMPLEMENTATION-DATA-TYPE">/AUTOSAR_Csm/ImplementationDataTypes/Csm_HashResultType_[!"node:name(.)"!]</TYPE-TREF>
                      <DIRECTION>OUT</DIRECTION>
                    </ARGUMENT-DATA-PROTOTYPE>
                    <ARGUMENT-DATA-PROTOTYPE>
                      <SHORT-NAME>resultLength</SHORT-NAME>
                      <TYPE-TREF DEST="IMPLEMENTATION-DATA-TYPE">/AUTOSAR_Platform/ImplementationDataTypes/uint32</TYPE-TREF>
                      <DIRECTION>INOUT</DIRECTION>
                    </ARGUMENT-DATA-PROTOTYPE>
                  </ARGUMENTS>
                  <POSSIBLE-ERROR-REFS>
                    <POSSIBLE-ERROR-REF DEST="APPLICATION-ERROR">/AUTOSAR_Csm/PortInterfaces/CsmHash_[!"node:name(.)"!]/E_NOT_OK</POSSIBLE-ERROR-REF>
                    <POSSIBLE-ERROR-REF DEST="APPLICATION-ERROR">/AUTOSAR_Csm/PortInterfaces/CsmHash_[!"node:name(.)"!]/CSM_E_BUSY</POSSIBLE-ERROR-REF>
                    <POSSIBLE-ERROR-REF DEST="APPLICATION-ERROR">/AUTOSAR_Csm/PortInterfaces/CsmHash_[!"node:name(.)"!]/CSM_E_SMALL_BUFFER</POSSIBLE-ERROR-REF>
                  </POSSIBLE-ERROR-REFS>
                </CLIENT-SERVER-OPERATION>
              </OPERATIONS>
              <POSSIBLE-ERRORS>
                <APPLICATION-ERROR>
                  <SHORT-NAME>E_NOT_OK</SHORT-NAME>
                  <ERROR-CODE>1</ERROR-CODE>
                </APPLICATION-ERROR>
                <APPLICATION-ERROR>
                  <SHORT-NAME>CSM_E_BUSY</SHORT-NAME>
                  <ERROR-CODE>2</ERROR-CODE>
                </APPLICATION-ERROR>
                <APPLICATION-ERROR>
                  <SHORT-NAME>CSM_E_SMALL_BUFFER</SHORT-NAME>
                  <ERROR-CODE>3</ERROR-CODE>
                </APPLICATION-ERROR>
              </POSSIBLE-ERRORS>
            </CLIENT-SERVER-INTERFACE>
    [!ENDSELECT!][!//
    [!ENDIF!][!//
  [!ENDLOOP!][!//
  [!LOOP "node:refs(as:modconf('Csm')/CsmJobs/CsmJob/*[CsmJobUsePort = 'true']/CsmJobPrimitiveRef)/*[@name = 'CsmMacGenerate']"!][!//
    [!IF "node:value(as:modconf('Csm')/CsmEbGeneral/CsmEbMisc/CsmEbCorrectionCsmAsyncJobInterfaceUseDataReferences) = 'false' or
    num:i(count(./*[CsmMacGenerateProcessing = 'CSM_SYNCHRONOUS'])) > 0"!][!//
    [!SELECT "./.."!][!//
            <!-- !LINKSTO CSM.Req.Correction.SWS_Csm_09000,1 -->
            <CLIENT-SERVER-INTERFACE>
              <SHORT-NAME>CsmMacGenerate_[!"node:name(.)"!]</SHORT-NAME>
              <IS-SERVICE>true</IS-SERVICE>
              <OPERATIONS>
                <CLIENT-SERVER-OPERATION>
                  <SHORT-NAME>CancelJob</SHORT-NAME>
                  <ARGUMENTS>
                  </ARGUMENTS>
                  <POSSIBLE-ERROR-REFS>
                    <POSSIBLE-ERROR-REF DEST="APPLICATION-ERROR">/AUTOSAR_Csm/PortInterfaces/CsmMacGenerate_[!"node:name(.)"!]/E_NOT_OK</POSSIBLE-ERROR-REF>
                  </POSSIBLE-ERROR-REFS>
                </CLIENT-SERVER-OPERATION>
                <CLIENT-SERVER-OPERATION>
                  <SHORT-NAME>MacGenerate</SHORT-NAME>
                  <ARGUMENTS>
                    <ARGUMENT-DATA-PROTOTYPE>
                      <SHORT-NAME>dataBuffer</SHORT-NAME>
                      <TYPE-TREF DEST="IMPLEMENTATION-DATA-TYPE">/AUTOSAR_Csm/ImplementationDataTypes/Csm_MacGenerateDataType_[!"node:name(.)"!]</TYPE-TREF>
                      <DIRECTION>IN</DIRECTION>
                    </ARGUMENT-DATA-PROTOTYPE>
                    <ARGUMENT-DATA-PROTOTYPE>
                      <SHORT-NAME>dataLength</SHORT-NAME>
                      <TYPE-TREF DEST="IMPLEMENTATION-DATA-TYPE">/AUTOSAR_Platform/ImplementationDataTypes/uint32</TYPE-TREF>
                      <DIRECTION>IN</DIRECTION>
                    </ARGUMENT-DATA-PROTOTYPE>
                    <ARGUMENT-DATA-PROTOTYPE>
                      <SHORT-NAME>resultBuffer</SHORT-NAME>
                      <TYPE-TREF DEST="IMPLEMENTATION-DATA-TYPE">/AUTOSAR_Csm/ImplementationDataTypes/Csm_MacGenerateResultType_[!"node:name(.)"!]</TYPE-TREF>
                      <DIRECTION>OUT</DIRECTION>
                    </ARGUMENT-DATA-PROTOTYPE>
                    <ARGUMENT-DATA-PROTOTYPE>
                      <SHORT-NAME>resultLength</SHORT-NAME>
                      <TYPE-TREF DEST="IMPLEMENTATION-DATA-TYPE">/AUTOSAR_Platform/ImplementationDataTypes/uint32</TYPE-TREF>
                      <DIRECTION>INOUT</DIRECTION>
                    </ARGUMENT-DATA-PROTOTYPE>
                  </ARGUMENTS>
                  <POSSIBLE-ERROR-REFS>
                    <POSSIBLE-ERROR-REF DEST="APPLICATION-ERROR">/AUTOSAR_Csm/PortInterfaces/CsmMacGenerate_[!"node:name(.)"!]/E_NOT_OK</POSSIBLE-ERROR-REF>
                    <POSSIBLE-ERROR-REF DEST="APPLICATION-ERROR">/AUTOSAR_Csm/PortInterfaces/CsmMacGenerate_[!"node:name(.)"!]/CSM_E_BUSY</POSSIBLE-ERROR-REF>
                    <POSSIBLE-ERROR-REF DEST="APPLICATION-ERROR">/AUTOSAR_Csm/PortInterfaces/CsmMacGenerate_[!"node:name(.)"!]/CSM_E_SMALL_BUFFER</POSSIBLE-ERROR-REF>
                  </POSSIBLE-ERROR-REFS>
                </CLIENT-SERVER-OPERATION>
              </OPERATIONS>
              <POSSIBLE-ERRORS>
                <APPLICATION-ERROR>
                  <SHORT-NAME>E_NOT_OK</SHORT-NAME>
                  <ERROR-CODE>1</ERROR-CODE>
                </APPLICATION-ERROR>
                <APPLICATION-ERROR>
                  <SHORT-NAME>CSM_E_BUSY</SHORT-NAME>
                  <ERROR-CODE>2</ERROR-CODE>
                </APPLICATION-ERROR>
                <APPLICATION-ERROR>
                  <SHORT-NAME>CSM_E_SMALL_BUFFER</SHORT-NAME>
                  <ERROR-CODE>3</ERROR-CODE>
                </APPLICATION-ERROR>
              </POSSIBLE-ERRORS>
            </CLIENT-SERVER-INTERFACE>
    [!ENDSELECT!][!//
    [!ENDIF!][!//
  [!ENDLOOP!][!//
  [!LOOP "node:refs(as:modconf('Csm')/CsmJobs/CsmJob/*[CsmJobUsePort = 'true']/CsmJobPrimitiveRef)/*[@name = 'CsmMacVerify']"!][!//
    [!IF "node:value(as:modconf('Csm')/CsmEbGeneral/CsmEbMisc/CsmEbCorrectionCsmAsyncJobInterfaceUseDataReferences) = 'false' or
    num:i(count(./*[CsmMacVerifyProcessing = 'CSM_SYNCHRONOUS'])) > 0"!][!//
    [!SELECT "./.."!][!//
            <!-- !LINKSTO CSM.Req.Correction.SWS_Csm_00936,1 -->
            <CLIENT-SERVER-INTERFACE>
              <SHORT-NAME>CsmMacVerify_[!"node:name(.)"!]</SHORT-NAME>
              <IS-SERVICE>true</IS-SERVICE>
              <OPERATIONS>
                <CLIENT-SERVER-OPERATION>
                  <SHORT-NAME>CancelJob</SHORT-NAME>
                  <ARGUMENTS>
                  </ARGUMENTS>
                  <POSSIBLE-ERROR-REFS>
                    <POSSIBLE-ERROR-REF DEST="APPLICATION-ERROR">/AUTOSAR_Csm/PortInterfaces/CsmMacVerify_[!"node:name(.)"!]/E_NOT_OK</POSSIBLE-ERROR-REF>
                  </POSSIBLE-ERROR-REFS>
                </CLIENT-SERVER-OPERATION>
                <CLIENT-SERVER-OPERATION>
                  <SHORT-NAME>MacVerify</SHORT-NAME>
                  <ARGUMENTS>
                    <ARGUMENT-DATA-PROTOTYPE>
                      <SHORT-NAME>dataBuffer</SHORT-NAME>
                      <TYPE-TREF DEST="IMPLEMENTATION-DATA-TYPE">/AUTOSAR_Csm/ImplementationDataTypes/Csm_MacVerifyDataType_[!"node:name(.)"!]</TYPE-TREF>
                      <DIRECTION>IN</DIRECTION>
                    </ARGUMENT-DATA-PROTOTYPE>
                    <ARGUMENT-DATA-PROTOTYPE>
                      <SHORT-NAME>dataLength</SHORT-NAME>
                      <TYPE-TREF DEST="IMPLEMENTATION-DATA-TYPE">/AUTOSAR_Platform/ImplementationDataTypes/uint32</TYPE-TREF>
                      <DIRECTION>IN</DIRECTION>
                    </ARGUMENT-DATA-PROTOTYPE>
                    <ARGUMENT-DATA-PROTOTYPE>
                      <SHORT-NAME>compareBuffer</SHORT-NAME>
                      <TYPE-TREF DEST="IMPLEMENTATION-DATA-TYPE">/AUTOSAR_Csm/ImplementationDataTypes/Csm_MacVerifyCompareType_[!"node:name(.)"!]</TYPE-TREF>
                      <DIRECTION>IN</DIRECTION>
                    </ARGUMENT-DATA-PROTOTYPE>
                    <ARGUMENT-DATA-PROTOTYPE>
                      <SHORT-NAME>compareLength</SHORT-NAME>
                      <TYPE-TREF DEST="IMPLEMENTATION-DATA-TYPE">/AUTOSAR_Platform/ImplementationDataTypes/uint32</TYPE-TREF>
                      <DIRECTION>IN</DIRECTION>
                    </ARGUMENT-DATA-PROTOTYPE>
                    <ARGUMENT-DATA-PROTOTYPE>
                      <SHORT-NAME>resultBuffer</SHORT-NAME>
                      <TYPE-TREF DEST="IMPLEMENTATION-DATA-TYPE">/AUTOSAR_Csm/ImplementationDataTypes/Crypto_VerifyResultType</TYPE-TREF>
                      <DIRECTION>OUT</DIRECTION>
                    </ARGUMENT-DATA-PROTOTYPE>
                  </ARGUMENTS>
                  <POSSIBLE-ERROR-REFS>
                    <POSSIBLE-ERROR-REF DEST="APPLICATION-ERROR">/AUTOSAR_Csm/PortInterfaces/CsmMacVerify_[!"node:name(.)"!]/E_NOT_OK</POSSIBLE-ERROR-REF>
                    <POSSIBLE-ERROR-REF DEST="APPLICATION-ERROR">/AUTOSAR_Csm/PortInterfaces/CsmMacVerify_[!"node:name(.)"!]/CSM_E_BUSY</POSSIBLE-ERROR-REF>
                    <POSSIBLE-ERROR-REF DEST="APPLICATION-ERROR">/AUTOSAR_Csm/PortInterfaces/CsmMacVerify_[!"node:name(.)"!]/CSM_E_SMALL_BUFFER</POSSIBLE-ERROR-REF>
                  </POSSIBLE-ERROR-REFS>
                </CLIENT-SERVER-OPERATION>
              </OPERATIONS>
              <POSSIBLE-ERRORS>
                <APPLICATION-ERROR>
                  <SHORT-NAME>E_NOT_OK</SHORT-NAME>
                  <ERROR-CODE>1</ERROR-CODE>
                </APPLICATION-ERROR>
                <APPLICATION-ERROR>
                  <SHORT-NAME>CSM_E_BUSY</SHORT-NAME>
                  <ERROR-CODE>2</ERROR-CODE>
                </APPLICATION-ERROR>
                <APPLICATION-ERROR>
                  <SHORT-NAME>CSM_E_SMALL_BUFFER</SHORT-NAME>
                  <ERROR-CODE>3</ERROR-CODE>
                </APPLICATION-ERROR>
              </POSSIBLE-ERRORS>
            </CLIENT-SERVER-INTERFACE>
    [!ENDSELECT!][!//
    [!ENDIF!][!//
  [!ENDLOOP!][!//
  [!LOOP "node:refs(as:modconf('Csm')/CsmJobs/CsmJob/*[CsmJobUsePort = 'true']/CsmJobPrimitiveRef)/*[@name = 'CsmRandomGenerate']"!][!//
    [!IF "node:value(as:modconf('Csm')/CsmEbGeneral/CsmEbMisc/CsmEbCorrectionCsmAsyncJobInterfaceUseDataReferences) = 'false' or
    num:i(count(./*[CsmRandomGenerateProcessing = 'CSM_SYNCHRONOUS'])) > 0"!][!//
    [!SELECT "./.."!][!//
            <!-- !LINKSTO CSM.Req.Correction.SWS_Csm_00902,1 -->
            <CLIENT-SERVER-INTERFACE>
              <SHORT-NAME>CsmRandomGenerate_[!"node:name(.)"!]</SHORT-NAME>
              <IS-SERVICE>true</IS-SERVICE>
              <OPERATIONS>
                <CLIENT-SERVER-OPERATION>
                  <SHORT-NAME>RandomGenerate</SHORT-NAME>
                  <ARGUMENTS>
                    <ARGUMENT-DATA-PROTOTYPE>
                      <SHORT-NAME>resultBuffer</SHORT-NAME>
                      <TYPE-TREF DEST="IMPLEMENTATION-DATA-TYPE">/AUTOSAR_Csm/ImplementationDataTypes/Csm_RandomGenerateResultType_[!"node:name(.)"!]</TYPE-TREF>
                      <DIRECTION>OUT</DIRECTION>
                    </ARGUMENT-DATA-PROTOTYPE>
                    <ARGUMENT-DATA-PROTOTYPE>
                      <SHORT-NAME>resultLength</SHORT-NAME>
                      <TYPE-TREF DEST="IMPLEMENTATION-DATA-TYPE">/AUTOSAR_Platform/ImplementationDataTypes/uint32</TYPE-TREF>
                      <DIRECTION>INOUT</DIRECTION>
                    </ARGUMENT-DATA-PROTOTYPE>
                  </ARGUMENTS>
                  <POSSIBLE-ERROR-REFS>
                    <POSSIBLE-ERROR-REF DEST="APPLICATION-ERROR">/AUTOSAR_Csm/PortInterfaces/CsmRandomGenerate_[!"node:name(.)"!]/E_NOT_OK</POSSIBLE-ERROR-REF>
                    <POSSIBLE-ERROR-REF DEST="APPLICATION-ERROR">/AUTOSAR_Csm/PortInterfaces/CsmRandomGenerate_[!"node:name(.)"!]/CSM_E_BUSY</POSSIBLE-ERROR-REF>
                    <POSSIBLE-ERROR-REF DEST="APPLICATION-ERROR">/AUTOSAR_Csm/PortInterfaces/CsmRandomGenerate_[!"node:name(.)"!]/CSM_E_ENTROPY_EXHAUSTION</POSSIBLE-ERROR-REF>
                  </POSSIBLE-ERROR-REFS>
                </CLIENT-SERVER-OPERATION>
              </OPERATIONS>
              <POSSIBLE-ERRORS>
                <APPLICATION-ERROR>
                  <SHORT-NAME>E_NOT_OK</SHORT-NAME>
                  <ERROR-CODE>1</ERROR-CODE>
                </APPLICATION-ERROR>
                <APPLICATION-ERROR>
                  <SHORT-NAME>CSM_E_BUSY</SHORT-NAME>
                  <ERROR-CODE>2</ERROR-CODE>
                </APPLICATION-ERROR>
                <APPLICATION-ERROR>
                  <SHORT-NAME>CSM_E_ENTROPY_EXHAUSTION</SHORT-NAME>
                  <ERROR-CODE>4</ERROR-CODE>
                </APPLICATION-ERROR>
              </POSSIBLE-ERRORS>
            </CLIENT-SERVER-INTERFACE>
    [!ENDSELECT!][!//
    [!ENDIF!][!//
  [!ENDLOOP!][!//
  [!LOOP "node:refs(as:modconf('Csm')/CsmJobs/CsmJob/*[CsmJobUsePort = 'true']/CsmJobPrimitiveRef)/*[@name = 'CsmSignatureGenerate']"!][!//
    [!IF "node:value(as:modconf('Csm')/CsmEbGeneral/CsmEbMisc/CsmEbCorrectionCsmAsyncJobInterfaceUseDataReferences) = 'false' or
    num:i(count(./*[CsmSignatureGenerateProcessing = 'CSM_SYNCHRONOUS'])) > 0"!][!//
    [!SELECT "./.."!][!//
            <!-- !LINKSTO CSM.Req.Correction.SWS_Csm_00903,1 -->
            <CLIENT-SERVER-INTERFACE>
              <SHORT-NAME>CsmSignatureGenerate_[!"node:name(.)"!]</SHORT-NAME>
              <IS-SERVICE>true</IS-SERVICE>
              <OPERATIONS>
                <CLIENT-SERVER-OPERATION>
                  <SHORT-NAME>CancelJob</SHORT-NAME>
                  <ARGUMENTS>
                  </ARGUMENTS>
                  <POSSIBLE-ERROR-REFS>
                    <POSSIBLE-ERROR-REF DEST="APPLICATION-ERROR">/AUTOSAR_Csm/PortInterfaces/CsmSignatureGenerate_[!"node:name(.)"!]/E_NOT_OK</POSSIBLE-ERROR-REF>
                  </POSSIBLE-ERROR-REFS>
                </CLIENT-SERVER-OPERATION>
                <CLIENT-SERVER-OPERATION>
                  <SHORT-NAME>SignatureGenerate</SHORT-NAME>
                  <ARGUMENTS>
                    <ARGUMENT-DATA-PROTOTYPE>
                      <SHORT-NAME>dataBuffer</SHORT-NAME>
                      <TYPE-TREF DEST="IMPLEMENTATION-DATA-TYPE">/AUTOSAR_Csm/ImplementationDataTypes/Csm_SignatureGenerateDataType_[!"node:name(.)"!]</TYPE-TREF>
                      <DIRECTION>IN</DIRECTION>
                    </ARGUMENT-DATA-PROTOTYPE>
                    <ARGUMENT-DATA-PROTOTYPE>
                      <SHORT-NAME>dataLength</SHORT-NAME>
                      <TYPE-TREF DEST="IMPLEMENTATION-DATA-TYPE">/AUTOSAR_Platform/ImplementationDataTypes/uint32</TYPE-TREF>
                      <DIRECTION>IN</DIRECTION>
                    </ARGUMENT-DATA-PROTOTYPE>
                    <ARGUMENT-DATA-PROTOTYPE>
                      <SHORT-NAME>resultBuffer</SHORT-NAME>
                      <TYPE-TREF DEST="IMPLEMENTATION-DATA-TYPE">/AUTOSAR_Csm/ImplementationDataTypes/Csm_SignatureGenerateResultType_[!"node:name(.)"!]</TYPE-TREF>
                      <DIRECTION>OUT</DIRECTION>
                    </ARGUMENT-DATA-PROTOTYPE>
                    <ARGUMENT-DATA-PROTOTYPE>
                      <SHORT-NAME>resultLength</SHORT-NAME>
                      <TYPE-TREF DEST="IMPLEMENTATION-DATA-TYPE">/AUTOSAR_Platform/ImplementationDataTypes/uint32</TYPE-TREF>
                      <DIRECTION>INOUT</DIRECTION>
                    </ARGUMENT-DATA-PROTOTYPE>
                  </ARGUMENTS>
                  <POSSIBLE-ERROR-REFS>
                    <POSSIBLE-ERROR-REF DEST="APPLICATION-ERROR">/AUTOSAR_Csm/PortInterfaces/CsmSignatureGenerate_[!"node:name(.)"!]/E_NOT_OK</POSSIBLE-ERROR-REF>
                    <POSSIBLE-ERROR-REF DEST="APPLICATION-ERROR">/AUTOSAR_Csm/PortInterfaces/CsmSignatureGenerate_[!"node:name(.)"!]/CSM_E_BUSY</POSSIBLE-ERROR-REF>
                    <POSSIBLE-ERROR-REF DEST="APPLICATION-ERROR">/AUTOSAR_Csm/PortInterfaces/CsmSignatureGenerate_[!"node:name(.)"!]/CSM_E_SMALL_BUFFER</POSSIBLE-ERROR-REF>
                  </POSSIBLE-ERROR-REFS>
                </CLIENT-SERVER-OPERATION>
              </OPERATIONS>
              <POSSIBLE-ERRORS>
                <APPLICATION-ERROR>
                  <SHORT-NAME>E_NOT_OK</SHORT-NAME>
                  <ERROR-CODE>1</ERROR-CODE>
                </APPLICATION-ERROR>
                <APPLICATION-ERROR>
                  <SHORT-NAME>CSM_E_BUSY</SHORT-NAME>
                  <ERROR-CODE>2</ERROR-CODE>
                </APPLICATION-ERROR>
                <APPLICATION-ERROR>
                  <SHORT-NAME>CSM_E_SMALL_BUFFER</SHORT-NAME>
                  <ERROR-CODE>3</ERROR-CODE>
                </APPLICATION-ERROR>
              </POSSIBLE-ERRORS>
            </CLIENT-SERVER-INTERFACE>
    [!ENDSELECT!][!//
    [!ENDIF!][!//
  [!ENDLOOP!][!//
  [!LOOP "node:refs(as:modconf('Csm')/CsmJobs/CsmJob/*[CsmJobUsePort = 'true']/CsmJobPrimitiveRef)/*[@name = 'CsmSignatureVerify']"!][!//
    [!IF "node:value(as:modconf('Csm')/CsmEbGeneral/CsmEbMisc/CsmEbCorrectionCsmAsyncJobInterfaceUseDataReferences) = 'false' or
    num:i(count(./*[CsmSignatureVerifyProcessing = 'CSM_SYNCHRONOUS'])) > 0"!][!//
    [!SELECT "./.."!][!//
            <!-- !LINKSTO CSM.Req.Correction.SWS_Csm_00943,1 -->
            <CLIENT-SERVER-INTERFACE>
              <SHORT-NAME>CsmSignatureVerify_[!"node:name(.)"!]</SHORT-NAME>
              <IS-SERVICE>true</IS-SERVICE>
              <OPERATIONS>
                <CLIENT-SERVER-OPERATION>
                  <SHORT-NAME>CancelJob</SHORT-NAME>
                  <ARGUMENTS>
                  </ARGUMENTS>
                  <POSSIBLE-ERROR-REFS>
                    <POSSIBLE-ERROR-REF DEST="APPLICATION-ERROR">/AUTOSAR_Csm/PortInterfaces/CsmSignatureVerify_[!"node:name(.)"!]/E_NOT_OK</POSSIBLE-ERROR-REF>
                  </POSSIBLE-ERROR-REFS>
                </CLIENT-SERVER-OPERATION>
                <CLIENT-SERVER-OPERATION>
                  <SHORT-NAME>SignatureVerify</SHORT-NAME>
                  <ARGUMENTS>
                    <ARGUMENT-DATA-PROTOTYPE>
                      <SHORT-NAME>dataBuffer</SHORT-NAME>
                      <TYPE-TREF DEST="IMPLEMENTATION-DATA-TYPE">/AUTOSAR_Csm/ImplementationDataTypes/Csm_SignatureVerifyDataType_[!"node:name(.)"!]</TYPE-TREF>
                      <DIRECTION>IN</DIRECTION>
                    </ARGUMENT-DATA-PROTOTYPE>
                    <ARGUMENT-DATA-PROTOTYPE>
                      <SHORT-NAME>dataLength</SHORT-NAME>
                      <TYPE-TREF DEST="IMPLEMENTATION-DATA-TYPE">/AUTOSAR_Platform/ImplementationDataTypes/uint32</TYPE-TREF>
                      <DIRECTION>IN</DIRECTION>
                    </ARGUMENT-DATA-PROTOTYPE>
                    <ARGUMENT-DATA-PROTOTYPE>
                      <SHORT-NAME>compareBuffer</SHORT-NAME>
                      <TYPE-TREF DEST="IMPLEMENTATION-DATA-TYPE">/AUTOSAR_Csm/ImplementationDataTypes/Csm_SignatureVerifyCompareType_[!"node:name(.)"!]</TYPE-TREF>
                      <DIRECTION>IN</DIRECTION>
                    </ARGUMENT-DATA-PROTOTYPE>
                    <ARGUMENT-DATA-PROTOTYPE>
                      <SHORT-NAME>compareLength</SHORT-NAME>
                      <TYPE-TREF DEST="IMPLEMENTATION-DATA-TYPE">/AUTOSAR_Platform/ImplementationDataTypes/uint32</TYPE-TREF>
                      <DIRECTION>IN</DIRECTION>
                    </ARGUMENT-DATA-PROTOTYPE>
                    <ARGUMENT-DATA-PROTOTYPE>
                      <SHORT-NAME>resultBuffer</SHORT-NAME>
                      <TYPE-TREF DEST="IMPLEMENTATION-DATA-TYPE">/AUTOSAR_Csm/ImplementationDataTypes/Crypto_VerifyResultType</TYPE-TREF>
                      <DIRECTION>OUT</DIRECTION>
                    </ARGUMENT-DATA-PROTOTYPE>
                  </ARGUMENTS>
                  <POSSIBLE-ERROR-REFS>
                    <POSSIBLE-ERROR-REF DEST="APPLICATION-ERROR">/AUTOSAR_Csm/PortInterfaces/CsmSignatureVerify_[!"node:name(.)"!]/E_NOT_OK</POSSIBLE-ERROR-REF>
                    <POSSIBLE-ERROR-REF DEST="APPLICATION-ERROR">/AUTOSAR_Csm/PortInterfaces/CsmSignatureVerify_[!"node:name(.)"!]/CSM_E_BUSY</POSSIBLE-ERROR-REF>
                  </POSSIBLE-ERROR-REFS>
                </CLIENT-SERVER-OPERATION>
              </OPERATIONS>
              <POSSIBLE-ERRORS>
                <APPLICATION-ERROR>
                  <SHORT-NAME>E_NOT_OK</SHORT-NAME>
                  <ERROR-CODE>1</ERROR-CODE>
                </APPLICATION-ERROR>
                <APPLICATION-ERROR>
                  <SHORT-NAME>CSM_E_BUSY</SHORT-NAME>
                  <ERROR-CODE>2</ERROR-CODE>
                </APPLICATION-ERROR>
                <APPLICATION-ERROR>
                  <SHORT-NAME>CSM_E_SMALL_BUFFER</SHORT-NAME>
                  <ERROR-CODE>3</ERROR-CODE>
                </APPLICATION-ERROR>
              </POSSIBLE-ERRORS>
            </CLIENT-SERVER-INTERFACE>
    [!ENDSELECT!][!//
    [!ENDIF!][!//
  [!ENDLOOP!][!//


[!IF "node:value(as:modconf('Csm')/CsmEbGeneral/CsmEbMisc/CsmEbCorrectionCsmAsyncJobInterfaceUseDataReferences) = 'true' and
 num:i(count(node:refs(as:modconf('Csm')/CsmJobs/CsmJob/*[CsmJobUsePort = 'true']/CsmJobPrimitiveRef)/*[@name = 'CsmAEADDecrypt']/*[CsmAEADDecryptProcessing = 'CSM_ASYNCHRONOUS'])) > 0"!][!//
            <!-- !LINKSTO SWS_Csm_91056,1 -->
            <CLIENT-SERVER-INTERFACE>
              <SHORT-NAME>CsmAEADDecrypt</SHORT-NAME>
              <IS-SERVICE>true</IS-SERVICE>
              <OPERATIONS>
                <CLIENT-SERVER-OPERATION>
                  <SHORT-NAME>CancelJob</SHORT-NAME>
                  <ARGUMENTS>
                  </ARGUMENTS>
                  <POSSIBLE-ERROR-REFS>
                    <POSSIBLE-ERROR-REF DEST="APPLICATION-ERROR">/AUTOSAR_Csm/PortInterfaces/CsmAEADDecrypt/E_NOT_OK</POSSIBLE-ERROR-REF>
                    <POSSIBLE-ERROR-REF DEST="APPLICATION-ERROR">/AUTOSAR_Csm/PortInterfaces/CsmAEADDecrypt/CRYPTO_E_JOB_CANCELED</POSSIBLE-ERROR-REF>
                  </POSSIBLE-ERROR-REFS>
                </CLIENT-SERVER-OPERATION>
                <CLIENT-SERVER-OPERATION>
                  <SHORT-NAME>AEADDecrypt</SHORT-NAME>
                  <ARGUMENTS>
                    <ARGUMENT-DATA-PROTOTYPE>
                      <SHORT-NAME>ciphertextPtr</SHORT-NAME>
                      <TYPE-TREF DEST="IMPLEMENTATION-DATA-TYPE">/AUTOSAR_Platform/ImplementationDataTypes/ConstVoidPtr</TYPE-TREF>
                      <DIRECTION>IN</DIRECTION>
                    </ARGUMENT-DATA-PROTOTYPE>
                    <ARGUMENT-DATA-PROTOTYPE>
                      <SHORT-NAME>ciphertextLength</SHORT-NAME>
                      <TYPE-TREF DEST="IMPLEMENTATION-DATA-TYPE">/AUTOSAR_Platform/ImplementationDataTypes/uint32</TYPE-TREF>
                      <DIRECTION>IN</DIRECTION>
                    </ARGUMENT-DATA-PROTOTYPE>
                    <ARGUMENT-DATA-PROTOTYPE>
                      <SHORT-NAME>associatedDataPtr</SHORT-NAME>
                      <TYPE-TREF DEST="IMPLEMENTATION-DATA-TYPE">/AUTOSAR_Platform/ImplementationDataTypes/ConstVoidPtr</TYPE-TREF>
                      <DIRECTION>IN</DIRECTION>
                    </ARGUMENT-DATA-PROTOTYPE>
                    <ARGUMENT-DATA-PROTOTYPE>
                      <SHORT-NAME>associatedDataLength</SHORT-NAME>
                      <TYPE-TREF DEST="IMPLEMENTATION-DATA-TYPE">/AUTOSAR_Platform/ImplementationDataTypes/uint32</TYPE-TREF>
                      <DIRECTION>IN</DIRECTION>
                    </ARGUMENT-DATA-PROTOTYPE>
                    <ARGUMENT-DATA-PROTOTYPE>
                      <SHORT-NAME>tagPtr</SHORT-NAME>
                      <TYPE-TREF DEST="IMPLEMENTATION-DATA-TYPE">/AUTOSAR_Platform/ImplementationDataTypes/ConstVoidPtr</TYPE-TREF>
                      <DIRECTION>IN</DIRECTION>
                    </ARGUMENT-DATA-PROTOTYPE>
                    <ARGUMENT-DATA-PROTOTYPE>
                      <SHORT-NAME>tagLength</SHORT-NAME>
                      <TYPE-TREF DEST="IMPLEMENTATION-DATA-TYPE">/AUTOSAR_Platform/ImplementationDataTypes/uint32</TYPE-TREF>
                      <DIRECTION>IN</DIRECTION>
                    </ARGUMENT-DATA-PROTOTYPE>
                    <ARGUMENT-DATA-PROTOTYPE>
                      <SHORT-NAME>plaintextPtr</SHORT-NAME>
                      <TYPE-TREF DEST="IMPLEMENTATION-DATA-TYPE">/AUTOSAR_Platform/ImplementationDataTypes/VoidPtr</TYPE-TREF>
                      <DIRECTION>IN</DIRECTION>
                    </ARGUMENT-DATA-PROTOTYPE>
                    <ARGUMENT-DATA-PROTOTYPE>
                      <SHORT-NAME>plaintextLength</SHORT-NAME>
                      <TYPE-TREF DEST="IMPLEMENTATION-DATA-TYPE">/AUTOSAR_Csm/ImplementationDataTypes/Csm_LengthPtr</TYPE-TREF>
                      <DIRECTION>IN</DIRECTION>
                    </ARGUMENT-DATA-PROTOTYPE>
                    <ARGUMENT-DATA-PROTOTYPE>
                      <SHORT-NAME>verifyPtr</SHORT-NAME>
                      <TYPE-TREF DEST="IMPLEMENTATION-DATA-TYPE">/AUTOSAR_Csm/ImplementationDataTypes/Csm_VerifyResultPtr</TYPE-TREF>
                      <DIRECTION>IN</DIRECTION>
                    </ARGUMENT-DATA-PROTOTYPE>
                  </ARGUMENTS>
                  <POSSIBLE-ERROR-REFS>
                    <POSSIBLE-ERROR-REF DEST="APPLICATION-ERROR">/AUTOSAR_Csm/PortInterfaces/CsmAEADDecrypt/E_NOT_OK</POSSIBLE-ERROR-REF>
                    <POSSIBLE-ERROR-REF DEST="APPLICATION-ERROR">/AUTOSAR_Csm/PortInterfaces/CsmAEADDecrypt/CRYPTO_E_BUSY</POSSIBLE-ERROR-REF>
                    <POSSIBLE-ERROR-REF DEST="APPLICATION-ERROR">/AUTOSAR_Csm/PortInterfaces/CsmAEADDecrypt/CRYPTO_E_KEY_NOT_VALID</POSSIBLE-ERROR-REF>
                    <POSSIBLE-ERROR-REF DEST="APPLICATION-ERROR">/AUTOSAR_Csm/PortInterfaces/CsmAEADDecrypt/CRYPTO_E_KEY_SIZE_MISMATCH</POSSIBLE-ERROR-REF>
                    <POSSIBLE-ERROR-REF DEST="APPLICATION-ERROR">/AUTOSAR_Csm/PortInterfaces/CsmAEADDecrypt/CRYPTO_E_KEY_EMPTY</POSSIBLE-ERROR-REF>
                  </POSSIBLE-ERROR-REFS>
                </CLIENT-SERVER-OPERATION>
              </OPERATIONS>
              <POSSIBLE-ERRORS>
                <APPLICATION-ERROR>
                  <SHORT-NAME>E_NOT_OK</SHORT-NAME>
                  <ERROR-CODE>1</ERROR-CODE>
                </APPLICATION-ERROR>
                <APPLICATION-ERROR>
                  <SHORT-NAME>CRYPTO_E_BUSY</SHORT-NAME>
                  <ERROR-CODE>2</ERROR-CODE>
                </APPLICATION-ERROR>
                <APPLICATION-ERROR>
                  <SHORT-NAME>CRYPTO_E_KEY_NOT_VALID</SHORT-NAME>
                  <ERROR-CODE>9</ERROR-CODE>
                </APPLICATION-ERROR>
                <APPLICATION-ERROR>
                  <SHORT-NAME>CRYPTO_E_KEY_SIZE_MISMATCH</SHORT-NAME>
                  <ERROR-CODE>10</ERROR-CODE>
                </APPLICATION-ERROR>
                <APPLICATION-ERROR>
                  <SHORT-NAME>CRYPTO_E_JOB_CANCELED</SHORT-NAME>
                  <ERROR-CODE>12</ERROR-CODE>
                </APPLICATION-ERROR>
                <APPLICATION-ERROR>
                  <SHORT-NAME>CRYPTO_E_KEY_EMPTY</SHORT-NAME>
                  <ERROR-CODE>13</ERROR-CODE>
                </APPLICATION-ERROR>
              </POSSIBLE-ERRORS>
            </CLIENT-SERVER-INTERFACE>
  [!ENDIF!][!//
[!IF "node:value(as:modconf('Csm')/CsmEbGeneral/CsmEbMisc/CsmEbCorrectionCsmAsyncJobInterfaceUseDataReferences) = 'true' and
 num:i(count(node:refs(as:modconf('Csm')/CsmJobs/CsmJob/*[CsmJobUsePort = 'true']/CsmJobPrimitiveRef)/*[@name = 'CsmAEADEncrypt']/*[CsmAEADEncryptProcessing = 'CSM_ASYNCHRONOUS'])) > 0"!][!//
            <!-- !LINKSTO SWS_Csm_91057,1 -->
            <CLIENT-SERVER-INTERFACE>
              <SHORT-NAME>CsmAEADEncrypt</SHORT-NAME>
              <IS-SERVICE>true</IS-SERVICE>
              <OPERATIONS>
                <CLIENT-SERVER-OPERATION>
                  <SHORT-NAME>CancelJob</SHORT-NAME>
                  <ARGUMENTS>
                  </ARGUMENTS>
                  <POSSIBLE-ERROR-REFS>
                    <POSSIBLE-ERROR-REF DEST="APPLICATION-ERROR">/AUTOSAR_Csm/PortInterfaces/CsmAEADEncrypt/E_NOT_OK</POSSIBLE-ERROR-REF>
                    <POSSIBLE-ERROR-REF DEST="APPLICATION-ERROR">/AUTOSAR_Csm/PortInterfaces/CsmAEADEncrypt/CRYPTO_E_JOB_CANCELED</POSSIBLE-ERROR-REF>
                  </POSSIBLE-ERROR-REFS>
                </CLIENT-SERVER-OPERATION>
                <CLIENT-SERVER-OPERATION>
                  <SHORT-NAME>AEADEncrypt</SHORT-NAME>
                  <ARGUMENTS>
                    <ARGUMENT-DATA-PROTOTYPE>
                      <SHORT-NAME>plaintextPtr</SHORT-NAME>
                      <TYPE-TREF DEST="IMPLEMENTATION-DATA-TYPE">/AUTOSAR_Platform/ImplementationDataTypes/ConstVoidPtr</TYPE-TREF>
                      <DIRECTION>IN</DIRECTION>
                    </ARGUMENT-DATA-PROTOTYPE>
                    <ARGUMENT-DATA-PROTOTYPE>
                      <SHORT-NAME>plaintextLength</SHORT-NAME>
                      <TYPE-TREF DEST="IMPLEMENTATION-DATA-TYPE">/AUTOSAR_Platform/ImplementationDataTypes/uint32</TYPE-TREF>
                      <DIRECTION>IN</DIRECTION>
                    </ARGUMENT-DATA-PROTOTYPE>
                    <ARGUMENT-DATA-PROTOTYPE>
                      <SHORT-NAME>associatedDataPtr</SHORT-NAME>
                      <TYPE-TREF DEST="IMPLEMENTATION-DATA-TYPE">/AUTOSAR_Platform/ImplementationDataTypes/ConstVoidPtr</TYPE-TREF>
                      <DIRECTION>IN</DIRECTION>
                    </ARGUMENT-DATA-PROTOTYPE>
                    <ARGUMENT-DATA-PROTOTYPE>
                      <SHORT-NAME>associatedDataLength</SHORT-NAME>
                      <TYPE-TREF DEST="IMPLEMENTATION-DATA-TYPE">/AUTOSAR_Platform/ImplementationDataTypes/uint32</TYPE-TREF>
                      <DIRECTION>IN</DIRECTION>
                    </ARGUMENT-DATA-PROTOTYPE>
                    <ARGUMENT-DATA-PROTOTYPE>
                      <SHORT-NAME>ciphertextPtr</SHORT-NAME>
                      <TYPE-TREF DEST="IMPLEMENTATION-DATA-TYPE">/AUTOSAR_Platform/ImplementationDataTypes/VoidPtr</TYPE-TREF>
                      <DIRECTION>IN</DIRECTION>
                    </ARGUMENT-DATA-PROTOTYPE>
                    <ARGUMENT-DATA-PROTOTYPE>
                      <SHORT-NAME>ciphertextLengthPtr</SHORT-NAME>
                      <TYPE-TREF DEST="IMPLEMENTATION-DATA-TYPE">/AUTOSAR_Csm/ImplementationDataTypes/Csm_LengthPtr</TYPE-TREF>
                      <DIRECTION>IN</DIRECTION>
                    </ARGUMENT-DATA-PROTOTYPE>
                    <ARGUMENT-DATA-PROTOTYPE>
                      <SHORT-NAME>tagPtr</SHORT-NAME>
                      <TYPE-TREF DEST="IMPLEMENTATION-DATA-TYPE">/AUTOSAR_Platform/ImplementationDataTypes/VoidPtr</TYPE-TREF>
                      <DIRECTION>IN</DIRECTION>
                    </ARGUMENT-DATA-PROTOTYPE>
                    <ARGUMENT-DATA-PROTOTYPE>
                      <SHORT-NAME>tagLengthPtr</SHORT-NAME>
                      <TYPE-TREF DEST="IMPLEMENTATION-DATA-TYPE">/AUTOSAR_Csm/ImplementationDataTypes/Csm_LengthPtr</TYPE-TREF>
                      <DIRECTION>IN</DIRECTION>
                    </ARGUMENT-DATA-PROTOTYPE>
                  </ARGUMENTS>
                  <POSSIBLE-ERROR-REFS>
                    <POSSIBLE-ERROR-REF DEST="APPLICATION-ERROR">/AUTOSAR_Csm/PortInterfaces/CsmAEADEncrypt/E_NOT_OK</POSSIBLE-ERROR-REF>
                    <POSSIBLE-ERROR-REF DEST="APPLICATION-ERROR">/AUTOSAR_Csm/PortInterfaces/CsmAEADEncrypt/CRYPTO_E_BUSY</POSSIBLE-ERROR-REF>
                    <POSSIBLE-ERROR-REF DEST="APPLICATION-ERROR">/AUTOSAR_Csm/PortInterfaces/CsmAEADEncrypt/CRYPTO_E_KEY_NOT_VALID</POSSIBLE-ERROR-REF>
                    <POSSIBLE-ERROR-REF DEST="APPLICATION-ERROR">/AUTOSAR_Csm/PortInterfaces/CsmAEADEncrypt/CRYPTO_E_KEY_SIZE_MISMATCH</POSSIBLE-ERROR-REF>
                    <POSSIBLE-ERROR-REF DEST="APPLICATION-ERROR">/AUTOSAR_Csm/PortInterfaces/CsmAEADEncrypt/CRYPTO_E_KEY_EMPTY</POSSIBLE-ERROR-REF>
                  </POSSIBLE-ERROR-REFS>
                </CLIENT-SERVER-OPERATION>
              </OPERATIONS>
              <POSSIBLE-ERRORS>
                <APPLICATION-ERROR>
                  <SHORT-NAME>E_NOT_OK</SHORT-NAME>
                  <ERROR-CODE>1</ERROR-CODE>
                </APPLICATION-ERROR>
                <APPLICATION-ERROR>
                  <SHORT-NAME>CRYPTO_E_BUSY</SHORT-NAME>
                  <ERROR-CODE>2</ERROR-CODE>
                </APPLICATION-ERROR>
                <APPLICATION-ERROR>
                  <SHORT-NAME>CRYPTO_E_KEY_NOT_VALID</SHORT-NAME>
                  <ERROR-CODE>9</ERROR-CODE>
                </APPLICATION-ERROR>
                <APPLICATION-ERROR>
                  <SHORT-NAME>CRYPTO_E_KEY_SIZE_MISMATCH</SHORT-NAME>
                  <ERROR-CODE>10</ERROR-CODE>
                </APPLICATION-ERROR>
                <APPLICATION-ERROR>
                  <SHORT-NAME>CRYPTO_E_JOB_CANCELED</SHORT-NAME>
                  <ERROR-CODE>12</ERROR-CODE>
                </APPLICATION-ERROR>
                <APPLICATION-ERROR>
                  <SHORT-NAME>CRYPTO_E_KEY_EMPTY</SHORT-NAME>
                  <ERROR-CODE>13</ERROR-CODE>
                </APPLICATION-ERROR>
              </POSSIBLE-ERRORS>
            </CLIENT-SERVER-INTERFACE>
  [!ENDIF!][!//
[!IF "node:value(as:modconf('Csm')/CsmEbGeneral/CsmEbMisc/CsmEbCorrectionCsmAsyncJobInterfaceUseDataReferences) = 'true' and
 num:i(count(node:refs(as:modconf('Csm')/CsmJobs/CsmJob/*[CsmJobUsePort = 'true']/CsmJobPrimitiveRef)/*[@name = 'CsmDecrypt']/*[CsmDecryptProcessing = 'CSM_ASYNCHRONOUS'])) > 0"!][!//
            <!-- !LINKSTO SWS_Csm_91055,1 -->
            <CLIENT-SERVER-INTERFACE>
              <SHORT-NAME>CsmDecrypt</SHORT-NAME>
              <IS-SERVICE>true</IS-SERVICE>
              <OPERATIONS>
                <CLIENT-SERVER-OPERATION>
                  <SHORT-NAME>CancelJob</SHORT-NAME>
                  <ARGUMENTS>
                  </ARGUMENTS>
                  <POSSIBLE-ERROR-REFS>
                    <POSSIBLE-ERROR-REF DEST="APPLICATION-ERROR">/AUTOSAR_Csm/PortInterfaces/CsmDecrypt/E_NOT_OK</POSSIBLE-ERROR-REF>
                    <POSSIBLE-ERROR-REF DEST="APPLICATION-ERROR">/AUTOSAR_Csm/PortInterfaces/CsmDecrypt/CRYPTO_E_JOB_CANCELED</POSSIBLE-ERROR-REF>
                  </POSSIBLE-ERROR-REFS>
                </CLIENT-SERVER-OPERATION>
                <CLIENT-SERVER-OPERATION>
                  <SHORT-NAME>Decrypt</SHORT-NAME>
                  <ARGUMENTS>
                    <ARGUMENT-DATA-PROTOTYPE>
                      <SHORT-NAME>dataPtr</SHORT-NAME>
                      <TYPE-TREF DEST="IMPLEMENTATION-DATA-TYPE">/AUTOSAR_Platform/ImplementationDataTypes/ConstVoidPtr</TYPE-TREF>
                      <DIRECTION>IN</DIRECTION>
                    </ARGUMENT-DATA-PROTOTYPE>
                    <ARGUMENT-DATA-PROTOTYPE>
                      <SHORT-NAME>dataLength</SHORT-NAME>
                      <TYPE-TREF DEST="IMPLEMENTATION-DATA-TYPE">/AUTOSAR_Platform/ImplementationDataTypes/uint32</TYPE-TREF>
                      <DIRECTION>IN</DIRECTION>
                    </ARGUMENT-DATA-PROTOTYPE>
                    <ARGUMENT-DATA-PROTOTYPE>
                      <SHORT-NAME>resultPtr</SHORT-NAME>
                      <TYPE-TREF DEST="IMPLEMENTATION-DATA-TYPE">/AUTOSAR_Platform/ImplementationDataTypes/VoidPtr</TYPE-TREF>
                      <DIRECTION>IN</DIRECTION>
                    </ARGUMENT-DATA-PROTOTYPE>
                    <ARGUMENT-DATA-PROTOTYPE>
                      <SHORT-NAME>resultLengthPtr</SHORT-NAME>
                      <TYPE-TREF DEST="IMPLEMENTATION-DATA-TYPE">/AUTOSAR_Csm/ImplementationDataTypes/Csm_LengthPtr</TYPE-TREF>
                      <DIRECTION>IN</DIRECTION>
                    </ARGUMENT-DATA-PROTOTYPE>
                  </ARGUMENTS>
                  <POSSIBLE-ERROR-REFS>
                    <POSSIBLE-ERROR-REF DEST="APPLICATION-ERROR">/AUTOSAR_Csm/PortInterfaces/CsmDecrypt/E_NOT_OK</POSSIBLE-ERROR-REF>
                    <POSSIBLE-ERROR-REF DEST="APPLICATION-ERROR">/AUTOSAR_Csm/PortInterfaces/CsmDecrypt/CRYPTO_E_BUSY</POSSIBLE-ERROR-REF>
                    <POSSIBLE-ERROR-REF DEST="APPLICATION-ERROR">/AUTOSAR_Csm/PortInterfaces/CsmDecrypt/CRYPTO_E_KEY_NOT_VALID</POSSIBLE-ERROR-REF>
                    <POSSIBLE-ERROR-REF DEST="APPLICATION-ERROR">/AUTOSAR_Csm/PortInterfaces/CsmDecrypt/CRYPTO_E_KEY_SIZE_MISMATCH</POSSIBLE-ERROR-REF>
                    <POSSIBLE-ERROR-REF DEST="APPLICATION-ERROR">/AUTOSAR_Csm/PortInterfaces/CsmDecrypt/CRYPTO_E_KEY_EMPTY</POSSIBLE-ERROR-REF>
                  </POSSIBLE-ERROR-REFS>
                </CLIENT-SERVER-OPERATION>
              </OPERATIONS>
              <POSSIBLE-ERRORS>
                <APPLICATION-ERROR>
                  <SHORT-NAME>E_NOT_OK</SHORT-NAME>
                  <ERROR-CODE>1</ERROR-CODE>
                </APPLICATION-ERROR>
                <APPLICATION-ERROR>
                  <SHORT-NAME>CRYPTO_E_BUSY</SHORT-NAME>
                  <ERROR-CODE>2</ERROR-CODE>
                </APPLICATION-ERROR>
                <APPLICATION-ERROR>
                  <SHORT-NAME>CRYPTO_E_KEY_NOT_VALID</SHORT-NAME>
                  <ERROR-CODE>9</ERROR-CODE>
                </APPLICATION-ERROR>
                <APPLICATION-ERROR>
                  <SHORT-NAME>CRYPTO_E_KEY_SIZE_MISMATCH</SHORT-NAME>
                  <ERROR-CODE>10</ERROR-CODE>
                </APPLICATION-ERROR>
                <APPLICATION-ERROR>
                  <SHORT-NAME>CRYPTO_E_JOB_CANCELED</SHORT-NAME>
                  <ERROR-CODE>12</ERROR-CODE>
                </APPLICATION-ERROR>
                <APPLICATION-ERROR>
                  <SHORT-NAME>CRYPTO_E_KEY_EMPTY</SHORT-NAME>
                  <ERROR-CODE>13</ERROR-CODE>
                </APPLICATION-ERROR>
              </POSSIBLE-ERRORS>
            </CLIENT-SERVER-INTERFACE>
  [!ENDIF!][!//
[!IF "node:value(as:modconf('Csm')/CsmEbGeneral/CsmEbMisc/CsmEbCorrectionCsmAsyncJobInterfaceUseDataReferences) = 'true' and
 num:i(count(node:refs(as:modconf('Csm')/CsmJobs/CsmJob/*[CsmJobUsePort = 'true']/CsmJobPrimitiveRef)/*[@name = 'CsmEncrypt']/*[CsmEncryptProcessing = 'CSM_ASYNCHRONOUS'])) > 0"!][!//
            <!-- !LINKSTO SWS_Csm_91054,1 -->
            <CLIENT-SERVER-INTERFACE>
              <SHORT-NAME>CsmEncrypt</SHORT-NAME>
              <IS-SERVICE>true</IS-SERVICE>
              <OPERATIONS>
                <CLIENT-SERVER-OPERATION>
                  <SHORT-NAME>CancelJob</SHORT-NAME>
                  <ARGUMENTS>
                  </ARGUMENTS>
                  <POSSIBLE-ERROR-REFS>
                    <POSSIBLE-ERROR-REF DEST="APPLICATION-ERROR">/AUTOSAR_Csm/PortInterfaces/CsmEncrypt/E_NOT_OK</POSSIBLE-ERROR-REF>
                    <POSSIBLE-ERROR-REF DEST="APPLICATION-ERROR">/AUTOSAR_Csm/PortInterfaces/CsmEncrypt/CRYPTO_E_JOB_CANCELED</POSSIBLE-ERROR-REF>
                  </POSSIBLE-ERROR-REFS>
                </CLIENT-SERVER-OPERATION>
                <CLIENT-SERVER-OPERATION>
                  <SHORT-NAME>Encrypt</SHORT-NAME>
                  <ARGUMENTS>
                    <ARGUMENT-DATA-PROTOTYPE>
                      <SHORT-NAME>dataPtr</SHORT-NAME>
                      <TYPE-TREF DEST="IMPLEMENTATION-DATA-TYPE">/AUTOSAR_Platform/ImplementationDataTypes/ConstVoidPtr</TYPE-TREF>
                      <DIRECTION>IN</DIRECTION>
                    </ARGUMENT-DATA-PROTOTYPE>
                    <ARGUMENT-DATA-PROTOTYPE>
                      <SHORT-NAME>dataLength</SHORT-NAME>
                      <TYPE-TREF DEST="IMPLEMENTATION-DATA-TYPE">/AUTOSAR_Platform/ImplementationDataTypes/uint32</TYPE-TREF>
                      <DIRECTION>IN</DIRECTION>
                    </ARGUMENT-DATA-PROTOTYPE>
                    <ARGUMENT-DATA-PROTOTYPE>
                      <SHORT-NAME>resultPtr</SHORT-NAME>
                      <TYPE-TREF DEST="IMPLEMENTATION-DATA-TYPE">/AUTOSAR_Platform/ImplementationDataTypes/VoidPtr</TYPE-TREF>
                      <DIRECTION>IN</DIRECTION>
                    </ARGUMENT-DATA-PROTOTYPE>
                    <ARGUMENT-DATA-PROTOTYPE>
                      <SHORT-NAME>resultLengthPtr</SHORT-NAME>
                      <TYPE-TREF DEST="IMPLEMENTATION-DATA-TYPE">/AUTOSAR_Csm/ImplementationDataTypes/Csm_LengthPtr</TYPE-TREF>
                      <DIRECTION>IN</DIRECTION>
                    </ARGUMENT-DATA-PROTOTYPE>
                  </ARGUMENTS>
                  <POSSIBLE-ERROR-REFS>
                    <POSSIBLE-ERROR-REF DEST="APPLICATION-ERROR">/AUTOSAR_Csm/PortInterfaces/CsmEncrypt/E_NOT_OK</POSSIBLE-ERROR-REF>
                    <POSSIBLE-ERROR-REF DEST="APPLICATION-ERROR">/AUTOSAR_Csm/PortInterfaces/CsmEncrypt/CRYPTO_E_BUSY</POSSIBLE-ERROR-REF>
                    <POSSIBLE-ERROR-REF DEST="APPLICATION-ERROR">/AUTOSAR_Csm/PortInterfaces/CsmEncrypt/CRYPTO_E_KEY_NOT_VALID</POSSIBLE-ERROR-REF>
                    <POSSIBLE-ERROR-REF DEST="APPLICATION-ERROR">/AUTOSAR_Csm/PortInterfaces/CsmEncrypt/CRYPTO_E_KEY_SIZE_MISMATCH</POSSIBLE-ERROR-REF>
                    <POSSIBLE-ERROR-REF DEST="APPLICATION-ERROR">/AUTOSAR_Csm/PortInterfaces/CsmEncrypt/CRYPTO_E_KEY_EMPTY</POSSIBLE-ERROR-REF>
                  </POSSIBLE-ERROR-REFS>
                </CLIENT-SERVER-OPERATION>
              </OPERATIONS>
              <POSSIBLE-ERRORS>
                <APPLICATION-ERROR>
                  <SHORT-NAME>E_NOT_OK</SHORT-NAME>
                  <ERROR-CODE>1</ERROR-CODE>
                </APPLICATION-ERROR>
                <APPLICATION-ERROR>
                  <SHORT-NAME>CRYPTO_E_BUSY</SHORT-NAME>
                  <ERROR-CODE>2</ERROR-CODE>
                </APPLICATION-ERROR>
                <APPLICATION-ERROR>
                  <SHORT-NAME>CRYPTO_E_KEY_NOT_VALID</SHORT-NAME>
                  <ERROR-CODE>9</ERROR-CODE>
                </APPLICATION-ERROR>
                <APPLICATION-ERROR>
                  <SHORT-NAME>CRYPTO_E_KEY_SIZE_MISMATCH</SHORT-NAME>
                  <ERROR-CODE>10</ERROR-CODE>
                </APPLICATION-ERROR>
                <APPLICATION-ERROR>
                  <SHORT-NAME>CRYPTO_E_JOB_CANCELED</SHORT-NAME>
                  <ERROR-CODE>12</ERROR-CODE>
                </APPLICATION-ERROR>
                <APPLICATION-ERROR>
                  <SHORT-NAME>CRYPTO_E_KEY_EMPTY</SHORT-NAME>
                  <ERROR-CODE>13</ERROR-CODE>
                </APPLICATION-ERROR>
              </POSSIBLE-ERRORS>
            </CLIENT-SERVER-INTERFACE>
  [!ENDIF!][!//
[!IF "node:value(as:modconf('Csm')/CsmEbGeneral/CsmEbMisc/CsmEbCorrectionCsmAsyncJobInterfaceUseDataReferences) = 'true' and
 num:i(count(node:refs(as:modconf('Csm')/CsmJobs/CsmJob/*[CsmJobUsePort = 'true']/CsmJobPrimitiveRef)/*[@name = 'CsmHash']/*[CsmHashProcessing = 'CSM_ASYNCHRONOUS'])) > 0"!][!//
            <!-- !LINKSTO SWS_Csm_91051,1 -->
            <CLIENT-SERVER-INTERFACE>
              <SHORT-NAME>CsmHash</SHORT-NAME>
              <IS-SERVICE>true</IS-SERVICE>
              <OPERATIONS>
                <CLIENT-SERVER-OPERATION>
                  <SHORT-NAME>CancelJob</SHORT-NAME>
                  <ARGUMENTS>
                  </ARGUMENTS>
                  <POSSIBLE-ERROR-REFS>
                    <POSSIBLE-ERROR-REF DEST="APPLICATION-ERROR">/AUTOSAR_Csm/PortInterfaces/CsmHash/E_NOT_OK</POSSIBLE-ERROR-REF>
                    <POSSIBLE-ERROR-REF DEST="APPLICATION-ERROR">/AUTOSAR_Csm/PortInterfaces/CsmHash/CRYPTO_E_JOB_CANCELED</POSSIBLE-ERROR-REF>
                  </POSSIBLE-ERROR-REFS>
                </CLIENT-SERVER-OPERATION>
                <CLIENT-SERVER-OPERATION>
                  <SHORT-NAME>Hash</SHORT-NAME>
                  <ARGUMENTS>
                    <ARGUMENT-DATA-PROTOTYPE>
                      <SHORT-NAME>dataPtr</SHORT-NAME>
                      <TYPE-TREF DEST="IMPLEMENTATION-DATA-TYPE">/AUTOSAR_Platform/ImplementationDataTypes/ConstVoidPtr</TYPE-TREF>
                      <DIRECTION>IN</DIRECTION>
                    </ARGUMENT-DATA-PROTOTYPE>
                    <ARGUMENT-DATA-PROTOTYPE>
                      <SHORT-NAME>dataLength</SHORT-NAME>
                      <TYPE-TREF DEST="IMPLEMENTATION-DATA-TYPE">/AUTOSAR_Platform/ImplementationDataTypes/uint32</TYPE-TREF>
                      <DIRECTION>IN</DIRECTION>
                    </ARGUMENT-DATA-PROTOTYPE>
                    <ARGUMENT-DATA-PROTOTYPE>
                      <SHORT-NAME>resultPtr</SHORT-NAME>
                      <TYPE-TREF DEST="IMPLEMENTATION-DATA-TYPE">/AUTOSAR_Platform/ImplementationDataTypes/VoidPtr</TYPE-TREF>
                      <DIRECTION>IN</DIRECTION>
                    </ARGUMENT-DATA-PROTOTYPE>
                    <ARGUMENT-DATA-PROTOTYPE>
                      <SHORT-NAME>resultLengthPtr</SHORT-NAME>
                      <TYPE-TREF DEST="IMPLEMENTATION-DATA-TYPE">/AUTOSAR_Csm/ImplementationDataTypes/Csm_LengthPtr</TYPE-TREF>
                      <DIRECTION>IN</DIRECTION>
                    </ARGUMENT-DATA-PROTOTYPE>
                  </ARGUMENTS>
                  <POSSIBLE-ERROR-REFS>
                    <POSSIBLE-ERROR-REF DEST="APPLICATION-ERROR">/AUTOSAR_Csm/PortInterfaces/CsmHash/E_NOT_OK</POSSIBLE-ERROR-REF>
                    <POSSIBLE-ERROR-REF DEST="APPLICATION-ERROR">/AUTOSAR_Csm/PortInterfaces/CsmHash/CRYPTO_E_BUSY</POSSIBLE-ERROR-REF>
                  </POSSIBLE-ERROR-REFS>
                </CLIENT-SERVER-OPERATION>
              </OPERATIONS>
              <POSSIBLE-ERRORS>
                <APPLICATION-ERROR>
                  <SHORT-NAME>E_NOT_OK</SHORT-NAME>
                  <ERROR-CODE>1</ERROR-CODE>
                </APPLICATION-ERROR>
                <APPLICATION-ERROR>
                  <SHORT-NAME>CRYPTO_E_BUSY</SHORT-NAME>
                  <ERROR-CODE>2</ERROR-CODE>
                </APPLICATION-ERROR>
                <APPLICATION-ERROR>
                  <SHORT-NAME>CRYPTO_E_JOB_CANCELED</SHORT-NAME>
                  <ERROR-CODE>12</ERROR-CODE>
                </APPLICATION-ERROR>
              </POSSIBLE-ERRORS>
            </CLIENT-SERVER-INTERFACE>
  [!ENDIF!][!//
[!IF "node:value(as:modconf('Csm')/CsmEbGeneral/CsmEbMisc/CsmEbCorrectionCsmAsyncJobInterfaceUseDataReferences) = 'true' and
 num:i(count(node:refs(as:modconf('Csm')/CsmJobs/CsmJob/*[CsmJobUsePort = 'true']/CsmJobPrimitiveRef)/*[@name = 'CsmMacGenerate']/*[CsmMacGenerateProcessing = 'CSM_ASYNCHRONOUS'])) > 0"!][!//
            <!-- !LINKSTO SWS_Csm_91052,1 -->
            <CLIENT-SERVER-INTERFACE>
              <SHORT-NAME>CsmMacGenerate</SHORT-NAME>
              <IS-SERVICE>true</IS-SERVICE>
              <OPERATIONS>
                <CLIENT-SERVER-OPERATION>
                  <SHORT-NAME>CancelJob</SHORT-NAME>
                  <ARGUMENTS>
                  </ARGUMENTS>
                  <POSSIBLE-ERROR-REFS>
                    <POSSIBLE-ERROR-REF DEST="APPLICATION-ERROR">/AUTOSAR_Csm/PortInterfaces/CsmMacGenerate/E_NOT_OK</POSSIBLE-ERROR-REF>
                    <POSSIBLE-ERROR-REF DEST="APPLICATION-ERROR">/AUTOSAR_Csm/PortInterfaces/CsmMacGenerate/CRYPTO_E_JOB_CANCELED</POSSIBLE-ERROR-REF>
                  </POSSIBLE-ERROR-REFS>
                </CLIENT-SERVER-OPERATION>
                <CLIENT-SERVER-OPERATION>
                  <SHORT-NAME>MacGenerate</SHORT-NAME>
                  <ARGUMENTS>
                    <ARGUMENT-DATA-PROTOTYPE>
                      <SHORT-NAME>dataPtr</SHORT-NAME>
                      <TYPE-TREF DEST="IMPLEMENTATION-DATA-TYPE">/AUTOSAR_Platform/ImplementationDataTypes/ConstVoidPtr</TYPE-TREF>
                      <DIRECTION>IN</DIRECTION>
                    </ARGUMENT-DATA-PROTOTYPE>
                    <ARGUMENT-DATA-PROTOTYPE>
                      <SHORT-NAME>dataLength</SHORT-NAME>
                      <TYPE-TREF DEST="IMPLEMENTATION-DATA-TYPE">/AUTOSAR_Platform/ImplementationDataTypes/uint32</TYPE-TREF>
                      <DIRECTION>IN</DIRECTION>
                    </ARGUMENT-DATA-PROTOTYPE>
                    <ARGUMENT-DATA-PROTOTYPE>
                      <SHORT-NAME>macPtr</SHORT-NAME>
                      <TYPE-TREF DEST="IMPLEMENTATION-DATA-TYPE">/AUTOSAR_Platform/ImplementationDataTypes/VoidPtr</TYPE-TREF>
                      <DIRECTION>IN</DIRECTION>
                    </ARGUMENT-DATA-PROTOTYPE>
                    <ARGUMENT-DATA-PROTOTYPE>
                      <SHORT-NAME>macLengthPtr</SHORT-NAME>
                      <TYPE-TREF DEST="IMPLEMENTATION-DATA-TYPE">/AUTOSAR_Csm/ImplementationDataTypes/Csm_LengthPtr</TYPE-TREF>
                      <DIRECTION>IN</DIRECTION>
                    </ARGUMENT-DATA-PROTOTYPE>
                  </ARGUMENTS>
                  <POSSIBLE-ERROR-REFS>
                    <POSSIBLE-ERROR-REF DEST="APPLICATION-ERROR">/AUTOSAR_Csm/PortInterfaces/CsmMacGenerate/E_NOT_OK</POSSIBLE-ERROR-REF>
                    <POSSIBLE-ERROR-REF DEST="APPLICATION-ERROR">/AUTOSAR_Csm/PortInterfaces/CsmMacGenerate/CRYPTO_E_BUSY</POSSIBLE-ERROR-REF>
                    <POSSIBLE-ERROR-REF DEST="APPLICATION-ERROR">/AUTOSAR_Csm/PortInterfaces/CsmMacGenerate/CRYPTO_E_KEY_NOT_VALID</POSSIBLE-ERROR-REF>
                    <POSSIBLE-ERROR-REF DEST="APPLICATION-ERROR">/AUTOSAR_Csm/PortInterfaces/CsmMacGenerate/CRYPTO_E_KEY_SIZE_MISMATCH</POSSIBLE-ERROR-REF>
                    <POSSIBLE-ERROR-REF DEST="APPLICATION-ERROR">/AUTOSAR_Csm/PortInterfaces/CsmMacGenerate/CRYPTO_E_KEY_EMPTY</POSSIBLE-ERROR-REF>
                  </POSSIBLE-ERROR-REFS>
                </CLIENT-SERVER-OPERATION>
              </OPERATIONS>
              <POSSIBLE-ERRORS>
                <APPLICATION-ERROR>
                  <SHORT-NAME>E_NOT_OK</SHORT-NAME>
                  <ERROR-CODE>1</ERROR-CODE>
                </APPLICATION-ERROR>
                <APPLICATION-ERROR>
                  <SHORT-NAME>CRYPTO_E_BUSY</SHORT-NAME>
                  <ERROR-CODE>2</ERROR-CODE>
                </APPLICATION-ERROR>
                <APPLICATION-ERROR>
                  <SHORT-NAME>CRYPTO_E_KEY_NOT_VALID</SHORT-NAME>
                  <ERROR-CODE>9</ERROR-CODE>
                </APPLICATION-ERROR>
                <APPLICATION-ERROR>
                  <SHORT-NAME>CRYPTO_E_KEY_SIZE_MISMATCH</SHORT-NAME>
                  <ERROR-CODE>10</ERROR-CODE>
                </APPLICATION-ERROR>
                <APPLICATION-ERROR>
                  <SHORT-NAME>CRYPTO_E_JOB_CANCELED</SHORT-NAME>
                  <ERROR-CODE>12</ERROR-CODE>
                </APPLICATION-ERROR>
                <APPLICATION-ERROR>
                  <SHORT-NAME>CRYPTO_E_KEY_EMPTY</SHORT-NAME>
                  <ERROR-CODE>13</ERROR-CODE>
                </APPLICATION-ERROR>
              </POSSIBLE-ERRORS>
            </CLIENT-SERVER-INTERFACE>
  [!ENDIF!][!//
[!IF "node:value(as:modconf('Csm')/CsmEbGeneral/CsmEbMisc/CsmEbCorrectionCsmAsyncJobInterfaceUseDataReferences) = 'true' and
 num:i(count(node:refs(as:modconf('Csm')/CsmJobs/CsmJob/*[CsmJobUsePort = 'true']/CsmJobPrimitiveRef)/*[@name = 'CsmMacVerify']/*[CsmMacVerifyProcessing = 'CSM_ASYNCHRONOUS'])) > 0"!][!//
            <!-- !LINKSTO SWS_Csm_91053,1 -->
            <CLIENT-SERVER-INTERFACE>
              <SHORT-NAME>CsmMacVerify</SHORT-NAME>
              <IS-SERVICE>true</IS-SERVICE>
              <OPERATIONS>
                <CLIENT-SERVER-OPERATION>
                  <SHORT-NAME>CancelJob</SHORT-NAME>
                  <ARGUMENTS>
                  </ARGUMENTS>
                  <POSSIBLE-ERROR-REFS>
                    <POSSIBLE-ERROR-REF DEST="APPLICATION-ERROR">/AUTOSAR_Csm/PortInterfaces/CsmMacVerify/E_NOT_OK</POSSIBLE-ERROR-REF>
                    <POSSIBLE-ERROR-REF DEST="APPLICATION-ERROR">/AUTOSAR_Csm/PortInterfaces/CsmMacVerify/CRYPTO_E_JOB_CANCELED</POSSIBLE-ERROR-REF>
                  </POSSIBLE-ERROR-REFS>
                </CLIENT-SERVER-OPERATION>
                <CLIENT-SERVER-OPERATION>
                  <SHORT-NAME>MacVerify</SHORT-NAME>
                  <ARGUMENTS>
                    <ARGUMENT-DATA-PROTOTYPE>
                      <SHORT-NAME>dataPtr</SHORT-NAME>
                      <TYPE-TREF DEST="IMPLEMENTATION-DATA-TYPE">/AUTOSAR_Platform/ImplementationDataTypes/ConstVoidPtr</TYPE-TREF>
                      <DIRECTION>IN</DIRECTION>
                    </ARGUMENT-DATA-PROTOTYPE>
                    <ARGUMENT-DATA-PROTOTYPE>
                      <SHORT-NAME>dataLength</SHORT-NAME>
                      <TYPE-TREF DEST="IMPLEMENTATION-DATA-TYPE">/AUTOSAR_Platform/ImplementationDataTypes/uint32</TYPE-TREF>
                      <DIRECTION>IN</DIRECTION>
                    </ARGUMENT-DATA-PROTOTYPE>
                    <ARGUMENT-DATA-PROTOTYPE>
                      <SHORT-NAME>macPtr</SHORT-NAME>
                      <TYPE-TREF DEST="IMPLEMENTATION-DATA-TYPE">/AUTOSAR_Platform/ImplementationDataTypes/ConstVoidPtr</TYPE-TREF>
                      <DIRECTION>IN</DIRECTION>
                    </ARGUMENT-DATA-PROTOTYPE>
                    <ARGUMENT-DATA-PROTOTYPE>
                      <SHORT-NAME>macLength</SHORT-NAME>
                      <TYPE-TREF DEST="IMPLEMENTATION-DATA-TYPE">/AUTOSAR_Platform/ImplementationDataTypes/uint32</TYPE-TREF>
                      <DIRECTION>IN</DIRECTION>
                    </ARGUMENT-DATA-PROTOTYPE>
                    <ARGUMENT-DATA-PROTOTYPE>
                      <SHORT-NAME>verifyPtr</SHORT-NAME>
                      <TYPE-TREF DEST="IMPLEMENTATION-DATA-TYPE">/AUTOSAR_Csm/ImplementationDataTypes/Csm_VerifyResultPtr</TYPE-TREF>
                      <DIRECTION>IN</DIRECTION>
                    </ARGUMENT-DATA-PROTOTYPE>
                  </ARGUMENTS>
                  <POSSIBLE-ERROR-REFS>
                    <POSSIBLE-ERROR-REF DEST="APPLICATION-ERROR">/AUTOSAR_Csm/PortInterfaces/CsmMacVerify/E_NOT_OK</POSSIBLE-ERROR-REF>
                    <POSSIBLE-ERROR-REF DEST="APPLICATION-ERROR">/AUTOSAR_Csm/PortInterfaces/CsmMacVerify/CRYPTO_E_BUSY</POSSIBLE-ERROR-REF>
                    <POSSIBLE-ERROR-REF DEST="APPLICATION-ERROR">/AUTOSAR_Csm/PortInterfaces/CsmMacVerify/CRYPTO_E_KEY_NOT_VALID</POSSIBLE-ERROR-REF>
                    <POSSIBLE-ERROR-REF DEST="APPLICATION-ERROR">/AUTOSAR_Csm/PortInterfaces/CsmMacVerify/CRYPTO_E_KEY_SIZE_MISMATCH</POSSIBLE-ERROR-REF>
                    <POSSIBLE-ERROR-REF DEST="APPLICATION-ERROR">/AUTOSAR_Csm/PortInterfaces/CsmMacVerify/CRYPTO_E_KEY_EMPTY</POSSIBLE-ERROR-REF>
                  </POSSIBLE-ERROR-REFS>
                </CLIENT-SERVER-OPERATION>
              </OPERATIONS>
              <POSSIBLE-ERRORS>
                <APPLICATION-ERROR>
                  <SHORT-NAME>E_NOT_OK</SHORT-NAME>
                  <ERROR-CODE>1</ERROR-CODE>
                </APPLICATION-ERROR>
                <APPLICATION-ERROR>
                  <SHORT-NAME>CRYPTO_E_BUSY</SHORT-NAME>
                  <ERROR-CODE>2</ERROR-CODE>
                </APPLICATION-ERROR>
                <APPLICATION-ERROR>
                  <SHORT-NAME>CRYPTO_E_KEY_NOT_VALID</SHORT-NAME>
                  <ERROR-CODE>9</ERROR-CODE>
                </APPLICATION-ERROR>
                <APPLICATION-ERROR>
                  <SHORT-NAME>CRYPTO_E_KEY_SIZE_MISMATCH</SHORT-NAME>
                  <ERROR-CODE>10</ERROR-CODE>
                </APPLICATION-ERROR>
                <APPLICATION-ERROR>
                  <SHORT-NAME>CRYPTO_E_JOB_CANCELED</SHORT-NAME>
                  <ERROR-CODE>12</ERROR-CODE>
                </APPLICATION-ERROR>
                <APPLICATION-ERROR>
                  <SHORT-NAME>CRYPTO_E_KEY_EMPTY</SHORT-NAME>
                  <ERROR-CODE>13</ERROR-CODE>
                </APPLICATION-ERROR>
              </POSSIBLE-ERRORS>
            </CLIENT-SERVER-INTERFACE>
  [!ENDIF!][!//
[!IF "node:value(as:modconf('Csm')/CsmEbGeneral/CsmEbMisc/CsmEbCorrectionCsmAsyncJobInterfaceUseDataReferences) = 'true' and
 num:i(count(node:refs(as:modconf('Csm')/CsmJobs/CsmJob/*[CsmJobUsePort = 'true']/CsmJobPrimitiveRef)/*[@name = 'CsmRandomGenerate']/*[CsmRandomGenerateProcessing = 'CSM_ASYNCHRONOUS'])) > 0"!][!//
            <!-- !LINKSTO SWS_Csm_91060,1 -->
            <CLIENT-SERVER-INTERFACE>
              <SHORT-NAME>CsmRandomGenerate</SHORT-NAME>
              <IS-SERVICE>true</IS-SERVICE>
              <OPERATIONS>
                <CLIENT-SERVER-OPERATION>
                  <SHORT-NAME>CancelJob</SHORT-NAME>
                  <ARGUMENTS>
                  </ARGUMENTS>
                  <POSSIBLE-ERROR-REFS>
                    <POSSIBLE-ERROR-REF DEST="APPLICATION-ERROR">/AUTOSAR_Csm/PortInterfaces/CsmRandomGenerate/E_NOT_OK</POSSIBLE-ERROR-REF>
                    <POSSIBLE-ERROR-REF DEST="APPLICATION-ERROR">/AUTOSAR_Csm/PortInterfaces/CsmRandomGenerate/CRYPTO_E_JOB_CANCELED</POSSIBLE-ERROR-REF>
                  </POSSIBLE-ERROR-REFS>
                </CLIENT-SERVER-OPERATION>
                <CLIENT-SERVER-OPERATION>
                  <SHORT-NAME>RandomGenerate</SHORT-NAME>
                  <ARGUMENTS>
                    <ARGUMENT-DATA-PROTOTYPE>
                      <SHORT-NAME>resultPtr</SHORT-NAME>
                      <TYPE-TREF DEST="IMPLEMENTATION-DATA-TYPE">/AUTOSAR_Platform/ImplementationDataTypes/VoidPtr</TYPE-TREF>
                      <DIRECTION>IN</DIRECTION>
                    </ARGUMENT-DATA-PROTOTYPE>
                    <ARGUMENT-DATA-PROTOTYPE>
                      <SHORT-NAME>resultLengthPtr</SHORT-NAME>
                      <TYPE-TREF DEST="IMPLEMENTATION-DATA-TYPE">/AUTOSAR_Csm/ImplementationDataTypes/Csm_LengthPtr</TYPE-TREF>
                      <DIRECTION>IN</DIRECTION>
                    </ARGUMENT-DATA-PROTOTYPE>
                  </ARGUMENTS>
                  <POSSIBLE-ERROR-REFS>
                    <POSSIBLE-ERROR-REF DEST="APPLICATION-ERROR">/AUTOSAR_Csm/PortInterfaces/CsmRandomGenerate/E_NOT_OK</POSSIBLE-ERROR-REF>
                    <POSSIBLE-ERROR-REF DEST="APPLICATION-ERROR">/AUTOSAR_Csm/PortInterfaces/CsmRandomGenerate/CRYPTO_E_BUSY</POSSIBLE-ERROR-REF>
                    <POSSIBLE-ERROR-REF DEST="APPLICATION-ERROR">/AUTOSAR_Csm/PortInterfaces/CsmRandomGenerate/CRYPTO_E_ENTROPY_EXHAUSTED</POSSIBLE-ERROR-REF>
                  </POSSIBLE-ERROR-REFS>
                </CLIENT-SERVER-OPERATION>
              </OPERATIONS>
              <POSSIBLE-ERRORS>
                <APPLICATION-ERROR>
                  <SHORT-NAME>E_NOT_OK</SHORT-NAME>
                  <ERROR-CODE>1</ERROR-CODE>
                </APPLICATION-ERROR>
                <APPLICATION-ERROR>
                  <SHORT-NAME>CRYPTO_E_BUSY</SHORT-NAME>
                  <ERROR-CODE>2</ERROR-CODE>
                </APPLICATION-ERROR>
                <APPLICATION-ERROR>
                  <SHORT-NAME>CRYPTO_E_ENTROPY_EXHAUSTED</SHORT-NAME>
                  <ERROR-CODE>4</ERROR-CODE>
                </APPLICATION-ERROR>
                <APPLICATION-ERROR>
                  <SHORT-NAME>CRYPTO_E_JOB_CANCELED</SHORT-NAME>
                  <ERROR-CODE>12</ERROR-CODE>
                </APPLICATION-ERROR>
              </POSSIBLE-ERRORS>
            </CLIENT-SERVER-INTERFACE>
  [!ENDIF!][!//
[!IF "node:value(as:modconf('Csm')/CsmEbGeneral/CsmEbMisc/CsmEbCorrectionCsmAsyncJobInterfaceUseDataReferences) = 'true' and
 num:i(count(node:refs(as:modconf('Csm')/CsmJobs/CsmJob/*[CsmJobUsePort = 'true']/CsmJobPrimitiveRef)/*[@name = 'CsmSignatureGenerate']/*[CsmSignatureGenerateProcessing = 'CSM_ASYNCHRONOUS'])) > 0"!][!//
            <!-- !LINKSTO SWS_Csm_91058,1 -->
            <CLIENT-SERVER-INTERFACE>
              <SHORT-NAME>CsmSignatureGenerate</SHORT-NAME>
              <IS-SERVICE>true</IS-SERVICE>
              <OPERATIONS>
                <CLIENT-SERVER-OPERATION>
                  <SHORT-NAME>CancelJob</SHORT-NAME>
                  <ARGUMENTS>
                  </ARGUMENTS>
                  <POSSIBLE-ERROR-REFS>
                    <POSSIBLE-ERROR-REF DEST="APPLICATION-ERROR">/AUTOSAR_Csm/PortInterfaces/CsmSignatureGenerate/E_NOT_OK</POSSIBLE-ERROR-REF>
                    <POSSIBLE-ERROR-REF DEST="APPLICATION-ERROR">/AUTOSAR_Csm/PortInterfaces/CsmSignatureGenerate/CRYPTO_E_JOB_CANCELED</POSSIBLE-ERROR-REF>
                  </POSSIBLE-ERROR-REFS>
                </CLIENT-SERVER-OPERATION>
                <CLIENT-SERVER-OPERATION>
                  <SHORT-NAME>SignatureGenerate</SHORT-NAME>
                  <ARGUMENTS>
                    <ARGUMENT-DATA-PROTOTYPE>
                      <SHORT-NAME>dataPtr</SHORT-NAME>
                      <TYPE-TREF DEST="IMPLEMENTATION-DATA-TYPE">/AUTOSAR_Platform/ImplementationDataTypes/ConstVoidPtr</TYPE-TREF>
                      <DIRECTION>IN</DIRECTION>
                    </ARGUMENT-DATA-PROTOTYPE>
                    <ARGUMENT-DATA-PROTOTYPE>
                      <SHORT-NAME>dataLength</SHORT-NAME>
                      <TYPE-TREF DEST="IMPLEMENTATION-DATA-TYPE">/AUTOSAR_Platform/ImplementationDataTypes/uint32</TYPE-TREF>
                      <DIRECTION>IN</DIRECTION>
                    </ARGUMENT-DATA-PROTOTYPE>
                    <ARGUMENT-DATA-PROTOTYPE>
                      <SHORT-NAME>resultPtr</SHORT-NAME>
                      <TYPE-TREF DEST="IMPLEMENTATION-DATA-TYPE">/AUTOSAR_Platform/ImplementationDataTypes/VoidPtr</TYPE-TREF>
                      <DIRECTION>IN</DIRECTION>
                    </ARGUMENT-DATA-PROTOTYPE>
                    <ARGUMENT-DATA-PROTOTYPE>
                      <SHORT-NAME>resultLengthPtr</SHORT-NAME>
                      <TYPE-TREF DEST="IMPLEMENTATION-DATA-TYPE">/AUTOSAR_Csm/ImplementationDataTypes/Csm_LengthPtr</TYPE-TREF>
                      <DIRECTION>IN</DIRECTION>
                    </ARGUMENT-DATA-PROTOTYPE>
                  </ARGUMENTS>
                  <POSSIBLE-ERROR-REFS>
                    <POSSIBLE-ERROR-REF DEST="APPLICATION-ERROR">/AUTOSAR_Csm/PortInterfaces/CsmSignatureGenerate/E_NOT_OK</POSSIBLE-ERROR-REF>
                    <POSSIBLE-ERROR-REF DEST="APPLICATION-ERROR">/AUTOSAR_Csm/PortInterfaces/CsmSignatureGenerate/CRYPTO_E_BUSY</POSSIBLE-ERROR-REF>
                    <POSSIBLE-ERROR-REF DEST="APPLICATION-ERROR">/AUTOSAR_Csm/PortInterfaces/CsmSignatureGenerate/CRYPTO_E_KEY_NOT_VALID</POSSIBLE-ERROR-REF>
                    <POSSIBLE-ERROR-REF DEST="APPLICATION-ERROR">/AUTOSAR_Csm/PortInterfaces/CsmSignatureGenerate/CRYPTO_E_KEY_SIZE_MISMATCH</POSSIBLE-ERROR-REF>
                    <POSSIBLE-ERROR-REF DEST="APPLICATION-ERROR">/AUTOSAR_Csm/PortInterfaces/CsmSignatureGenerate/CRYPTO_E_KEY_EMPTY</POSSIBLE-ERROR-REF>
                  </POSSIBLE-ERROR-REFS>
                </CLIENT-SERVER-OPERATION>
              </OPERATIONS>
              <POSSIBLE-ERRORS>
                <APPLICATION-ERROR>
                  <SHORT-NAME>E_NOT_OK</SHORT-NAME>
                  <ERROR-CODE>1</ERROR-CODE>
                </APPLICATION-ERROR>
                <APPLICATION-ERROR>
                  <SHORT-NAME>CRYPTO_E_BUSY</SHORT-NAME>
                  <ERROR-CODE>2</ERROR-CODE>
                </APPLICATION-ERROR>
                <APPLICATION-ERROR>
                  <SHORT-NAME>CRYPTO_E_KEY_NOT_VALID</SHORT-NAME>
                  <ERROR-CODE>9</ERROR-CODE>
                </APPLICATION-ERROR>
                <APPLICATION-ERROR>
                  <SHORT-NAME>CRYPTO_E_KEY_SIZE_MISMATCH</SHORT-NAME>
                  <ERROR-CODE>10</ERROR-CODE>
                </APPLICATION-ERROR>
                <APPLICATION-ERROR>
                  <SHORT-NAME>CRYPTO_E_JOB_CANCELED</SHORT-NAME>
                  <ERROR-CODE>12</ERROR-CODE>
                </APPLICATION-ERROR>
                <APPLICATION-ERROR>
                  <SHORT-NAME>CRYPTO_E_KEY_EMPTY</SHORT-NAME>
                  <ERROR-CODE>13</ERROR-CODE>
                </APPLICATION-ERROR>
              </POSSIBLE-ERRORS>
            </CLIENT-SERVER-INTERFACE>
  [!ENDIF!][!//
[!IF "node:value(as:modconf('Csm')/CsmEbGeneral/CsmEbMisc/CsmEbCorrectionCsmAsyncJobInterfaceUseDataReferences) = 'true' and
 num:i(count(node:refs(as:modconf('Csm')/CsmJobs/CsmJob/*[CsmJobUsePort = 'true']/CsmJobPrimitiveRef)/*[@name = 'CsmSignatureVerify']/*[CsmSignatureVerifyProcessing = 'CSM_ASYNCHRONOUS'])) > 0"!][!//
            <!-- !LINKSTO SWS_Csm_91059,1 -->
            <CLIENT-SERVER-INTERFACE>
              <SHORT-NAME>CsmSignatureVerify</SHORT-NAME>
              <IS-SERVICE>true</IS-SERVICE>
              <OPERATIONS>
                <CLIENT-SERVER-OPERATION>
                  <SHORT-NAME>CancelJob</SHORT-NAME>
                  <ARGUMENTS>
                  </ARGUMENTS>
                  <POSSIBLE-ERROR-REFS>
                    <POSSIBLE-ERROR-REF DEST="APPLICATION-ERROR">/AUTOSAR_Csm/PortInterfaces/CsmSignatureVerify/E_NOT_OK</POSSIBLE-ERROR-REF>
                    <POSSIBLE-ERROR-REF DEST="APPLICATION-ERROR">/AUTOSAR_Csm/PortInterfaces/CsmSignatureVerify/CRYPTO_E_JOB_CANCELED</POSSIBLE-ERROR-REF>
                  </POSSIBLE-ERROR-REFS>
                </CLIENT-SERVER-OPERATION>
                <CLIENT-SERVER-OPERATION>
                  <SHORT-NAME>SignatureVerify</SHORT-NAME>
                  <ARGUMENTS>
                    <ARGUMENT-DATA-PROTOTYPE>
                      <SHORT-NAME>dataPtr</SHORT-NAME>
                      <TYPE-TREF DEST="IMPLEMENTATION-DATA-TYPE">/AUTOSAR_Platform/ImplementationDataTypes/ConstVoidPtr</TYPE-TREF>
                      <DIRECTION>IN</DIRECTION>
                    </ARGUMENT-DATA-PROTOTYPE>
                    <ARGUMENT-DATA-PROTOTYPE>
                      <SHORT-NAME>dataLength</SHORT-NAME>
                      <TYPE-TREF DEST="IMPLEMENTATION-DATA-TYPE">/AUTOSAR_Platform/ImplementationDataTypes/uint32</TYPE-TREF>
                      <DIRECTION>IN</DIRECTION>
                    </ARGUMENT-DATA-PROTOTYPE>
                    <ARGUMENT-DATA-PROTOTYPE>
                      <SHORT-NAME>comparePtr</SHORT-NAME>
                      <TYPE-TREF DEST="IMPLEMENTATION-DATA-TYPE">/AUTOSAR_Platform/ImplementationDataTypes/ConstVoidPtr</TYPE-TREF>
                      <DIRECTION>IN</DIRECTION>
                    </ARGUMENT-DATA-PROTOTYPE>
                    <ARGUMENT-DATA-PROTOTYPE>
                      <SHORT-NAME>compareLength</SHORT-NAME>
                      <TYPE-TREF DEST="IMPLEMENTATION-DATA-TYPE">/AUTOSAR_Platform/ImplementationDataTypes/uint32</TYPE-TREF>
                      <DIRECTION>IN</DIRECTION>
                    </ARGUMENT-DATA-PROTOTYPE>
                    <ARGUMENT-DATA-PROTOTYPE>
                      <SHORT-NAME>verifyPtr</SHORT-NAME>
                      <TYPE-TREF DEST="IMPLEMENTATION-DATA-TYPE">/AUTOSAR_Csm/ImplementationDataTypes/Csm_VerifyResultPtr</TYPE-TREF>
                      <DIRECTION>IN</DIRECTION>
                    </ARGUMENT-DATA-PROTOTYPE>
                  </ARGUMENTS>
                  <POSSIBLE-ERROR-REFS>
                    <POSSIBLE-ERROR-REF DEST="APPLICATION-ERROR">/AUTOSAR_Csm/PortInterfaces/CsmSignatureVerify/E_NOT_OK</POSSIBLE-ERROR-REF>
                    <POSSIBLE-ERROR-REF DEST="APPLICATION-ERROR">/AUTOSAR_Csm/PortInterfaces/CsmSignatureVerify/CRYPTO_E_BUSY</POSSIBLE-ERROR-REF>
                    <POSSIBLE-ERROR-REF DEST="APPLICATION-ERROR">/AUTOSAR_Csm/PortInterfaces/CsmSignatureVerify/CRYPTO_E_KEY_NOT_VALID</POSSIBLE-ERROR-REF>
                    <POSSIBLE-ERROR-REF DEST="APPLICATION-ERROR">/AUTOSAR_Csm/PortInterfaces/CsmSignatureVerify/CRYPTO_E_KEY_SIZE_MISMATCH</POSSIBLE-ERROR-REF>
                    <POSSIBLE-ERROR-REF DEST="APPLICATION-ERROR">/AUTOSAR_Csm/PortInterfaces/CsmSignatureVerify/CRYPTO_E_KEY_EMPTY</POSSIBLE-ERROR-REF>
                  </POSSIBLE-ERROR-REFS>
                </CLIENT-SERVER-OPERATION>
              </OPERATIONS>
              <POSSIBLE-ERRORS>
                <APPLICATION-ERROR>
                  <SHORT-NAME>E_NOT_OK</SHORT-NAME>
                  <ERROR-CODE>1</ERROR-CODE>
                </APPLICATION-ERROR>
                <APPLICATION-ERROR>
                  <SHORT-NAME>CRYPTO_E_BUSY</SHORT-NAME>
                  <ERROR-CODE>2</ERROR-CODE>
                </APPLICATION-ERROR>
                <APPLICATION-ERROR>
                  <SHORT-NAME>CRYPTO_E_KEY_NOT_VALID</SHORT-NAME>
                  <ERROR-CODE>9</ERROR-CODE>
                </APPLICATION-ERROR>
                <APPLICATION-ERROR>
                  <SHORT-NAME>CRYPTO_E_KEY_SIZE_MISMATCH</SHORT-NAME>
                  <ERROR-CODE>10</ERROR-CODE>
                </APPLICATION-ERROR>
                <APPLICATION-ERROR>
                  <SHORT-NAME>CRYPTO_E_JOB_CANCELED</SHORT-NAME>
                  <ERROR-CODE>12</ERROR-CODE>
                </APPLICATION-ERROR>
                <APPLICATION-ERROR>
                  <SHORT-NAME>CRYPTO_E_KEY_EMPTY</SHORT-NAME>
                  <ERROR-CODE>13</ERROR-CODE>
                </APPLICATION-ERROR>
              </POSSIBLE-ERRORS>
            </CLIENT-SERVER-INTERFACE>
  [!ENDIF!][!//
            <!-- !LINKSTO CSM.Req.Correction.SWS_Csm_00928,1 -->
            <CLIENT-SERVER-INTERFACE>
              <SHORT-NAME>CallbackNotification</SHORT-NAME>
              <IS-SERVICE>true</IS-SERVICE>
              <OPERATIONS>
                <CLIENT-SERVER-OPERATION>
                  <SHORT-NAME>CallbackNotification</SHORT-NAME>
                  <ARGUMENTS>
[!IF "node:value(as:modconf('Csm')/CsmEbGeneral/CsmEbMisc/CsmEbCorrectionCsmJobBasedCallbacknotificationPorts) = 'false'"!][!//
                    <ARGUMENT-DATA-PROTOTYPE>
                      <SHORT-NAME>job</SHORT-NAME>
                      <TYPE-TREF DEST="IMPLEMENTATION-DATA-TYPE">/AUTOSAR_Csm/ImplementationDataTypes/Crypto_JobType</TYPE-TREF>
                      <DIRECTION>IN</DIRECTION>
                    </ARGUMENT-DATA-PROTOTYPE>
[!ENDIF!][!//
                    <ARGUMENT-DATA-PROTOTYPE>
                      <SHORT-NAME>result</SHORT-NAME>
[!IF "node:value(as:modconf('Csm')/CsmEbGeneral/CsmEbMisc/CsmEbCorrectionCsmJobBasedCallbacknotificationPorts) = 'false'"!][!//
                      <TYPE-TREF DEST="IMPLEMENTATION-DATA-TYPE">/AUTOSAR_Std/ImplementationDataTypes/Std_ReturnType</TYPE-TREF>
[!ELSE!][!//
                      <TYPE-TREF DEST="IMPLEMENTATION-DATA-TYPE">/AUTOSAR_Csm/ImplementationDataTypes/Crypto_ResultType</TYPE-TREF>
[!ENDIF!][!//
                      <DIRECTION>IN</DIRECTION>
                    </ARGUMENT-DATA-PROTOTYPE>
                  </ARGUMENTS>
                </CLIENT-SERVER-OPERATION>
              </OPERATIONS>
            </CLIENT-SERVER-INTERFACE>
            <!-- ~~~~~~~~~~~~~~~~~~~~~~~~~~~~~~~~~~~~~~~~~~~~~~~~~~~~~~~~~~~~~~~~~~~~~~~~~~~~~~~ -->
          </ELEMENTS>
        </AR-PACKAGE>

      </AR-PACKAGES>
    </AR-PACKAGE>
  </AR-PACKAGES>
</AUTOSAR>
