AUTOSAR XML (schema 00046)
package /TS_TxDxM5I3R0
  module config PduRRecConfigurationGatewayEcu: definition=PduR
    11 x PduRBswModules, all with PduRUseTag=1, PduRBswModuleIsEnabled=1, PduRBswModuleApiDefinition=FUNCTION:
      Com: PduRCommunicationInterface=1, PduRLowerModule=0, PduRRetransmission=0, PduRTransportProtocol=0, PduRTriggertransmit=1, PduRTxConfirmation=1, PduRUpperModule=1, PduRStaticPduLengthSupport=0
      Dcm: PduRCancelReceive=1, PduRCancelTransmit=1, PduRChangeParameterRequestApi=0, PduRCommunicationInterface=1, PduRLowerModule=0, PduRRetransmission=1, PduRTransportProtocol=1, PduRTriggertransmit=0, PduRTxConfirmation=1, PduRUpperModule=1, PduRStaticPduLengthSupport=0
      CanIf: PduRCommunicationInterface=1, PduRLowerModule=1, PduRRetransmission=0, PduRTransportProtocol=0, PduRTriggertransmit=0, PduRTxConfirmation=1, PduRUpperModule=0, PduRStaticPduLengthSupport=0
      LinIf: PduRCommunicationInterface=1, PduRLowerModule=1, PduRRetransmission=0, PduRTransportProtocol=0, PduRTriggertransmit=1, PduRTxConfirmation=1, PduRUpperModule=0, PduRStaticPduLengthSupport=0
      FrIf: PduRCommunicationInterface=1, PduRLowerModule=1, PduRRetransmission=0, PduRTransportProtocol=0, PduRTriggertransmit=1, PduRTxConfirmation=1, PduRUpperModule=0, PduRStaticPduLengthSupport=0
      CanTp: PduRCancelReceive=1, PduRCancelTransmit=1, PduRChangeParameterRequestApi=1, PduRCommunicationInterface=0, PduRLowerModule=1, PduRRetransmission=0, PduRTransportProtocol=1, PduRUpperModule=0
      LinTp: PduRCancelReceive=1, PduRCancelTransmit=1, PduRChangeParameterRequestApi=1, PduRCommunicationInterface=0, PduRLowerModule=1, PduRRetransmission=0, PduRTransportProtocol=1, PduRUpperModule=0
      FrTp: PduRCancelReceive=1, PduRCancelTransmit=1, PduRChangeParameterRequestApi=1, PduRCommunicationInterface=0, PduRLowerModule=1, PduRRetransmission=1, PduRTransportProtocol=1, PduRUpperModule=0
      SoAd: PduRCancelReceive=1, PduRCancelTransmit=0, PduRChangeParameterRequestApi=0, PduRCommunicationInterface=1, PduRLowerModule=1, PduRRetransmission=0, PduRTransportProtocol=1, PduRTriggertransmit=1, PduRTxConfirmation=1, PduRUpperModule=0, PduRStaticPduLengthSupport=0
      DoIP: PduRCancelReceive=0, PduRCancelTransmit=0, PduRChangeParameterRequestApi=0, PduRCommunicationInterface=1, PduRLowerModule=1, PduRRetransmission=0, PduRTransportProtocol=1, PduRTriggertransmit=0, PduRTxConfirmation=0, PduRUpperModule=0, PduRStaticPduLengthSupport=0
      IpduM: PduRCommunicationInterface=1, PduRLowerModule=1, PduRRetransmission=0, PduRTransportProtocol=0, PduRTriggertransmit=1, PduRTxConfirmation=1, PduRUpperModule=1, PduRStaticPduLengthSupport=0
    PduRGeneral:
      PduRIfGatewaySupport = 1
      PduRTpGatewaySupport = 1
      PduRSbTxBufferSupport = 1
      PduRFifoTxBufferSupport = 1
      PduRMulticastFromIfSupport = 1
      PduRMulticastToIfSupport = 1
      PduRMulticastLoTpToUpSupport = 1
      PduRMulticastUpToLoTpSupport = 1
