AUTOSAR XML (schema 00046)
package /TS_TxDxM5I3R0
  module config PduRRecConfigurationEthernetEcu: definition=PduR
    5 x PduRBswModules, all with PduRCommunicationInterface=1, PduRUseTag=1, PduRBswModuleIsEnabled=1, PduRBswModuleApiDefinition=FUNCTION:
      Com: PduRLowerModule=0, PduRRetransmission=0, PduRTransportProtocol=0, PduRTriggertransmit=1, PduRTxConfirmation=1, PduRUpperModule=1
      Dcm: PduRCancelReceive=1, PduRCancelTransmit=1, PduRChangeParameterRequestApi=0, PduRLowerModule=0, PduRRetransmission=1, PduRTransportProtocol=1, PduRTriggertransmit=0, PduRTxConfirmation=1, PduRUpperModule=1
      SoAd: PduRCancelReceive=1, PduRCancelTransmit=0, PduRChangeParameterRequestApi=0, PduRLowerModule=1, PduRRetransmission=0, PduRTransportProtocol=1, PduRTriggertransmit=1, PduRTxConfirmation=1, PduRUpperModule=0
      DoIP: PduRCancelReceive=0, PduRCancelTransmit=0, PduRChangeParameterRequestApi=0, PduRLowerModule=1, PduRRetransmission=0, PduRTransportProtocol=1, PduRTriggertransmit=0, PduRTxConfirmation=0, PduRUpperModule=0
      IpduM: PduRLowerModule=1, PduRRetransmission=0, PduRTransportProtocol=0, PduRTriggertransmit=1, PduRTxConfirmation=1, PduRUpperModule=1
