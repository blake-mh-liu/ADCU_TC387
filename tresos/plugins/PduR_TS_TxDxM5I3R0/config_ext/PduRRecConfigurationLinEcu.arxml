AUTOSAR XML (schema 00046)
package /TS_TxDxM5I3R0
  module config PduRRecConfigurationLinEcu: definition=PduR
    5 x PduRBswModules, all with PduRUseTag=1, PduRBswModuleIsEnabled=1, PduRBswModuleApiDefinition=FUNCTION:
      Com: PduRCommunicationInterface=1, PduRLowerModule=0, PduRRetransmission=0, PduRTransportProtocol=0, PduRTriggertransmit=1, PduRTxConfirmation=1, PduRUpperModule=1
      Dcm: PduRCancelReceive=1, PduRCancelTransmit=1, PduRChangeParameterRequestApi=0, PduRCommunicationInterface=1, PduRLowerModule=0, PduRRetransmission=1, PduRTransportProtocol=1, PduRTriggertransmit=0, PduRTxConfirmation=1, PduRUpperModule=1
      LinIf: PduRCommunicationInterface=1, PduRLowerModule=1, PduRRetransmission=0, PduRTransportProtocol=0, PduRTriggertransmit=1, PduRTxConfirmation=1, PduRUpperModule=0
      LinTp: PduRCancelReceive=1, PduRCancelTransmit=1, PduRChangeParameterRequestApi=1, PduRCommunicationInterface=0, PduRLowerModule=1, PduRRetransmission=1, PduRTransportProtocol=1, PduRUpperModule=0
      IpduM: PduRCommunicationInterface=1, PduRLowerModule=1, PduRRetransmission=0, PduRTransportProtocol=0, PduRTriggertransmit=1, PduRTxConfirmation=1, PduRUpperModule=1
