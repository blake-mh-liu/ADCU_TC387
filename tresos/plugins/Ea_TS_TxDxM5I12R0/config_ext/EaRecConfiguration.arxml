AUTOSAR XML (schema 00046)
package /TS_TxDxM5I12R0
  module config EaRecConfiguration: definition=Ea
    EaBlockConfiguration_0 (EaBlockConfiguration): EaBlockNumber=16, EaImmediateData=1, EaBlockSize=4
    EaBlockConfiguration_1 (EaBlockConfiguration): EaBlockNumber=17, EaImmediateData=1, EaBlockSize=4
