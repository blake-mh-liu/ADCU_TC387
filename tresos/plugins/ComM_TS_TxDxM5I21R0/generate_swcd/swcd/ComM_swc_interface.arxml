<?xml version="1.0" encoding="UTF-8"?>
[!AUTOSPACING!]
<AUTOSAR xmlns="http://autosar.org/schema/r4.0"
  xmlns:xsi="http://www.w3.org/2001/XMLSchema-instance"
  xsi:schemaLocation="http://autosar.org/schema/r4.0 AUTOSAR_4-0-3.xsd">
[!IF "not(node:exists(as:modconf('ComM')[1]/ComMConfigSet/*[1]))"!][!//
[!ERROR "Configuration not exist!"!][!//
[!ENDIF!][!//
[!/* do not generate this file if RTE is not used */!]
[!SKIPFILE "ComMGeneral/ComMRteUsage = 'false'"!]
[!// find maximum number of users for a channel
[!VAR "maxNumUsersPerChannel"="0"!]
[!LOOP "ComMConfigSet/*[1]/ComMChannel/*"!]
[!IF "as:modconf('ComM')[1]/ComMGeneral/ComMPncSupport = 'true'"!]
<!-- Number of users of a channel is calculated by adding number of users directly mapped to a channel +
     (Number of users mapped to a channel via pnc - Number of users directly mapped to a channel) -->
[!VAR "numUserOfCh"="num:i(count(ComMUserPerChannel/*/ComMUserChannel)+count(node:difference(util:distinct(node:refs(as:modconf('ComM')[1]/ComMConfigSet/*[1]/ComMPnc/*/ComMChannelPerPnc/*[(node:ref(.)/ComMChannelId=node:current()/ComMChannelId)]/../../ComMUserPerPnc/*)),util:distinct(node:refs(as:modconf('ComM')[1]/ComMConfigSet/*[1]/ComMChannel/*[./ComMChannelId=node:current()/ComMChannelId]/ComMUserPerChannel/*/ComMUserChannel)))))"!][!//
[!ELSE!][!//
[!VAR "numUserOfCh"="num:i(count(ComMUserPerChannel/*/ComMUserChannel))"!]
[!ENDIF!][!//
[!IF "$numUserOfCh > $maxNumUsersPerChannel"!]
  [!VAR "maxNumUsersPerChannel"= "$numUserOfCh"!]
[!ENDIF!]
[!ENDLOOP!]
[!INCLUDE "ComM_Functions.m"!][!//
[!CALL "GetUsedUserPlusChannelPlusMasterPncPlusInhibitionOsApplications"!][!//
[!IF "(count(text:split($FoundUserPlusChannePlusMasterPncPlusInhibitionOsApplications,' ')) > 1) and (as:modconf('ComM')[1]/ComMGeneral/ComMMultiCoreSupport = 'false')"!]
  <AR-PACKAGES>
    <AR-PACKAGE>
      <SHORT-NAME>AUTOSAR_ComM</SHORT-NAME>
      <ELEMENTS/>
      <AR-PACKAGES>
        <!-- Provide default service interface -->
        <AR-PACKAGE> <!-- ImplementationDataTypes -->
          <SHORT-NAME>ImplementationDataTypes</SHORT-NAME>
          <ELEMENTS>
            <!-- Type definitions -->
            <IMPLEMENTATION-DATA-TYPE>
              <SHORT-NAME>ComM_ModeType</SHORT-NAME>
              <CATEGORY>TYPE_REFERENCE</CATEGORY>
              <SW-DATA-DEF-PROPS>
                <SW-DATA-DEF-PROPS-VARIANTS>
                  <SW-DATA-DEF-PROPS-CONDITIONAL>
                    <COMPU-METHOD-REF DEST="COMPU-METHOD">/AUTOSAR_ComM/CompuMethods/ComM_ModeTypeValues</COMPU-METHOD-REF>
                    <IMPLEMENTATION-DATA-TYPE-REF DEST="IMPLEMENTATION-DATA-TYPE">/AUTOSAR_Platform/ImplementationDataTypes/uint8</IMPLEMENTATION-DATA-TYPE-REF>
                  </SW-DATA-DEF-PROPS-CONDITIONAL>
                </SW-DATA-DEF-PROPS-VARIANTS>
              </SW-DATA-DEF-PROPS>
            </IMPLEMENTATION-DATA-TYPE>
            <IMPLEMENTATION-DATA-TYPE>
              <SHORT-NAME>ComM_UserHandleType</SHORT-NAME>
              <CATEGORY>TYPE_REFERENCE</CATEGORY>
              <SW-DATA-DEF-PROPS>
                <SW-DATA-DEF-PROPS-VARIANTS>
                  <SW-DATA-DEF-PROPS-CONDITIONAL>
                    <IMPLEMENTATION-DATA-TYPE-REF DEST="IMPLEMENTATION-DATA-TYPE">/AUTOSAR_Platform/ImplementationDataTypes/uint8</IMPLEMENTATION-DATA-TYPE-REF>
                  </SW-DATA-DEF-PROPS-CONDITIONAL>
                </SW-DATA-DEF-PROPS-VARIANTS>
              </SW-DATA-DEF-PROPS>
            </IMPLEMENTATION-DATA-TYPE>
            <IMPLEMENTATION-DATA-TYPE>
              <SHORT-NAME>ComM_InhibitionStatusType</SHORT-NAME>
              <CATEGORY>TYPE_REFERENCE</CATEGORY>
              <SW-DATA-DEF-PROPS>
                <SW-DATA-DEF-PROPS-VARIANTS>
                  <SW-DATA-DEF-PROPS-CONDITIONAL>
                    <IMPLEMENTATION-DATA-TYPE-REF DEST="IMPLEMENTATION-DATA-TYPE">/AUTOSAR_Platform/ImplementationDataTypes/uint8</IMPLEMENTATION-DATA-TYPE-REF>
                  </SW-DATA-DEF-PROPS-CONDITIONAL>
                </SW-DATA-DEF-PROPS-VARIANTS>
              </SW-DATA-DEF-PROPS>
            </IMPLEMENTATION-DATA-TYPE>
            <IMPLEMENTATION-DATA-TYPE>
              <!-- !LINKSTO ComM.ASR403.SWS_ComM_00906,1 -->
              <SHORT-NAME>ComM_UserHandleArrayType</SHORT-NAME>
              <CATEGORY>STRUCTURE</CATEGORY>
              <SUB-ELEMENTS>
                <IMPLEMENTATION-DATA-TYPE-ELEMENT>
                  <SHORT-NAME>numberOfRequesters</SHORT-NAME>
                  <CATEGORY>TYPE_REFERENCE</CATEGORY>
                  <SW-DATA-DEF-PROPS>
                    <SW-DATA-DEF-PROPS-VARIANTS>
                      <SW-DATA-DEF-PROPS-CONDITIONAL>
                        <IMPLEMENTATION-DATA-TYPE-REF DEST="IMPLEMENTATION-DATA-TYPE">/AUTOSAR_Platform/ImplementationDataTypes/uint8</IMPLEMENTATION-DATA-TYPE-REF>
                      </SW-DATA-DEF-PROPS-CONDITIONAL>
                    </SW-DATA-DEF-PROPS-VARIANTS>
                  </SW-DATA-DEF-PROPS>
                </IMPLEMENTATION-DATA-TYPE-ELEMENT>
                <IMPLEMENTATION-DATA-TYPE-ELEMENT>
                  <SHORT-NAME>handleArray</SHORT-NAME>
                  <CATEGORY>TYPE_REFERENCE</CATEGORY>
                  <SW-DATA-DEF-PROPS>
                    <SW-DATA-DEF-PROPS-VARIANTS>
                      <SW-DATA-DEF-PROPS-CONDITIONAL>
                        <IMPLEMENTATION-DATA-TYPE-REF DEST="IMPLEMENTATION-DATA-TYPE">/AUTOSAR_ComM/ImplementationDataTypes/ComM_InternalHandleArrayType</IMPLEMENTATION-DATA-TYPE-REF>
                      </SW-DATA-DEF-PROPS-CONDITIONAL>
                    </SW-DATA-DEF-PROPS-VARIANTS>
                  </SW-DATA-DEF-PROPS>
                </IMPLEMENTATION-DATA-TYPE-ELEMENT>
              </SUB-ELEMENTS>
            </IMPLEMENTATION-DATA-TYPE>
            <IMPLEMENTATION-DATA-TYPE>
              <!-- !LINKSTO ComM.EB.SWS_ComM_01005,1 -->
              <SHORT-NAME>ComM_InternalHandleArrayType</SHORT-NAME>
              <CATEGORY>ARRAY</CATEGORY>
              <SUB-ELEMENTS>
                <IMPLEMENTATION-DATA-TYPE-ELEMENT>
                  <SHORT-NAME>handleArrayElement</SHORT-NAME>
                  <CATEGORY>TYPE_REFERENCE</CATEGORY>
[!IF "$maxNumUsersPerChannel != 0"!]
                  <ARRAY-SIZE>[!"$maxNumUsersPerChannel"!]</ARRAY-SIZE>
[!ELSE!][!//
                  <ARRAY-SIZE>1</ARRAY-SIZE>
[!ENDIF!]
                  <ARRAY-SIZE-SEMANTICS>FIXED-SIZE</ARRAY-SIZE-SEMANTICS>
                  <SW-DATA-DEF-PROPS>
                    <SW-DATA-DEF-PROPS-VARIANTS>
                      <SW-DATA-DEF-PROPS-CONDITIONAL>
                        <IMPLEMENTATION-DATA-TYPE-REF DEST="IMPLEMENTATION-DATA-TYPE">/AUTOSAR_ComM/ImplementationDataTypes/ComM_UserHandleType</IMPLEMENTATION-DATA-TYPE-REF>
                      </SW-DATA-DEF-PROPS-CONDITIONAL>
                    </SW-DATA-DEF-PROPS-VARIANTS>
                  </SW-DATA-DEF-PROPS>
                </IMPLEMENTATION-DATA-TYPE-ELEMENT>
              </SUB-ELEMENTS>
            </IMPLEMENTATION-DATA-TYPE>
          </ELEMENTS>
        </AR-PACKAGE>
        <AR-PACKAGE> <!-- ConstantSpecifications -->
          <SHORT-NAME>ConstantSpecifications</SHORT-NAME>
          <ELEMENTS>
            <CONSTANT-SPECIFICATION>
              <SHORT-NAME>ComM_InitConst_UserHandleArray</SHORT-NAME>
              <VALUE-SPEC>
                <RECORD-VALUE-SPECIFICATION>
                  <FIELDS>
                    <NUMERICAL-VALUE-SPECIFICATION>
                      <VALUE>0</VALUE>
                    </NUMERICAL-VALUE-SPECIFICATION>
                    <ARRAY-VALUE-SPECIFICATION>
                      <ELEMENTS>
[!IF "$maxNumUsersPerChannel != 0"!]
[!FOR "i" = "0" TO "$maxNumUsersPerChannel - 1"!]
                        <NUMERICAL-VALUE-SPECIFICATION>
                          <VALUE>0</VALUE>
                        </NUMERICAL-VALUE-SPECIFICATION>
[!ENDFOR!]
[!ELSE!][!//
                        <NUMERICAL-VALUE-SPECIFICATION>
                          <VALUE>0</VALUE>
                        </NUMERICAL-VALUE-SPECIFICATION>
[!ENDIF!]
                      </ELEMENTS>
                    </ARRAY-VALUE-SPECIFICATION>
                  </FIELDS>
                </RECORD-VALUE-SPECIFICATION>
              </VALUE-SPEC>
            </CONSTANT-SPECIFICATION>
          </ELEMENTS>
        </AR-PACKAGE>
        <AR-PACKAGE> <!-- ModeDeclarationGroups -->
          <SHORT-NAME>ModeDeclarationGroups</SHORT-NAME>
          <ELEMENTS>
            <MODE-DECLARATION-GROUP>
              <SHORT-NAME>ComMMode</SHORT-NAME>
<!-- !LINKSTO ComM.EB.ModeDeclarationGroup.ComMDefineOrder,1 -->
[!IF "node:exists(ComMGeneral/ComMDefineOrder) and (ComMGeneral/ComMDefineOrder = 'ALPHABETIC_ORDER')"!][!//
              <CATEGORY>ALPHABETIC_ORDER</CATEGORY>
              <INITIAL-MODE-REF DEST="MODE-DECLARATION">/AUTOSAR_ComM/ModeDeclarationGroups/ComMMode/COMM_NO_COMMUNICATION</INITIAL-MODE-REF>
              <MODE-DECLARATIONS>
                <MODE-DECLARATION>
                  <SHORT-NAME>COMM_FULL_COMMUNICATION</SHORT-NAME>
                </MODE-DECLARATION>
                <MODE-DECLARATION>
                  <SHORT-NAME>COMM_NO_COMMUNICATION</SHORT-NAME>
                </MODE-DECLARATION>
                <MODE-DECLARATION>
                  <SHORT-NAME>COMM_SILENT_COMMUNICATION</SHORT-NAME>
                </MODE-DECLARATION>
              </MODE-DECLARATIONS>
            </MODE-DECLARATION-GROUP>
[!ELSE!][!//
              <CATEGORY>EXPLICIT_ORDER</CATEGORY>
              <INITIAL-MODE-REF DEST="MODE-DECLARATION">/AUTOSAR_ComM/ModeDeclarationGroups/ComMMode/COMM_NO_COMMUNICATION</INITIAL-MODE-REF>
              <MODE-DECLARATIONS>
                <MODE-DECLARATION>
                  <SHORT-NAME>COMM_NO_COMMUNICATION</SHORT-NAME>
                  <VALUE>0</VALUE>
                </MODE-DECLARATION>
                <MODE-DECLARATION>
                  <SHORT-NAME>COMM_SILENT_COMMUNICATION</SHORT-NAME>
                  <VALUE>1</VALUE>
                </MODE-DECLARATION>
                <MODE-DECLARATION>
                  <SHORT-NAME>COMM_FULL_COMMUNICATION</SHORT-NAME>
                  <VALUE>2</VALUE>
                </MODE-DECLARATION>
              </MODE-DECLARATIONS>
              <ON-TRANSITION-VALUE>3</ON-TRANSITION-VALUE>
            </MODE-DECLARATION-GROUP>
[!ENDIF!][!//
          </ELEMENTS>
        </AR-PACKAGE>
        <AR-PACKAGE> <!-- CompuMethods -->
          <SHORT-NAME>CompuMethods</SHORT-NAME>
          <ELEMENTS>
            <COMPU-METHOD>
              <!-- !LINKSTO ComM.SWS_ComM_00672,1 -->
              <SHORT-NAME>ComM_ModeTypeValues</SHORT-NAME>
              <CATEGORY>TEXTTABLE</CATEGORY>
              <COMPU-INTERNAL-TO-PHYS>
                <COMPU-SCALES>
                  <COMPU-SCALE>
                    <LOWER-LIMIT INTERVAL-TYPE="CLOSED">0</LOWER-LIMIT>
                    <UPPER-LIMIT INTERVAL-TYPE="CLOSED">0</UPPER-LIMIT>
                    <COMPU-CONST>
                      <VT>COMM_NO_COMMUNICATION</VT>
                    </COMPU-CONST>
                  </COMPU-SCALE>
                  <COMPU-SCALE>
                    <LOWER-LIMIT INTERVAL-TYPE="CLOSED">1</LOWER-LIMIT>
                    <UPPER-LIMIT INTERVAL-TYPE="CLOSED">1</UPPER-LIMIT>
                    <COMPU-CONST>
                      <VT>COMM_SILENT_COMMUNICATION</VT>
                    </COMPU-CONST>
                  </COMPU-SCALE>
                  <COMPU-SCALE>
                    <LOWER-LIMIT INTERVAL-TYPE="CLOSED">2</LOWER-LIMIT>
                    <UPPER-LIMIT INTERVAL-TYPE="CLOSED">2</UPPER-LIMIT>
                    <COMPU-CONST>
                      <VT>COMM_FULL_COMMUNICATION</VT>
                    </COMPU-CONST>
                  </COMPU-SCALE>
[!IF "num:i(count(as:modconf('ComM')[1]/ComMConfigSet/*[1]/ComMChannel/*[node:exists(ComMWakeupSleepRequestEnabled) and (ComMWakeupSleepRequestEnabled = 'true') ])) != 0"!]
                  <COMPU-SCALE>
                    <LOWER-LIMIT INTERVAL-TYPE="CLOSED">3</LOWER-LIMIT>
                    <UPPER-LIMIT INTERVAL-TYPE="CLOSED">3</UPPER-LIMIT>
                    <COMPU-CONST>
                      <VT>COMM_FULL_COMMUNICATION_WITH_WAKEUP_REQUEST</VT>
                    </COMPU-CONST>
                  </COMPU-SCALE>
[!ENDIF!] [!/*[!IF "num:i(count(as:modconf('ComM')[1]/ComMConfigSet/*[1]/ComMChannel/*[node:exists(ComMWakeupSleepRequestEnabled) and (ComMWakeupSleepRequestEnabled = 'true') ])) != 0"!] */!]
                </COMPU-SCALES>
              </COMPU-INTERNAL-TO-PHYS>
            </COMPU-METHOD>
          </ELEMENTS>
        </AR-PACKAGE>
        <AR-PACKAGE> <!-- DataTypeMappingSets -->
          <SHORT-NAME>DataTypeMappingSets</SHORT-NAME>
          <ELEMENTS>
            <DATA-TYPE-MAPPING-SET>
              <SHORT-NAME>DataTypeMappingSet_0</SHORT-NAME>
              <MODE-REQUEST-TYPE-MAPS>
                <MODE-REQUEST-TYPE-MAP>
                  <IMPLEMENTATION-DATA-TYPE-REF DEST="IMPLEMENTATION-DATA-TYPE">/AUTOSAR_Platform/ImplementationDataTypes/uint8</IMPLEMENTATION-DATA-TYPE-REF>
                  <MODE-GROUP-REF DEST="MODE-DECLARATION-GROUP">/AUTOSAR_ComM/ModeDeclarationGroups/ComMMode</MODE-GROUP-REF>
                </MODE-REQUEST-TYPE-MAP>
              </MODE-REQUEST-TYPE-MAPS>
            </DATA-TYPE-MAPPING-SET>
          </ELEMENTS>
        </AR-PACKAGE>
        <AR-PACKAGE> <!-- PortInterfaces -->
          <SHORT-NAME>PortInterfaces</SHORT-NAME>
          <ELEMENTS>
            <!-- Interface ComM_CurrentMode -->
            <!-- !LINKSTO ComM.SWS_ComM_01001,1 -->
            <MODE-SWITCH-INTERFACE>
              <SHORT-NAME>ComM_CurrentMode</SHORT-NAME>
              <IS-SERVICE>true</IS-SERVICE>
              <MODE-GROUP>
                <SHORT-NAME>currentMode</SHORT-NAME>
                <TYPE-TREF DEST="MODE-DECLARATION-GROUP">/AUTOSAR_ComM/ModeDeclarationGroups/ComMMode</TYPE-TREF>
              </MODE-GROUP>
            </MODE-SWITCH-INTERFACE>

            <!-- Interface ComM_UserRequest -->
            <CLIENT-SERVER-INTERFACE>
              <SHORT-NAME>ComM_UserRequest</SHORT-NAME>
              <IS-SERVICE>true</IS-SERVICE>
              <OPERATIONS>
                <!-- Operation RequestComMode -->
                <!-- !LINKSTO ComM.EB_Ref.SWS_ComM_01000.Operation.RequestComMode,1 -->
                <CLIENT-SERVER-OPERATION>
                  <SHORT-NAME>RequestComMode</SHORT-NAME>
                  <ARGUMENTS>
                    <ARGUMENT-DATA-PROTOTYPE>
                      <SHORT-NAME>ComMode</SHORT-NAME>
                      <TYPE-TREF DEST="IMPLEMENTATION-DATA-TYPE">/AUTOSAR_ComM/ImplementationDataTypes/ComM_ModeType</TYPE-TREF>
                      <DIRECTION>IN</DIRECTION>
                    </ARGUMENT-DATA-PROTOTYPE>
                  </ARGUMENTS>
                  <POSSIBLE-ERROR-REFS>
                    <POSSIBLE-ERROR-REF DEST="APPLICATION-ERROR">/AUTOSAR_ComM/PortInterfaces/ComM_UserRequest/E_NOT_OK</POSSIBLE-ERROR-REF>
                    <POSSIBLE-ERROR-REF DEST="APPLICATION-ERROR">/AUTOSAR_ComM/PortInterfaces/ComM_UserRequest/E_MODE_LIMITATION</POSSIBLE-ERROR-REF>
                  </POSSIBLE-ERROR-REFS>
                </CLIENT-SERVER-OPERATION>

                <!-- Operation GetCurrentComMode -->
                <!-- !LINKSTO ComM.EB_Ref.SWS_ComM_01000.Operation.GetCurrentComMode,1 -->
                <CLIENT-SERVER-OPERATION>
                  <SHORT-NAME>GetCurrentComMode</SHORT-NAME>
                  <ARGUMENTS>
                    <ARGUMENT-DATA-PROTOTYPE>
                      <SHORT-NAME>ComMode</SHORT-NAME>
                      <TYPE-TREF DEST="IMPLEMENTATION-DATA-TYPE">/AUTOSAR_ComM/ImplementationDataTypes/ComM_ModeType</TYPE-TREF>
                      <DIRECTION>OUT</DIRECTION>
                    </ARGUMENT-DATA-PROTOTYPE>
                  </ARGUMENTS>
                  <POSSIBLE-ERROR-REFS>
                    <POSSIBLE-ERROR-REF DEST="APPLICATION-ERROR">/AUTOSAR_ComM/PortInterfaces/ComM_UserRequest/E_NOT_OK</POSSIBLE-ERROR-REF>
                  </POSSIBLE-ERROR-REFS>
                </CLIENT-SERVER-OPERATION>
[!IF "as:modconf('ComM')[1]/ComMGeneral/ComMEnableGetCurrentPNCComMode = 'true'"!]
                <!-- Operation GetCurrentPNCComMode -->
                <!-- !LINKSTO ComM.EB_Ref.SWS_ComM_01000.Operation.GetCurrentPNCComMode,1 -->
                <CLIENT-SERVER-OPERATION>
                  <SHORT-NAME>GetCurrentPNCComMode</SHORT-NAME>
                  <ARGUMENTS>
                    <ARGUMENT-DATA-PROTOTYPE>
                      <SHORT-NAME>ComMode</SHORT-NAME>
                      <TYPE-TREF DEST="IMPLEMENTATION-DATA-TYPE">/AUTOSAR_ComM/ImplementationDataTypes/ComM_ModeType</TYPE-TREF>
                      <DIRECTION>OUT</DIRECTION>
                    </ARGUMENT-DATA-PROTOTYPE>
                  </ARGUMENTS>
                  <POSSIBLE-ERROR-REFS>
                    <POSSIBLE-ERROR-REF DEST="APPLICATION-ERROR">/AUTOSAR_ComM/PortInterfaces/ComM_UserRequest/E_NOT_OK</POSSIBLE-ERROR-REF>
                    <POSSIBLE-ERROR-REF DEST="APPLICATION-ERROR">/AUTOSAR_ComM/PortInterfaces/ComM_UserRequest/E_MULTIPLE_PNC_ASSIGNED</POSSIBLE-ERROR-REF>
                    <POSSIBLE-ERROR-REF DEST="APPLICATION-ERROR">/AUTOSAR_ComM/PortInterfaces/ComM_UserRequest/E_NO_PNC_ASSIGNED</POSSIBLE-ERROR-REF>
                  </POSSIBLE-ERROR-REFS>
                </CLIENT-SERVER-OPERATION>
[!ENDIF!]
                <!-- Operation GetMaxComMode -->
                <!-- !LINKSTO ComM.EB_Ref.SWS_ComM_01000.Operation.GetMaxComMode,1 -->
                <CLIENT-SERVER-OPERATION>
                  <SHORT-NAME>GetMaxComMode</SHORT-NAME>
                  <ARGUMENTS>
                    <ARGUMENT-DATA-PROTOTYPE>
                      <SHORT-NAME>ComMode</SHORT-NAME>
                      <TYPE-TREF DEST="IMPLEMENTATION-DATA-TYPE">/AUTOSAR_ComM/ImplementationDataTypes/ComM_ModeType</TYPE-TREF>
                      <DIRECTION>OUT</DIRECTION>
                    </ARGUMENT-DATA-PROTOTYPE>
                  </ARGUMENTS>
                  <POSSIBLE-ERROR-REFS>
                    <POSSIBLE-ERROR-REF DEST="APPLICATION-ERROR">/AUTOSAR_ComM/PortInterfaces/ComM_UserRequest/E_NOT_OK</POSSIBLE-ERROR-REF>
                  </POSSIBLE-ERROR-REFS>
                </CLIENT-SERVER-OPERATION>
                <!-- Operation GetRequestedComMode -->
                <!-- !LINKSTO ComM.EB_Ref.SWS_ComM_01000.Operation.GetRequestedComMode,1 -->
                <CLIENT-SERVER-OPERATION>
                  <SHORT-NAME>GetRequestedComMode</SHORT-NAME>
                  <ARGUMENTS>
                    <ARGUMENT-DATA-PROTOTYPE>
                      <SHORT-NAME>ComMode</SHORT-NAME>
                      <TYPE-TREF DEST="IMPLEMENTATION-DATA-TYPE">/AUTOSAR_ComM/ImplementationDataTypes/ComM_ModeType</TYPE-TREF>
                      <DIRECTION>OUT</DIRECTION>
                    </ARGUMENT-DATA-PROTOTYPE>
                  </ARGUMENTS>
                  <POSSIBLE-ERROR-REFS>
                    <POSSIBLE-ERROR-REF DEST="APPLICATION-ERROR">/AUTOSAR_ComM/PortInterfaces/ComM_UserRequest/E_NOT_OK</POSSIBLE-ERROR-REF>
                  </POSSIBLE-ERROR-REFS>
                </CLIENT-SERVER-OPERATION>
              </OPERATIONS>
              <!-- Possible Errors -->
              <POSSIBLE-ERRORS>
                <APPLICATION-ERROR>
                  <SHORT-NAME>E_NOT_OK</SHORT-NAME>
                  <ERROR-CODE>1</ERROR-CODE>
                </APPLICATION-ERROR>
                <APPLICATION-ERROR>
                  <SHORT-NAME>E_MODE_LIMITATION</SHORT-NAME>
                  <ERROR-CODE>2</ERROR-CODE>
                </APPLICATION-ERROR>
[!IF "as:modconf('ComM')[1]/ComMGeneral/ComMEnableGetCurrentPNCComMode = 'true'"!]
                <APPLICATION-ERROR>
                  <SHORT-NAME>E_MULTIPLE_PNC_ASSIGNED</SHORT-NAME>
                  <ERROR-CODE>3</ERROR-CODE>
                </APPLICATION-ERROR>
                <APPLICATION-ERROR>
                  <SHORT-NAME>E_NO_PNC_ASSIGNED</SHORT-NAME>
                  <ERROR-CODE>4</ERROR-CODE>
                </APPLICATION-ERROR>
[!ENDIF!]
              </POSSIBLE-ERRORS>
            </CLIENT-SERVER-INTERFACE>
            <!-- Interface ComM_CurrentChannelRequest -->
            <SENDER-RECEIVER-INTERFACE>
              <SHORT-NAME>ComM_CurrentChannelRequest</SHORT-NAME>
              <IS-SERVICE>true</IS-SERVICE>
              <DATA-ELEMENTS>
                <VARIABLE-DATA-PROTOTYPE>
                   <!-- !LINKSTO ComM.EB.SWS_ComM_00904,1 -->
                  <SHORT-NAME>fullComRequestors</SHORT-NAME>
                  <SW-DATA-DEF-PROPS>
                    <SW-DATA-DEF-PROPS-VARIANTS>
                      <SW-DATA-DEF-PROPS-CONDITIONAL>
                        <SW-IMPL-POLICY>STANDARD</SW-IMPL-POLICY>
                      </SW-DATA-DEF-PROPS-CONDITIONAL>
                    </SW-DATA-DEF-PROPS-VARIANTS>
                  </SW-DATA-DEF-PROPS>
                  <TYPE-TREF DEST="IMPLEMENTATION-DATA-TYPE">/AUTOSAR_ComM/ImplementationDataTypes/ComM_UserHandleArrayType</TYPE-TREF>
                </VARIABLE-DATA-PROTOTYPE>
              </DATA-ELEMENTS>
            </SENDER-RECEIVER-INTERFACE>
            <!-- Interface ComM_ECUModeLimitation -->
            <!-- !LINKSTO ComM.SWS_ComM_00740,1, ComM.SWS_ComM_00741,1, ComM.SWS_ComM_00744,1 -->
            <CLIENT-SERVER-INTERFACE>
              <SHORT-NAME>ComM_ECUModeLimitation</SHORT-NAME>
              <IS-SERVICE>true</IS-SERVICE>
              <OPERATIONS>
                <!-- Operation LimitECUToNoComMode -->
                <CLIENT-SERVER-OPERATION>
                  <SHORT-NAME>LimitECUToNoComMode</SHORT-NAME>
                  <ARGUMENTS>
                    <ARGUMENT-DATA-PROTOTYPE>
                      <SHORT-NAME>Status</SHORT-NAME>
                      <TYPE-TREF DEST="IMPLEMENTATION-DATA-TYPE">/AUTOSAR_Platform/ImplementationDataTypes/boolean</TYPE-TREF>
                      <DIRECTION>IN</DIRECTION>
                    </ARGUMENT-DATA-PROTOTYPE>
                  </ARGUMENTS>
                  <POSSIBLE-ERROR-REFS>
                    <POSSIBLE-ERROR-REF DEST="APPLICATION-ERROR">/AUTOSAR_ComM/PortInterfaces/ComM_ECUModeLimitation/E_NOT_OK</POSSIBLE-ERROR-REF>
                  </POSSIBLE-ERROR-REFS>
                </CLIENT-SERVER-OPERATION>
                <!-- Operation ReadInhibitCounter -->
                <CLIENT-SERVER-OPERATION>
                  <SHORT-NAME>ReadInhibitCounter</SHORT-NAME>
                  <ARGUMENTS>
                    <ARGUMENT-DATA-PROTOTYPE>
                      <SHORT-NAME>CounterValue</SHORT-NAME>
                      <TYPE-TREF DEST="IMPLEMENTATION-DATA-TYPE">/AUTOSAR_Platform/ImplementationDataTypes/uint16</TYPE-TREF>
                      <DIRECTION>OUT</DIRECTION>
                    </ARGUMENT-DATA-PROTOTYPE>
                  </ARGUMENTS>
                  <POSSIBLE-ERROR-REFS>
                    <POSSIBLE-ERROR-REF DEST="APPLICATION-ERROR">/AUTOSAR_ComM/PortInterfaces/ComM_ECUModeLimitation/E_NOT_OK</POSSIBLE-ERROR-REF>
                  </POSSIBLE-ERROR-REFS>
                </CLIENT-SERVER-OPERATION>
                <!-- Operation ResetInhibitCounter -->
                <CLIENT-SERVER-OPERATION>
                  <SHORT-NAME>ResetInhibitCounter</SHORT-NAME>
                  <ARGUMENTS/>
                  <POSSIBLE-ERROR-REFS>
                    <POSSIBLE-ERROR-REF DEST="APPLICATION-ERROR">/AUTOSAR_ComM/PortInterfaces/ComM_ECUModeLimitation/E_NOT_OK</POSSIBLE-ERROR-REF>
                  </POSSIBLE-ERROR-REFS>
                </CLIENT-SERVER-OPERATION>
                <!-- Operation SetECUGroupClassification -->
                <CLIENT-SERVER-OPERATION>
                  <SHORT-NAME>SetECUGroupClassification</SHORT-NAME>
                  <ARGUMENTS>
                    <ARGUMENT-DATA-PROTOTYPE>
                      <SHORT-NAME>Status</SHORT-NAME>
                      <TYPE-TREF DEST="IMPLEMENTATION-DATA-TYPE">/AUTOSAR_ComM/ImplementationDataTypes/ComM_InhibitionStatusType</TYPE-TREF>
                      <DIRECTION>IN</DIRECTION>
                    </ARGUMENT-DATA-PROTOTYPE>
                  </ARGUMENTS>
                  <POSSIBLE-ERROR-REFS>
                    <POSSIBLE-ERROR-REF DEST="APPLICATION-ERROR">/AUTOSAR_ComM/PortInterfaces/ComM_ECUModeLimitation/E_NOT_OK</POSSIBLE-ERROR-REF>
                  </POSSIBLE-ERROR-REFS>
                </CLIENT-SERVER-OPERATION>
              </OPERATIONS>
              <!-- Possible Errors -->
              <POSSIBLE-ERRORS>
                <APPLICATION-ERROR>
                  <SHORT-NAME>E_NOT_OK</SHORT-NAME>
                  <ERROR-CODE>1</ERROR-CODE>
                </APPLICATION-ERROR>
              </POSSIBLE-ERRORS>
            </CLIENT-SERVER-INTERFACE>

            <!-- Interface ComM_ChannelLimitation -->
            <!-- !LINKSTO ComM.SWS_ComM_00752,1, ComM.SWS_ComM_00743,1, ComM.SWS_ComM_00744,1 -->
            <CLIENT-SERVER-INTERFACE>
              <SHORT-NAME>ComM_ChannelLimitation</SHORT-NAME>
              <IS-SERVICE>true</IS-SERVICE>
              <OPERATIONS>
                <!-- Operation LimitChannelToNoComMode -->
                <CLIENT-SERVER-OPERATION>
                  <SHORT-NAME>LimitChannelToNoComMode</SHORT-NAME>
                  <ARGUMENTS>
                    <ARGUMENT-DATA-PROTOTYPE>
                      <SHORT-NAME>Status</SHORT-NAME>
                      <TYPE-TREF DEST="IMPLEMENTATION-DATA-TYPE">/AUTOSAR_Platform/ImplementationDataTypes/boolean</TYPE-TREF>
                      <DIRECTION>IN</DIRECTION>
                    </ARGUMENT-DATA-PROTOTYPE>
                  </ARGUMENTS>
                  <POSSIBLE-ERROR-REFS>
                    <POSSIBLE-ERROR-REF DEST="APPLICATION-ERROR">/AUTOSAR_ComM/PortInterfaces/ComM_ChannelLimitation/E_NOT_OK</POSSIBLE-ERROR-REF>
                  </POSSIBLE-ERROR-REFS>
                </CLIENT-SERVER-OPERATION>
                <!-- Operation GetInhibitionStatus -->
                <CLIENT-SERVER-OPERATION>
                  <SHORT-NAME>GetInhibitionStatus</SHORT-NAME>
                  <ARGUMENTS>
                    <ARGUMENT-DATA-PROTOTYPE>
                      <SHORT-NAME>Status</SHORT-NAME>
                      <TYPE-TREF DEST="IMPLEMENTATION-DATA-TYPE">/AUTOSAR_ComM/ImplementationDataTypes/ComM_InhibitionStatusType</TYPE-TREF>
                      <DIRECTION>OUT</DIRECTION>
                    </ARGUMENT-DATA-PROTOTYPE>
                  </ARGUMENTS>
                  <POSSIBLE-ERROR-REFS>
                    <POSSIBLE-ERROR-REF DEST="APPLICATION-ERROR">/AUTOSAR_ComM/PortInterfaces/ComM_ChannelLimitation/E_NOT_OK</POSSIBLE-ERROR-REF>
                  </POSSIBLE-ERROR-REFS>
                </CLIENT-SERVER-OPERATION>
              </OPERATIONS>
              <POSSIBLE-ERRORS>
                <APPLICATION-ERROR>
                  <SHORT-NAME>E_NOT_OK</SHORT-NAME>
                  <ERROR-CODE>1</ERROR-CODE>
                </APPLICATION-ERROR>
              </POSSIBLE-ERRORS>
            </CLIENT-SERVER-INTERFACE>

            <!-- Interface ComM_ChannelWakeup -->
            <!-- !LINKSTO ComM.SWS_ComM_00747,1, ComM.SWS_ComM_00742,1, ComM.SWS_ComM_00744,1 -->
            <CLIENT-SERVER-INTERFACE>
              <SHORT-NAME>ComM_ChannelWakeup</SHORT-NAME>
              <IS-SERVICE>true</IS-SERVICE>
              <OPERATIONS>
                <CLIENT-SERVER-OPERATION>
                  <SHORT-NAME>PreventWakeUp</SHORT-NAME>
                  <ARGUMENTS>
                    <ARGUMENT-DATA-PROTOTYPE>
                      <SHORT-NAME>Status</SHORT-NAME>
                      <TYPE-TREF DEST="IMPLEMENTATION-DATA-TYPE">/AUTOSAR_Platform/ImplementationDataTypes/boolean</TYPE-TREF>
                      <DIRECTION>IN</DIRECTION>
                    </ARGUMENT-DATA-PROTOTYPE>
                  </ARGUMENTS>
                  <POSSIBLE-ERROR-REFS>
                    <POSSIBLE-ERROR-REF DEST="APPLICATION-ERROR">/AUTOSAR_ComM/PortInterfaces/ComM_ChannelWakeup/E_NOT_OK</POSSIBLE-ERROR-REF>
                  </POSSIBLE-ERROR-REFS>
                </CLIENT-SERVER-OPERATION>
                <!-- Operation GetInhibitionStatus -->
                <CLIENT-SERVER-OPERATION>
                  <SHORT-NAME>GetInhibitionStatus</SHORT-NAME>
                  <ARGUMENTS>
                    <ARGUMENT-DATA-PROTOTYPE>
                      <SHORT-NAME>Status</SHORT-NAME>
                      <TYPE-TREF DEST="IMPLEMENTATION-DATA-TYPE">/AUTOSAR_ComM/ImplementationDataTypes/ComM_InhibitionStatusType</TYPE-TREF>
                      <DIRECTION>OUT</DIRECTION>
                    </ARGUMENT-DATA-PROTOTYPE>
                  </ARGUMENTS>
                  <POSSIBLE-ERROR-REFS>
                    <POSSIBLE-ERROR-REF DEST="APPLICATION-ERROR">/AUTOSAR_ComM/PortInterfaces/ComM_ChannelWakeup/E_NOT_OK</POSSIBLE-ERROR-REF>
                  </POSSIBLE-ERROR-REFS>
                </CLIENT-SERVER-OPERATION>
              </OPERATIONS>
              <POSSIBLE-ERRORS>
                <APPLICATION-ERROR>
                  <SHORT-NAME>E_NOT_OK</SHORT-NAME>
                  <ERROR-CODE>1</ERROR-CODE>
                </APPLICATION-ERROR>
              </POSSIBLE-ERRORS>
            </CLIENT-SERVER-INTERFACE>
          </ELEMENTS>
        </AR-PACKAGE>
      </AR-PACKAGES>
    </AR-PACKAGE>
  </AR-PACKAGES>
[!ELSE!] [!/*[!IF "(count(text:split($FoundUserPlusChannePlusMasterPncPlusInhibitionOsApplications,' ')) > 1) and (as:modconf('ComM')[1]/ComMGeneral/ComMMultiCoreSupport = 'false')"!]*/!]
  <AR-PACKAGES>
    <AR-PACKAGE>
      <SHORT-NAME>AUTOSAR_ComM</SHORT-NAME>
      <ELEMENTS/>
      <AR-PACKAGES>
[!IF "ComMGeneral/ComMServiceAPI/ComMEnableASR32ServiceAPI = 'true'"!]
        <!-- Provide AUTOSAR 3.2 service interface -->
        <AR-PACKAGE> <!-- ASR32 -->
          <SHORT-NAME>ASR32</SHORT-NAME>
          <AR-PACKAGES>
            <AR-PACKAGE> <!-- ImplementationDataTypes -->
              <SHORT-NAME>ImplementationDataTypes</SHORT-NAME>
              <!--
                We do not use AUTOSAR 3.2.2 package name here for the sake of consistency, since for
                the SwServiceComponentType we _HAVE_ to use the AUTSOAR 4.0.3 package name unless 3.2.2
                has been selected as default (i.e., we _CANNOT_ replicate the SwServiceComponentType
                for each activated version (e.g., one for 3.2.2 and one for 4.0.3)
              -->
              <ELEMENTS>
                <!-- Type definitions -->
                <IMPLEMENTATION-DATA-TYPE>
                  <SHORT-NAME>ComM_ASR32_ModeType</SHORT-NAME>
                  <CATEGORY>TYPE_REFERENCE</CATEGORY>
                  <SW-DATA-DEF-PROPS>
                    <SW-DATA-DEF-PROPS-VARIANTS>
                      <SW-DATA-DEF-PROPS-CONDITIONAL>
                        <COMPU-METHOD-REF DEST="COMPU-METHOD">/AUTOSAR_ComM/ASR32/CompuMethods/ComM_ASR32_ModeTypeValues</COMPU-METHOD-REF>
                        <IMPLEMENTATION-DATA-TYPE-REF DEST="IMPLEMENTATION-DATA-TYPE">/AUTOSAR_Platform/ImplementationDataTypes/uint8</IMPLEMENTATION-DATA-TYPE-REF>
                      </SW-DATA-DEF-PROPS-CONDITIONAL>
                    </SW-DATA-DEF-PROPS-VARIANTS>
                  </SW-DATA-DEF-PROPS>
                </IMPLEMENTATION-DATA-TYPE>
                <IMPLEMENTATION-DATA-TYPE>
                  <SHORT-NAME>ComM_ASR32_UserHandleType</SHORT-NAME>
                  <CATEGORY>TYPE_REFERENCE</CATEGORY>
                  <SW-DATA-DEF-PROPS>
                    <SW-DATA-DEF-PROPS-VARIANTS>
                      <SW-DATA-DEF-PROPS-CONDITIONAL>
                        <IMPLEMENTATION-DATA-TYPE-REF DEST="IMPLEMENTATION-DATA-TYPE">/AUTOSAR_Platform/ImplementationDataTypes/uint8</IMPLEMENTATION-DATA-TYPE-REF>
                          <!--
                            We intentionally referring to AUTSOAR 4.0.3 uint8 type here - There is no need to replicate uint8 for AUTOSAR 3.2.2
                          -->
                      </SW-DATA-DEF-PROPS-CONDITIONAL>
                    </SW-DATA-DEF-PROPS-VARIANTS>
                  </SW-DATA-DEF-PROPS>
                </IMPLEMENTATION-DATA-TYPE>
                <IMPLEMENTATION-DATA-TYPE>
                  <SHORT-NAME>ComM_ASR32_InhibitionStatusType</SHORT-NAME>
                  <CATEGORY>TYPE_REFERENCE</CATEGORY>
                  <SW-DATA-DEF-PROPS>
                    <SW-DATA-DEF-PROPS-VARIANTS>
                      <SW-DATA-DEF-PROPS-CONDITIONAL>
                        <IMPLEMENTATION-DATA-TYPE-REF DEST="IMPLEMENTATION-DATA-TYPE">/AUTOSAR_Platform/ImplementationDataTypes/uint8</IMPLEMENTATION-DATA-TYPE-REF>
                          <!--
                            We intentionally referring to AUTSOAR 4.0.3 uint8 type here - There is no need to replicate uint8 for AUTOSAR 3.2.2
                          -->
                      </SW-DATA-DEF-PROPS-CONDITIONAL>
                    </SW-DATA-DEF-PROPS-VARIANTS>
                  </SW-DATA-DEF-PROPS>
                </IMPLEMENTATION-DATA-TYPE>
              </ELEMENTS>
            </AR-PACKAGE>
            <AR-PACKAGE> <!-- ConstantSpecifications -->
              <SHORT-NAME>ConstantSpecifications</SHORT-NAME>
              <ELEMENTS>
                <CONSTANT-SPECIFICATION>
                  <SHORT-NAME>ComM_ASR32_InitConst_UserHandleArray</SHORT-NAME>
                  <VALUE-SPEC>
                    <RECORD-VALUE-SPECIFICATION>
                      <FIELDS>
                        <NUMERICAL-VALUE-SPECIFICATION>
                          <VALUE>0</VALUE>
                        </NUMERICAL-VALUE-SPECIFICATION>
                        <ARRAY-VALUE-SPECIFICATION>
                          <ELEMENTS>
[!IF "$maxNumUsersPerChannel != 0"!]
[!FOR "i" = "0" TO "$maxNumUsersPerChannel - 1"!]
                            <NUMERICAL-VALUE-SPECIFICATION>
                              <VALUE>0</VALUE>
                            </NUMERICAL-VALUE-SPECIFICATION>
[!ENDFOR!]
[!ELSE!][!//
                            <NUMERICAL-VALUE-SPECIFICATION>
                              <VALUE>0</VALUE>
                            </NUMERICAL-VALUE-SPECIFICATION>
[!ENDIF!]
                          </ELEMENTS>
                        </ARRAY-VALUE-SPECIFICATION>
                      </FIELDS>
                    </RECORD-VALUE-SPECIFICATION>
                  </VALUE-SPEC>
                </CONSTANT-SPECIFICATION>
              </ELEMENTS>
            </AR-PACKAGE>
            <AR-PACKAGE> <!-- ModeDeclarationGroups -->
              <SHORT-NAME>ModeDeclarationGroups</SHORT-NAME>
              <ELEMENTS>
                <MODE-DECLARATION-GROUP>
                  <SHORT-NAME>ComM_ASR32_Mode</SHORT-NAME>
                  <CATEGORY>EXPLICIT_ORDER</CATEGORY>
                  <INITIAL-MODE-REF DEST="MODE-DECLARATION">/AUTOSAR_ComM/ASR32/ModeDeclarationGroups/ComM_ASR32_Mode/NO_COMMUNICATION</INITIAL-MODE-REF>
                  <MODE-DECLARATIONS>
                    <MODE-DECLARATION>
                      <SHORT-NAME>NO_COMMUNICATION</SHORT-NAME>
                      <VALUE>0</VALUE>
                    </MODE-DECLARATION>
                    <MODE-DECLARATION>
                      <SHORT-NAME>SILENT_COMMUNICATION</SHORT-NAME>
                      <VALUE>1</VALUE>
                    </MODE-DECLARATION>
                    <MODE-DECLARATION>
                      <SHORT-NAME>FULL_COMMUNICATION</SHORT-NAME>
                      <VALUE>2</VALUE>
                    </MODE-DECLARATION>
                  </MODE-DECLARATIONS>
                  <ON-TRANSITION-VALUE>3</ON-TRANSITION-VALUE>
                </MODE-DECLARATION-GROUP>
              </ELEMENTS>
            </AR-PACKAGE>
            <AR-PACKAGE> <!-- CompuMethods -->
              <SHORT-NAME>CompuMethods</SHORT-NAME>
              <ELEMENTS>
                <COMPU-METHOD>
                  <SHORT-NAME>ComM_ASR32_ModeTypeValues</SHORT-NAME>
                  <CATEGORY>TEXTTABLE</CATEGORY>
                  <COMPU-INTERNAL-TO-PHYS>
                    <COMPU-SCALES>
                      <COMPU-SCALE>
                        <LOWER-LIMIT INTERVAL-TYPE="CLOSED">0</LOWER-LIMIT>
                        <UPPER-LIMIT INTERVAL-TYPE="CLOSED">0</UPPER-LIMIT>
                        <COMPU-CONST>
                          <VT>NO_COMMUNICATION</VT>
                        </COMPU-CONST>
                      </COMPU-SCALE>
                      <COMPU-SCALE>
                        <LOWER-LIMIT INTERVAL-TYPE="CLOSED">1</LOWER-LIMIT>
                        <UPPER-LIMIT INTERVAL-TYPE="CLOSED">1</UPPER-LIMIT>
                        <COMPU-CONST>
                          <VT>SILENT_COMMUNICATION</VT>
                        </COMPU-CONST>
                      </COMPU-SCALE>
                      <COMPU-SCALE>
                        <LOWER-LIMIT INTERVAL-TYPE="CLOSED">2</LOWER-LIMIT>
                        <UPPER-LIMIT INTERVAL-TYPE="CLOSED">2</UPPER-LIMIT>
                        <COMPU-CONST>
                          <VT>FULL_COMMUNICATION</VT>
                        </COMPU-CONST>
                      </COMPU-SCALE>
                    </COMPU-SCALES>
                  </COMPU-INTERNAL-TO-PHYS>
                </COMPU-METHOD>
              </ELEMENTS>
            </AR-PACKAGE>
            <AR-PACKAGE> <!-- DataTypeMappingSets -->
              <SHORT-NAME>DataTypeMappingSets</SHORT-NAME>
              <ELEMENTS>
                <DATA-TYPE-MAPPING-SET>
                  <SHORT-NAME>ComM_ASR32_DataTypeMappingSet_0</SHORT-NAME>
                  <MODE-REQUEST-TYPE-MAPS>
                    <MODE-REQUEST-TYPE-MAP>
                      <IMPLEMENTATION-DATA-TYPE-REF DEST="IMPLEMENTATION-DATA-TYPE">/AUTOSAR_Platform/ImplementationDataTypes/uint8</IMPLEMENTATION-DATA-TYPE-REF>
                      <MODE-GROUP-REF DEST="MODE-DECLARATION-GROUP">/AUTOSAR_ComM/ASR32/ModeDeclarationGroups/ComM_ASR32_Mode</MODE-GROUP-REF>
                    </MODE-REQUEST-TYPE-MAP>
                  </MODE-REQUEST-TYPE-MAPS>
                </DATA-TYPE-MAPPING-SET>
              </ELEMENTS>
            </AR-PACKAGE>
            <AR-PACKAGE> <!-- PortInterfaces -->
              <SHORT-NAME>PortInterfaces</SHORT-NAME>
              <ELEMENTS>
                <!-- Interface ComM_CurrentMode -->
                <!-- !LINKSTO ComM.SWS_ComM_01001,1 -->
                <!-- !LINKSTO ComM.SWS_ComM_00847,1, ComM.SWS_ComM_00733,1 -->
                <MODE-SWITCH-INTERFACE>
                  <SHORT-NAME>ComM_ASR32_CurrentMode</SHORT-NAME>
                  <IS-SERVICE>true</IS-SERVICE>
                  <MODE-GROUP>
                    <SHORT-NAME>currentMode</SHORT-NAME>
                    <TYPE-TREF DEST="MODE-DECLARATION-GROUP">/AUTOSAR_ComM/ASR32/ModeDeclarationGroups/ComM_ASR32_Mode</TYPE-TREF>
                  </MODE-GROUP>
                </MODE-SWITCH-INTERFACE>

                <!-- Interface ComM_UserRequest -->
                <CLIENT-SERVER-INTERFACE>
                  <SHORT-NAME>ComM_ASR32_UserRequest</SHORT-NAME>
                  <IS-SERVICE>true</IS-SERVICE>
                  <OPERATIONS>
                    <!-- Operation RequestComMode -->
                    <!-- !LINKSTO ComM.EB_Ref.SWS_ComM_01000.Operation.RequestComMode,1 -->
                    <CLIENT-SERVER-OPERATION>
                      <SHORT-NAME>RequestComMode</SHORT-NAME>
                      <ARGUMENTS>
                        <ARGUMENT-DATA-PROTOTYPE>
                          <SHORT-NAME>ComMode</SHORT-NAME>
                          <TYPE-TREF DEST="IMPLEMENTATION-DATA-TYPE">/AUTOSAR_ComM/ASR32/ImplementationDataTypes/ComM_ASR32_ModeType</TYPE-TREF>
                          <DIRECTION>IN</DIRECTION>
                        </ARGUMENT-DATA-PROTOTYPE>
                      </ARGUMENTS>
                      <POSSIBLE-ERROR-REFS>
                        <POSSIBLE-ERROR-REF DEST="APPLICATION-ERROR">/AUTOSAR_ComM/ASR32/PortInterfaces/ComM_ASR32_UserRequest/E_NOT_OK</POSSIBLE-ERROR-REF>
                        <POSSIBLE-ERROR-REF DEST="APPLICATION-ERROR">/AUTOSAR_ComM/ASR32/PortInterfaces/ComM_ASR32_UserRequest/E_MODE_LIMITATION</POSSIBLE-ERROR-REF>
                      </POSSIBLE-ERROR-REFS>
                    </CLIENT-SERVER-OPERATION>

                    <!-- Operation GetCurrentComMode -->
                    <!-- !LINKSTO ComM.EB_Ref.SWS_ComM_01000.Operation.GetCurrentComMode,1 -->
                    <CLIENT-SERVER-OPERATION>
                      <SHORT-NAME>GetCurrentComMode</SHORT-NAME>
                      <ARGUMENTS>
                        <ARGUMENT-DATA-PROTOTYPE>
                          <SHORT-NAME>ComMode</SHORT-NAME>
                          <TYPE-TREF DEST="IMPLEMENTATION-DATA-TYPE">/AUTOSAR_ComM/ASR32/ImplementationDataTypes/ComM_ASR32_ModeType</TYPE-TREF>
                          <DIRECTION>OUT</DIRECTION>
                        </ARGUMENT-DATA-PROTOTYPE>
                      </ARGUMENTS>
                      <POSSIBLE-ERROR-REFS>
                        <POSSIBLE-ERROR-REF DEST="APPLICATION-ERROR">/AUTOSAR_ComM/ASR32/PortInterfaces/ComM_ASR32_UserRequest/E_NOT_OK</POSSIBLE-ERROR-REF>
                      </POSSIBLE-ERROR-REFS>
                    </CLIENT-SERVER-OPERATION>
                    <!-- Operation GetMaxComMode -->
                    <!-- !LINKSTO ComM.EB_Ref.SWS_ComM_01000.Operation.GetMaxComMode,1 -->
                    <CLIENT-SERVER-OPERATION>
                      <SHORT-NAME>GetMaxComMode</SHORT-NAME>
                      <ARGUMENTS>
                        <ARGUMENT-DATA-PROTOTYPE>
                          <SHORT-NAME>ComMode</SHORT-NAME>
                          <TYPE-TREF DEST="IMPLEMENTATION-DATA-TYPE">/AUTOSAR_ComM/ASR32/ImplementationDataTypes/ComM_ASR32_ModeType</TYPE-TREF>
                          <DIRECTION>OUT</DIRECTION>
                        </ARGUMENT-DATA-PROTOTYPE>
                      </ARGUMENTS>
                      <POSSIBLE-ERROR-REFS>
                        <POSSIBLE-ERROR-REF DEST="APPLICATION-ERROR">/AUTOSAR_ComM/ASR32/PortInterfaces/ComM_ASR32_UserRequest/E_NOT_OK</POSSIBLE-ERROR-REF>
                      </POSSIBLE-ERROR-REFS>
                    </CLIENT-SERVER-OPERATION>
                    <!-- Operation GetRequestedMode -->
                    <CLIENT-SERVER-OPERATION>
                      <SHORT-NAME>GetRequestedMode</SHORT-NAME>
                      <ARGUMENTS>
                        <ARGUMENT-DATA-PROTOTYPE>
                          <SHORT-NAME>ComMode</SHORT-NAME>
                          <TYPE-TREF DEST="IMPLEMENTATION-DATA-TYPE">/AUTOSAR_ComM/ASR32/ImplementationDataTypes/ComM_ASR32_ModeType</TYPE-TREF>
                          <DIRECTION>OUT</DIRECTION>
                        </ARGUMENT-DATA-PROTOTYPE>
                      </ARGUMENTS>
                      <POSSIBLE-ERROR-REFS>
                        <POSSIBLE-ERROR-REF DEST="APPLICATION-ERROR">/AUTOSAR_ComM/ASR32/PortInterfaces/ComM_ASR32_UserRequest/E_NOT_OK</POSSIBLE-ERROR-REF>
                      </POSSIBLE-ERROR-REFS>
                    </CLIENT-SERVER-OPERATION>
                  </OPERATIONS>
                  <!-- Possible Errors -->
                  <POSSIBLE-ERRORS>
                    <APPLICATION-ERROR>
                      <SHORT-NAME>E_NOT_OK</SHORT-NAME>
                      <ERROR-CODE>1</ERROR-CODE>
                    </APPLICATION-ERROR>
                    <APPLICATION-ERROR>
                      <SHORT-NAME>E_MODE_LIMITATION</SHORT-NAME>
                      <ERROR-CODE>2</ERROR-CODE>
                    </APPLICATION-ERROR>
                  </POSSIBLE-ERRORS>
                </CLIENT-SERVER-INTERFACE>

                <!-- Interface ComM_ECUModeLimitation -->
                <CLIENT-SERVER-INTERFACE>
                  <SHORT-NAME>ComM_ASR32_ECUModeLimitation</SHORT-NAME>
                  <IS-SERVICE>true</IS-SERVICE>
                  <OPERATIONS>
                    <!-- Operation LimitECUToNoComMode -->
                    <CLIENT-SERVER-OPERATION>
                      <SHORT-NAME>LimitECUToNoComMode</SHORT-NAME>
                      <ARGUMENTS>
                        <ARGUMENT-DATA-PROTOTYPE>
                          <SHORT-NAME>Status</SHORT-NAME>
                          <TYPE-TREF DEST="IMPLEMENTATION-DATA-TYPE">/AUTOSAR_Platform/ImplementationDataTypes/boolean</TYPE-TREF>
                          <DIRECTION>IN</DIRECTION>
                        </ARGUMENT-DATA-PROTOTYPE>
                      </ARGUMENTS>
                      <POSSIBLE-ERROR-REFS>
                        <POSSIBLE-ERROR-REF DEST="APPLICATION-ERROR">/AUTOSAR_ComM/ASR32/PortInterfaces/ComM_ASR32_ECUModeLimitation/E_NOT_OK</POSSIBLE-ERROR-REF>
                      </POSSIBLE-ERROR-REFS>
                    </CLIENT-SERVER-OPERATION>
                    <!-- Operation ReadInhibitCounter -->
                    <CLIENT-SERVER-OPERATION>
                      <SHORT-NAME>ReadInhibitCounter</SHORT-NAME>
                      <ARGUMENTS>
                        <ARGUMENT-DATA-PROTOTYPE>
                          <SHORT-NAME>CounterValue</SHORT-NAME>
                          <TYPE-TREF DEST="IMPLEMENTATION-DATA-TYPE">/AUTOSAR_Platform/ImplementationDataTypes/uint16</TYPE-TREF>
                          <DIRECTION>OUT</DIRECTION>
                        </ARGUMENT-DATA-PROTOTYPE>
                      </ARGUMENTS>
                      <POSSIBLE-ERROR-REFS>
                        <POSSIBLE-ERROR-REF DEST="APPLICATION-ERROR">/AUTOSAR_ComM/ASR32/PortInterfaces/ComM_ASR32_ECUModeLimitation/E_NOT_OK</POSSIBLE-ERROR-REF>
                      </POSSIBLE-ERROR-REFS>
                    </CLIENT-SERVER-OPERATION>
                    <!-- Operation ResetInhibitCounter -->
                    <CLIENT-SERVER-OPERATION>
                      <SHORT-NAME>ResetInhibitCounter</SHORT-NAME>
                      <ARGUMENTS/>
                      <POSSIBLE-ERROR-REFS>
                        <POSSIBLE-ERROR-REF DEST="APPLICATION-ERROR">/AUTOSAR_ComM/ASR32/PortInterfaces/ComM_ASR32_ECUModeLimitation/E_NOT_OK</POSSIBLE-ERROR-REF>
                      </POSSIBLE-ERROR-REFS>
                    </CLIENT-SERVER-OPERATION>
                    <!-- Operation SetECUGroupClassification -->
                    <CLIENT-SERVER-OPERATION>
                      <SHORT-NAME>SetECUGroupClassification</SHORT-NAME>
                      <ARGUMENTS>
                        <ARGUMENT-DATA-PROTOTYPE>
                          <SHORT-NAME>Status</SHORT-NAME>
                          <TYPE-TREF DEST="IMPLEMENTATION-DATA-TYPE">/AUTOSAR_ComM/ASR32/ImplementationDataTypes/ComM_ASR32_InhibitionStatusType</TYPE-TREF>
                          <DIRECTION>IN</DIRECTION>
                        </ARGUMENT-DATA-PROTOTYPE>
                      </ARGUMENTS>
                      <POSSIBLE-ERROR-REFS>
                        <POSSIBLE-ERROR-REF DEST="APPLICATION-ERROR">/AUTOSAR_ComM/ASR32/PortInterfaces/ComM_ASR32_ECUModeLimitation/E_NOT_OK</POSSIBLE-ERROR-REF>
                      </POSSIBLE-ERROR-REFS>
                    </CLIENT-SERVER-OPERATION>
                  </OPERATIONS>
                  <!-- Possible Errors -->
                  <POSSIBLE-ERRORS>
                    <APPLICATION-ERROR>
                      <SHORT-NAME>E_NOT_OK</SHORT-NAME>
                      <ERROR-CODE>1</ERROR-CODE>
                    </APPLICATION-ERROR>
                  </POSSIBLE-ERRORS>
                </CLIENT-SERVER-INTERFACE>

                <!-- Interface ComM_ChannelLimitation -->
                <CLIENT-SERVER-INTERFACE>
                  <SHORT-NAME>ComM_ASR32_ChannelLimitation</SHORT-NAME>
                  <IS-SERVICE>true</IS-SERVICE>
                  <OPERATIONS>
                    <!-- Operation LimitChannelToNoComMode -->
                    <CLIENT-SERVER-OPERATION>
                      <SHORT-NAME>LimitChannelToNoComMode</SHORT-NAME>
                      <ARGUMENTS>
                        <ARGUMENT-DATA-PROTOTYPE>
                          <SHORT-NAME>Status</SHORT-NAME>
                          <TYPE-TREF DEST="IMPLEMENTATION-DATA-TYPE">/AUTOSAR_Platform/ImplementationDataTypes/boolean</TYPE-TREF>
                          <DIRECTION>IN</DIRECTION>
                        </ARGUMENT-DATA-PROTOTYPE>
                      </ARGUMENTS>
                      <POSSIBLE-ERROR-REFS>
                        <POSSIBLE-ERROR-REF DEST="APPLICATION-ERROR">/AUTOSAR_ComM/ASR32/PortInterfaces/ComM_ASR32_ChannelLimitation/E_NOT_OK</POSSIBLE-ERROR-REF>
                      </POSSIBLE-ERROR-REFS>
                    </CLIENT-SERVER-OPERATION>
                    <!-- Operation GetInhibitionStatus -->
                    <CLIENT-SERVER-OPERATION>
                      <SHORT-NAME>GetInhibitionStatus</SHORT-NAME>
                      <ARGUMENTS>
                        <ARGUMENT-DATA-PROTOTYPE>
                          <SHORT-NAME>Status</SHORT-NAME>
                          <TYPE-TREF DEST="IMPLEMENTATION-DATA-TYPE">/AUTOSAR_ComM/ASR32/ImplementationDataTypes/ComM_ASR32_InhibitionStatusType</TYPE-TREF>
                          <DIRECTION>OUT</DIRECTION>
                        </ARGUMENT-DATA-PROTOTYPE>
                      </ARGUMENTS>
                      <POSSIBLE-ERROR-REFS>
                        <POSSIBLE-ERROR-REF DEST="APPLICATION-ERROR">/AUTOSAR_ComM/ASR32/PortInterfaces/ComM_ASR32_ChannelLimitation/E_NOT_OK</POSSIBLE-ERROR-REF>
                      </POSSIBLE-ERROR-REFS>
                    </CLIENT-SERVER-OPERATION>
                  </OPERATIONS>
                  <POSSIBLE-ERRORS>
                    <APPLICATION-ERROR>
                      <SHORT-NAME>E_NOT_OK</SHORT-NAME>
                      <ERROR-CODE>1</ERROR-CODE>
                    </APPLICATION-ERROR>
                  </POSSIBLE-ERRORS>
                </CLIENT-SERVER-INTERFACE>

                <!-- Interface ComM_ChannelWakeup -->
                <CLIENT-SERVER-INTERFACE>
                  <SHORT-NAME>ComM_ASR32_ChannelWakeup</SHORT-NAME>
                  <IS-SERVICE>true</IS-SERVICE>
                  <OPERATIONS>
                    <CLIENT-SERVER-OPERATION>
                      <SHORT-NAME>PreventWakeUp</SHORT-NAME>
                      <ARGUMENTS>
                        <ARGUMENT-DATA-PROTOTYPE>
                          <SHORT-NAME>Status</SHORT-NAME>
                          <TYPE-TREF DEST="IMPLEMENTATION-DATA-TYPE">/AUTOSAR_Platform/ImplementationDataTypes/boolean</TYPE-TREF>
                          <DIRECTION>IN</DIRECTION>
                        </ARGUMENT-DATA-PROTOTYPE>
                      </ARGUMENTS>
                      <POSSIBLE-ERROR-REFS>
                        <POSSIBLE-ERROR-REF DEST="APPLICATION-ERROR">/AUTOSAR_ComM/ASR32/PortInterfaces/ComM_ASR32_ChannelWakeup/E_NOT_OK</POSSIBLE-ERROR-REF>
                      </POSSIBLE-ERROR-REFS>
                    </CLIENT-SERVER-OPERATION>
                    <!-- Operation GetInhibitionStatus -->
                    <CLIENT-SERVER-OPERATION>
                      <SHORT-NAME>GetInhibitionStatus</SHORT-NAME>
                      <ARGUMENTS>
                        <ARGUMENT-DATA-PROTOTYPE>
                          <SHORT-NAME>Status</SHORT-NAME>
                          <TYPE-TREF DEST="IMPLEMENTATION-DATA-TYPE">/AUTOSAR_ComM/ASR32/ImplementationDataTypes/ComM_ASR32_InhibitionStatusType</TYPE-TREF>
                          <DIRECTION>OUT</DIRECTION>
                        </ARGUMENT-DATA-PROTOTYPE>
                      </ARGUMENTS>
                      <POSSIBLE-ERROR-REFS>
                        <POSSIBLE-ERROR-REF DEST="APPLICATION-ERROR">/AUTOSAR_ComM/ASR32/PortInterfaces/ComM_ASR32_ChannelWakeup/E_NOT_OK</POSSIBLE-ERROR-REF>
                      </POSSIBLE-ERROR-REFS>
                    </CLIENT-SERVER-OPERATION>
                  </OPERATIONS>
                  <POSSIBLE-ERRORS>
                    <APPLICATION-ERROR>
                      <SHORT-NAME>E_NOT_OK</SHORT-NAME>
                      <ERROR-CODE>1</ERROR-CODE>
                    </APPLICATION-ERROR>
                  </POSSIBLE-ERRORS>
                </CLIENT-SERVER-INTERFACE>
              </ELEMENTS>
            </AR-PACKAGE>
          </AR-PACKAGES>
        </AR-PACKAGE>

[!ENDIF!]

[!IF "ComMGeneral/ComMServiceAPI/ComMEnableASR40ServiceAPI = 'true'"!]
        <!-- Provide AUTOSAR 4.0 service interface -->
        <AR-PACKAGE> <!-- ASR40 -->
          <SHORT-NAME>ASR40</SHORT-NAME>
          <AR-PACKAGES>
            <AR-PACKAGE> <!-- ImplementationDataTypes -->
              <SHORT-NAME>ImplementationDataTypes</SHORT-NAME>
              <ELEMENTS>
                <!-- Type definitions -->
                <IMPLEMENTATION-DATA-TYPE>
                  <SHORT-NAME>ComM_ASR40_ModeType</SHORT-NAME>
                  <CATEGORY>TYPE_REFERENCE</CATEGORY>
                  <SW-DATA-DEF-PROPS>
                    <SW-DATA-DEF-PROPS-VARIANTS>
                      <SW-DATA-DEF-PROPS-CONDITIONAL>
                        <COMPU-METHOD-REF DEST="COMPU-METHOD">/AUTOSAR_ComM/ASR40/CompuMethods/ComM_ASR40_ModeTypeValues</COMPU-METHOD-REF>
                        <IMPLEMENTATION-DATA-TYPE-REF DEST="IMPLEMENTATION-DATA-TYPE">/AUTOSAR_Platform/ImplementationDataTypes/uint8</IMPLEMENTATION-DATA-TYPE-REF>
                      </SW-DATA-DEF-PROPS-CONDITIONAL>
                    </SW-DATA-DEF-PROPS-VARIANTS>
                  </SW-DATA-DEF-PROPS>
                </IMPLEMENTATION-DATA-TYPE>
                <IMPLEMENTATION-DATA-TYPE>
                  <SHORT-NAME>ComM_ASR40_UserHandleType</SHORT-NAME>
                  <CATEGORY>TYPE_REFERENCE</CATEGORY>
                  <SW-DATA-DEF-PROPS>
                    <SW-DATA-DEF-PROPS-VARIANTS>
                      <SW-DATA-DEF-PROPS-CONDITIONAL>
                        <IMPLEMENTATION-DATA-TYPE-REF DEST="IMPLEMENTATION-DATA-TYPE">/AUTOSAR_Platform/ImplementationDataTypes/uint8</IMPLEMENTATION-DATA-TYPE-REF>
                      </SW-DATA-DEF-PROPS-CONDITIONAL>
                    </SW-DATA-DEF-PROPS-VARIANTS>
                  </SW-DATA-DEF-PROPS>
                </IMPLEMENTATION-DATA-TYPE>
                <IMPLEMENTATION-DATA-TYPE>
                  <SHORT-NAME>ComM_ASR40_InhibitionStatusType</SHORT-NAME>
                  <CATEGORY>TYPE_REFERENCE</CATEGORY>
                  <SW-DATA-DEF-PROPS>
                    <SW-DATA-DEF-PROPS-VARIANTS>
                      <SW-DATA-DEF-PROPS-CONDITIONAL>
                        <IMPLEMENTATION-DATA-TYPE-REF DEST="IMPLEMENTATION-DATA-TYPE">/AUTOSAR_Platform/ImplementationDataTypes/uint8</IMPLEMENTATION-DATA-TYPE-REF>
                      </SW-DATA-DEF-PROPS-CONDITIONAL>
                    </SW-DATA-DEF-PROPS-VARIANTS>
                  </SW-DATA-DEF-PROPS>
                </IMPLEMENTATION-DATA-TYPE>
                <IMPLEMENTATION-DATA-TYPE>
                  <SHORT-NAME>ComM_ASR40_UserHandleArrayType</SHORT-NAME>
                  <CATEGORY>STRUCTURE</CATEGORY>
                  <SUB-ELEMENTS>
                    <IMPLEMENTATION-DATA-TYPE-ELEMENT>
                      <SHORT-NAME>numberOfRequesters</SHORT-NAME>
                      <CATEGORY>TYPE_REFERENCE</CATEGORY>
                      <SW-DATA-DEF-PROPS>
                        <SW-DATA-DEF-PROPS-VARIANTS>
                          <SW-DATA-DEF-PROPS-CONDITIONAL>
                            <IMPLEMENTATION-DATA-TYPE-REF DEST="IMPLEMENTATION-DATA-TYPE">/AUTOSAR_Platform/ImplementationDataTypes/uint8</IMPLEMENTATION-DATA-TYPE-REF>
                          </SW-DATA-DEF-PROPS-CONDITIONAL>
                        </SW-DATA-DEF-PROPS-VARIANTS>
                      </SW-DATA-DEF-PROPS>
                    </IMPLEMENTATION-DATA-TYPE-ELEMENT>
                    <IMPLEMENTATION-DATA-TYPE-ELEMENT>
                      <SHORT-NAME>handleArray</SHORT-NAME>
                      <CATEGORY>TYPE_REFERENCE</CATEGORY>
                      <SW-DATA-DEF-PROPS>
                        <SW-DATA-DEF-PROPS-VARIANTS>
                          <SW-DATA-DEF-PROPS-CONDITIONAL>
                            <IMPLEMENTATION-DATA-TYPE-REF DEST="IMPLEMENTATION-DATA-TYPE">/AUTOSAR_ComM/ASR40/ImplementationDataTypes/ComM_ASR40_InternalHandleArrayType</IMPLEMENTATION-DATA-TYPE-REF>
                          </SW-DATA-DEF-PROPS-CONDITIONAL>
                        </SW-DATA-DEF-PROPS-VARIANTS>
                      </SW-DATA-DEF-PROPS>
                    </IMPLEMENTATION-DATA-TYPE-ELEMENT>
                  </SUB-ELEMENTS>
                </IMPLEMENTATION-DATA-TYPE>
                <IMPLEMENTATION-DATA-TYPE>
                  <!-- !LINKSTO ComM.EB.SWS_ComM_01005,1 -->
                  <SHORT-NAME>ComM_ASR40_InternalHandleArrayType</SHORT-NAME>
                  <CATEGORY>ARRAY</CATEGORY>
                  <SUB-ELEMENTS>
                    <IMPLEMENTATION-DATA-TYPE-ELEMENT>
                      <SHORT-NAME>handleArrayElement</SHORT-NAME>
                      <CATEGORY>TYPE_REFERENCE</CATEGORY>
[!IF "$maxNumUsersPerChannel != 0"!]
                      <ARRAY-SIZE>[!"$maxNumUsersPerChannel"!]</ARRAY-SIZE>
[!ELSE!][!//
                      <ARRAY-SIZE>1</ARRAY-SIZE>
[!ENDIF!]
                      <ARRAY-SIZE-SEMANTICS>FIXED-SIZE</ARRAY-SIZE-SEMANTICS>
                      <SW-DATA-DEF-PROPS>
                        <SW-DATA-DEF-PROPS-VARIANTS>
                          <SW-DATA-DEF-PROPS-CONDITIONAL>
                            <IMPLEMENTATION-DATA-TYPE-REF DEST="IMPLEMENTATION-DATA-TYPE">/AUTOSAR_ComM/ASR40/ImplementationDataTypes/ComM_ASR40_UserHandleType</IMPLEMENTATION-DATA-TYPE-REF>
                          </SW-DATA-DEF-PROPS-CONDITIONAL>
                        </SW-DATA-DEF-PROPS-VARIANTS>
                      </SW-DATA-DEF-PROPS>
                    </IMPLEMENTATION-DATA-TYPE-ELEMENT>
                  </SUB-ELEMENTS>
                </IMPLEMENTATION-DATA-TYPE>
              </ELEMENTS>
            </AR-PACKAGE>
            <AR-PACKAGE> <!-- ConstantSpecifications -->
              <SHORT-NAME>ConstantSpecifications</SHORT-NAME>
              <ELEMENTS>
                <CONSTANT-SPECIFICATION>
                  <SHORT-NAME>ComM_ASR40_InitConst_UserHandleArray</SHORT-NAME>
                  <VALUE-SPEC>
                    <RECORD-VALUE-SPECIFICATION>
                      <FIELDS>
                        <NUMERICAL-VALUE-SPECIFICATION>
                          <VALUE>0</VALUE>
                        </NUMERICAL-VALUE-SPECIFICATION>
                        <ARRAY-VALUE-SPECIFICATION>
                          <ELEMENTS>
[!IF "$maxNumUsersPerChannel != 0"!]
[!FOR "i" = "0" TO "$maxNumUsersPerChannel - 1"!]
                            <NUMERICAL-VALUE-SPECIFICATION>
                              <VALUE>0</VALUE>
                            </NUMERICAL-VALUE-SPECIFICATION>
[!ENDFOR!]
[!ELSE!][!//
                            <NUMERICAL-VALUE-SPECIFICATION>
                              <VALUE>0</VALUE>
                            </NUMERICAL-VALUE-SPECIFICATION>
[!ENDIF!]
                          </ELEMENTS>
                        </ARRAY-VALUE-SPECIFICATION>
                      </FIELDS>
                    </RECORD-VALUE-SPECIFICATION>
                  </VALUE-SPEC>
                </CONSTANT-SPECIFICATION>
              </ELEMENTS>
            </AR-PACKAGE>
            <AR-PACKAGE> <!-- ModeDeclarationGroups -->
              <SHORT-NAME>ModeDeclarationGroups</SHORT-NAME>
              <ELEMENTS>
                <MODE-DECLARATION-GROUP>
                  <SHORT-NAME>ComM_ASR40_Mode</SHORT-NAME>
<!-- !LINKSTO ComM.EB.ModeDeclarationGroup.ComMDefineOrder,1 -->
[!IF "node:exists(ComMGeneral/ComMDefineOrder) and (ComMGeneral/ComMDefineOrder = 'ALPHABETIC_ORDER')"!][!//
                  <CATEGORY>ALPHABETIC_ORDER</CATEGORY>
                  <INITIAL-MODE-REF DEST="MODE-DECLARATION">/AUTOSAR_ComM/ASR40/ModeDeclarationGroups/ComM_ASR40_Mode/COMM_NO_COMMUNICATION</INITIAL-MODE-REF>
                  <MODE-DECLARATIONS>
                    <MODE-DECLARATION>
                      <SHORT-NAME>COMM_FULL_COMMUNICATION</SHORT-NAME>
                    </MODE-DECLARATION>
                    <MODE-DECLARATION>
                      <SHORT-NAME>COMM_NO_COMMUNICATION</SHORT-NAME>
                    </MODE-DECLARATION>
                    <MODE-DECLARATION>
                      <SHORT-NAME>COMM_SILENT_COMMUNICATION</SHORT-NAME>
                    </MODE-DECLARATION>
                  </MODE-DECLARATIONS>
                </MODE-DECLARATION-GROUP>
[!ELSE!][!//
                  <CATEGORY>EXPLICIT_ORDER</CATEGORY>
                  <INITIAL-MODE-REF DEST="MODE-DECLARATION">/AUTOSAR_ComM/ASR40/ModeDeclarationGroups/ComM_ASR40_Mode/COMM_NO_COMMUNICATION</INITIAL-MODE-REF>
                  <MODE-DECLARATIONS>
                    <MODE-DECLARATION>
                      <SHORT-NAME>COMM_NO_COMMUNICATION</SHORT-NAME>
                      <VALUE>0</VALUE>
                    </MODE-DECLARATION>
                    <MODE-DECLARATION>
                      <SHORT-NAME>COMM_SILENT_COMMUNICATION</SHORT-NAME>
                      <VALUE>1</VALUE>
                    </MODE-DECLARATION>
                    <MODE-DECLARATION>
                      <SHORT-NAME>COMM_FULL_COMMUNICATION</SHORT-NAME>
                      <VALUE>2</VALUE>
                    </MODE-DECLARATION>
                  </MODE-DECLARATIONS>
                  <ON-TRANSITION-VALUE>3</ON-TRANSITION-VALUE>
                </MODE-DECLARATION-GROUP>
[!ENDIF!][!//
              </ELEMENTS>
            </AR-PACKAGE>
            <AR-PACKAGE> <!-- CompuMethods -->
              <SHORT-NAME>CompuMethods</SHORT-NAME>
              <ELEMENTS>
                <COMPU-METHOD>
                  <SHORT-NAME>ComM_ASR40_ModeTypeValues</SHORT-NAME>
                  <CATEGORY>TEXTTABLE</CATEGORY>
                  <COMPU-INTERNAL-TO-PHYS>
                    <COMPU-SCALES>
                      <COMPU-SCALE>
                        <LOWER-LIMIT INTERVAL-TYPE="CLOSED">0</LOWER-LIMIT>
                        <UPPER-LIMIT INTERVAL-TYPE="CLOSED">0</UPPER-LIMIT>
                        <COMPU-CONST>
                          <VT>COMM_NO_COMMUNICATION</VT>
                        </COMPU-CONST>
                      </COMPU-SCALE>
                      <COMPU-SCALE>
                        <LOWER-LIMIT INTERVAL-TYPE="CLOSED">1</LOWER-LIMIT>
                        <UPPER-LIMIT INTERVAL-TYPE="CLOSED">1</UPPER-LIMIT>
                        <COMPU-CONST>
                          <VT>COMM_SILENT_COMMUNICATION</VT>
                        </COMPU-CONST>
                      </COMPU-SCALE>
                      <COMPU-SCALE>
                        <LOWER-LIMIT INTERVAL-TYPE="CLOSED">2</LOWER-LIMIT>
                        <UPPER-LIMIT INTERVAL-TYPE="CLOSED">2</UPPER-LIMIT>
                        <COMPU-CONST>
                          <VT>COMM_FULL_COMMUNICATION</VT>
                        </COMPU-CONST>
                      </COMPU-SCALE>
                    </COMPU-SCALES>
                  </COMPU-INTERNAL-TO-PHYS>
                </COMPU-METHOD>
              </ELEMENTS>
            </AR-PACKAGE>
            <AR-PACKAGE> <!-- DataTypeMappingSets -->
              <SHORT-NAME>DataTypeMappingSets</SHORT-NAME>
              <ELEMENTS>
                <DATA-TYPE-MAPPING-SET>
                  <SHORT-NAME>ComM_ASR40_DataTypeMappingSet_0</SHORT-NAME>
                  <MODE-REQUEST-TYPE-MAPS>
                    <MODE-REQUEST-TYPE-MAP>
                      <IMPLEMENTATION-DATA-TYPE-REF DEST="IMPLEMENTATION-DATA-TYPE">/AUTOSAR_Platform/ImplementationDataTypes/uint8</IMPLEMENTATION-DATA-TYPE-REF>
                      <MODE-GROUP-REF DEST="MODE-DECLARATION-GROUP">/AUTOSAR_ComM/ASR40/ModeDeclarationGroups/ComM_ASR40_Mode</MODE-GROUP-REF>
                    </MODE-REQUEST-TYPE-MAP>
                  </MODE-REQUEST-TYPE-MAPS>
                </DATA-TYPE-MAPPING-SET>
              </ELEMENTS>
            </AR-PACKAGE>
            <AR-PACKAGE> <!-- PortInterfaces -->
              <SHORT-NAME>PortInterfaces</SHORT-NAME>
              <ELEMENTS>
                <!-- Interface ComM_CurrentMode -->
                <!-- !LINKSTO ComM.SWS_ComM_01001,1 -->
                <MODE-SWITCH-INTERFACE>
                  <SHORT-NAME>ComM_ASR40_CurrentMode</SHORT-NAME>
                  <IS-SERVICE>true</IS-SERVICE>
                  <MODE-GROUP>
                    <SHORT-NAME>currentMode</SHORT-NAME>
                    <TYPE-TREF DEST="MODE-DECLARATION-GROUP">/AUTOSAR_ComM/ASR40/ModeDeclarationGroups/ComM_ASR40_Mode</TYPE-TREF>
                  </MODE-GROUP>
                </MODE-SWITCH-INTERFACE>

                <!-- Interface ComM_UserRequest -->
                <CLIENT-SERVER-INTERFACE>
                  <SHORT-NAME>ComM_ASR40_UserRequest</SHORT-NAME>
                  <IS-SERVICE>true</IS-SERVICE>
                  <OPERATIONS>
                    <!-- Operation RequestComMode -->
                    <!-- !LINKSTO ComM.EB_Ref.SWS_ComM_01000.Operation.RequestComMode,1 -->
                    <CLIENT-SERVER-OPERATION>
                      <SHORT-NAME>RequestComMode</SHORT-NAME>
                      <ARGUMENTS>
                        <ARGUMENT-DATA-PROTOTYPE>
                          <SHORT-NAME>ComMode</SHORT-NAME>
                          <TYPE-TREF DEST="IMPLEMENTATION-DATA-TYPE">/AUTOSAR_ComM/ASR40/ImplementationDataTypes/ComM_ASR40_ModeType</TYPE-TREF>
                          <DIRECTION>IN</DIRECTION>
                        </ARGUMENT-DATA-PROTOTYPE>
                      </ARGUMENTS>
                      <POSSIBLE-ERROR-REFS>
                        <POSSIBLE-ERROR-REF DEST="APPLICATION-ERROR">/AUTOSAR_ComM/ASR40/PortInterfaces/ComM_ASR40_UserRequest/E_NOT_OK</POSSIBLE-ERROR-REF>
                        <POSSIBLE-ERROR-REF DEST="APPLICATION-ERROR">/AUTOSAR_ComM/ASR40/PortInterfaces/ComM_ASR40_UserRequest/E_MODE_LIMITATION</POSSIBLE-ERROR-REF>
                      </POSSIBLE-ERROR-REFS>
                    </CLIENT-SERVER-OPERATION>

                    <!-- Operation GetCurrentComMode -->
                    <!-- !LINKSTO ComM.EB_Ref.SWS_ComM_01000.Operation.GetCurrentComMode,1 -->
                    <CLIENT-SERVER-OPERATION>
                      <SHORT-NAME>GetCurrentComMode</SHORT-NAME>
                      <ARGUMENTS>
                        <ARGUMENT-DATA-PROTOTYPE>
                          <SHORT-NAME>ComMode</SHORT-NAME>
                          <TYPE-TREF DEST="IMPLEMENTATION-DATA-TYPE">/AUTOSAR_ComM/ASR40/ImplementationDataTypes/ComM_ASR40_ModeType</TYPE-TREF>
                          <DIRECTION>OUT</DIRECTION>
                        </ARGUMENT-DATA-PROTOTYPE>
                      </ARGUMENTS>
                      <POSSIBLE-ERROR-REFS>
                        <POSSIBLE-ERROR-REF DEST="APPLICATION-ERROR">/AUTOSAR_ComM/ASR40/PortInterfaces/ComM_ASR40_UserRequest/E_NOT_OK</POSSIBLE-ERROR-REF>
                      </POSSIBLE-ERROR-REFS>
                    </CLIENT-SERVER-OPERATION>
[!IF "as:modconf('ComM')[1]/ComMGeneral/ComMEnableGetCurrentPNCComMode = 'true'"!]
                    <!-- Operation GetCurrentPNCComMode -->
                    <!-- !LINKSTO ComM.EB_Ref.SWS_ComM_01000.Operation.GetCurrentPNCComMode,1 -->
                    <CLIENT-SERVER-OPERATION>
                      <SHORT-NAME>GetCurrentPNCComMode</SHORT-NAME>
                      <ARGUMENTS>
                        <ARGUMENT-DATA-PROTOTYPE>
                          <SHORT-NAME>ComMode</SHORT-NAME>
                          <TYPE-TREF DEST="IMPLEMENTATION-DATA-TYPE">/AUTOSAR_ComM/ASR40/ImplementationDataTypes/ComM_ASR40_ModeType</TYPE-TREF>
                          <DIRECTION>OUT</DIRECTION>
                        </ARGUMENT-DATA-PROTOTYPE>
                      </ARGUMENTS>
                      <POSSIBLE-ERROR-REFS>
                        <POSSIBLE-ERROR-REF DEST="APPLICATION-ERROR">/AUTOSAR_ComM/ASR40/PortInterfaces/ComM_ASR40_UserRequest/E_NOT_OK</POSSIBLE-ERROR-REF>
                        <POSSIBLE-ERROR-REF DEST="APPLICATION-ERROR">/AUTOSAR_ComM/ASR40/PortInterfaces/ComM_ASR40_UserRequest/E_MULTIPLE_PNC_ASSIGNED</POSSIBLE-ERROR-REF>
                        <POSSIBLE-ERROR-REF DEST="APPLICATION-ERROR">/AUTOSAR_ComM/ASR40/PortInterfaces/ComM_ASR40_UserRequest/E_NO_PNC_ASSIGNED</POSSIBLE-ERROR-REF>
                      </POSSIBLE-ERROR-REFS>
                    </CLIENT-SERVER-OPERATION>
[!ENDIF!]
                    <!-- Operation GetMaxComMode -->
                    <!-- !LINKSTO ComM.EB_Ref.SWS_ComM_01000.Operation.GetMaxComMode,1 -->
                    <CLIENT-SERVER-OPERATION>
                      <SHORT-NAME>GetMaxComMode</SHORT-NAME>
                      <ARGUMENTS>
                        <ARGUMENT-DATA-PROTOTYPE>
                          <SHORT-NAME>ComMode</SHORT-NAME>
                          <TYPE-TREF DEST="IMPLEMENTATION-DATA-TYPE">/AUTOSAR_ComM/ASR40/ImplementationDataTypes/ComM_ASR40_ModeType</TYPE-TREF>
                          <DIRECTION>OUT</DIRECTION>
                        </ARGUMENT-DATA-PROTOTYPE>
                      </ARGUMENTS>
                      <POSSIBLE-ERROR-REFS>
                        <POSSIBLE-ERROR-REF DEST="APPLICATION-ERROR">/AUTOSAR_ComM/ASR40/PortInterfaces/ComM_ASR40_UserRequest/E_NOT_OK</POSSIBLE-ERROR-REF>
                      </POSSIBLE-ERROR-REFS>
                    </CLIENT-SERVER-OPERATION>
                    <!-- Operation GetRequestedComMode -->
                    <!-- !LINKSTO ComM.EB_Ref.SWS_ComM_01000.Operation.GetRequestedComMode,1 -->
                    <CLIENT-SERVER-OPERATION>
                      <SHORT-NAME>GetRequestedComMode</SHORT-NAME>
                      <ARGUMENTS>
                        <ARGUMENT-DATA-PROTOTYPE>
                          <SHORT-NAME>ComMode</SHORT-NAME>
                          <TYPE-TREF DEST="IMPLEMENTATION-DATA-TYPE">/AUTOSAR_ComM/ASR40/ImplementationDataTypes/ComM_ASR40_ModeType</TYPE-TREF>
                          <DIRECTION>OUT</DIRECTION>
                        </ARGUMENT-DATA-PROTOTYPE>
                      </ARGUMENTS>
                      <POSSIBLE-ERROR-REFS>
                        <POSSIBLE-ERROR-REF DEST="APPLICATION-ERROR">/AUTOSAR_ComM/ASR40/PortInterfaces/ComM_ASR40_UserRequest/E_NOT_OK</POSSIBLE-ERROR-REF>
                      </POSSIBLE-ERROR-REFS>
                    </CLIENT-SERVER-OPERATION>
                  </OPERATIONS>
                  <!-- Possible Errors -->
                  <POSSIBLE-ERRORS>
                    <APPLICATION-ERROR>
                      <SHORT-NAME>E_NOT_OK</SHORT-NAME>
                      <ERROR-CODE>1</ERROR-CODE>
                    </APPLICATION-ERROR>
                    <APPLICATION-ERROR>
                      <SHORT-NAME>E_MODE_LIMITATION</SHORT-NAME>
                      <ERROR-CODE>2</ERROR-CODE>
                    </APPLICATION-ERROR>
[!IF "as:modconf('ComM')[1]/ComMGeneral/ComMEnableGetCurrentPNCComMode = 'true'"!]
                    <APPLICATION-ERROR>
                      <SHORT-NAME>E_MULTIPLE_PNC_ASSIGNED</SHORT-NAME>
                      <ERROR-CODE>3</ERROR-CODE>
                    </APPLICATION-ERROR>
                    <APPLICATION-ERROR>
                      <SHORT-NAME>E_NO_PNC_ASSIGNED</SHORT-NAME>
                      <ERROR-CODE>4</ERROR-CODE>
                    </APPLICATION-ERROR>
[!ENDIF!]
                  </POSSIBLE-ERRORS>
                </CLIENT-SERVER-INTERFACE>

                <!-- Interface ComM_CurrentChannelRequest -->
                <!-- !LINKSTO ComM.SWS_ComM_00734,1 -->
                <SENDER-RECEIVER-INTERFACE>
                  <SHORT-NAME>ComM_ASR40_CurrentChannelRequest</SHORT-NAME>
                  <IS-SERVICE>true</IS-SERVICE>
                  <DATA-ELEMENTS>
                    <VARIABLE-DATA-PROTOTYPE>
                       <!-- !LINKSTO ComM.EB.SWS_ComM_00904,1 -->
                      <SHORT-NAME>fullComRequestors</SHORT-NAME>
                      <!-- !LINKSTO ComM.SWS_ComM_00736,1 -->
                      <SW-DATA-DEF-PROPS>
                        <SW-DATA-DEF-PROPS-VARIANTS>
                          <SW-DATA-DEF-PROPS-CONDITIONAL>
                            <SW-IMPL-POLICY>STANDARD</SW-IMPL-POLICY>
                          </SW-DATA-DEF-PROPS-CONDITIONAL>
                        </SW-DATA-DEF-PROPS-VARIANTS>
                      </SW-DATA-DEF-PROPS>
                      <TYPE-TREF DEST="IMPLEMENTATION-DATA-TYPE">/AUTOSAR_ComM/ASR40/ImplementationDataTypes/ComM_ASR40_UserHandleArrayType</TYPE-TREF>
                    </VARIABLE-DATA-PROTOTYPE>
                  </DATA-ELEMENTS>
                </SENDER-RECEIVER-INTERFACE>

                <!-- Interface ComM_ECUModeLimitation -->
                <CLIENT-SERVER-INTERFACE>
                  <SHORT-NAME>ComM_ASR40_ECUModeLimitation</SHORT-NAME>
                  <IS-SERVICE>true</IS-SERVICE>
                  <OPERATIONS>
                    <!-- Operation LimitECUToNoComMode -->
                    <CLIENT-SERVER-OPERATION>
                      <SHORT-NAME>LimitECUToNoComMode</SHORT-NAME>
                      <ARGUMENTS>
                        <ARGUMENT-DATA-PROTOTYPE>
                          <SHORT-NAME>Status</SHORT-NAME>
                          <TYPE-TREF DEST="IMPLEMENTATION-DATA-TYPE">/AUTOSAR_Platform/ImplementationDataTypes/boolean</TYPE-TREF>
                          <DIRECTION>IN</DIRECTION>
                        </ARGUMENT-DATA-PROTOTYPE>
                      </ARGUMENTS>
                      <POSSIBLE-ERROR-REFS>
                        <POSSIBLE-ERROR-REF DEST="APPLICATION-ERROR">/AUTOSAR_ComM/ASR40/PortInterfaces/ComM_ASR40_ECUModeLimitation/E_NOT_OK</POSSIBLE-ERROR-REF>
                      </POSSIBLE-ERROR-REFS>
                    </CLIENT-SERVER-OPERATION>
                    <!-- Operation ReadInhibitCounter -->
                    <CLIENT-SERVER-OPERATION>
                      <SHORT-NAME>ReadInhibitCounter</SHORT-NAME>
                      <ARGUMENTS>
                        <ARGUMENT-DATA-PROTOTYPE>
                          <SHORT-NAME>CounterValue</SHORT-NAME>
                          <TYPE-TREF DEST="IMPLEMENTATION-DATA-TYPE">/AUTOSAR_Platform/ImplementationDataTypes/uint16</TYPE-TREF>
                          <DIRECTION>OUT</DIRECTION>
                        </ARGUMENT-DATA-PROTOTYPE>
                      </ARGUMENTS>
                      <POSSIBLE-ERROR-REFS>
                        <POSSIBLE-ERROR-REF DEST="APPLICATION-ERROR">/AUTOSAR_ComM/ASR40/PortInterfaces/ComM_ASR40_ECUModeLimitation/E_NOT_OK</POSSIBLE-ERROR-REF>
                      </POSSIBLE-ERROR-REFS>
                    </CLIENT-SERVER-OPERATION>
                    <!-- Operation ResetInhibitCounter -->
                    <CLIENT-SERVER-OPERATION>
                      <SHORT-NAME>ResetInhibitCounter</SHORT-NAME>
                      <ARGUMENTS/>
                      <POSSIBLE-ERROR-REFS>
                        <POSSIBLE-ERROR-REF DEST="APPLICATION-ERROR">/AUTOSAR_ComM/ASR40/PortInterfaces/ComM_ASR40_ECUModeLimitation/E_NOT_OK</POSSIBLE-ERROR-REF>
                      </POSSIBLE-ERROR-REFS>
                    </CLIENT-SERVER-OPERATION>
                    <!-- Operation SetECUGroupClassification -->
                    <CLIENT-SERVER-OPERATION>
                      <SHORT-NAME>SetECUGroupClassification</SHORT-NAME>
                      <ARGUMENTS>
                        <ARGUMENT-DATA-PROTOTYPE>
                          <SHORT-NAME>Status</SHORT-NAME>
                          <TYPE-TREF DEST="IMPLEMENTATION-DATA-TYPE">/AUTOSAR_ComM/ASR40/ImplementationDataTypes/ComM_ASR40_InhibitionStatusType</TYPE-TREF>
                          <DIRECTION>IN</DIRECTION>
                        </ARGUMENT-DATA-PROTOTYPE>
                      </ARGUMENTS>
                      <POSSIBLE-ERROR-REFS>
                        <POSSIBLE-ERROR-REF DEST="APPLICATION-ERROR">/AUTOSAR_ComM/ASR40/PortInterfaces/ComM_ASR40_ECUModeLimitation/E_NOT_OK</POSSIBLE-ERROR-REF>
                      </POSSIBLE-ERROR-REFS>
                    </CLIENT-SERVER-OPERATION>
                  </OPERATIONS>
                  <!-- Possible Errors -->
                  <POSSIBLE-ERRORS>
                    <APPLICATION-ERROR>
                      <SHORT-NAME>E_NOT_OK</SHORT-NAME>
                      <ERROR-CODE>1</ERROR-CODE>
                    </APPLICATION-ERROR>
                  </POSSIBLE-ERRORS>
                </CLIENT-SERVER-INTERFACE>

                <!-- Interface ComM_ChannelLimitation -->
                <CLIENT-SERVER-INTERFACE>
                  <SHORT-NAME>ComM_ASR40_ChannelLimitation</SHORT-NAME>
                  <IS-SERVICE>true</IS-SERVICE>
                  <OPERATIONS>
                    <!-- Operation LimitChannelToNoComMode -->
                    <CLIENT-SERVER-OPERATION>
                      <SHORT-NAME>LimitChannelToNoComMode</SHORT-NAME>
                      <ARGUMENTS>
                        <ARGUMENT-DATA-PROTOTYPE>
                          <SHORT-NAME>Status</SHORT-NAME>
                          <TYPE-TREF DEST="IMPLEMENTATION-DATA-TYPE">/AUTOSAR_Platform/ImplementationDataTypes/boolean</TYPE-TREF>
                          <DIRECTION>IN</DIRECTION>
                        </ARGUMENT-DATA-PROTOTYPE>
                      </ARGUMENTS>
                      <POSSIBLE-ERROR-REFS>
                        <POSSIBLE-ERROR-REF DEST="APPLICATION-ERROR">/AUTOSAR_ComM/ASR40/PortInterfaces/ComM_ASR40_ChannelLimitation/E_NOT_OK</POSSIBLE-ERROR-REF>
                      </POSSIBLE-ERROR-REFS>
                    </CLIENT-SERVER-OPERATION>
                    <!-- Operation GetInhibitionStatus -->
                    <CLIENT-SERVER-OPERATION>
                      <SHORT-NAME>GetInhibitionStatus</SHORT-NAME>
                      <ARGUMENTS>
                        <ARGUMENT-DATA-PROTOTYPE>
                          <SHORT-NAME>Status</SHORT-NAME>
                          <TYPE-TREF DEST="IMPLEMENTATION-DATA-TYPE">/AUTOSAR_ComM/ASR40/ImplementationDataTypes/ComM_ASR40_InhibitionStatusType</TYPE-TREF>
                          <DIRECTION>OUT</DIRECTION>
                        </ARGUMENT-DATA-PROTOTYPE>
                      </ARGUMENTS>
                      <POSSIBLE-ERROR-REFS>
                        <POSSIBLE-ERROR-REF DEST="APPLICATION-ERROR">/AUTOSAR_ComM/ASR40/PortInterfaces/ComM_ASR40_ChannelLimitation/E_NOT_OK</POSSIBLE-ERROR-REF>
                      </POSSIBLE-ERROR-REFS>
                    </CLIENT-SERVER-OPERATION>
                  </OPERATIONS>
                  <POSSIBLE-ERRORS>
                    <APPLICATION-ERROR>
                      <SHORT-NAME>E_NOT_OK</SHORT-NAME>
                      <ERROR-CODE>1</ERROR-CODE>
                    </APPLICATION-ERROR>
                  </POSSIBLE-ERRORS>
                </CLIENT-SERVER-INTERFACE>

                <!-- Interface ComM_ChannelWakeup -->
                <CLIENT-SERVER-INTERFACE>
                  <SHORT-NAME>ComM_ASR40_ChannelWakeup</SHORT-NAME>
                  <IS-SERVICE>true</IS-SERVICE>
                  <OPERATIONS>
                    <CLIENT-SERVER-OPERATION>
                      <SHORT-NAME>PreventWakeUp</SHORT-NAME>
                      <ARGUMENTS>
                        <ARGUMENT-DATA-PROTOTYPE>
                          <SHORT-NAME>Status</SHORT-NAME>
                          <TYPE-TREF DEST="IMPLEMENTATION-DATA-TYPE">/AUTOSAR_Platform/ImplementationDataTypes/boolean</TYPE-TREF>
                          <DIRECTION>IN</DIRECTION>
                        </ARGUMENT-DATA-PROTOTYPE>
                      </ARGUMENTS>
                      <POSSIBLE-ERROR-REFS>
                        <POSSIBLE-ERROR-REF DEST="APPLICATION-ERROR">/AUTOSAR_ComM/ASR40/PortInterfaces/ComM_ASR40_ChannelWakeup/E_NOT_OK</POSSIBLE-ERROR-REF>
                      </POSSIBLE-ERROR-REFS>
                    </CLIENT-SERVER-OPERATION>
                    <!-- Operation GetInhibitionStatus -->
                    <CLIENT-SERVER-OPERATION>
                      <SHORT-NAME>GetInhibitionStatus</SHORT-NAME>
                      <ARGUMENTS>
                        <ARGUMENT-DATA-PROTOTYPE>
                          <SHORT-NAME>Status</SHORT-NAME>
                          <TYPE-TREF DEST="IMPLEMENTATION-DATA-TYPE">/AUTOSAR_ComM/ASR40/ImplementationDataTypes/ComM_ASR40_InhibitionStatusType</TYPE-TREF>
                          <DIRECTION>OUT</DIRECTION>
                        </ARGUMENT-DATA-PROTOTYPE>
                      </ARGUMENTS>
                      <POSSIBLE-ERROR-REFS>
                        <POSSIBLE-ERROR-REF DEST="APPLICATION-ERROR">/AUTOSAR_ComM/ASR40/PortInterfaces/ComM_ASR40_ChannelWakeup/E_NOT_OK</POSSIBLE-ERROR-REF>
                      </POSSIBLE-ERROR-REFS>
                    </CLIENT-SERVER-OPERATION>
                  </OPERATIONS>
                  <POSSIBLE-ERRORS>
                    <APPLICATION-ERROR>
                      <SHORT-NAME>E_NOT_OK</SHORT-NAME>
                      <ERROR-CODE>1</ERROR-CODE>
                    </APPLICATION-ERROR>
                  </POSSIBLE-ERRORS>
                </CLIENT-SERVER-INTERFACE>
              </ELEMENTS>
            </AR-PACKAGE>
          </AR-PACKAGES>
        </AR-PACKAGE>

[!ENDIF!]

[!IF "ComMGeneral/ComMServiceAPI/ComMDefaultASRServiceAPI != 'NONE'"!]
        <!-- Provide default service interface -->
        <AR-PACKAGE> <!-- ImplementationDataTypes -->
          <SHORT-NAME>ImplementationDataTypes</SHORT-NAME>
          <ELEMENTS>
            <!-- Type definitions -->
            <IMPLEMENTATION-DATA-TYPE>
              <SHORT-NAME>ComM_ModeType</SHORT-NAME>
              <CATEGORY>TYPE_REFERENCE</CATEGORY>
              <SW-DATA-DEF-PROPS>
                <SW-DATA-DEF-PROPS-VARIANTS>
                  <SW-DATA-DEF-PROPS-CONDITIONAL>
                    <COMPU-METHOD-REF DEST="COMPU-METHOD">/AUTOSAR_ComM/CompuMethods/ComM_ModeTypeValues</COMPU-METHOD-REF>
                    <IMPLEMENTATION-DATA-TYPE-REF DEST="IMPLEMENTATION-DATA-TYPE">/AUTOSAR_Platform/ImplementationDataTypes/uint8</IMPLEMENTATION-DATA-TYPE-REF>
                  </SW-DATA-DEF-PROPS-CONDITIONAL>
                </SW-DATA-DEF-PROPS-VARIANTS>
              </SW-DATA-DEF-PROPS>
            </IMPLEMENTATION-DATA-TYPE>
            <IMPLEMENTATION-DATA-TYPE>
              <SHORT-NAME>ComM_UserHandleType</SHORT-NAME>
              <CATEGORY>TYPE_REFERENCE</CATEGORY>
              <SW-DATA-DEF-PROPS>
                <SW-DATA-DEF-PROPS-VARIANTS>
                  <SW-DATA-DEF-PROPS-CONDITIONAL>
                    <IMPLEMENTATION-DATA-TYPE-REF DEST="IMPLEMENTATION-DATA-TYPE">/AUTOSAR_Platform/ImplementationDataTypes/uint8</IMPLEMENTATION-DATA-TYPE-REF>
                  </SW-DATA-DEF-PROPS-CONDITIONAL>
                </SW-DATA-DEF-PROPS-VARIANTS>
              </SW-DATA-DEF-PROPS>
            </IMPLEMENTATION-DATA-TYPE>
            <IMPLEMENTATION-DATA-TYPE>
              <SHORT-NAME>ComM_InhibitionStatusType</SHORT-NAME>
              <CATEGORY>TYPE_REFERENCE</CATEGORY>
              <SW-DATA-DEF-PROPS>
                <SW-DATA-DEF-PROPS-VARIANTS>
                  <SW-DATA-DEF-PROPS-CONDITIONAL>
                    <IMPLEMENTATION-DATA-TYPE-REF DEST="IMPLEMENTATION-DATA-TYPE">/AUTOSAR_Platform/ImplementationDataTypes/uint8</IMPLEMENTATION-DATA-TYPE-REF>
                  </SW-DATA-DEF-PROPS-CONDITIONAL>
                </SW-DATA-DEF-PROPS-VARIANTS>
              </SW-DATA-DEF-PROPS>
            </IMPLEMENTATION-DATA-TYPE>
[!IF "ComMGeneral/ComMServiceAPI/ComMDefaultASRServiceAPI = 'AUTOSAR_40'"!]
            <IMPLEMENTATION-DATA-TYPE>
              <!-- !LINKSTO ComM.ASR403.SWS_ComM_00906,1 -->
              <SHORT-NAME>ComM_UserHandleArrayType</SHORT-NAME>
              <CATEGORY>STRUCTURE</CATEGORY>
              <SUB-ELEMENTS>
                <IMPLEMENTATION-DATA-TYPE-ELEMENT>
                  <SHORT-NAME>numberOfRequesters</SHORT-NAME>
                  <CATEGORY>TYPE_REFERENCE</CATEGORY>
                  <SW-DATA-DEF-PROPS>
                    <SW-DATA-DEF-PROPS-VARIANTS>
                      <SW-DATA-DEF-PROPS-CONDITIONAL>
                        <IMPLEMENTATION-DATA-TYPE-REF DEST="IMPLEMENTATION-DATA-TYPE">/AUTOSAR_Platform/ImplementationDataTypes/uint8</IMPLEMENTATION-DATA-TYPE-REF>
                      </SW-DATA-DEF-PROPS-CONDITIONAL>
                    </SW-DATA-DEF-PROPS-VARIANTS>
                  </SW-DATA-DEF-PROPS>
                </IMPLEMENTATION-DATA-TYPE-ELEMENT>
                <IMPLEMENTATION-DATA-TYPE-ELEMENT>
                  <SHORT-NAME>handleArray</SHORT-NAME>
                  <CATEGORY>TYPE_REFERENCE</CATEGORY>
                  <SW-DATA-DEF-PROPS>
                    <SW-DATA-DEF-PROPS-VARIANTS>
                      <SW-DATA-DEF-PROPS-CONDITIONAL>
                        <IMPLEMENTATION-DATA-TYPE-REF DEST="IMPLEMENTATION-DATA-TYPE">/AUTOSAR_ComM/ImplementationDataTypes/ComM_InternalHandleArrayType</IMPLEMENTATION-DATA-TYPE-REF>
                      </SW-DATA-DEF-PROPS-CONDITIONAL>
                    </SW-DATA-DEF-PROPS-VARIANTS>
                  </SW-DATA-DEF-PROPS>
                </IMPLEMENTATION-DATA-TYPE-ELEMENT>
              </SUB-ELEMENTS>
            </IMPLEMENTATION-DATA-TYPE>
            <IMPLEMENTATION-DATA-TYPE>
              <!-- !LINKSTO ComM.EB.SWS_ComM_01005,1 -->
              <SHORT-NAME>ComM_InternalHandleArrayType</SHORT-NAME>
              <CATEGORY>ARRAY</CATEGORY>
              <SUB-ELEMENTS>
                <IMPLEMENTATION-DATA-TYPE-ELEMENT>
                  <SHORT-NAME>handleArrayElement</SHORT-NAME>
                  <CATEGORY>TYPE_REFERENCE</CATEGORY>
[!IF "$maxNumUsersPerChannel != 0"!]
                  <ARRAY-SIZE>[!"$maxNumUsersPerChannel"!]</ARRAY-SIZE>
[!ELSE!][!//
                  <ARRAY-SIZE>1</ARRAY-SIZE>
[!ENDIF!]
                  <ARRAY-SIZE-SEMANTICS>FIXED-SIZE</ARRAY-SIZE-SEMANTICS>
                  <SW-DATA-DEF-PROPS>
                    <SW-DATA-DEF-PROPS-VARIANTS>
                      <SW-DATA-DEF-PROPS-CONDITIONAL>
                        <IMPLEMENTATION-DATA-TYPE-REF DEST="IMPLEMENTATION-DATA-TYPE">/AUTOSAR_ComM/ImplementationDataTypes/ComM_UserHandleType</IMPLEMENTATION-DATA-TYPE-REF>
                      </SW-DATA-DEF-PROPS-CONDITIONAL>
                    </SW-DATA-DEF-PROPS-VARIANTS>
                  </SW-DATA-DEF-PROPS>
                </IMPLEMENTATION-DATA-TYPE-ELEMENT>
              </SUB-ELEMENTS>
            </IMPLEMENTATION-DATA-TYPE>
[!ENDIF!]
          </ELEMENTS>
        </AR-PACKAGE>
        <AR-PACKAGE> <!-- ConstantSpecifications -->
          <SHORT-NAME>ConstantSpecifications</SHORT-NAME>
          <ELEMENTS>
            <CONSTANT-SPECIFICATION>
              <SHORT-NAME>ComM_InitConst_UserHandleArray</SHORT-NAME>
              <VALUE-SPEC>
                <RECORD-VALUE-SPECIFICATION>
                  <FIELDS>
                    <NUMERICAL-VALUE-SPECIFICATION>
                      <VALUE>0</VALUE>
                    </NUMERICAL-VALUE-SPECIFICATION>
                    <ARRAY-VALUE-SPECIFICATION>
                      <ELEMENTS>
[!IF "$maxNumUsersPerChannel != 0"!]
[!FOR "i" = "0" TO "$maxNumUsersPerChannel - 1"!]
                        <NUMERICAL-VALUE-SPECIFICATION>
                          <VALUE>0</VALUE>
                        </NUMERICAL-VALUE-SPECIFICATION>
[!ENDFOR!]
[!ELSE!][!//
                        <NUMERICAL-VALUE-SPECIFICATION>
                          <VALUE>0</VALUE>
                        </NUMERICAL-VALUE-SPECIFICATION>
[!ENDIF!]
                      </ELEMENTS>
                    </ARRAY-VALUE-SPECIFICATION>
                  </FIELDS>
                </RECORD-VALUE-SPECIFICATION>
              </VALUE-SPEC>
            </CONSTANT-SPECIFICATION>
          </ELEMENTS>
        </AR-PACKAGE>
[!IF "ComMGeneral/ComMServiceAPI/ComMDefaultASRServiceAPI = 'AUTOSAR_32'"!]
        <AR-PACKAGE> <!-- ModeDeclarationGroups -->
          <SHORT-NAME>ModeDeclarationGroups</SHORT-NAME>
          <ELEMENTS>
            <MODE-DECLARATION-GROUP>
              <SHORT-NAME>ComMMode</SHORT-NAME>
              <CATEGORY>EXPLICIT_ORDER</CATEGORY>
              <INITIAL-MODE-REF DEST="MODE-DECLARATION">/AUTOSAR_ComM/ModeDeclarationGroups/ComMMode/NO_COMMUNICATION</INITIAL-MODE-REF>
              <MODE-DECLARATIONS>
                <MODE-DECLARATION>
                  <SHORT-NAME>NO_COMMUNICATION</SHORT-NAME>
                  <VALUE>0</VALUE>
                </MODE-DECLARATION>
                <MODE-DECLARATION>
                  <SHORT-NAME>SILENT_COMMUNICATION</SHORT-NAME>
                  <VALUE>1</VALUE>
                </MODE-DECLARATION>
                <MODE-DECLARATION>
                  <SHORT-NAME>FULL_COMMUNICATION</SHORT-NAME>
                  <VALUE>2</VALUE>
                </MODE-DECLARATION>
              </MODE-DECLARATIONS>
              <ON-TRANSITION-VALUE>3</ON-TRANSITION-VALUE>
            </MODE-DECLARATION-GROUP>
          </ELEMENTS>
        </AR-PACKAGE>
        <AR-PACKAGE> <!-- CompuMethods -->
          <SHORT-NAME>CompuMethods</SHORT-NAME>
          <ELEMENTS>
            <COMPU-METHOD>
              <SHORT-NAME>ComM_ModeTypeValues</SHORT-NAME>
              <CATEGORY>TEXTTABLE</CATEGORY>
              <COMPU-INTERNAL-TO-PHYS>
                <COMPU-SCALES>
                  <COMPU-SCALE>
                    <LOWER-LIMIT INTERVAL-TYPE="CLOSED">0</LOWER-LIMIT>
                    <UPPER-LIMIT INTERVAL-TYPE="CLOSED">0</UPPER-LIMIT>
                    <COMPU-CONST>
                      <VT>NO_COMMUNICATION</VT>
                    </COMPU-CONST>
                  </COMPU-SCALE>
                  <COMPU-SCALE>
                    <LOWER-LIMIT INTERVAL-TYPE="CLOSED">1</LOWER-LIMIT>
                    <UPPER-LIMIT INTERVAL-TYPE="CLOSED">1</UPPER-LIMIT>
                    <COMPU-CONST>
                      <VT>SILENT_COMMUNICATION</VT>
                    </COMPU-CONST>
                  </COMPU-SCALE>
                  <COMPU-SCALE>
                    <LOWER-LIMIT INTERVAL-TYPE="CLOSED">2</LOWER-LIMIT>
                    <UPPER-LIMIT INTERVAL-TYPE="CLOSED">2</UPPER-LIMIT>
                    <COMPU-CONST>
                      <VT>FULL_COMMUNICATION</VT>
                    </COMPU-CONST>
                  </COMPU-SCALE>
                </COMPU-SCALES>
              </COMPU-INTERNAL-TO-PHYS>
            </COMPU-METHOD>
          </ELEMENTS>
        </AR-PACKAGE>
[!ELSE!][!//
        <AR-PACKAGE> <!-- ModeDeclarationGroups -->
          <SHORT-NAME>ModeDeclarationGroups</SHORT-NAME>
          <ELEMENTS>
            <MODE-DECLARATION-GROUP>
              <SHORT-NAME>ComMMode</SHORT-NAME>
<!-- !LINKSTO ComM.EB.ModeDeclarationGroup.ComMDefineOrder,1 -->
[!IF "node:exists(ComMGeneral/ComMDefineOrder) and (ComMGeneral/ComMDefineOrder = 'ALPHABETIC_ORDER')"!][!//
              <CATEGORY>ALPHABETIC_ORDER</CATEGORY>
              <INITIAL-MODE-REF DEST="MODE-DECLARATION">/AUTOSAR_ComM/ModeDeclarationGroups/ComMMode/COMM_NO_COMMUNICATION</INITIAL-MODE-REF>
              <MODE-DECLARATIONS>
                <MODE-DECLARATION>
                  <SHORT-NAME>COMM_FULL_COMMUNICATION</SHORT-NAME>
                </MODE-DECLARATION>
                <MODE-DECLARATION>
                  <SHORT-NAME>COMM_NO_COMMUNICATION</SHORT-NAME>
                </MODE-DECLARATION>
                <MODE-DECLARATION>
                  <SHORT-NAME>COMM_SILENT_COMMUNICATION</SHORT-NAME>
                </MODE-DECLARATION>
              </MODE-DECLARATIONS>
            </MODE-DECLARATION-GROUP>
[!ELSE!][!//
              <CATEGORY>EXPLICIT_ORDER</CATEGORY>
              <INITIAL-MODE-REF DEST="MODE-DECLARATION">/AUTOSAR_ComM/ModeDeclarationGroups/ComMMode/COMM_NO_COMMUNICATION</INITIAL-MODE-REF>
              <MODE-DECLARATIONS>
                <MODE-DECLARATION>
                  <SHORT-NAME>COMM_NO_COMMUNICATION</SHORT-NAME>
                  <VALUE>0</VALUE>
                </MODE-DECLARATION>
                <MODE-DECLARATION>
                  <SHORT-NAME>COMM_SILENT_COMMUNICATION</SHORT-NAME>
                  <VALUE>1</VALUE>
                </MODE-DECLARATION>
                <MODE-DECLARATION>
                  <SHORT-NAME>COMM_FULL_COMMUNICATION</SHORT-NAME>
                  <VALUE>2</VALUE>
                </MODE-DECLARATION>
              </MODE-DECLARATIONS>
              <ON-TRANSITION-VALUE>3</ON-TRANSITION-VALUE>
            </MODE-DECLARATION-GROUP>
[!ENDIF!][!//
          </ELEMENTS>
        </AR-PACKAGE>
        <AR-PACKAGE> <!-- CompuMethods -->
          <SHORT-NAME>CompuMethods</SHORT-NAME>
          <ELEMENTS>
            <COMPU-METHOD>
              <SHORT-NAME>ComM_ModeTypeValues</SHORT-NAME>
              <CATEGORY>TEXTTABLE</CATEGORY>
              <COMPU-INTERNAL-TO-PHYS>
                <COMPU-SCALES>
                  <COMPU-SCALE>
                    <LOWER-LIMIT INTERVAL-TYPE="CLOSED">0</LOWER-LIMIT>
                    <UPPER-LIMIT INTERVAL-TYPE="CLOSED">0</UPPER-LIMIT>
                    <COMPU-CONST>
                      <VT>COMM_NO_COMMUNICATION</VT>
                    </COMPU-CONST>
                  </COMPU-SCALE>
                  <COMPU-SCALE>
                    <LOWER-LIMIT INTERVAL-TYPE="CLOSED">1</LOWER-LIMIT>
                    <UPPER-LIMIT INTERVAL-TYPE="CLOSED">1</UPPER-LIMIT>
                    <COMPU-CONST>
                      <VT>COMM_SILENT_COMMUNICATION</VT>
                    </COMPU-CONST>
                  </COMPU-SCALE>
                  <COMPU-SCALE>
                    <LOWER-LIMIT INTERVAL-TYPE="CLOSED">2</LOWER-LIMIT>
                    <UPPER-LIMIT INTERVAL-TYPE="CLOSED">2</UPPER-LIMIT>
                    <COMPU-CONST>
                      <VT>COMM_FULL_COMMUNICATION</VT>
                    </COMPU-CONST>
                  </COMPU-SCALE>
[!IF "num:i(count(as:modconf('ComM')[1]/ComMConfigSet/*[1]/ComMChannel/*[node:exists(ComMWakeupSleepRequestEnabled) and (ComMWakeupSleepRequestEnabled = 'true') ])) != 0"!]
                  <COMPU-SCALE>
                    <LOWER-LIMIT INTERVAL-TYPE="CLOSED">3</LOWER-LIMIT>
                    <UPPER-LIMIT INTERVAL-TYPE="CLOSED">3</UPPER-LIMIT>
                    <COMPU-CONST>
                      <VT>COMM_FULL_COMMUNICATION_WITH_WAKEUP_REQUEST</VT>
                    </COMPU-CONST>
                  </COMPU-SCALE>
[!ENDIF!] [!/*[!IF "num:i(count(as:modconf('ComM')[1]/ComMConfigSet/*[1]/ComMChannel/*[node:exists(ComMWakeupSleepRequestEnabled) and (ComMWakeupSleepRequestEnabled = 'true') ])) != 0"!] */!]
                </COMPU-SCALES>
              </COMPU-INTERNAL-TO-PHYS>
            </COMPU-METHOD>
          </ELEMENTS>
        </AR-PACKAGE>
[!ENDIF!]
        <AR-PACKAGE> <!-- DataTypeMappingSets -->
          <SHORT-NAME>DataTypeMappingSets</SHORT-NAME>
          <ELEMENTS>
            <DATA-TYPE-MAPPING-SET>
              <SHORT-NAME>DataTypeMappingSet_0</SHORT-NAME>
              <MODE-REQUEST-TYPE-MAPS>
                <MODE-REQUEST-TYPE-MAP>
                  <IMPLEMENTATION-DATA-TYPE-REF DEST="IMPLEMENTATION-DATA-TYPE">/AUTOSAR_Platform/ImplementationDataTypes/uint8</IMPLEMENTATION-DATA-TYPE-REF>
                  <MODE-GROUP-REF DEST="MODE-DECLARATION-GROUP">/AUTOSAR_ComM/ModeDeclarationGroups/ComMMode</MODE-GROUP-REF>
                </MODE-REQUEST-TYPE-MAP>
              </MODE-REQUEST-TYPE-MAPS>
            </DATA-TYPE-MAPPING-SET>
          </ELEMENTS>
        </AR-PACKAGE>
        <AR-PACKAGE> <!-- PortInterfaces -->
          <SHORT-NAME>PortInterfaces</SHORT-NAME>
          <ELEMENTS>
            <!-- Interface ComM_CurrentMode -->
            <!-- !LINKSTO ComM.SWS_ComM_01001,1 -->
            <MODE-SWITCH-INTERFACE>
              <SHORT-NAME>ComM_CurrentMode</SHORT-NAME>
              <IS-SERVICE>true</IS-SERVICE>
              <MODE-GROUP>
                <SHORT-NAME>currentMode</SHORT-NAME>
                <TYPE-TREF DEST="MODE-DECLARATION-GROUP">/AUTOSAR_ComM/ModeDeclarationGroups/ComMMode</TYPE-TREF>
              </MODE-GROUP>
            </MODE-SWITCH-INTERFACE>

            <!-- Interface ComM_UserRequest -->
            <CLIENT-SERVER-INTERFACE>
              <SHORT-NAME>ComM_UserRequest</SHORT-NAME>
              <IS-SERVICE>true</IS-SERVICE>
              <OPERATIONS>
                <!-- Operation RequestComMode -->
                <!-- !LINKSTO ComM.EB_Ref.SWS_ComM_01000.Operation.RequestComMode,1 -->
                <CLIENT-SERVER-OPERATION>
                  <SHORT-NAME>RequestComMode</SHORT-NAME>
                  <ARGUMENTS>
                    <ARGUMENT-DATA-PROTOTYPE>
                      <SHORT-NAME>ComMode</SHORT-NAME>
                      <TYPE-TREF DEST="IMPLEMENTATION-DATA-TYPE">/AUTOSAR_ComM/ImplementationDataTypes/ComM_ModeType</TYPE-TREF>
                      <DIRECTION>IN</DIRECTION>
                    </ARGUMENT-DATA-PROTOTYPE>
                  </ARGUMENTS>
                  <POSSIBLE-ERROR-REFS>
                    <POSSIBLE-ERROR-REF DEST="APPLICATION-ERROR">/AUTOSAR_ComM/PortInterfaces/ComM_UserRequest/E_NOT_OK</POSSIBLE-ERROR-REF>
                    <POSSIBLE-ERROR-REF DEST="APPLICATION-ERROR">/AUTOSAR_ComM/PortInterfaces/ComM_UserRequest/E_MODE_LIMITATION</POSSIBLE-ERROR-REF>
                  </POSSIBLE-ERROR-REFS>
                </CLIENT-SERVER-OPERATION>

                <!-- Operation GetCurrentComMode -->
                <!-- !LINKSTO ComM.EB_Ref.SWS_ComM_01000.Operation.GetCurrentComMode,1 -->
                <CLIENT-SERVER-OPERATION>
                  <SHORT-NAME>GetCurrentComMode</SHORT-NAME>
                  <ARGUMENTS>
                    <ARGUMENT-DATA-PROTOTYPE>
                      <SHORT-NAME>ComMode</SHORT-NAME>
                      <TYPE-TREF DEST="IMPLEMENTATION-DATA-TYPE">/AUTOSAR_ComM/ImplementationDataTypes/ComM_ModeType</TYPE-TREF>
                      <DIRECTION>OUT</DIRECTION>
                    </ARGUMENT-DATA-PROTOTYPE>
                  </ARGUMENTS>
                  <POSSIBLE-ERROR-REFS>
                    <POSSIBLE-ERROR-REF DEST="APPLICATION-ERROR">/AUTOSAR_ComM/PortInterfaces/ComM_UserRequest/E_NOT_OK</POSSIBLE-ERROR-REF>
                  </POSSIBLE-ERROR-REFS>
                </CLIENT-SERVER-OPERATION>
[!IF "ComMGeneral/ComMServiceAPI/ComMDefaultASRServiceAPI = 'AUTOSAR_40'"!]
[!IF "as:modconf('ComM')[1]/ComMGeneral/ComMEnableGetCurrentPNCComMode = 'true'"!]
                <!-- Operation GetCurrentPNCComMode -->
                <!-- !LINKSTO ComM.EB_Ref.SWS_ComM_01000.Operation.GetCurrentPNCComMode,1 -->
                <CLIENT-SERVER-OPERATION>
                  <SHORT-NAME>GetCurrentPNCComMode</SHORT-NAME>
                  <ARGUMENTS>
                    <ARGUMENT-DATA-PROTOTYPE>
                      <SHORT-NAME>ComMode</SHORT-NAME>
                      <TYPE-TREF DEST="IMPLEMENTATION-DATA-TYPE">/AUTOSAR_ComM/ImplementationDataTypes/ComM_ModeType</TYPE-TREF>
                      <DIRECTION>OUT</DIRECTION>
                    </ARGUMENT-DATA-PROTOTYPE>
                  </ARGUMENTS>
                  <POSSIBLE-ERROR-REFS>
                    <POSSIBLE-ERROR-REF DEST="APPLICATION-ERROR">/AUTOSAR_ComM/PortInterfaces/ComM_UserRequest/E_NOT_OK</POSSIBLE-ERROR-REF>
                    <POSSIBLE-ERROR-REF DEST="APPLICATION-ERROR">/AUTOSAR_ComM/PortInterfaces/ComM_UserRequest/E_MULTIPLE_PNC_ASSIGNED</POSSIBLE-ERROR-REF>
                    <POSSIBLE-ERROR-REF DEST="APPLICATION-ERROR">/AUTOSAR_ComM/PortInterfaces/ComM_UserRequest/E_NO_PNC_ASSIGNED</POSSIBLE-ERROR-REF>
                  </POSSIBLE-ERROR-REFS>
                </CLIENT-SERVER-OPERATION>
[!ENDIF!]
[!ENDIF!]
                <!-- Operation GetMaxComMode -->
                <!-- !LINKSTO ComM.EB_Ref.SWS_ComM_01000.Operation.GetMaxComMode,1 -->
                <CLIENT-SERVER-OPERATION>
                  <SHORT-NAME>GetMaxComMode</SHORT-NAME>
                  <ARGUMENTS>
                    <ARGUMENT-DATA-PROTOTYPE>
                      <SHORT-NAME>ComMode</SHORT-NAME>
                      <TYPE-TREF DEST="IMPLEMENTATION-DATA-TYPE">/AUTOSAR_ComM/ImplementationDataTypes/ComM_ModeType</TYPE-TREF>
                      <DIRECTION>OUT</DIRECTION>
                    </ARGUMENT-DATA-PROTOTYPE>
                  </ARGUMENTS>
                  <POSSIBLE-ERROR-REFS>
                    <POSSIBLE-ERROR-REF DEST="APPLICATION-ERROR">/AUTOSAR_ComM/PortInterfaces/ComM_UserRequest/E_NOT_OK</POSSIBLE-ERROR-REF>
                  </POSSIBLE-ERROR-REFS>
                </CLIENT-SERVER-OPERATION>
[!IF "ComMGeneral/ComMServiceAPI/ComMDefaultASRServiceAPI = 'AUTOSAR_32'"!]
                <!-- Operation GetRequestedMode -->
                <CLIENT-SERVER-OPERATION>
                  <SHORT-NAME>GetRequestedMode</SHORT-NAME>
                  <ARGUMENTS>
                    <ARGUMENT-DATA-PROTOTYPE>
                      <SHORT-NAME>ComMode</SHORT-NAME>
                      <TYPE-TREF DEST="IMPLEMENTATION-DATA-TYPE">/AUTOSAR_ComM/ImplementationDataTypes/ComM_ModeType</TYPE-TREF>
                      <DIRECTION>OUT</DIRECTION>
                    </ARGUMENT-DATA-PROTOTYPE>
                  </ARGUMENTS>
                  <POSSIBLE-ERROR-REFS>
                    <POSSIBLE-ERROR-REF DEST="APPLICATION-ERROR">/AUTOSAR_ComM/PortInterfaces/ComM_UserRequest/E_NOT_OK</POSSIBLE-ERROR-REF>
                  </POSSIBLE-ERROR-REFS>
                </CLIENT-SERVER-OPERATION>
[!ELSE!][!//
                <!-- Operation GetRequestedComMode -->
                <!-- !LINKSTO ComM.EB_Ref.SWS_ComM_01000.Operation.GetRequestedComMode,1 -->
                <CLIENT-SERVER-OPERATION>
                  <SHORT-NAME>GetRequestedComMode</SHORT-NAME>
                  <ARGUMENTS>
                    <ARGUMENT-DATA-PROTOTYPE>
                      <SHORT-NAME>ComMode</SHORT-NAME>
                      <TYPE-TREF DEST="IMPLEMENTATION-DATA-TYPE">/AUTOSAR_ComM/ImplementationDataTypes/ComM_ModeType</TYPE-TREF>
                      <DIRECTION>OUT</DIRECTION>
                    </ARGUMENT-DATA-PROTOTYPE>
                  </ARGUMENTS>
                  <POSSIBLE-ERROR-REFS>
                    <POSSIBLE-ERROR-REF DEST="APPLICATION-ERROR">/AUTOSAR_ComM/PortInterfaces/ComM_UserRequest/E_NOT_OK</POSSIBLE-ERROR-REF>
                  </POSSIBLE-ERROR-REFS>
                </CLIENT-SERVER-OPERATION>
[!ENDIF!]
              </OPERATIONS>
              <!-- Possible Errors -->
              <POSSIBLE-ERRORS>
                <APPLICATION-ERROR>
                  <SHORT-NAME>E_NOT_OK</SHORT-NAME>
                  <ERROR-CODE>1</ERROR-CODE>
                </APPLICATION-ERROR>
                <APPLICATION-ERROR>
                  <SHORT-NAME>E_MODE_LIMITATION</SHORT-NAME>
                  <ERROR-CODE>2</ERROR-CODE>
                </APPLICATION-ERROR>
[!IF "ComMGeneral/ComMServiceAPI/ComMDefaultASRServiceAPI = 'AUTOSAR_40'"!]
[!IF "as:modconf('ComM')[1]/ComMGeneral/ComMEnableGetCurrentPNCComMode = 'true'"!]
                <APPLICATION-ERROR>
                  <SHORT-NAME>E_MULTIPLE_PNC_ASSIGNED</SHORT-NAME>
                  <ERROR-CODE>3</ERROR-CODE>
                </APPLICATION-ERROR>
                <APPLICATION-ERROR>
                  <SHORT-NAME>E_NO_PNC_ASSIGNED</SHORT-NAME>
                  <ERROR-CODE>4</ERROR-CODE>
                </APPLICATION-ERROR>
[!ENDIF!]
[!ENDIF!]
              </POSSIBLE-ERRORS>
            </CLIENT-SERVER-INTERFACE>
[!IF "ComMGeneral/ComMServiceAPI/ComMDefaultASRServiceAPI = 'AUTOSAR_40'"!]
            <!-- Interface ComM_CurrentChannelRequest -->
            <SENDER-RECEIVER-INTERFACE>
              <SHORT-NAME>ComM_CurrentChannelRequest</SHORT-NAME>
              <IS-SERVICE>true</IS-SERVICE>
              <DATA-ELEMENTS>
                <VARIABLE-DATA-PROTOTYPE>
                  <!-- !LINKSTO ComM.EB.SWS_ComM_00904,1 -->
                  <SHORT-NAME>fullComRequestors</SHORT-NAME>
                  <SW-DATA-DEF-PROPS>
                    <SW-DATA-DEF-PROPS-VARIANTS>
                      <SW-DATA-DEF-PROPS-CONDITIONAL>
                        <SW-IMPL-POLICY>STANDARD</SW-IMPL-POLICY>
                      </SW-DATA-DEF-PROPS-CONDITIONAL>
                    </SW-DATA-DEF-PROPS-VARIANTS>
                  </SW-DATA-DEF-PROPS>
                  <TYPE-TREF DEST="IMPLEMENTATION-DATA-TYPE">/AUTOSAR_ComM/ImplementationDataTypes/ComM_UserHandleArrayType</TYPE-TREF>
                </VARIABLE-DATA-PROTOTYPE>
              </DATA-ELEMENTS>
            </SENDER-RECEIVER-INTERFACE>
[!ENDIF!]
            <!-- Interface ComM_ECUModeLimitation -->
            <!-- !LINKSTO ComM.SWS_ComM_00740,1, ComM.SWS_ComM_00741,1, ComM.SWS_ComM_00744,1 -->
            <CLIENT-SERVER-INTERFACE>
              <SHORT-NAME>ComM_ECUModeLimitation</SHORT-NAME>
              <IS-SERVICE>true</IS-SERVICE>
              <OPERATIONS>
                <!-- Operation LimitECUToNoComMode -->
                <CLIENT-SERVER-OPERATION>
                  <SHORT-NAME>LimitECUToNoComMode</SHORT-NAME>
                  <ARGUMENTS>
                    <ARGUMENT-DATA-PROTOTYPE>
                      <SHORT-NAME>Status</SHORT-NAME>
                      <TYPE-TREF DEST="IMPLEMENTATION-DATA-TYPE">/AUTOSAR_Platform/ImplementationDataTypes/boolean</TYPE-TREF>
                      <DIRECTION>IN</DIRECTION>
                    </ARGUMENT-DATA-PROTOTYPE>
                  </ARGUMENTS>
                  <POSSIBLE-ERROR-REFS>
                    <POSSIBLE-ERROR-REF DEST="APPLICATION-ERROR">/AUTOSAR_ComM/PortInterfaces/ComM_ECUModeLimitation/E_NOT_OK</POSSIBLE-ERROR-REF>
                  </POSSIBLE-ERROR-REFS>
                </CLIENT-SERVER-OPERATION>
                <!-- Operation ReadInhibitCounter -->
                <CLIENT-SERVER-OPERATION>
                  <SHORT-NAME>ReadInhibitCounter</SHORT-NAME>
                  <ARGUMENTS>
                    <ARGUMENT-DATA-PROTOTYPE>
                      <SHORT-NAME>CounterValue</SHORT-NAME>
                      <TYPE-TREF DEST="IMPLEMENTATION-DATA-TYPE">/AUTOSAR_Platform/ImplementationDataTypes/uint16</TYPE-TREF>
                      <DIRECTION>OUT</DIRECTION>
                    </ARGUMENT-DATA-PROTOTYPE>
                  </ARGUMENTS>
                  <POSSIBLE-ERROR-REFS>
                    <POSSIBLE-ERROR-REF DEST="APPLICATION-ERROR">/AUTOSAR_ComM/PortInterfaces/ComM_ECUModeLimitation/E_NOT_OK</POSSIBLE-ERROR-REF>
                  </POSSIBLE-ERROR-REFS>
                </CLIENT-SERVER-OPERATION>
                <!-- Operation ResetInhibitCounter -->
                <CLIENT-SERVER-OPERATION>
                  <SHORT-NAME>ResetInhibitCounter</SHORT-NAME>
                  <ARGUMENTS/>
                  <POSSIBLE-ERROR-REFS>
                    <POSSIBLE-ERROR-REF DEST="APPLICATION-ERROR">/AUTOSAR_ComM/PortInterfaces/ComM_ECUModeLimitation/E_NOT_OK</POSSIBLE-ERROR-REF>
                  </POSSIBLE-ERROR-REFS>
                </CLIENT-SERVER-OPERATION>
                <!-- Operation SetECUGroupClassification -->
                <CLIENT-SERVER-OPERATION>
                  <SHORT-NAME>SetECUGroupClassification</SHORT-NAME>
                  <ARGUMENTS>
                    <ARGUMENT-DATA-PROTOTYPE>
                      <SHORT-NAME>Status</SHORT-NAME>
                      <TYPE-TREF DEST="IMPLEMENTATION-DATA-TYPE">/AUTOSAR_ComM/ImplementationDataTypes/ComM_InhibitionStatusType</TYPE-TREF>
                      <DIRECTION>IN</DIRECTION>
                    </ARGUMENT-DATA-PROTOTYPE>
                  </ARGUMENTS>
                  <POSSIBLE-ERROR-REFS>
                    <POSSIBLE-ERROR-REF DEST="APPLICATION-ERROR">/AUTOSAR_ComM/PortInterfaces/ComM_ECUModeLimitation/E_NOT_OK</POSSIBLE-ERROR-REF>
                  </POSSIBLE-ERROR-REFS>
                </CLIENT-SERVER-OPERATION>
              </OPERATIONS>
              <!-- Possible Errors -->
              <POSSIBLE-ERRORS>
                <APPLICATION-ERROR>
                  <SHORT-NAME>E_NOT_OK</SHORT-NAME>
                  <ERROR-CODE>1</ERROR-CODE>
                </APPLICATION-ERROR>
              </POSSIBLE-ERRORS>
            </CLIENT-SERVER-INTERFACE>

            <!-- Interface ComM_ChannelLimitation -->
            <!-- !LINKSTO ComM.SWS_ComM_00752,1, ComM.SWS_ComM_00743,1, ComM.SWS_ComM_00744,1 -->
            <CLIENT-SERVER-INTERFACE>
              <SHORT-NAME>ComM_ChannelLimitation</SHORT-NAME>
              <IS-SERVICE>true</IS-SERVICE>
              <OPERATIONS>
                <!-- Operation LimitChannelToNoComMode -->
                <CLIENT-SERVER-OPERATION>
                  <SHORT-NAME>LimitChannelToNoComMode</SHORT-NAME>
                  <ARGUMENTS>
                    <ARGUMENT-DATA-PROTOTYPE>
                      <SHORT-NAME>Status</SHORT-NAME>
                      <TYPE-TREF DEST="IMPLEMENTATION-DATA-TYPE">/AUTOSAR_Platform/ImplementationDataTypes/boolean</TYPE-TREF>
                      <DIRECTION>IN</DIRECTION>
                    </ARGUMENT-DATA-PROTOTYPE>
                  </ARGUMENTS>
                  <POSSIBLE-ERROR-REFS>
                    <POSSIBLE-ERROR-REF DEST="APPLICATION-ERROR">/AUTOSAR_ComM/PortInterfaces/ComM_ChannelLimitation/E_NOT_OK</POSSIBLE-ERROR-REF>
                  </POSSIBLE-ERROR-REFS>
                </CLIENT-SERVER-OPERATION>
                <!-- Operation GetInhibitionStatus -->
                <CLIENT-SERVER-OPERATION>
                  <SHORT-NAME>GetInhibitionStatus</SHORT-NAME>
                  <ARGUMENTS>
                    <ARGUMENT-DATA-PROTOTYPE>
                      <SHORT-NAME>Status</SHORT-NAME>
                      <TYPE-TREF DEST="IMPLEMENTATION-DATA-TYPE">/AUTOSAR_ComM/ImplementationDataTypes/ComM_InhibitionStatusType</TYPE-TREF>
                      <DIRECTION>OUT</DIRECTION>
                    </ARGUMENT-DATA-PROTOTYPE>
                  </ARGUMENTS>
                  <POSSIBLE-ERROR-REFS>
                    <POSSIBLE-ERROR-REF DEST="APPLICATION-ERROR">/AUTOSAR_ComM/PortInterfaces/ComM_ChannelLimitation/E_NOT_OK</POSSIBLE-ERROR-REF>
                  </POSSIBLE-ERROR-REFS>
                </CLIENT-SERVER-OPERATION>
              </OPERATIONS>
              <POSSIBLE-ERRORS>
                <APPLICATION-ERROR>
                  <SHORT-NAME>E_NOT_OK</SHORT-NAME>
                  <ERROR-CODE>1</ERROR-CODE>
                </APPLICATION-ERROR>
              </POSSIBLE-ERRORS>
            </CLIENT-SERVER-INTERFACE>

            <!-- Interface ComM_ChannelWakeup -->
            <!-- !LINKSTO ComM.SWS_ComM_00747,1, ComM.SWS_ComM_00742,1, ComM.SWS_ComM_00744,1 -->
            <CLIENT-SERVER-INTERFACE>
              <SHORT-NAME>ComM_ChannelWakeup</SHORT-NAME>
              <IS-SERVICE>true</IS-SERVICE>
              <OPERATIONS>
                <CLIENT-SERVER-OPERATION>
                  <SHORT-NAME>PreventWakeUp</SHORT-NAME>
                  <ARGUMENTS>
                    <ARGUMENT-DATA-PROTOTYPE>
                      <SHORT-NAME>Status</SHORT-NAME>
                      <TYPE-TREF DEST="IMPLEMENTATION-DATA-TYPE">/AUTOSAR_Platform/ImplementationDataTypes/boolean</TYPE-TREF>
                      <DIRECTION>IN</DIRECTION>
                    </ARGUMENT-DATA-PROTOTYPE>
                  </ARGUMENTS>
                  <POSSIBLE-ERROR-REFS>
                    <POSSIBLE-ERROR-REF DEST="APPLICATION-ERROR">/AUTOSAR_ComM/PortInterfaces/ComM_ChannelWakeup/E_NOT_OK</POSSIBLE-ERROR-REF>
                  </POSSIBLE-ERROR-REFS>
                </CLIENT-SERVER-OPERATION>
                <!-- Operation GetInhibitionStatus -->
                <CLIENT-SERVER-OPERATION>
                  <SHORT-NAME>GetInhibitionStatus</SHORT-NAME>
                  <ARGUMENTS>
                    <ARGUMENT-DATA-PROTOTYPE>
                      <SHORT-NAME>Status</SHORT-NAME>
                      <TYPE-TREF DEST="IMPLEMENTATION-DATA-TYPE">/AUTOSAR_ComM/ImplementationDataTypes/ComM_InhibitionStatusType</TYPE-TREF>
                      <DIRECTION>OUT</DIRECTION>
                    </ARGUMENT-DATA-PROTOTYPE>
                  </ARGUMENTS>
                  <POSSIBLE-ERROR-REFS>
                    <POSSIBLE-ERROR-REF DEST="APPLICATION-ERROR">/AUTOSAR_ComM/PortInterfaces/ComM_ChannelWakeup/E_NOT_OK</POSSIBLE-ERROR-REF>
                  </POSSIBLE-ERROR-REFS>
                </CLIENT-SERVER-OPERATION>
              </OPERATIONS>
              <POSSIBLE-ERRORS>
                <APPLICATION-ERROR>
                  <SHORT-NAME>E_NOT_OK</SHORT-NAME>
                  <ERROR-CODE>1</ERROR-CODE>
                </APPLICATION-ERROR>
              </POSSIBLE-ERRORS>
            </CLIENT-SERVER-INTERFACE>
          </ELEMENTS>
        </AR-PACKAGE>
[!ENDIF!]
      </AR-PACKAGES>
    </AR-PACKAGE>
  </AR-PACKAGES>
[!ENDIF!] [!/*[!/*[!IF "(count(text:split($FoundUserPlusChannePlusMasterPncPlusInhibitionOsApplications,' ')) > 1) and (as:modconf('ComM')[1]/ComMGeneral/ComMMultiCoreSupport = 'false')"!]*/!]
</AUTOSAR>
