[part 2 of 3]

  [!IF "num:i(count(as:modconf('ComM')[1]/ComMConfigSet/*[1]/ComMUser/*)) > 0"!]
    [!FOR "Idx1" = "1" TO "count(text:split($UserToMasterPncFromOsApp_ToOsApp,' '))"!]
      [!VAR "FromOsApplicationToOsApplication" = "string(text:split($UserToMasterPncFromOsApp_ToOsApp,' ')[position() = $Idx1])"!]
      [!VAR "FromOsApplication" = "string(text:split($FromOsApplicationToOsApplication,'->')[position() = 1])"!]
      [!VAR "ToOsApplication" = "string(text:split($FromOsApplicationToOsApplication,'->')[position() = 2])"!]
        [!CALL "GetUserToMasterPncQueueSize","FromOsApplication"="$FromOsApplication"!]
                    <BSW-QUEUED-DATA-RECEPTION-POLICY>
                      <ENABLE-TAKE-ADDRESS>true</ENABLE-TAKE-ADDRESS>
                      <RECEIVED-DATA-REF DEST="VARIABLE-DATA-PROTOTYPE">/AUTOSAR_ComM/BswModuleDescriptions/ComM/ComM_User_To_MasterPnc_From_[!"$FromOsApplication"!]_To_[!"$ToOsApplication"!]_DataGet</RECEIVED-DATA-REF>
                      <QUEUE-LENGTH>[!"num:i($UserToMasterPncQueueSize)"!]</QUEUE-LENGTH>
                    </BSW-QUEUED-DATA-RECEPTION-POLICY>
    [!ENDFOR!] [!/*[!FOR "Idx1" = "1" TO "count(text:split($UserToMasterPncFromOsApp_ToOsApp,' '))"!]*/!]
  [!ENDIF!] [!/*[!IF "num:i(count(as:modconf('ComM')[1]/ComMConfigSet/*[1]/ComMUser/*)) > 0"!]*/!]
  [!FOR "Idx1" = "1" TO "count(text:split($ChToMasterPncFromOsApp_ToOsApp,' '))"!]
    [!VAR "FromOsApplicationToOsApplication" = "string(text:split($ChToMasterPncFromOsApp_ToOsApp,' ')[position() = $Idx1])"!]
    [!VAR "FromOsApplication" = "string(text:split($FromOsApplicationToOsApplication,'->')[position() = 1])"!]
    [!VAR "ToOsApplication" = "string(text:split($FromOsApplicationToOsApplication,'->')[position() = 2])"!]
    [!CALL "GetChToMasterPncQueueSize","FromOsApplication"="$FromOsApplication"!]
                    <BSW-QUEUED-DATA-RECEPTION-POLICY>
                      <ENABLE-TAKE-ADDRESS>true</ENABLE-TAKE-ADDRESS>
                      <RECEIVED-DATA-REF DEST="VARIABLE-DATA-PROTOTYPE">/AUTOSAR_ComM/BswModuleDescriptions/ComM/ComM_Ch_To_MasterPnc_From_[!"$FromOsApplication"!]_To_[!"$ToOsApplication"!]_DataGet</RECEIVED-DATA-REF>
                      <QUEUE-LENGTH>[!"num:i($ChToMasterPncQueueSize)"!]</QUEUE-LENGTH>
                    </BSW-QUEUED-DATA-RECEPTION-POLICY>
  [!ENDFOR!] [!/*[!FOR "Idx1" = "1" TO "count(text:split($ChToMasterPncFromOsApp_ToOsApp,' '))"!]*/!]

  [!IF "node:exists(as:modconf('ComM')[1]/ComMGeneral/ComMSynchronizedPncShutdownEnabled) and (as:modconf('ComM')[1]/ComMGeneral/ComMSynchronizedPncShutdownEnabled = 'true')"!]
    [!FOR "Idx1" = "1" TO "count(text:split($SynchShutDownChToMasterPncFromOsApp_ToOsApp,' '))"!]
      [!VAR "FromOsApplicationToOsApplication" = "string(text:split($SynchShutDownChToMasterPncFromOsApp_ToOsApp,' ')[position() = $Idx1])"!]
      [!VAR "FromOsApplication" = "string(text:split($FromOsApplicationToOsApplication,'->')[position() = 1])"!]
      [!VAR "ToOsApplication" = "string(text:split($FromOsApplicationToOsApplication,'->')[position() = 2])"!]
      [!CALL "GetSynchShutDownChToMasterPnc_QueueSize","FromOsApplication"="$FromOsApplication"!]
                    <BSW-QUEUED-DATA-RECEPTION-POLICY>
                      <ENABLE-TAKE-ADDRESS>true</ENABLE-TAKE-ADDRESS>
                      <RECEIVED-DATA-REF DEST="VARIABLE-DATA-PROTOTYPE">/AUTOSAR_ComM/BswModuleDescriptions/ComM/ComM_SynchShutDownCh_To_MasterPnc_From_[!"$FromOsApplication"!]_To_[!"$ToOsApplication"!]_DataGet</RECEIVED-DATA-REF>
                      <QUEUE-LENGTH>[!"num:i($SynchShutDownChToMasterPncQueueSize)"!]</QUEUE-LENGTH>
                    </BSW-QUEUED-DATA-RECEPTION-POLICY>
    [!ENDFOR!] [!/*[!FOR "Idx1" = "1" TO "count(text:split($SynchShutDownChToMasterPncFromOsApp_ToOsApp,' '))"!]*/!]
  [!ENDIF!] [!/*[!IF "node:exists(as:modconf('ComM')[1]/ComMGeneral/ComMSynchronizedPncShutdownEnabled) and (as:modconf('ComM')[1]/ComMGeneral/ComMSynchronizedPncShutdownEnabled = 'true')"!]*/!]
                  </RECEPTION-POLICYS>
                </BSW-INTERNAL-BEHAVIOR>
[!ENDIF!] [!/* [!IF "as:modconf('ComM')[1]/ComMGeneral/ComMPncSupport = 'true'"!] */!]
[!FOR "Idx1" = "1" TO "count(text:split($FoundChannelsOsApplications,' '))"!]
  [!VAR "CurrentOsApplication" = "string(text:split($FoundChannelsOsApplications,' ')[position() = $Idx1])"!]
                <BSW-INTERNAL-BEHAVIOR>
                  <SHORT-NAME>InternalBehavior_Ch_OsApplication_[!"$CurrentOsApplication"!]</SHORT-NAME>
                  <EXCLUSIVE-AREAS>
                    <EXCLUSIVE-AREA>
                      <SHORT-NAME>SCHM_COMM_EXCLUSIVE_AREA_CH_OSAPPLICATION_[!"$CurrentOsApplication"!]</SHORT-NAME>
                    </EXCLUSIVE-AREA>
                  </EXCLUSIVE-AREAS>
                  <ENTITYS>
  [!LOOP "as:modconf('ComM')[1]/ComMConfigSet/*[1]/ComMChannel/*"!]
    [!VAR "EcuCChannelPartitonRef" = "ComMChannelPartitionRef"!]
    [!IF "string(node:name(as:modconf('Os')[1]/OsApplication/*[node:exists(OsAppEcucPartitionRef) and (string(OsAppEcucPartitionRef) = $EcuCChannelPartitonRef)])) = $CurrentOsApplication"!]
      [!CALL "GetDcmChannelFound","CurrentComMChannelId"="ComMChannelId"!]
      [!CALL "GetChannelOsApplication","ChannelEcuCPartitionRef"="ComMChannelPartitionRef"!]
                    <BSW-SCHEDULABLE-ENTITY>
                      <SHORT-NAME>ComM_1_Ch_OsApplication_[!"$ChannelOsApplication"!]_ComM_MainFunction_[!"ComMChannelId"!]</SHORT-NAME>
                      <CAN-ENTER-EXCLUSIVE-AREA-REFS>
                        <CAN-ENTER-EXCLUSIVE-AREA-REF DEST="EXCLUSIVE-AREA">/AUTOSAR_ComM/BswModuleDescriptions/ComM/InternalBehavior_Ch_OsApplication_[!"$CurrentOsApplication"!]/SCHM_COMM_EXCLUSIVE_AREA_CH_OSAPPLICATION_[!"$CurrentOsApplication"!]</CAN-ENTER-EXCLUSIVE-AREA-REF>
                      </CAN-ENTER-EXCLUSIVE-AREA-REFS>
                      <MINIMUM-START-INTERVAL>0.0</MINIMUM-START-INTERVAL>
                      <CALL-POINTS>
      [!IF "$DcmChannelFound = 'true'"!]
                        <BSW-ASYNCHRONOUS-SERVER-CALL-POINT>
                          <SHORT-NAME>AsynchCallPoint_Dcm_ComM_FullComModeEntered_[!"node:name(.)"!]</SHORT-NAME>
                          <CALLED-ENTRY-REF DEST="BSW-MODULE-CLIENT-SERVER-ENTRY">/AUTOSAR_ComM/BswModuleDescriptions/ComM/RequiredCSEntry_Dcm_ComM_FullComModeEntered_[!"node:name(.)"!]</CALLED-ENTRY-REF>
                        </BSW-ASYNCHRONOUS-SERVER-CALL-POINT>
        [!IF "(ComMBusType = 'COMM_BUS_TYPE_CAN' or ComMBusType = 'COMM_BUS_TYPE_ETH') and (ComMNetworkManagement/ComMNmVariant = 'FULL' or ComMNetworkManagement/ComMNmVariant = 'PASSIVE')"!]
                        <BSW-ASYNCHRONOUS-SERVER-CALL-POINT>
                          <SHORT-NAME>AsynchCallPoint_Dcm_ComM_SilentComModeEntered_[!"node:name(.)"!]</SHORT-NAME>
                          <CALLED-ENTRY-REF DEST="BSW-MODULE-CLIENT-SERVER-ENTRY">/AUTOSAR_ComM/BswModuleDescriptions/ComM/RequiredCSEntry_Dcm_ComM_SilentComModeEntered_[!"node:name(.)"!]</CALLED-ENTRY-REF>
                        </BSW-ASYNCHRONOUS-SERVER-CALL-POINT>
        [!ENDIF!] [!/* [!IF "(ComMBusType = 'COMM_BUS_TYPE_CAN' or ComMBusType = 'COMM_BUS_TYPE_ETH') and (ComMNetworkManagement/ComMNmVariant = 'FULL' or ComMNetworkManagement/ComMNmVariant = 'PASSIVE')"!] */!]
                        <BSW-ASYNCHRONOUS-SERVER-CALL-POINT>
                          <SHORT-NAME>AsynchCallPoint_Dcm_ComM_NoComModeEntered_[!"node:name(.)"!]</SHORT-NAME>
                          <CALLED-ENTRY-REF DEST="BSW-MODULE-CLIENT-SERVER-ENTRY">/AUTOSAR_ComM/BswModuleDescriptions/ComM/RequiredCSEntry_Dcm_ComM_NoComModeEntered_[!"node:name(.)"!]</CALLED-ENTRY-REF>
                        </BSW-ASYNCHRONOUS-SERVER-CALL-POINT>
      [!ENDIF!] [!/* [!IF "$DcmChannelFound = 'true'"!] */!]
                      </CALL-POINTS>
                      <IMPLEMENTED-ENTRY-REF DEST="BSW-MODULE-ENTRY">/AUTOSAR_ComM/[!"$bswModuleEntryPackageName"!]/ComM_MainFunction_[!"ComMChannelId"!]</IMPLEMENTED-ENTRY-REF>
                    </BSW-SCHEDULABLE-ENTITY>
    [!ENDIF!] [!/* [!IF "string(node:name(as:modconf('Os')[1]/OsApplication/*[node:exists(OsAppEcucPartitionRef) and (string(OsAppEcucPartitionRef) = $EcuCChannelPartitonRef)])) = $CurrentOsApplication"!] */!]
  [!ENDLOOP!] [!/* [!LOOP "as:modconf('ComM')[1]/ComMConfigSet/*[1]/ComMChannel/*"!]!*/!]
  [!FOR "Idx2" = "1" TO "count(text:split($ChToChFromOsApp_ToOsApp,' '))"!]
    [!VAR "FromOsApplicationToOsApplication" = "string(text:split($ChToChFromOsApp_ToOsApp,' ')[position() = $Idx2])"!]
    [!VAR "FromOsApplication" = "string(text:split($FromOsApplicationToOsApplication,'->')[position() = 1])"!]
    [!VAR "ToOsApplication" = "string(text:split($FromOsApplicationToOsApplication,'->')[position() = 2])"!]
    [!IF "$CurrentOsApplication = $ToOsApplication"!]
                    <BSW-SCHEDULABLE-ENTITY>
                      <SHORT-NAME>BswSchEnt_ComM_Ch_To_Ch_From_[!"$FromOsApplication"!]_To_[!"$ToOsApplication"!]_RcvFnct</SHORT-NAME>
                      <CAN-ENTER-EXCLUSIVE-AREA-REFS>
                        <CAN-ENTER-EXCLUSIVE-AREA-REF DEST="EXCLUSIVE-AREA">/AUTOSAR_ComM/BswModuleDescriptions/ComM/InternalBehavior_Ch_OsApplication_[!"$ToOsApplication"!]/SCHM_COMM_EXCLUSIVE_AREA_CH_OSAPPLICATION_[!"$ToOsApplication"!]</CAN-ENTER-EXCLUSIVE-AREA-REF>
                      </CAN-ENTER-EXCLUSIVE-AREA-REFS>
                      <MINIMUM-START-INTERVAL>0.0</MINIMUM-START-INTERVAL>
                      <DATA-RECEIVE-POINTS>
                        <!-- MasterPnc core only -->
                        <BSW-VARIABLE-ACCESS>
                          <SHORT-NAME>BswVarAccess_ComM_Ch_To_Ch_From_[!"$FromOsApplication"!]_To_[!"$ToOsApplication"!]_DataGet</SHORT-NAME>
                          <ACCESSED-VARIABLE-REF DEST="VARIABLE-DATA-PROTOTYPE">/AUTOSAR_ComM/BswModuleDescriptions/ComM/ComM_Ch_To_Ch_From_[!"$FromOsApplication"!]_To_[!"$ToOsApplication"!]_DataGet</ACCESSED-VARIABLE-REF>
                        </BSW-VARIABLE-ACCESS>
                      </DATA-RECEIVE-POINTS>
                      <IMPLEMENTED-ENTRY-REF DEST="BSW-MODULE-ENTRY">/AUTOSAR_ComM/[!"$bswModuleEntryPackageName"!]/ComM_Ch_To_Ch_From_[!"$FromOsApplication"!]_To_[!"$ToOsApplication"!]_RcvFnct</IMPLEMENTED-ENTRY-REF>
                    </BSW-SCHEDULABLE-ENTITY>
    [!ENDIF!] [!/*[!IF "$CurrentOsApplication = $ToOsApplication"!]*/!]
  [!ENDFOR!] [!/*[!FOR "Idx2" = "1" TO "count(text:split($ChToChFromOsApp_ToOsApp,' '))"!]*/!]
  [!IF "as:modconf('ComM')[1]/ComMGeneral/ComMPncSupport = 'true'"!]
    [!FOR "Idx2" = "1" TO "count(text:split($MasterPncToChFromOsApp_ToOsApp,' '))"!]
      [!VAR "FromOsApplicationToOsApplication" = "string(text:split($MasterPncToChFromOsApp_ToOsApp,' ')[position() = $Idx2])"!]
      [!VAR "FromOsApplication" = "string(text:split($FromOsApplicationToOsApplication,'->')[position() = 1])"!]
      [!VAR "ToOsApplication" = "string(text:split($FromOsApplicationToOsApplication,'->')[position() = 2])"!]
      [!IF "$CurrentOsApplication = $ToOsApplication"!]
                    <BSW-SCHEDULABLE-ENTITY>
                      <SHORT-NAME>BswSchEnt_ComM_MasterPnc_To_Ch_From_[!"$FromOsApplication"!]_To_[!"$ToOsApplication"!]_RcvFnct</SHORT-NAME>
                      <CAN-ENTER-EXCLUSIVE-AREA-REFS>
                        <CAN-ENTER-EXCLUSIVE-AREA-REF DEST="EXCLUSIVE-AREA">/AUTOSAR_ComM/BswModuleDescriptions/ComM/InternalBehavior_Ch_OsApplication_[!"$ToOsApplication"!]/SCHM_COMM_EXCLUSIVE_AREA_CH_OSAPPLICATION_[!"$ToOsApplication"!]</CAN-ENTER-EXCLUSIVE-AREA-REF>
                      </CAN-ENTER-EXCLUSIVE-AREA-REFS>
                      <MINIMUM-START-INTERVAL>0.0</MINIMUM-START-INTERVAL>
                      <DATA-RECEIVE-POINTS>
                        <!-- MasterPnc core only -->
                        <BSW-VARIABLE-ACCESS>
                          <SHORT-NAME>BswVarAccess_ComM_MasterPnc_To_Ch_From_[!"$FromOsApplication"!]_To_[!"$ToOsApplication"!]_DataGet</SHORT-NAME>
                          <ACCESSED-VARIABLE-REF DEST="VARIABLE-DATA-PROTOTYPE">/AUTOSAR_ComM/BswModuleDescriptions/ComM/ComM_MasterPnc_To_Ch_From_[!"$FromOsApplication"!]_To_[!"$ToOsApplication"!]_DataGet</ACCESSED-VARIABLE-REF>
                        </BSW-VARIABLE-ACCESS>
                      </DATA-RECEIVE-POINTS>
                      <IMPLEMENTED-ENTRY-REF DEST="BSW-MODULE-ENTRY">/AUTOSAR_ComM/[!"$bswModuleEntryPackageName"!]/ComM_MasterPnc_To_Ch_From_[!"$FromOsApplication"!]_To_[!"$ToOsApplication"!]_RcvFnct</IMPLEMENTED-ENTRY-REF>
                    </BSW-SCHEDULABLE-ENTITY>
      [!ENDIF!] [!/*[!IF "$CurrentOsApplication = $ToOsApplication"!]*/!]
    [!ENDFOR!] [!/*[!FOR "Idx2" = "1" TO "count(text:split($MasterPncToChFromOsApp_ToOsApp,' '))"!] */!]
    
    
    [!FOR "Idx2" = "1" TO "count(text:split($EvaluateChannelMasterPncToChFromOsApp_ToOsApp,' '))"!]
      [!VAR "FromOsApplicationToOsApplication" = "string(text:split($EvaluateChannelMasterPncToChFromOsApp_ToOsApp,' ')[position() = $Idx2])"!]
      [!VAR "FromOsApplication" = "string(text:split($FromOsApplicationToOsApplication,'->')[position() = 1])"!]
      [!VAR "ToOsApplication" = "string(text:split($FromOsApplicationToOsApplication,'->')[position() = 2])"!]
      [!IF "$CurrentOsApplication = $ToOsApplication"!]
                    <BSW-SCHEDULABLE-ENTITY>
                      <SHORT-NAME>BswSchEnt_ComM_EvaluateChannel_MasterPnc_To_Ch_From_[!"$FromOsApplication"!]_To_[!"$ToOsApplication"!]_RcvFnct</SHORT-NAME>
                      <CAN-ENTER-EXCLUSIVE-AREA-REFS>
                        <CAN-ENTER-EXCLUSIVE-AREA-REF DEST="EXCLUSIVE-AREA">/AUTOSAR_ComM/BswModuleDescriptions/ComM/InternalBehavior_Ch_OsApplication_[!"$ToOsApplication"!]/SCHM_COMM_EXCLUSIVE_AREA_CH_OSAPPLICATION_[!"$ToOsApplication"!]</CAN-ENTER-EXCLUSIVE-AREA-REF>
                      </CAN-ENTER-EXCLUSIVE-AREA-REFS>
                      <MINIMUM-START-INTERVAL>0.0</MINIMUM-START-INTERVAL>
                      <DATA-RECEIVE-POINTS>
                        <!-- MasterPnc core only -->
                        <BSW-VARIABLE-ACCESS>
                          <SHORT-NAME>BswVarAccess_ComM_EvaluateChannel_MasterPnc_To_Ch_From_[!"$FromOsApplication"!]_To_[!"$ToOsApplication"!]_DataGet</SHORT-NAME>
                          <ACCESSED-VARIABLE-REF DEST="VARIABLE-DATA-PROTOTYPE">/AUTOSAR_ComM/BswModuleDescriptions/ComM/ComM_EvaluateChannel_MasterPnc_To_Ch_From_[!"$FromOsApplication"!]_To_[!"$ToOsApplication"!]_DataGet</ACCESSED-VARIABLE-REF>
                        </BSW-VARIABLE-ACCESS>
                      </DATA-RECEIVE-POINTS>
                      <IMPLEMENTED-ENTRY-REF DEST="BSW-MODULE-ENTRY">/AUTOSAR_ComM/[!"$bswModuleEntryPackageName"!]/ComM_EvaluateChannel_MasterPnc_To_Ch_From_[!"$FromOsApplication"!]_To_[!"$ToOsApplication"!]_RcvFnct</IMPLEMENTED-ENTRY-REF>
                    </BSW-SCHEDULABLE-ENTITY>
      [!ENDIF!] [!/*[!IF "$CurrentOsApplication = $ToOsApplication"!]*/!]
    [!ENDFOR!] [!/*[!FOR "Idx2" = "1" TO "count(text:split($EvaluateChannelMasterPncToChFromOsApp_ToOsApp,' '))"!] */!]    
    
    
    [!FOR "Idx2" = "1" TO "count(text:split($SynchShutDownMasterPncToChFromOsApp_ToOsApp,' '))"!]
      [!VAR "FromOsApplicationToOsApplication" = "string(text:split($SynchShutDownMasterPncToChFromOsApp_ToOsApp,' ')[position() = $Idx2])"!]
      [!VAR "FromOsApplication" = "string(text:split($FromOsApplicationToOsApplication,'->')[position() = 1])"!]
      [!VAR "ToOsApplication" = "string(text:split($FromOsApplicationToOsApplication,'->')[position() = 2])"!]
      [!IF "$CurrentOsApplication = $ToOsApplication"!]
                    <BSW-SCHEDULABLE-ENTITY>
                      <SHORT-NAME>BswSchEnt_ComM_SynchShutDown_MasterPnc_To_Ch_From_[!"$FromOsApplication"!]_To_[!"$ToOsApplication"!]_RcvFnct</SHORT-NAME>
                      <CAN-ENTER-EXCLUSIVE-AREA-REFS>
                        <CAN-ENTER-EXCLUSIVE-AREA-REF DEST="EXCLUSIVE-AREA">/AUTOSAR_ComM/BswModuleDescriptions/ComM/InternalBehavior_Ch_OsApplication_[!"$ToOsApplication"!]/SCHM_COMM_EXCLUSIVE_AREA_CH_OSAPPLICATION_[!"$ToOsApplication"!]</CAN-ENTER-EXCLUSIVE-AREA-REF>
                      </CAN-ENTER-EXCLUSIVE-AREA-REFS>
                      <MINIMUM-START-INTERVAL>0.0</MINIMUM-START-INTERVAL>
                      <DATA-RECEIVE-POINTS>
                        <!-- MasterPnc core only -->
                        <BSW-VARIABLE-ACCESS>
                          <SHORT-NAME>BswVarAccess_ComM_SynchShutDown_MasterPnc_To_Ch_From_[!"$FromOsApplication"!]_To_[!"$ToOsApplication"!]_DataGet</SHORT-NAME>
                          <ACCESSED-VARIABLE-REF DEST="VARIABLE-DATA-PROTOTYPE">/AUTOSAR_ComM/BswModuleDescriptions/ComM/ComM_SynchShutDown_MasterPnc_To_Ch_From_[!"$FromOsApplication"!]_To_[!"$ToOsApplication"!]_DataGet</ACCESSED-VARIABLE-REF>
                        </BSW-VARIABLE-ACCESS>
                      </DATA-RECEIVE-POINTS>
                      <IMPLEMENTED-ENTRY-REF DEST="BSW-MODULE-ENTRY">/AUTOSAR_ComM/[!"$bswModuleEntryPackageName"!]/ComM_SynchShutDown_MasterPnc_To_Ch_From_[!"$FromOsApplication"!]_To_[!"$ToOsApplication"!]_RcvFnct</IMPLEMENTED-ENTRY-REF>
                    </BSW-SCHEDULABLE-ENTITY>
      [!ENDIF!] [!/*[!IF "$CurrentOsApplication = $ToOsApplication"!]*/!]
    [!ENDFOR!] [!/*[!FOR "Idx2" = "1" TO "count(text:split($SynchShutDownMasterPncToChFromOsApp_ToOsApp,' '))"!] */!]    
  [!ENDIF!] [!/*[!IF "as:modconf('ComM')[1]/ComMGeneral/ComMPncSupport = 'true'"!]*/!]

  [!FOR "Idx2" = "1" TO "count(text:split($UserToChFromOsApp_ToOsApp,' '))"!]
    [!VAR "FromOsApplicationToOsApplication" = "string(text:split($UserToChFromOsApp_ToOsApp,' ')[position() = $Idx2])"!]
    [!VAR "FromOsApplication" = "string(text:split($FromOsApplicationToOsApplication,'->')[position() = 1])"!]
    [!VAR "ToOsApplication" = "string(text:split($FromOsApplicationToOsApplication,'->')[position() = 2])"!]
    [!IF "$CurrentOsApplication = $ToOsApplication"!]
                    <BSW-SCHEDULABLE-ENTITY>
                      <SHORT-NAME>BswSchEnt_ComM_User_To_Ch_From_[!"$FromOsApplication"!]_To_[!"$CurrentOsApplication"!]_RcvFnct</SHORT-NAME>
                      <CAN-ENTER-EXCLUSIVE-AREA-REFS>
                        <CAN-ENTER-EXCLUSIVE-AREA-REF DEST="EXCLUSIVE-AREA">/AUTOSAR_ComM/BswModuleDescriptions/ComM/InternalBehavior_Ch_OsApplication_[!"$CurrentOsApplication"!]/SCHM_COMM_EXCLUSIVE_AREA_CH_OSAPPLICATION_[!"$ToOsApplication"!]</CAN-ENTER-EXCLUSIVE-AREA-REF>
                      </CAN-ENTER-EXCLUSIVE-AREA-REFS>
                      <MINIMUM-START-INTERVAL>0.0</MINIMUM-START-INTERVAL>
                      <DATA-RECEIVE-POINTS>
                        <!-- MasterPnc core only -->
                        <BSW-VARIABLE-ACCESS>
                          <SHORT-NAME>BswVarAccess_ComM_User_To_Ch_From_[!"$FromOsApplication"!]_To_[!"$CurrentOsApplication"!]_DataGet</SHORT-NAME>
                          <ACCESSED-VARIABLE-REF DEST="VARIABLE-DATA-PROTOTYPE">/AUTOSAR_ComM/BswModuleDescriptions/ComM/ComM_User_To_Ch_From_[!"$FromOsApplication"!]_To_[!"$ToOsApplication"!]_DataGet</ACCESSED-VARIABLE-REF>
                        </BSW-VARIABLE-ACCESS>
                      </DATA-RECEIVE-POINTS>
                      <IMPLEMENTED-ENTRY-REF DEST="BSW-MODULE-ENTRY">/AUTOSAR_ComM/[!"$bswModuleEntryPackageName"!]/ComM_User_To_Ch_From_[!"$FromOsApplication"!]_To_[!"$ToOsApplication"!]_RcvFnct</IMPLEMENTED-ENTRY-REF>
                    </BSW-SCHEDULABLE-ENTITY>
    [!ENDIF!] [!/*[!IF "$CurrentOsApplication = $ToOsApplication"!]*/!]
  [!ENDFOR!] [!/*[!FOR "Idx2" = "1" TO "count(text:split($UserToChFromOsApp_ToOsApp,' '))"!]*/!]

  [!IF "(as:modconf('ComM')[1]/ComMGeneral/ComMModeLimitationEnabled = 'true') or (as:modconf('ComM')[1]/ComMGeneral/ComMWakeupInhibitionEnabled = 'true')"!]
    [!FOR "Idx2" = "1" TO "count(text:split($InhibitionToChFromOsApp_ToOsApp,' '))"!]
      [!VAR "FromOsApplicationToOsApplication" = "string(text:split($InhibitionToChFromOsApp_ToOsApp,' ')[position() = $Idx2])"!]
      [!VAR "FromOsApplication" = "string(text:split($FromOsApplicationToOsApplication,'->')[position() = 1])"!]
      [!VAR "ToOsApplication" = "string(text:split($FromOsApplicationToOsApplication,'->')[position() = 2])"!]
      [!IF "$CurrentOsApplication = $ToOsApplication"!]
                    <BSW-SCHEDULABLE-ENTITY>
                      <SHORT-NAME>BswSchEnt_ComM_Inhibition_To_Ch_From_[!"$InhibitionOsApplication"!]_To_[!"$CurrentOsApplication"!]_RcvFnct</SHORT-NAME>
                      <CAN-ENTER-EXCLUSIVE-AREA-REFS>
                        <CAN-ENTER-EXCLUSIVE-AREA-REF DEST="EXCLUSIVE-AREA">/AUTOSAR_ComM/BswModuleDescriptions/ComM/InternalBehavior_Ch_OsApplication_[!"$CurrentOsApplication"!]/SCHM_COMM_EXCLUSIVE_AREA_CH_OSAPPLICATION_[!"$CurrentOsApplication"!]</CAN-ENTER-EXCLUSIVE-AREA-REF>
                      </CAN-ENTER-EXCLUSIVE-AREA-REFS>
                      <MINIMUM-START-INTERVAL>0.0</MINIMUM-START-INTERVAL>
                      <DATA-RECEIVE-POINTS>
                        <!-- MasterPnc core only -->
                        <BSW-VARIABLE-ACCESS>
                          <SHORT-NAME>BswVarAccess_ComM_Inhibition_To_Ch_From_[!"$FromOsApplication"!]_To_[!"$ToOsApplication"!]_DataGet</SHORT-NAME>
                          <ACCESSED-VARIABLE-REF DEST="VARIABLE-DATA-PROTOTYPE">/AUTOSAR_ComM/BswModuleDescriptions/ComM/ComM_Inhibition_To_Ch_From_[!"$FromOsApplication"!]_To_[!"$ToOsApplication"!]_DataGet</ACCESSED-VARIABLE-REF>
                        </BSW-VARIABLE-ACCESS>
                      </DATA-RECEIVE-POINTS>
                      <IMPLEMENTED-ENTRY-REF DEST="BSW-MODULE-ENTRY">/AUTOSAR_ComM/[!"$bswModuleEntryPackageName"!]/ComM_Inhibition_To_Ch_From_[!"$FromOsApplication"!]_To_[!"$ToOsApplication"!]_RcvFnct</IMPLEMENTED-ENTRY-REF>
                    </BSW-SCHEDULABLE-ENTITY>
      [!ENDIF!] [!/*[!IF "$CurrentOsApplication = $ToOsApplication"!]*/!]
    [!ENDFOR!] [!/*[!FOR "Idx2" = "1" TO "count(text:split($InhibitionToChFromOsApp_ToOsApp,' '))"!]*/!]
  [!ENDIF!] [!/*[!IF "(as:modconf('ComM')[1]/ComMGeneral/ComMModeLimitationEnabled = 'true') or (as:modconf('ComM')[1]/ComMGeneral/ComMWakeupInhibitionEnabled = 'true')"!]*/!]

  [!LOOP "as:modconf('ComM')[1]/ComMConfigSet/*[1]/ComMChannel/*"!]
    [!VAR "EcuCChannelPartitonRef" = "ComMChannelPartitionRef"!]
    [!IF "string(node:name(as:modconf('Os')[1]/OsApplication/*[node:exists(OsAppEcucPartitionRef) and (string(OsAppEcucPartitionRef) = $EcuCChannelPartitonRef)])) = $CurrentOsApplication"!]
      [!CALL "GetDcmChannelFound","CurrentComMChannelId"="ComMChannelId"!]
      [!IF "$DcmChannelFound = 'true'"!]
                    <BSW-CALLED-ENTITY>
                      <SHORT-NAME>ComM_DCM_ActiveDiagnostic_CalledEntity_[!"node:name(.)"!]</SHORT-NAME>
                      <MINIMUM-START-INTERVAL>0.0</MINIMUM-START-INTERVAL>
                      <IMPLEMENTED-ENTRY-REF DEST="BSW-MODULE-ENTRY">/AUTOSAR_ComM/BswModuleEntrys/ComM_DCM_ActiveDiagnostic</IMPLEMENTED-ENTRY-REF>
                    </BSW-CALLED-ENTITY>
                    <BSW-CALLED-ENTITY>
                      <SHORT-NAME>ComM_DCM_InactiveDiagnostic_CalledEntity_[!"node:name(.)"!]</SHORT-NAME>
                      <MINIMUM-START-INTERVAL>0.0</MINIMUM-START-INTERVAL>
                      <IMPLEMENTED-ENTRY-REF DEST="BSW-MODULE-ENTRY">/AUTOSAR_ComM/BswModuleEntrys/ComM_DCM_InactiveDiagnostic</IMPLEMENTED-ENTRY-REF>
                    </BSW-CALLED-ENTITY>
      [!ENDIF!] [!/* [!IF "$DcmChannelFound = 'true'"!] */!]

      [!IF "node:exists(as:modconf('EcuM')[1]/EcuMGeneral/EcuMCrossCoreComMWakeup) and (node:value(as:modconf('EcuM')[1]/EcuMGeneral/EcuMCrossCoreComMWakeup) = 'true')"!]
        [!CALL "GetEcuMChannelFound","CurrentComMChannelId"="ComMChannelId"!]
        [!IF "$EcuMChannelFound = 'true'"!]
          [!FOR "Idx2" = "0" TO "(as:modconf('Os')[1]/OsOS/OsNumberOfCores) - 1"!]
                    <BSW-CALLED-ENTITY>
                      <SHORT-NAME>ComM_EcuM_WakeUpIndication_CalledEntity_[!"node:name(.)"!]_ToCore_[!"$Idx2"!]</SHORT-NAME>
                      <MINIMUM-START-INTERVAL>0.0</MINIMUM-START-INTERVAL>
                      <IMPLEMENTED-ENTRY-REF DEST="BSW-MODULE-ENTRY">/AUTOSAR_ComM/BswModuleEntrys/ComM_EcuM_WakeUpIndication</IMPLEMENTED-ENTRY-REF>
                    </BSW-CALLED-ENTITY>
          [!ENDFOR!]
        [!ENDIF!] [!/* [!IF "$EcuMChannelFound = 'true'"!] */!]
      [!ENDIF!] [!/* [!IF "node:exists(as:modconf('EcuM')[1]/EcuMGeneral/EcuMCrossCoreComMWakeup) and (node:value(as:modconf('EcuM')[1]/EcuMGeneral/EcuMCrossCoreComMWakeup) = 'true')"!] */!]
    [!ENDIF!] [!/* [!IF "string(node:name(as:modconf('Os')[1]/OsApplication/*[node:exists(OsAppEcucPartitionRef) and (string(OsAppEcucPartitionRef) = $EcuCChannelPartitonRef)])) = $CurrentOsApplication"!] */!]
  [!ENDLOOP!] [!/* [!LOOP "as:modconf('ComM')[1]/ComMConfigSet/*[1]/ComMChannel/*"!]!*/!]
  [!VAR "FromOsApplication"="$CurrentOsApplication"!]
  [!FOR "Idx2" = "1" TO "count(text:split($ChToChFromOsApp_ToOsApp,' '))"!]
    [!VAR "FromOsApplicationToOsApplication" = "string(text:split($ChToChFromOsApp_ToOsApp,' ')[position() = $Idx2])"!]
    [!VAR "FromOsApplication" = "string(text:split($FromOsApplicationToOsApplication,'->')[position() = 1])"!]
    [!VAR "ToOsApplication" = "string(text:split($FromOsApplicationToOsApplication,'->')[position() = 2])"!]
    [!IF "$CurrentOsApplication = $FromOsApplication"!]
                  <BSW-CALLED-ENTITY>
                    <SHORT-NAME>BswCalledEnt_ComM_Ch_To_Ch_From_[!"$FromOsApplication"!]_To_[!"$ToOsApplication"!]_DataSntFnct</SHORT-NAME>
                    <MINIMUM-START-INTERVAL>0.0</MINIMUM-START-INTERVAL>
                    <DATA-SEND-POINTS>
                      <!-- MasterPnc core only -->
                      <BSW-VARIABLE-ACCESS>
                        <SHORT-NAME>BswVarAccess_ComM_Ch_To_Ch_From_[!"$FromOsApplication"!]_To_[!"$ToOsApplication"!]_DataSet</SHORT-NAME>
                        <ACCESSED-VARIABLE-REF DEST="VARIABLE-DATA-PROTOTYPE">/AUTOSAR_ComM/BswModuleDescriptions/ComM/ComM_Ch_To_Ch_From_[!"$FromOsApplication"!]_To_[!"$ToOsApplication"!]_DataSet</ACCESSED-VARIABLE-REF>
                      </BSW-VARIABLE-ACCESS>
                    </DATA-SEND-POINTS>
                    <IMPLEMENTED-ENTRY-REF DEST="BSW-MODULE-ENTRY">/AUTOSAR_ComM/BswModuleEntrys/ComM_Ch_To_Ch_DataSntFnct</IMPLEMENTED-ENTRY-REF>
                  </BSW-CALLED-ENTITY>
    [!ENDIF!] [!/*[!IF "$CurrentOsApplication = $FromOsApplication"!]*/!]
  [!ENDFOR!] [!/*[!FOR "Idx2" = "1" TO "count(text:split($ChToChFromOsApp_ToOsApp,' '))"!]*/!]

  [!IF "num:i(count(as:modconf('ComM')[1]/ComMConfigSet/*[1]/ComMUser/*)) > 0"!]
    [!IF "(as:modconf('ComM')[1]/ComMGeneral/ComMRteUsage = 'true') or (as:modconf('ComM')[1]/ComMGeneral/ComMModeLimitationEnabled = 'true')"!]
      [!FOR "Idx2" = "1" TO "count(text:split($ChToUserFromOsApp_ToOsApp,' '))"!]
        [!VAR "FromOsApplicationToOsApplication" = "string(text:split($ChToUserFromOsApp_ToOsApp,' ')[position() = $Idx2])"!]
        [!VAR "FromOsApplication" = "string(text:split($FromOsApplicationToOsApplication,'->')[position() = 1])"!]
        [!VAR "ToOsApplication" = "string(text:split($FromOsApplicationToOsApplication,'->')[position() = 2])"!]
        [!IF "$CurrentOsApplication = $FromOsApplication"!]
                    <BSW-CALLED-ENTITY>
                      <SHORT-NAME>BswCalledEnt_ComM_Ch_To_User_From_[!"$FromOsApplication"!]_To_[!"$ToOsApplication"!]_DataSntFnct</SHORT-NAME>
                      <MINIMUM-START-INTERVAL>0.0</MINIMUM-START-INTERVAL>
                      <DATA-SEND-POINTS>
                        <!-- MasterPnc core only -->
                        <BSW-VARIABLE-ACCESS>
                          <SHORT-NAME>BswVarAccess_ComM_Ch_To_User_From_[!"$FromOsApplication"!]_To_[!"$ToOsApplication"!]_DataSet</SHORT-NAME>
                          <ACCESSED-VARIABLE-REF DEST="VARIABLE-DATA-PROTOTYPE">/AUTOSAR_ComM/BswModuleDescriptions/ComM/ComM_Ch_To_User_From_[!"$FromOsApplication"!]_To_[!"$ToOsApplication"!]_DataSet</ACCESSED-VARIABLE-REF>
                        </BSW-VARIABLE-ACCESS>
                      </DATA-SEND-POINTS>
                      <IMPLEMENTED-ENTRY-REF DEST="BSW-MODULE-ENTRY">/AUTOSAR_ComM/BswModuleEntrys/ComM_Ch_To_User_DataSntFnct</IMPLEMENTED-ENTRY-REF>
                    </BSW-CALLED-ENTITY>
        [!ENDIF!] [!/*[!IF "$CurrentOsApplication = $FromOsApplication"!]*/!]
      [!ENDFOR!] [!/*[!FOR "Idx2" = "1" TO "count(text:split($ChToUserFromOsApp_ToOsApp,' '))"!]*/!]
    [!ENDIF!] [!/*[!IF "(as:modconf('ComM')[1]/ComMGeneral/ComMRteUsage = 'true') or (as:modconf('ComM')[1]/ComMGeneral/ComMModeLimitationEnabled = 'true')"!]*/!]
  [!ENDIF!] [!/*[!IF "num:i(count(as:modconf('ComM')[1]/ComMConfigSet/*[1]/ComMUser/*)) > 0"!]*/!]

  [!IF "(as:modconf('ComM')[1]/ComMGeneral/ComMModeLimitationEnabled = 'true') or (as:modconf('ComM')[1]/ComMGeneral/ComMWakeupInhibitionEnabled = 'true')"!]
    [!FOR "Idx2" = "1" TO "count(text:split($ChToInhibitionFromOsApp_ToOsApp,' '))"!]
      [!VAR "FromOsApplicationToOsApplication" = "string(text:split($ChToInhibitionFromOsApp_ToOsApp,' ')[position() = $Idx2])"!]
      [!VAR "FromOsApplication" = "string(text:split($FromOsApplicationToOsApplication,'->')[position() = 1])"!]
      [!VAR "ToOsApplication" = "string(text:split($FromOsApplicationToOsApplication,'->')[position() = 2])"!]
      [!IF "$CurrentOsApplication = $FromOsApplication"!]
                    <BSW-CALLED-ENTITY>
                      <SHORT-NAME>BswCalledEnt_ComM_Ch_To_Inhibition_From_[!"$FromOsApplication"!]_To_[!"$ToOsApplication"!]_DataSntFnct</SHORT-NAME>
                      <MINIMUM-START-INTERVAL>0.0</MINIMUM-START-INTERVAL>
                      <DATA-SEND-POINTS>
                        <!-- MasterPnc core only -->
                        <BSW-VARIABLE-ACCESS>
                          <SHORT-NAME>BswVarAccess_ComM_Ch_To_Inhibition_From_[!"$FromOsApplication"!]_To_[!"$ToOsApplication"!]_DataSet</SHORT-NAME>
                          <ACCESSED-VARIABLE-REF DEST="VARIABLE-DATA-PROTOTYPE">/AUTOSAR_ComM/BswModuleDescriptions/ComM/ComM_Ch_To_Inhibition_From_[!"$FromOsApplication"!]_To_[!"$ToOsApplication"!]_DataSet</ACCESSED-VARIABLE-REF>
                        </BSW-VARIABLE-ACCESS>
                      </DATA-SEND-POINTS>
                      <IMPLEMENTED-ENTRY-REF DEST="BSW-MODULE-ENTRY">/AUTOSAR_ComM/BswModuleEntrys/ComM_Ch_To_Inhibition_DataSntFnct</IMPLEMENTED-ENTRY-REF>
                    </BSW-CALLED-ENTITY>
      [!ENDIF!] [!/*[!IF "$CurrentOsApplication = $FromOsApplication"!]*/!]
    [!ENDFOR!] [!/*[!FOR "Idx2" = "1" TO "count(text:split($ChToInhibitionFromOsApp_ToOsApp,' '))"!]*/!]
  [!ENDIF!] [!/*[!IF "(as:modconf('ComM')[1]/ComMGeneral/ComMModeLimitationEnabled = 'true') or (as:modconf('ComM')[1]/ComMGeneral/ComMWakeupInhibitionEnabled = 'true')"!]*/!]

  [!IF "as:modconf('ComM')[1]/ComMGeneral/ComMPncSupport = 'true'"!]
    [!FOR "Idx2" = "1" TO "count(text:split($ChToMasterPncFromOsApp_ToOsApp,' '))"!]
      [!VAR "FromOsApplicationToOsApplication" = "string(text:split($ChToMasterPncFromOsApp_ToOsApp,' ')[position() = $Idx2])"!]
      [!VAR "FromOsApplication" = "string(text:split($FromOsApplicationToOsApplication,'->')[position() = 1])"!]
      [!VAR "ToOsApplication" = "string(text:split($FromOsApplicationToOsApplication,'->')[position() = 2])"!]
      [!IF "$CurrentOsApplication = $FromOsApplication"!]
                  <BSW-CALLED-ENTITY>
                    <SHORT-NAME>BswCalledEnt_ComM_Ch_To_MasterPnc_From_[!"$FromOsApplication"!]_To_[!"$ToOsApplication"!]_DataSntFnct</SHORT-NAME>
                    <MINIMUM-START-INTERVAL>0.0</MINIMUM-START-INTERVAL>
                    <DATA-SEND-POINTS>
                      <!-- MasterPnc core only -->
                      <BSW-VARIABLE-ACCESS>
                        <SHORT-NAME>BswVarAccess_ComM_Ch_To_MasterPnc_From_[!"$FromOsApplication"!]_To_[!"$ToOsApplication"!]_DataSet</SHORT-NAME>
                        <ACCESSED-VARIABLE-REF DEST="VARIABLE-DATA-PROTOTYPE">/AUTOSAR_ComM/BswModuleDescriptions/ComM/ComM_Ch_To_MasterPnc_From_[!"$FromOsApplication"!]_To_[!"$ToOsApplication"!]_DataSet</ACCESSED-VARIABLE-REF>
                      </BSW-VARIABLE-ACCESS>
                    </DATA-SEND-POINTS>
                    <IMPLEMENTED-ENTRY-REF DEST="BSW-MODULE-ENTRY">/AUTOSAR_ComM/BswModuleEntrys/ComM_Ch_To_MasterPnc_DataSntFnct</IMPLEMENTED-ENTRY-REF>
                  </BSW-CALLED-ENTITY>
      [!ENDIF!] [!/*[!IF "$CurrentOsApplication = $FromOsApplication"!]*/!]
    [!ENDFOR!] [!/*[!FOR "Idx2" = "1" TO "count(text:split($ChToMasterPncFromOsApp_ToOsApp,' '))"!]*/!]
  [!ENDIF!] [!/*[!IF "as:modconf('ComM')[1]/ComMGeneral/ComMPncSupport = 'true'"!]*/!]



  [!IF "node:exists(as:modconf('ComM')[1]/ComMGeneral/ComMSynchronizedPncShutdownEnabled) and (as:modconf('ComM')[1]/ComMGeneral/ComMSynchronizedPncShutdownEnabled = 'true')"!]
    [!FOR "Idx2" = "1" TO "count(text:split($SynchShutDownChToMasterPncFromOsApp_ToOsApp,' '))"!]
      [!VAR "FromOsApplicationToOsApplication" = "string(text:split($SynchShutDownChToMasterPncFromOsApp_ToOsApp,' ')[position() = $Idx2])"!]
      [!VAR "FromOsApplication" = "string(text:split($FromOsApplicationToOsApplication,'->')[position() = 1])"!]
      [!VAR "ToOsApplication" = "string(text:split($FromOsApplicationToOsApplication,'->')[position() = 2])"!]
      [!IF "$CurrentOsApplication = $FromOsApplication"!]
                  <BSW-CALLED-ENTITY>
                    <SHORT-NAME>BswCalledEnt_ComM_SynchShutDownCh_To_MasterPnc_From_[!"$FromOsApplication"!]_To_[!"$ToOsApplication"!]_DataSntFnct</SHORT-NAME>
                    <MINIMUM-START-INTERVAL>0.0</MINIMUM-START-INTERVAL>
                    <DATA-SEND-POINTS>
                      <!-- MasterPnc core only -->
                      <BSW-VARIABLE-ACCESS>
                        <SHORT-NAME>BswVarAccess_ComM_SynchShutDownCh_To_MasterPnc_From_[!"$FromOsApplication"!]_To_[!"$ToOsApplication"!]_DataSet</SHORT-NAME>
                        <ACCESSED-VARIABLE-REF DEST="VARIABLE-DATA-PROTOTYPE">/AUTOSAR_ComM/BswModuleDescriptions/ComM/ComM_SynchShutDownCh_To_MasterPnc_From_[!"$FromOsApplication"!]_To_[!"$ToOsApplication"!]_DataSet</ACCESSED-VARIABLE-REF>
                      </BSW-VARIABLE-ACCESS>
                    </DATA-SEND-POINTS>
                    <IMPLEMENTED-ENTRY-REF DEST="BSW-MODULE-ENTRY">/AUTOSAR_ComM/BswModuleEntrys/ComM_SynchShutDownCh_To_MasterPnc_DataSntFnct</IMPLEMENTED-ENTRY-REF>
                  </BSW-CALLED-ENTITY>
      [!ENDIF!] [!/*[!IF "$CurrentOsApplication = $FromOsApplication"!]*/!]
    [!ENDFOR!] [!/*[!FOR "Idx2" = "1" TO "count(text:split($SynchShutDownChToMasterPncFromOsApp_ToOsApp,' '))"!]*/!]
  [!ENDIF!][!/*[!IF "node:exists(as:modconf('ComM')[1]/ComMGeneral/ComMSynchronizedPncShutdownEnabled) and (as:modconf('ComM')[1]/ComMGeneral/ComMSynchronizedPncShutdownEnabled = 'true')"!]*/!]
                  </ENTITYS>
                  <EVENTS>
  [!LOOP "as:modconf('ComM')[1]/ComMConfigSet/*[1]/ComMChannel/*"!]
    [!VAR "EcuCChannelPartitonRef" = "ComMChannelPartitionRef"!]
    [!IF "string(node:name(as:modconf('Os')[1]/OsApplication/*[node:exists(OsAppEcucPartitionRef) and (string(OsAppEcucPartitionRef)= $EcuCChannelPartitonRef)])) = $CurrentOsApplication"!]
      [!CALL "GetDcmChannelFound","CurrentComMChannelId"="ComMChannelId"!]
      [!CALL "GetChannelOsApplication","ChannelEcuCPartitionRef"="ComMChannelPartitionRef"!]
                    <BSW-TIMING-EVENT>
                      <SHORT-NAME>TimingEvent_MainFunction_[!"ComMChannelId"!]</SHORT-NAME>
                      <STARTS-ON-EVENT-REF DEST="BSW-SCHEDULABLE-ENTITY">/AUTOSAR_ComM/BswModuleDescriptions/ComM/InternalBehavior_Ch_OsApplication_[!"$CurrentOsApplication"!]/ComM_1_Ch_OsApplication_[!"$ChannelOsApplication"!]_ComM_MainFunction_[!"ComMChannelId"!]</STARTS-ON-EVENT-REF>
                      <PERIOD>[!"ComMMainFunctionPeriod"!]</PERIOD>
                    </BSW-TIMING-EVENT>
      [!IF "node:exists(as:modconf('EcuM')[1]/EcuMGeneral/EcuMCrossCoreComMWakeup) and (node:value(as:modconf('EcuM')[1]/EcuMGeneral/EcuMCrossCoreComMWakeup) = 'true')"!]
        [!CALL "GetEcuMChannelFound","CurrentComMChannelId"="ComMChannelId"!]
        [!IF "$EcuMChannelFound = 'true'"!]
          [!FOR "Idx2" = "0" TO "(as:modconf('Os')[1]/OsOS/OsNumberOfCores) - 1"!]
                    <BSW-OPERATION-INVOKED-EVENT>
                      <SHORT-NAME>OpInokedEv_ComM_EcuM_WakeUpIndication_[!"node:name(.)"!]_ToCore_[!"$Idx2"!]</SHORT-NAME>
                      <STARTS-ON-EVENT-REF DEST="BSW-CALLED-ENTITY">/AUTOSAR_ComM/BswModuleDescriptions/ComM/InternalBehavior_Ch_OsApplication_[!"$CurrentOsApplication"!]/ComM_EcuM_WakeUpIndication_CalledEntity_[!"node:name(.)"!]_ToCore_[!"$Idx2"!]</STARTS-ON-EVENT-REF>
                      <ENTRY-REF DEST="BSW-MODULE-CLIENT-SERVER-ENTRY">/AUTOSAR_ComM/BswModuleDescriptions/ComM/ProvidedCSEntry_ComM_EcuM_WakeUpIndication_[!"node:name(.)"!]_ToCore_[!"$Idx2"!]</ENTRY-REF>
                    </BSW-OPERATION-INVOKED-EVENT>
          [!ENDFOR!]
        [!ENDIF!] [!/* [!IF "$EcuMChannelFound = 'true'"!] */!]
      [!ENDIF!] [!/* [!IF "node:exists(as:modconf('EcuM')[1]/EcuMGeneral/EcuMCrossCoreComMWakeup) and (node:value(as:modconf('EcuM')[1]/EcuMGeneral/EcuMCrossCoreComMWakeup) = 'true')"!] */!]
      [!IF "$DcmChannelFound = 'true'"!]
                   <BSW-OPERATION-INVOKED-EVENT>
                     <SHORT-NAME>OpInokedEv_ComM_DCM_ActiveDiagnostic_[!"node:name(.)"!]</SHORT-NAME>
                     <STARTS-ON-EVENT-REF DEST="BSW-CALLED-ENTITY">/AUTOSAR_ComM/BswModuleDescriptions/ComM/InternalBehavior_Ch_OsApplication_[!"$CurrentOsApplication"!]/ComM_DCM_ActiveDiagnostic_CalledEntity_[!"node:name(.)"!]</STARTS-ON-EVENT-REF>
                     <ENTRY-REF DEST="BSW-MODULE-CLIENT-SERVER-ENTRY">/AUTOSAR_ComM/BswModuleDescriptions/ComM/ProvidedCSEntry_ComM_DCM_ActiveDiagnostic_[!"node:name(.)"!]</ENTRY-REF>
                   </BSW-OPERATION-INVOKED-EVENT>

                   <BSW-OPERATION-INVOKED-EVENT>
                     <SHORT-NAME>OpInokedEv_ComM_DCM_InactiveDiagnostic_[!"node:name(.)"!]</SHORT-NAME>
                     <STARTS-ON-EVENT-REF DEST="BSW-CALLED-ENTITY">/AUTOSAR_ComM/BswModuleDescriptions/ComM/InternalBehavior_Ch_OsApplication_[!"$CurrentOsApplication"!]/ComM_DCM_InactiveDiagnostic_CalledEntity_[!"node:name(.)"!]</STARTS-ON-EVENT-REF>
                     <ENTRY-REF DEST="BSW-MODULE-CLIENT-SERVER-ENTRY">/AUTOSAR_ComM/BswModuleDescriptions/ComM/ProvidedCSEntry_ComM_DCM_InactiveDiagnostic_[!"node:name(.)"!]</ENTRY-REF>
                   </BSW-OPERATION-INVOKED-EVENT>
      [!ENDIF!] [!/* [!IF "$DcmChannelFound = 'true'"!] */!]
    [!ENDIF!] [!/*[!IF "string(node:name(as:modconf('Os')[1]/OsApplication/*[node:exists(OsAppEcucPartitionRef) and (string(OsAppEcucPartitionRef) = $EcuCChannelPartitonRef)])) = $CurrentOsApplication"!] */!]
  [!ENDLOOP!] [!/*[!LOOP "as:modconf('ComM')[1]/ComMConfigSet/*[1]/ComMChannel/*"!] */!]

  [!FOR "Idx2" = "1" TO "count(text:split($ChToChFromOsApp_ToOsApp,' '))"!]
    [!VAR "FromOsApplicationToOsApplication" = "string(text:split($ChToChFromOsApp_ToOsApp,' ')[position() = $Idx2])"!]
    [!VAR "FromOsApplication" = "string(text:split($FromOsApplicationToOsApplication,'->')[position() = 1])"!]
    [!VAR "ToOsApplication" = "string(text:split($FromOsApplicationToOsApplication,'->')[position() = 2])"!]
    [!IF "$CurrentOsApplication = $ToOsApplication"!]
                    <BSW-DATA-RECEIVED-EVENT>
                        <SHORT-NAME>ComM_Ch_To_Ch_From_[!"$FromOsApplication"!]_To_[!"$ToOsApplication"!]_RecEv</SHORT-NAME>
                        <STARTS-ON-EVENT-REF DEST="BSW-SCHEDULABLE-ENTITY">/AUTOSAR_ComM/BswModuleDescriptions/ComM/InternalBehavior_Ch_OsApplication_[!"$ToOsApplication"!]/BswSchEnt_ComM_Ch_To_Ch_From_[!"$FromOsApplication"!]_To_[!"$ToOsApplication"!]_RcvFnct</STARTS-ON-EVENT-REF>
                        <DATA-REF DEST="VARIABLE-DATA-PROTOTYPE">/AUTOSAR_ComM/BswModuleDescriptions/ComM/ComM_Ch_To_Ch_From_[!"$FromOsApplication"!]_To_[!"$ToOsApplication"!]_DataGet</DATA-REF>
                    </BSW-DATA-RECEIVED-EVENT>
    [!ENDIF!] [!/*[!IF "$CurrentOsApplication = $ToOsApplication"!]*/!]
  [!ENDFOR!] [!/*[!FOR "Idx2" = "1" TO "count(text:split($ChToChFromOsApp_ToOsApp,' '))"!]*/!]

  [!IF "as:modconf('ComM')[1]/ComMGeneral/ComMPncSupport = 'true'"!]
    [!FOR "Idx2" = "1" TO "count(text:split($MasterPncToChFromOsApp_ToOsApp,' '))"!]
      [!VAR "FromOsApplicationToOsApplication" = "string(text:split($MasterPncToChFromOsApp_ToOsApp,' ')[position() = $Idx2])"!]
      [!VAR "FromOsApplication" = "string(text:split($FromOsApplicationToOsApplication,'->')[position() = 1])"!]
      [!VAR "ToOsApplication" = "string(text:split($FromOsApplicationToOsApplication,'->')[position() = 2])"!]
      [!IF "$CurrentOsApplication = $ToOsApplication"!]
                    <BSW-DATA-RECEIVED-EVENT>
                        <SHORT-NAME>ComM_MasterPnc_To_Ch_From_[!"$FromOsApplication"!]_To_[!"$ToOsApplication"!]_RecEv</SHORT-NAME>
                        <STARTS-ON-EVENT-REF DEST="BSW-SCHEDULABLE-ENTITY">/AUTOSAR_ComM/BswModuleDescriptions/ComM/InternalBehavior_Ch_OsApplication_[!"$ToOsApplication"!]/BswSchEnt_ComM_MasterPnc_To_Ch_From_[!"$FromOsApplication"!]_To_[!"$ToOsApplication"!]_RcvFnct</STARTS-ON-EVENT-REF>
                        <DATA-REF DEST="VARIABLE-DATA-PROTOTYPE">/AUTOSAR_ComM/BswModuleDescriptions/ComM/ComM_MasterPnc_To_Ch_From_[!"$FromOsApplication"!]_To_[!"$ToOsApplication"!]_DataGet</DATA-REF>
                    </BSW-DATA-RECEIVED-EVENT>
      [!ENDIF!] [!/*[!IF "$CurrentOsApplication = $ToOsApplication"!] */!]
    [!ENDFOR!] [!/*[!FOR "Idx2" = "1" TO "count(text:split($MasterPncToChFromOsApp_ToOsApp,' '))"!]*/!]
    
    [!FOR "Idx2" = "1" TO "count(text:split($EvaluateChannelMasterPncToChFromOsApp_ToOsApp,' '))"!]
      [!VAR "FromOsApplicationToOsApplication" = "string(text:split($EvaluateChannelMasterPncToChFromOsApp_ToOsApp,' ')[position() = $Idx2])"!]
      [!VAR "FromOsApplication" = "string(text:split($FromOsApplicationToOsApplication,'->')[position() = 1])"!]
      [!VAR "ToOsApplication" = "string(text:split($FromOsApplicationToOsApplication,'->')[position() = 2])"!]
      [!IF "$CurrentOsApplication = $ToOsApplication"!]
                    <BSW-DATA-RECEIVED-EVENT>
                        <SHORT-NAME>ComM_EvaluateChannel_MasterPnc_To_Ch_From_[!"$FromOsApplication"!]_To_[!"$ToOsApplication"!]_RecEv</SHORT-NAME>
                        <STARTS-ON-EVENT-REF DEST="BSW-SCHEDULABLE-ENTITY">/AUTOSAR_ComM/BswModuleDescriptions/ComM/InternalBehavior_Ch_OsApplication_[!"$ToOsApplication"!]/BswSchEnt_ComM_EvaluateChannel_MasterPnc_To_Ch_From_[!"$FromOsApplication"!]_To_[!"$ToOsApplication"!]_RcvFnct</STARTS-ON-EVENT-REF>
                        <DATA-REF DEST="VARIABLE-DATA-PROTOTYPE">/AUTOSAR_ComM/BswModuleDescriptions/ComM/ComM_EvaluateChannel_MasterPnc_To_Ch_From_[!"$FromOsApplication"!]_To_[!"$ToOsApplication"!]_DataGet</DATA-REF>
                    </BSW-DATA-RECEIVED-EVENT>
      [!ENDIF!] [!/*[!IF "$CurrentOsApplication = $ToOsApplication"!] */!]
    [!ENDFOR!] [!/*[!FOR "Idx2" = "1" TO "count(text:split($EvaluateChannelMasterPncToChFromOsApp_ToOsApp,' '))"!]*/!]    
    
    [!FOR "Idx2" = "1" TO "count(text:split($SynchShutDownMasterPncToChFromOsApp_ToOsApp,' '))"!]
      [!VAR "FromOsApplicationToOsApplication" = "string(text:split($SynchShutDownMasterPncToChFromOsApp_ToOsApp,' ')[position() = $Idx2])"!]
      [!VAR "FromOsApplication" = "string(text:split($FromOsApplicationToOsApplication,'->')[position() = 1])"!]
      [!VAR "ToOsApplication" = "string(text:split($FromOsApplicationToOsApplication,'->')[position() = 2])"!]
      [!IF "$CurrentOsApplication = $ToOsApplication"!]
                    <BSW-DATA-RECEIVED-EVENT>
                        <SHORT-NAME>ComM_SynchShutDown_MasterPnc_To_Ch_From_[!"$FromOsApplication"!]_To_[!"$ToOsApplication"!]_RecEv</SHORT-NAME>
                        <STARTS-ON-EVENT-REF DEST="BSW-SCHEDULABLE-ENTITY">/AUTOSAR_ComM/BswModuleDescriptions/ComM/InternalBehavior_Ch_OsApplication_[!"$ToOsApplication"!]/BswSchEnt_ComM_SynchShutDown_MasterPnc_To_Ch_From_[!"$FromOsApplication"!]_To_[!"$ToOsApplication"!]_RcvFnct</STARTS-ON-EVENT-REF>
                        <DATA-REF DEST="VARIABLE-DATA-PROTOTYPE">/AUTOSAR_ComM/BswModuleDescriptions/ComM/ComM_SynchShutDown_MasterPnc_To_Ch_From_[!"$FromOsApplication"!]_To_[!"$ToOsApplication"!]_DataGet</DATA-REF>
                    </BSW-DATA-RECEIVED-EVENT>
      [!ENDIF!] [!/*[!IF "$CurrentOsApplication = $ToOsApplication"!] */!]
    [!ENDFOR!] [!/*[!FOR "Idx2" = "1" TO "count(text:split($SynchShutDownMasterPncToChFromOsApp_ToOsApp,' '))"!]*/!]    
    
  [!ENDIF!] [!/*[!IF "as:modconf('ComM')[1]/ComMGeneral/ComMPncSupport = 'true'"!]*/!]

  [!FOR "Idx2" = "1" TO "count(text:split($UserToChFromOsApp_ToOsApp,' '))"!]
  [!VAR "FromOsApplicationToOsApplication" = "string(text:split($UserToChFromOsApp_ToOsApp,' ')[position() = $Idx2])"!]
  [!VAR "FromOsApplication" = "string(text:split($FromOsApplicationToOsApplication,'->')[position() = 1])"!]
  [!VAR "ToOsApplication" = "string(text:split($FromOsApplicationToOsApplication,'->')[position() = 2])"!]
  [!IF "$CurrentOsApplication = $ToOsApplication"!]
                    <BSW-DATA-RECEIVED-EVENT>
                        <SHORT-NAME>ComM_User_To_Ch_From_[!"$FromOsApplication"!]_To_[!"$ToOsApplication"!]_RecEv</SHORT-NAME>
                        <STARTS-ON-EVENT-REF DEST="BSW-SCHEDULABLE-ENTITY">/AUTOSAR_ComM/BswModuleDescriptions/ComM/InternalBehavior_Ch_OsApplication_[!"$ToOsApplication"!]/BswSchEnt_ComM_User_To_Ch_From_[!"$FromOsApplication"!]_To_[!"$ToOsApplication"!]_RcvFnct</STARTS-ON-EVENT-REF>
                        <DATA-REF DEST="VARIABLE-DATA-PROTOTYPE">/AUTOSAR_ComM/BswModuleDescriptions/ComM/ComM_User_To_Ch_From_[!"$FromOsApplication"!]_To_[!"$ToOsApplication"!]_DataGet</DATA-REF>
                    </BSW-DATA-RECEIVED-EVENT>
    [!ENDIF!] [!/*[!IF "$CurrentOsApplication = $ToOsApplication"!]*/!]
  [!ENDFOR!] [!/*[!FOR "Idx2" = "1" TO "count(text:split($UserToChFromOsApp_ToOsApp,' '))"!]*/!]

  [!IF "(as:modconf('ComM')[1]/ComMGeneral/ComMModeLimitationEnabled = 'true') or (as:modconf('ComM')[1]/ComMGeneral/ComMWakeupInhibitionEnabled = 'true')"!]
    [!FOR "Idx2" = "1" TO "count(text:split($InhibitionToChFromOsApp_ToOsApp,' '))"!]
      [!VAR "FromOsApplicationToOsApplication" = "string(text:split($InhibitionToChFromOsApp_ToOsApp,' ')[position() = $Idx2])"!]
      [!VAR "FromOsApplication" = "string(text:split($FromOsApplicationToOsApplication,'->')[position() = 1])"!]
      [!VAR "ToOsApplication" = "string(text:split($FromOsApplicationToOsApplication,'->')[position() = 2])"!]
      [!IF "$CurrentOsApplication = $ToOsApplication"!]
                    <BSW-DATA-RECEIVED-EVENT>
                        <SHORT-NAME>ComM_Inhibition_To_Ch_From_[!"$FromOsApplication"!]_To_[!"$ToOsApplication"!]_RecEv</SHORT-NAME>
                        <STARTS-ON-EVENT-REF DEST="BSW-SCHEDULABLE-ENTITY">/AUTOSAR_ComM/BswModuleDescriptions/ComM/InternalBehavior_Ch_OsApplication_[!"$ToOsApplication"!]/BswSchEnt_ComM_Inhibition_To_Ch_From_[!"$FromOsApplication"!]_To_[!"$ToOsApplication"!]_RcvFnct</STARTS-ON-EVENT-REF>
                        <DATA-REF DEST="VARIABLE-DATA-PROTOTYPE">/AUTOSAR_ComM/BswModuleDescriptions/ComM/ComM_Inhibition_To_Ch_From_[!"$FromOsApplication"!]_To_[!"$ToOsApplication"!]_DataGet</DATA-REF>
                    </BSW-DATA-RECEIVED-EVENT>
      [!ENDIF!] [!/*[!IF "$CurrentOsApplication = $ToOsApplication"!]*/!]
    [!ENDFOR!] [!/*[!FOR "Idx2" = "1" TO "count(text:split($InhibitionToChFromOsApp_ToOsApp,' '))"!]*/!]
  [!ENDIF!] [!/*[!IF "(as:modconf('ComM')[1]/ComMGeneral/ComMModeLimitationEnabled = 'true') or (as:modconf('ComM')[1]/ComMGeneral/ComMWakeupInhibitionEnabled = 'true')"!]*/!]
                  </EVENTS>
                  <RECEPTION-POLICYS>
  [!FOR "Idx2" = "1" TO "count(text:split($ChToChFromOsApp_ToOsApp,' '))"!]
    [!VAR "FromOsApplicationToOsApplication" = "string(text:split($ChToChFromOsApp_ToOsApp,' ')[position() = $Idx2])"!]
    [!VAR "FromOsApplication" = "string(text:split($FromOsApplicationToOsApplication,'->')[position() = 1])"!]
    [!VAR "ToOsApplication" = "string(text:split($FromOsApplicationToOsApplication,'->')[position() = 2])"!]
      [!CALL "GetChToChQueueSize","FromOsApplication"="$FromOsApplication","ToOsApplication"="$ToOsApplication"!]
                    <BSW-QUEUED-DATA-RECEPTION-POLICY>
                      <ENABLE-TAKE-ADDRESS>true</ENABLE-TAKE-ADDRESS>
                      <RECEIVED-DATA-REF DEST="VARIABLE-DATA-PROTOTYPE">/AUTOSAR_ComM/BswModuleDescriptions/ComM/ComM_Ch_To_Ch_From_[!"$FromOsApplication"!]_To_[!"$ToOsApplication"!]_DataGet</RECEIVED-DATA-REF>
                      <QUEUE-LENGTH>[!"num:i($ChToChQueueSize)"!]</QUEUE-LENGTH>
                    </BSW-QUEUED-DATA-RECEPTION-POLICY>
  [!ENDFOR!] [!/*[!FOR "Idx2" = "1" TO "count(text:split($ChToChFromOsApp_ToOsApp,' '))"!]*/!]

  [!IF "as:modconf('ComM')[1]/ComMGeneral/ComMPncSupport = 'true'"!]
    [!FOR "Idx2" = "1" TO "count(text:split($MasterPncToChFromOsApp_ToOsApp,' '))"!]
      [!VAR "FromOsApplicationToOsApplication" = "string(text:split($MasterPncToChFromOsApp_ToOsApp,' ')[position() = $Idx2])"!]
      [!VAR "FromOsApplication" = "string(text:split($FromOsApplicationToOsApplication,'->')[position() = 1])"!]
      [!VAR "ToOsApplication" = "string(text:split($FromOsApplicationToOsApplication,'->')[position() = 2])"!]
      [!IF "$CurrentOsApplication = $ToOsApplication"!]
        [!CALL "GetMasterPncToChQueueSize","ToOsApplication"="$ToOsApplication"!]
                    <BSW-QUEUED-DATA-RECEPTION-POLICY>
                      <ENABLE-TAKE-ADDRESS>true</ENABLE-TAKE-ADDRESS>
                      <RECEIVED-DATA-REF DEST="VARIABLE-DATA-PROTOTYPE">/AUTOSAR_ComM/BswModuleDescriptions/ComM/ComM_MasterPnc_To_Ch_From_[!"$FromOsApplication"!]_To_[!"$ToOsApplication"!]_DataGet</RECEIVED-DATA-REF>
                      <QUEUE-LENGTH>2</QUEUE-LENGTH>
                    </BSW-QUEUED-DATA-RECEPTION-POLICY>
      [!ENDIF!] [!/*[!IF "$CurrentOsApplication = $ToOsApplication"!]*/!]
    [!ENDFOR!] [!/*[!FOR "Idx2" = "1" TO "count(text:split($MasterPncToChFromOsApp_ToOsApp,' '))"!]*/!]
    
    [!FOR "Idx2" = "1" TO "count(text:split($EvaluateChannelMasterPncToChFromOsApp_ToOsApp,' '))"!]
      [!VAR "FromOsApplicationToOsApplication" = "string(text:split($EvaluateChannelMasterPncToChFromOsApp_ToOsApp,' ')[position() = $Idx2])"!]
      [!VAR "FromOsApplication" = "string(text:split($FromOsApplicationToOsApplication,'->')[position() = 1])"!]
      [!VAR "ToOsApplication" = "string(text:split($FromOsApplicationToOsApplication,'->')[position() = 2])"!]
      [!IF "$CurrentOsApplication = $ToOsApplication"!]
                    <BSW-QUEUED-DATA-RECEPTION-POLICY>
                      <ENABLE-TAKE-ADDRESS>true</ENABLE-TAKE-ADDRESS>
                      <RECEIVED-DATA-REF DEST="VARIABLE-DATA-PROTOTYPE">/AUTOSAR_ComM/BswModuleDescriptions/ComM/ComM_EvaluateChannel_MasterPnc_To_Ch_From_[!"$FromOsApplication"!]_To_[!"$ToOsApplication"!]_DataGet</RECEIVED-DATA-REF>
                      <QUEUE-LENGTH>2</QUEUE-LENGTH>
                    </BSW-QUEUED-DATA-RECEPTION-POLICY>
      [!ENDIF!] [!/*[!IF "$CurrentOsApplication = $ToOsApplication"!]*/!]
    [!ENDFOR!] [!/*[!FOR "Idx2" = "1" TO "count(text:split($EvaluateChannelMasterPncToChFromOsApp_ToOsApp,' '))"!]*/!]
        
    
    [!FOR "Idx2" = "1" TO "count(text:split($SynchShutDownMasterPncToChFromOsApp_ToOsApp,' '))"!]
      [!VAR "FromOsApplicationToOsApplication" = "string(text:split($SynchShutDownMasterPncToChFromOsApp_ToOsApp,' ')[position() = $Idx2])"!]
      [!VAR "FromOsApplication" = "string(text:split($FromOsApplicationToOsApplication,'->')[position() = 1])"!]
      [!VAR "ToOsApplication" = "string(text:split($FromOsApplicationToOsApplication,'->')[position() = 2])"!]
      [!IF "$CurrentOsApplication = $ToOsApplication"!]
                    <BSW-QUEUED-DATA-RECEPTION-POLICY>
                      <ENABLE-TAKE-ADDRESS>true</ENABLE-TAKE-ADDRESS>
                      <RECEIVED-DATA-REF DEST="VARIABLE-DATA-PROTOTYPE">/AUTOSAR_ComM/BswModuleDescriptions/ComM/ComM_SynchShutDown_MasterPnc_To_Ch_From_[!"$FromOsApplication"!]_To_[!"$ToOsApplication"!]_DataGet</RECEIVED-DATA-REF>
                      <QUEUE-LENGTH>2</QUEUE-LENGTH>
                    </BSW-QUEUED-DATA-RECEPTION-POLICY>
      [!ENDIF!] [!/*[!IF "$CurrentOsApplication = $ToOsApplication"!]*/!]
    [!ENDFOR!] [!/*[!FOR "Idx2" = "1" TO "count(text:split($SynchShutDownMasterPncToChFromOsApp_ToOsApp,' '))"!]*/!]    
    
  [!ENDIF!] [!/*[!IF "as:modconf('ComM')[1]/ComMGeneral/ComMPncSupport = 'true'"!]*/!]

  [!FOR "Idx2" = "1" TO "count(text:split($UserToChFromOsApp_ToOsApp,' '))"!]
    [!VAR "FromOsApplicationToOsApplication" = "string(text:split($UserToChFromOsApp_ToOsApp,' ')[position() = $Idx2])"!]
    [!VAR "FromOsApplication" = "string(text:split($FromOsApplicationToOsApplication,'->')[position() = 1])"!]
    [!VAR "ToOsApplication" = "string(text:split($FromOsApplicationToOsApplication,'->')[position() = 2])"!]
    [!IF "$CurrentOsApplication = $ToOsApplication"!]
      [!CALL "GetUserToChannelQueueSize","FromOsApplication"="$FromOsApplication","ToOsApplication"="$ToOsApplication"!]
                    <BSW-QUEUED-DATA-RECEPTION-POLICY>
                      <ENABLE-TAKE-ADDRESS>true</ENABLE-TAKE-ADDRESS>
                      <RECEIVED-DATA-REF DEST="VARIABLE-DATA-PROTOTYPE">/AUTOSAR_ComM/BswModuleDescriptions/ComM/ComM_User_To_Ch_From_[!"$FromOsApplication"!]_To_[!"$ToOsApplication"!]_DataGet</RECEIVED-DATA-REF>
                      <QUEUE-LENGTH>[!"num:i($UserToChannelQueueSize)"!]</QUEUE-LENGTH>
                    </BSW-QUEUED-DATA-RECEPTION-POLICY>
    [!ENDIF!] [!/*[!IF "$CurrentOsApplication = $ToOsApplication"!]*/!]
  [!ENDFOR!] [!/*[!FOR "Idx2" = "1" TO "count(text:split($UserToChFromOsApp_ToOsApp,' '))"!]*/!]

  [!IF "(as:modconf('ComM')[1]/ComMGeneral/ComMModeLimitationEnabled = 'true') or (as:modconf('ComM')[1]/ComMGeneral/ComMWakeupInhibitionEnabled = 'true')"!]
    [!FOR "Idx2" = "1" TO "count(text:split($InhibitionToChFromOsApp_ToOsApp,' '))"!]
      [!VAR "FromOsApplicationToOsApplication" = "string(text:split($InhibitionToChFromOsApp_ToOsApp,' ')[position() = $Idx2])"!]
      [!VAR "FromOsApplication" = "string(text:split($FromOsApplicationToOsApplication,'->')[position() = 1])"!]
      [!VAR "ToOsApplication" = "string(text:split($FromOsApplicationToOsApplication,'->')[position() = 2])"!]
      [!IF "$CurrentOsApplication = $ToOsApplication"!]
        [!CALL "GetInhibitionToChQueueSize","ToOsApplication"="$ToOsApplication"!]
                    <BSW-QUEUED-DATA-RECEPTION-POLICY>
                      <ENABLE-TAKE-ADDRESS>true</ENABLE-TAKE-ADDRESS>
                      <RECEIVED-DATA-REF DEST="VARIABLE-DATA-PROTOTYPE">/AUTOSAR_ComM/BswModuleDescriptions/ComM/ComM_Inhibition_To_Ch_From_[!"$FromOsApplication"!]_To_[!"$ToOsApplication"!]_DataGet</RECEIVED-DATA-REF>
                      <QUEUE-LENGTH>[!"num:i($InhibitionToChQueueSize)"!]</QUEUE-LENGTH>
                    </BSW-QUEUED-DATA-RECEPTION-POLICY>
      [!ENDIF!] [!/*[!IF "$CurrentOsApplication = $ToOsApplication"!]*/!]
    [!ENDFOR!] [!/*[!FOR "Idx2" = "1" TO "count(text:split($InhibitionToChFromOsApp_ToOsApp,' '))"!]*/!]
  [!ENDIF!] [!/*[!IF "(as:modconf('ComM')[1]/ComMGeneral/ComMModeLimitationEnabled = 'true') or (as:modconf('ComM')[1]/ComMGeneral/ComMWakeupInhibitionEnabled = 'true')"!]*/!]
                  </RECEPTION-POLICYS>
                </BSW-INTERNAL-BEHAVIOR>
[!ENDFOR!] [!/* [!FOR "Idx1" = "1" TO "count(text:split($FoundChannelsOsApplications,' '))"!] */!]
[!IF "as:modconf('ComM')[1]/ComMGeneral/ComMPncSupport = 'true'"!]
  [!IF "count(text:split($FoundMasterPncPlusSignalsOsApplications,' ')) > 1 "!]
    [!FOR "Idx1" = "1" TO "count(text:split($FoundMasterPncPlusSignalsOsApplications,' '))"!][!//
      [!VAR "CurrentOsApplication" = "string(text:split($FoundMasterPncPlusSignalsOsApplications,' ')[position() = $Idx1])"!]
      [!IF "($CurrentOsApplication) != ($MasterPncOsApplication)"!]
                <BSW-INTERNAL-BEHAVIOR>
                  <SHORT-NAME>InternalBehavior_SgnSlavePnc_[!"($CurrentOsApplication)"!]</SHORT-NAME>
                  <EXCLUSIVE-AREAS>
                    <EXCLUSIVE-AREA>
                      <SHORT-NAME>SCHM_COMM_EXCLUSIVE_AREA_SgnSlavePnc_[!"($CurrentOsApplication)"!]</SHORT-NAME>
                    </EXCLUSIVE-AREA>
                  </EXCLUSIVE-AREAS>
                  <ENTITYS>
        [!LOOP "util:distinct(node:order(util:distinct(node:refs(as:modconf('ComM')[1]/ComMConfigSet/*[1]/ComMPnc/*/ComMPncComSignal/*[ComMPncComSignalDirection='TX']/ComMPncComSignalRef)), 'ComHandleId'))"!]
          [!CALL "GetSignalOsApplication","SignalHandle"="ComHandleId","Direction"="'TX'"!]
          [!IF "($SignalOsApplication) = ($CurrentOsApplication)"!]
                    <BSW-SCHEDULABLE-ENTITY>
                      <SHORT-NAME>BswSchEnt_ComM_SgnSlavePnc_From_[!"$MasterPncOsApplication"!]_To_[!"$SignalOsApplication"!]_RcvFnct_[!"node:name(.)"!]</SHORT-NAME>
                      <CAN-ENTER-EXCLUSIVE-AREA-REFS>
                        <CAN-ENTER-EXCLUSIVE-AREA-REF DEST="EXCLUSIVE-AREA">/AUTOSAR_ComM/BswModuleDescriptions/ComM/InternalBehavior_SgnSlavePnc_[!"($SignalOsApplication)"!]/SCHM_COMM_EXCLUSIVE_AREA_SgnSlavePnc_[!"($CurrentOsApplication)"!]</CAN-ENTER-EXCLUSIVE-AREA-REF>
                      </CAN-ENTER-EXCLUSIVE-AREA-REFS>
                      <MINIMUM-START-INTERVAL>0.0</MINIMUM-START-INTERVAL>
                      <DATA-RECEIVE-POINTS>
                        <!-- Slave core only -->
                        <BSW-VARIABLE-ACCESS>
                          <SHORT-NAME>BswVarAccess_ComM_SgnSlavePnc_From_[!"$MasterPncOsApplication"!]_To_[!"$SignalOsApplication"!]_DataGet_[!"node:name(.)"!]</SHORT-NAME>
                          <ACCESSED-VARIABLE-REF DEST="VARIABLE-DATA-PROTOTYPE">/AUTOSAR_ComM/BswModuleDescriptions/ComM/ComM_SgnSlavePnc_From_[!"$MasterPncOsApplication"!]_To_[!"$SignalOsApplication"!]_DataGet_[!"node:name(.)"!]</ACCESSED-VARIABLE-REF>
                        </BSW-VARIABLE-ACCESS>
                      </DATA-RECEIVE-POINTS>
                      <IMPLEMENTED-ENTRY-REF DEST="BSW-MODULE-ENTRY">/AUTOSAR_ComM/[!"$bswModuleEntryPackageName"!]/ComM_SgnSlavePnc_From_[!"$MasterPncOsApplication"!]_To_[!"$SignalOsApplication"!]_RcvFnct_[!"node:name(.)"!]</IMPLEMENTED-ENTRY-REF>
                    </BSW-SCHEDULABLE-ENTITY>
          [!ENDIF!]
        [!ENDLOOP!]

        [!LOOP "util:distinct(node:order(util:distinct(node:refs(as:modconf('ComM')[1]/ComMConfigSet/*[1]/ComMPnc/*/ComMPncComSignal/*[ComMPncComSignalDirection='RX']/ComMPncComSignalRef)), 'ComHandleId'))"!]
          [!CALL "GetSignalOsApplication","SignalHandle"="ComHandleId","Direction"="'RX'"!]
          [!IF "($SignalOsApplication) = ($CurrentOsApplication)"!]
                    <BSW-CALLED-ENTITY>
                      <SHORT-NAME>BswCalledEnt_SgnSlavePnc_From_[!"$SignalOsApplication"!]_To_[!"$MasterPncOsApplication"!]_DataSntFnct_[!"node:name(.)"!]</SHORT-NAME>
                      <MINIMUM-START-INTERVAL>0.0</MINIMUM-START-INTERVAL>
                      <DATA-SEND-POINTS>
                        <!-- Slave core only -->
                        <BSW-VARIABLE-ACCESS>
                          <SHORT-NAME>BswVarAccess_SgnSlavePnc_OsApplication_[!"($SignalOsApplication)"!]_DataSet_[!"node:name(.)"!]</SHORT-NAME>
                          <ACCESSED-VARIABLE-REF DEST="VARIABLE-DATA-PROTOTYPE">/AUTOSAR_ComM/BswModuleDescriptions/ComM/ComM_SgnSlavePnc_From_[!"$SignalOsApplication"!]_To_[!"$MasterPncOsApplication"!]_DataSet_[!"node:name(.)"!]</ACCESSED-VARIABLE-REF>
                        </BSW-VARIABLE-ACCESS>
                      </DATA-SEND-POINTS>
                      <IMPLEMENTED-ENTRY-REF DEST="BSW-MODULE-ENTRY">/AUTOSAR_ComM/BswModuleEntrys/ComM_COMCbk_[!"node:name(.)"!]</IMPLEMENTED-ENTRY-REF>
                    </BSW-CALLED-ENTITY>
          [!ENDIF!]
        [!ENDLOOP!]
                  </ENTITYS>
                  <EVENTS>
        [!LOOP "util:distinct(node:order(util:distinct(node:refs(as:modconf('ComM')[1]/ComMConfigSet/*[1]/ComMPnc/*/ComMPncComSignal/*[ComMPncComSignalDirection='TX']/ComMPncComSignalRef)), 'ComHandleId'))"!]
          [!CALL "GetSignalOsApplication","SignalHandle"="ComHandleId","Direction"="'TX'"!]
          [!IF "($SignalOsApplication) = ($CurrentOsApplication)"!]
                    <BSW-DATA-RECEIVED-EVENT>
                        <SHORT-NAME>ComM_SgnSlavePnc_From_[!"$MasterPncOsApplication"!]_To_[!"$SignalOsApplication"!]_[!"node:name(.)"!]_RecEv</SHORT-NAME>
                        <STARTS-ON-EVENT-REF DEST="BSW-SCHEDULABLE-ENTITY">/AUTOSAR_ComM/BswModuleDescriptions/ComM/InternalBehavior_SgnSlavePnc_[!"($SignalOsApplication)"!]/BswSchEnt_ComM_SgnSlavePnc_From_[!"$MasterPncOsApplication"!]_To_[!"$SignalOsApplication"!]_RcvFnct_[!"node:name(.)"!]</STARTS-ON-EVENT-REF>
                        <DATA-REF DEST="VARIABLE-DATA-PROTOTYPE">/AUTOSAR_ComM/BswModuleDescriptions/ComM/ComM_SgnSlavePnc_From_[!"$MasterPncOsApplication"!]_To_[!"$SignalOsApplication"!]_DataGet_[!"node:name(.)"!]</DATA-REF>
                    </BSW-DATA-RECEIVED-EVENT>
          [!ENDIF!]
        [!ENDLOOP!]
                  </EVENTS>
                  <RECEPTION-POLICYS>
        [!LOOP "util:distinct(node:order(util:distinct(node:refs(as:modconf('ComM')[1]/ComMConfigSet/*[1]/ComMPnc/*/ComMPncComSignal/*[ComMPncComSignalDirection='TX']/ComMPncComSignalRef)), 'ComHandleId'))"!]
          [!CALL "GetSignalOsApplication","SignalHandle"="ComHandleId","Direction"="'TX'"!]
          [!IF "($SignalOsApplication) = ($CurrentOsApplication)"!]
                    <BSW-QUEUED-DATA-RECEPTION-POLICY>
                      <ENABLE-TAKE-ADDRESS>true</ENABLE-TAKE-ADDRESS>
                      <RECEIVED-DATA-REF DEST="VARIABLE-DATA-PROTOTYPE">/AUTOSAR_ComM/BswModuleDescriptions/ComM/ComM_SgnSlavePnc_From_[!"$MasterPncOsApplication"!]_To_[!"$SignalOsApplication"!]_DataGet_[!"node:name(.)"!]</RECEIVED-DATA-REF>
                      <QUEUE-LENGTH>2</QUEUE-LENGTH>
                    </BSW-QUEUED-DATA-RECEPTION-POLICY>
          [!ENDIF!]
        [!ENDLOOP!]
                  </RECEPTION-POLICYS>
                </BSW-INTERNAL-BEHAVIOR>
      [!ENDIF!]
    [!ENDFOR!]
  [!ENDIF!]
[!ENDIF!] [!/*[!IF "as:modconf('ComM')[1]/ComMGeneral/ComMPncSupport = 'true'"!]*/!]


              </INTERNAL-BEHAVIORS>
            </BSW-MODULE-DESCRIPTION>
          </ELEMENTS>
        </AR-PACKAGE>
        <AR-PACKAGE>
          <SHORT-NAME>[!"$bswModuleEntryPackageName"!]</SHORT-NAME>
          <ELEMENTS>
[!LOOP "ComMConfigSet/*[1]/ComMChannel/*"!]
            <BSW-MODULE-ENTRY>
              <SHORT-NAME>ComM_MainFunction_[!"ComMChannelId"!]</SHORT-NAME>
              <SERVICE-ID>96</SERVICE-ID>
              <IS-REENTRANT>false</IS-REENTRANT>
              <IS-SYNCHRONOUS>true</IS-SYNCHRONOUS>
              <CALL-TYPE>SCHEDULED</CALL-TYPE>
              <EXECUTION-CONTEXT>TASK</EXECUTION-CONTEXT>
              <SW-SERVICE-IMPL-POLICY>STANDARD</SW-SERVICE-IMPL-POLICY>
            </BSW-MODULE-ENTRY>
[!ENDLOOP!]

            <BSW-MODULE-ENTRY>
              <SHORT-NAME>ComM_DummyMainFunction</SHORT-NAME>
              <SERVICE-ID>255</SERVICE-ID>
              <IS-REENTRANT>false</IS-REENTRANT>
              <IS-SYNCHRONOUS>true</IS-SYNCHRONOUS>
              <CALL-TYPE>SCHEDULED</CALL-TYPE>
              <EXECUTION-CONTEXT>TASK</EXECUTION-CONTEXT>
              <SW-SERVICE-IMPL-POLICY>STANDARD</SW-SERVICE-IMPL-POLICY>
            </BSW-MODULE-ENTRY>
            <BSW-MODULE-ENTRY>
              <SHORT-NAME>ComM_DummyInhibitionMainFunction</SHORT-NAME>
              <SERVICE-ID>255</SERVICE-ID>
              <IS-REENTRANT>false</IS-REENTRANT>
              <IS-SYNCHRONOUS>true</IS-SYNCHRONOUS>
              <CALL-TYPE>SCHEDULED</CALL-TYPE>
              <EXECUTION-CONTEXT>TASK</EXECUTION-CONTEXT>
              <SW-SERVICE-IMPL-POLICY>STANDARD</SW-SERVICE-IMPL-POLICY>
            </BSW-MODULE-ENTRY>
[!IF "(as:modconf('ComM')[1]/ComMGeneral/ComMModeLimitationEnabled = 'true') or (as:modconf('ComM')[1]/ComMGeneral/ComMWakeupInhibitionEnabled = 'true')"!]
  [!IF "num:i(count(as:modconf('ComM')[1]/ComMConfigSet/*[1]/ComMUser/*)) > 0"!]
    [!FOR "Idx1" = "1" TO "count(text:split($UserToInhibitionFromOsApp_ToOsApp,' '))"!]
      [!VAR "FromOsApplicationToOsApplication" = "string(text:split($UserToInhibitionFromOsApp_ToOsApp,' ')[position() = $Idx1])"!]
      [!VAR "FromOsApplication" = "string(text:split($FromOsApplicationToOsApplication,'->')[position() = 1])"!]
      [!VAR "ToOsApplication" = "string(text:split($FromOsApplicationToOsApplication,'->')[position() = 2])"!]
            <BSW-MODULE-ENTRY>
              <SHORT-NAME>ComM_User_To_Inhibition_From_[!"$FromOsApplication"!]_To_[!"$InhibitionOsApplication"!]_RcvFnct</SHORT-NAME>
              <ADMIN-DATA>
                <SDGS>
                  <SDG GID="EB:DnT">
                    <SD GID="FunctionGroup">Extern</SD>
                    <SD GID="EnableTracing">true</SD>
                  </SDG>
                 </SDGS>
              </ADMIN-DATA>
              <SERVICE-ID>255</SERVICE-ID>
              <IS-REENTRANT>false</IS-REENTRANT>
              <IS-SYNCHRONOUS>true</IS-SYNCHRONOUS>
              <CALL-TYPE>SCHEDULED</CALL-TYPE>
              <EXECUTION-CONTEXT>TASK</EXECUTION-CONTEXT>
              <SW-SERVICE-IMPL-POLICY>STANDARD</SW-SERVICE-IMPL-POLICY>
              <ARGUMENTS>
              </ARGUMENTS>
            </BSW-MODULE-ENTRY>
    [!ENDFOR!] [!/*[!FOR "Idx1" = "1" TO "count(text:split($UserToInhibitionFromOsApp_ToOsApp,' '))"!]*/!]
            <BSW-MODULE-ENTRY>
              <SHORT-NAME>ComM_User_To_Inhibition_DataSntFnct</SHORT-NAME>
              <ADMIN-DATA>
                <SDGS>
                  <SDG GID="EB:DnT">
                    <SD GID="FunctionGroup">Extern</SD>
                    <SD GID="EnableTracing">true</SD>
                  </SDG>
                 </SDGS>
              </ADMIN-DATA>
              <SERVICE-ID>255</SERVICE-ID>
              <IS-REENTRANT>false</IS-REENTRANT>
              <IS-SYNCHRONOUS>true</IS-SYNCHRONOUS>
              <CALL-TYPE>REGULAR</CALL-TYPE>
              <EXECUTION-CONTEXT>TASK</EXECUTION-CONTEXT>
              <SW-SERVICE-IMPL-POLICY>STANDARD</SW-SERVICE-IMPL-POLICY>
              <ARGUMENTS>
              </ARGUMENTS>
            </BSW-MODULE-ENTRY>
  [!ENDIF!] [!/* [!IF "num:i(count(as:modconf('ComM')[1]/ComMConfigSet/*[1]/ComMUser/*)) > 0"!] */!]
  [!FOR "Idx1" = "1" TO "count(text:split($InhibitionToChFromOsApp_ToOsApp,' '))"!]
    [!VAR "FromOsApplicationToOsApplication" = "string(text:split($InhibitionToChFromOsApp_ToOsApp,' ')[position() = $Idx1])"!]
    [!VAR "FromOsApplication" = "string(text:split($FromOsApplicationToOsApplication,'->')[position() = 1])"!]
    [!VAR "ToOsApplication" = "string(text:split($FromOsApplicationToOsApplication,'->')[position() = 2])"!]
            <BSW-MODULE-ENTRY>
              <SHORT-NAME>ComM_Inhibition_To_Ch_From_[!"$FromOsApplication"!]_To_[!"$ToOsApplication"!]_RcvFnct</SHORT-NAME>
              <ADMIN-DATA>
                <SDGS>
                  <SDG GID="EB:DnT">
                    <SD GID="FunctionGroup">Extern</SD>
                    <SD GID="EnableTracing">true</SD>
                  </SDG>
                 </SDGS>
              </ADMIN-DATA>
              <SERVICE-ID>255</SERVICE-ID>
              <IS-REENTRANT>false</IS-REENTRANT>
              <IS-SYNCHRONOUS>true</IS-SYNCHRONOUS>
              <CALL-TYPE>SCHEDULED</CALL-TYPE>
              <EXECUTION-CONTEXT>TASK</EXECUTION-CONTEXT>
              <SW-SERVICE-IMPL-POLICY>STANDARD</SW-SERVICE-IMPL-POLICY>
              <ARGUMENTS>
              </ARGUMENTS>
            </BSW-MODULE-ENTRY>
  [!ENDFOR!] [!/* [!FOR "Idx1" = "1" TO "count(text:split($InhibitionToChFromOsApp_ToOsApp,' '))"!] */!]
            <BSW-MODULE-ENTRY>
              <SHORT-NAME>ComM_Inhibition_To_Ch_DataSntFnct</SHORT-NAME>
              <ADMIN-DATA>
                <SDGS>
                  <SDG GID="EB:DnT">
                    <SD GID="FunctionGroup">Extern</SD>
                    <SD GID="EnableTracing">true</SD>
                  </SDG>
                 </SDGS>
              </ADMIN-DATA>
              <SERVICE-ID>255</SERVICE-ID>
              <IS-REENTRANT>false</IS-REENTRANT>
              <IS-SYNCHRONOUS>true</IS-SYNCHRONOUS>
              <CALL-TYPE>REGULAR</CALL-TYPE>
              <EXECUTION-CONTEXT>TASK</EXECUTION-CONTEXT>
              <SW-SERVICE-IMPL-POLICY>STANDARD</SW-SERVICE-IMPL-POLICY>
              <ARGUMENTS>
              </ARGUMENTS>
            </BSW-MODULE-ENTRY>

  [!FOR "Idx1" = "1" TO "count(text:split($ChToInhibitionFromOsApp_ToOsApp,' '))"!]
    [!VAR "FromOsApplicationToOsApplication" = "string(text:split($ChToInhibitionFromOsApp_ToOsApp,' ')[position() = $Idx1])"!]
    [!VAR "FromOsApplication" = "string(text:split($FromOsApplicationToOsApplication,'->')[position() = 1])"!]
    [!VAR "ToOsApplication" = "string(text:split($FromOsApplicationToOsApplication,'->')[position() = 2])"!]
            <BSW-MODULE-ENTRY>
              <SHORT-NAME>ComM_Ch_To_Inhibition_From_[!"$FromOsApplication"!]_To_[!"$ToOsApplication"!]_RcvFnct</SHORT-NAME>
              <ADMIN-DATA>
                <SDGS>
                  <SDG GID="EB:DnT">
                    <SD GID="FunctionGroup">Extern</SD>
                    <SD GID="EnableTracing">true</SD>
                  </SDG>
                 </SDGS>
              </ADMIN-DATA>
              <SERVICE-ID>255</SERVICE-ID>
              <IS-REENTRANT>false</IS-REENTRANT>
              <IS-SYNCHRONOUS>true</IS-SYNCHRONOUS>
              <CALL-TYPE>SCHEDULED</CALL-TYPE>
              <EXECUTION-CONTEXT>TASK</EXECUTION-CONTEXT>
              <SW-SERVICE-IMPL-POLICY>STANDARD</SW-SERVICE-IMPL-POLICY>
              <ARGUMENTS>
              </ARGUMENTS>
            </BSW-MODULE-ENTRY>
  [!ENDFOR!] [!/* [!FOR "Idx1" = "1" TO "count(text:split($ChToInhibitionFromOsApp_ToOsApp,' '))"!] */!]
            <BSW-MODULE-ENTRY>
              <SHORT-NAME>ComM_Ch_To_Inhibition_DataSntFnct</SHORT-NAME>
              <ADMIN-DATA>
                <SDGS>
                  <SDG GID="EB:DnT">
                    <SD GID="FunctionGroup">Extern</SD>
                    <SD GID="EnableTracing">true</SD>
                  </SDG>
                 </SDGS>
              </ADMIN-DATA>
              <SERVICE-ID>255</SERVICE-ID>
              <IS-REENTRANT>false</IS-REENTRANT>
              <IS-SYNCHRONOUS>true</IS-SYNCHRONOUS>
              <CALL-TYPE>REGULAR</CALL-TYPE>
              <EXECUTION-CONTEXT>TASK</EXECUTION-CONTEXT>
              <SW-SERVICE-IMPL-POLICY>STANDARD</SW-SERVICE-IMPL-POLICY>
              <ARGUMENTS>
              </ARGUMENTS>
            </BSW-MODULE-ENTRY>
[!ENDIF!] [!/*[!IF "(as:modconf('ComM')[1]/ComMGeneral/ComMModeLimitationEnabled = 'true') or (as:modconf('ComM')[1]/ComMGeneral/ComMWakeupInhibitionEnabled = 'true')"!]*/!]

[!IF "as:modconf('ComM')[1]/ComMGeneral/ComMDcmUsage = 'true'"!]
            <BSW-MODULE-ENTRY>
              <SHORT-NAME>ComM_DCM_ActiveDiagnostic</SHORT-NAME>
              <ADMIN-DATA>
                <SDGS>
                  <SDG GID="EB:DnT">
                    <SD GID="FunctionGroup">Extern</SD>
                    <SD GID="EnableTracing">true</SD>
                  </SDG>
                 </SDGS>
              </ADMIN-DATA>
              <SERVICE-ID>31</SERVICE-ID>
              <IS-REENTRANT>true</IS-REENTRANT>
              <IS-SYNCHRONOUS>false</IS-SYNCHRONOUS>
              <CALL-TYPE>REGULAR</CALL-TYPE>
              <EXECUTION-CONTEXT>TASK</EXECUTION-CONTEXT>
              <SW-SERVICE-IMPL-POLICY>STANDARD</SW-SERVICE-IMPL-POLICY>
              <ARGUMENTS>
                <SW-SERVICE-ARG>
                  <SHORT-NAME>Channel</SHORT-NAME>
                  <DIRECTION>IN</DIRECTION>
                  <SW-DATA-DEF-PROPS>
                    <SW-DATA-DEF-PROPS-VARIANTS>
                      <SW-DATA-DEF-PROPS-CONDITIONAL>
                        <IMPLEMENTATION-DATA-TYPE-REF DEST="IMPLEMENTATION-DATA-TYPE">/AUTOSAR_Platform/ImplementationDataTypes/uint8</IMPLEMENTATION-DATA-TYPE-REF>
                      </SW-DATA-DEF-PROPS-CONDITIONAL>
                    </SW-DATA-DEF-PROPS-VARIANTS>
                  </SW-DATA-DEF-PROPS>
                </SW-SERVICE-ARG>
              </ARGUMENTS>
            </BSW-MODULE-ENTRY>
            <BSW-MODULE-ENTRY>
              <SHORT-NAME>ComM_DCM_InactiveDiagnostic</SHORT-NAME>
              <ADMIN-DATA>
                <SDGS>
                  <SDG GID="EB:DnT">
                    <SD GID="FunctionGroup">Extern</SD>
                    <SD GID="EnableTracing">true</SD>
                  </SDG>
                 </SDGS>
              </ADMIN-DATA>
              <SERVICE-ID>32</SERVICE-ID>
              <IS-REENTRANT>true</IS-REENTRANT>
              <IS-SYNCHRONOUS>false</IS-SYNCHRONOUS>
              <CALL-TYPE>REGULAR</CALL-TYPE>
              <EXECUTION-CONTEXT>TASK</EXECUTION-CONTEXT>
              <SW-SERVICE-IMPL-POLICY>STANDARD</SW-SERVICE-IMPL-POLICY>
              <ARGUMENTS>
                <SW-SERVICE-ARG>
                  <SHORT-NAME>Channel</SHORT-NAME>
                  <DIRECTION>IN</DIRECTION>
                  <SW-DATA-DEF-PROPS>
                    <SW-DATA-DEF-PROPS-VARIANTS>
                      <SW-DATA-DEF-PROPS-CONDITIONAL>
                        <IMPLEMENTATION-DATA-TYPE-REF DEST="IMPLEMENTATION-DATA-TYPE">/AUTOSAR_Platform/ImplementationDataTypes/uint8</IMPLEMENTATION-DATA-TYPE-REF>
                      </SW-DATA-DEF-PROPS-CONDITIONAL>
                    </SW-DATA-DEF-PROPS-VARIANTS>
                  </SW-DATA-DEF-PROPS>
                </SW-SERVICE-ARG>
              </ARGUMENTS>
            </BSW-MODULE-ENTRY>
[!ENDIF!] [!/* [!IF "as:modconf('ComM')[1]/ComMGeneral/ComMDcmUsage = 'true'"!] */!]
[!IF "node:exists(as:modconf('EcuM')[1]/EcuMGeneral/EcuMCrossCoreComMWakeup) and (node:value(as:modconf('EcuM')[1]/EcuMGeneral/EcuMCrossCoreComMWakeup) = 'true')"!]
            <BSW-MODULE-ENTRY>
              <SHORT-NAME>ComM_EcuM_WakeUpIndication</SHORT-NAME>
              <ADMIN-DATA>
                <SDGS>
                  <SDG GID="EB:DnT">
                    <SD GID="FunctionGroup">Extern</SD>
                    <SD GID="EnableTracing">true</SD>
                  </SDG>
                 </SDGS>
              </ADMIN-DATA>
              <SERVICE-ID>42</SERVICE-ID>
              <IS-REENTRANT>true</IS-REENTRANT>
              <IS-SYNCHRONOUS>false</IS-SYNCHRONOUS>
              <CALL-TYPE>REGULAR</CALL-TYPE>
              <EXECUTION-CONTEXT>TASK</EXECUTION-CONTEXT>
              <SW-SERVICE-IMPL-POLICY>STANDARD</SW-SERVICE-IMPL-POLICY>
              <ARGUMENTS>
                <SW-SERVICE-ARG>
                  <SHORT-NAME>Channel</SHORT-NAME>
                  <DIRECTION>IN</DIRECTION>
                  <SW-DATA-DEF-PROPS>
                    <SW-DATA-DEF-PROPS-VARIANTS>
                      <SW-DATA-DEF-PROPS-CONDITIONAL>
                        <IMPLEMENTATION-DATA-TYPE-REF DEST="IMPLEMENTATION-DATA-TYPE">/AUTOSAR_Platform/ImplementationDataTypes/uint8</IMPLEMENTATION-DATA-TYPE-REF>
                      </SW-DATA-DEF-PROPS-CONDITIONAL>
                    </SW-DATA-DEF-PROPS-VARIANTS>
                  </SW-DATA-DEF-PROPS>
                </SW-SERVICE-ARG>
              </ARGUMENTS>
            </BSW-MODULE-ENTRY>

            <BSW-MODULE-ENTRY>
              <SHORT-NAME>ComM_EcuM_PNCWakeUpIndication</SHORT-NAME>
              <ADMIN-DATA>
                <SDGS>
                  <SDG GID="EB:DnT">
                    <SD GID="FunctionGroup">Extern</SD>
                    <SD GID="EnableTracing">true</SD>
                  </SDG>
                 </SDGS>
              </ADMIN-DATA>
              <SERVICE-ID>55</SERVICE-ID>
              <IS-REENTRANT>true</IS-REENTRANT>
              <IS-SYNCHRONOUS>false</IS-SYNCHRONOUS>
              <CALL-TYPE>REGULAR</CALL-TYPE>
              <EXECUTION-CONTEXT>TASK</EXECUTION-CONTEXT>
              <SW-SERVICE-IMPL-POLICY>STANDARD</SW-SERVICE-IMPL-POLICY>
              <ARGUMENTS>
                <SW-SERVICE-ARG>
                  <SHORT-NAME>PNCid</SHORT-NAME>
                  <DIRECTION>IN</DIRECTION>
                  <SW-DATA-DEF-PROPS>
                    <SW-DATA-DEF-PROPS-VARIANTS>
                      <SW-DATA-DEF-PROPS-CONDITIONAL>
                        <IMPLEMENTATION-DATA-TYPE-REF DEST="IMPLEMENTATION-DATA-TYPE">/AUTOSAR_ComStack_Types/ImplementationDataTypes/PNCHandleType</IMPLEMENTATION-DATA-TYPE-REF>
                      </SW-DATA-DEF-PROPS-CONDITIONAL>
                    </SW-DATA-DEF-PROPS-VARIANTS>
                  </SW-DATA-DEF-PROPS>
                </SW-SERVICE-ARG>
              </ARGUMENTS>
            </BSW-MODULE-ENTRY>
[!ENDIF!] [!/* [!IF "node:exists(as:modconf('EcuM')[1]/EcuMGeneral/EcuMCrossCoreComMWakeup) and (node:value(as:modconf('EcuM')[1]/EcuMGeneral/EcuMCrossCoreComMWakeup) = 'true')"!] */!]

[!IF "num:i(count(as:modconf('ComM')[1]/ComMConfigSet/*[1]/ComMUser/*)) > 0"!]
  [!LOOP "as:modconf('ComM')[1]/ComMConfigSet/*[1]/ComMUser/*"!]
            <BSW-MODULE-ENTRY>
              <SHORT-NAME>ComM_MainFunction_User_[!"ComMUserIdentifier"!]</SHORT-NAME>
              <SERVICE-ID>255</SERVICE-ID>
              <IS-REENTRANT>false</IS-REENTRANT>
              <IS-SYNCHRONOUS>true</IS-SYNCHRONOUS>
              <CALL-TYPE>SCHEDULED</CALL-TYPE>
              <EXECUTION-CONTEXT>TASK</EXECUTION-CONTEXT>
              <SW-SERVICE-IMPL-POLICY>STANDARD</SW-SERVICE-IMPL-POLICY>
            </BSW-MODULE-ENTRY>
  [!ENDLOOP!] [!/*[!LOOP "as:modconf('ComM')[1]/ComMConfigSet/*[1]/ComMUser/*"!]*/!]
  [!FOR "Idx1" = "1" TO "count(text:split($FoundChannelsOsApplications,' '))"!]
    [!VAR "CurrentOsApplication" = "string(text:split($FoundChannelsOsApplications,' ')[position() = $Idx1])"!]
    [!FOR "Idx2" = "1" TO "count(text:split($UserToChFromOsApp_ToOsApp,' '))"!]
      [!VAR "FromOsApplicationToOsApplication" = "string(text:split($UserToChFromOsApp_ToOsApp,' ')[position() = $Idx2])"!]
      [!VAR "FromOsApplication" = "string(text:split($FromOsApplicationToOsApplication,'->')[position() = 1])"!]
      [!VAR "ToOsApplication" = "string(text:split($FromOsApplicationToOsApplication,'->')[position() = 2])"!]
      [!IF "$CurrentOsApplication = $ToOsApplication"!]
            <BSW-MODULE-ENTRY>
              <SHORT-NAME>ComM_User_To_Ch_From_[!"$FromOsApplication"!]_To_[!"$ToOsApplication"!]_RcvFnct</SHORT-NAME>
              <ADMIN-DATA>
                <SDGS>
                  <SDG GID="EB:DnT">
                    <SD GID="FunctionGroup">Extern</SD>
                    <SD GID="EnableTracing">true</SD>
                  </SDG>
                 </SDGS>
              </ADMIN-DATA>
              <SERVICE-ID>255</SERVICE-ID>
              <IS-REENTRANT>false</IS-REENTRANT>
              <IS-SYNCHRONOUS>true</IS-SYNCHRONOUS>
              <CALL-TYPE>SCHEDULED</CALL-TYPE>
              <EXECUTION-CONTEXT>TASK</EXECUTION-CONTEXT>
              <SW-SERVICE-IMPL-POLICY>STANDARD</SW-SERVICE-IMPL-POLICY>
              <ARGUMENTS>
              </ARGUMENTS>
            </BSW-MODULE-ENTRY>
      [!ENDIF!] [!/*[!IF "$CurrentOsApplication = $ToOsApplication"!]*/!]
    [!ENDFOR!] [!/*[!FOR "Idx2" = "1" TO "count(text:split($UserToChFromOsApp_ToOsApp,' '))"!]*/!]
  [!ENDFOR!] [!/*[!FOR "Idx1" = "1" TO "count(text:split($FoundChannelsOsApplications,' '))"!]*/!]
            <BSW-MODULE-ENTRY>
              <SHORT-NAME>ComM_User_To_Ch_DataSntFnct</SHORT-NAME>
              <ADMIN-DATA>
                <SDGS>
                  <SDG GID="EB:DnT">
                    <SD GID="FunctionGroup">Extern</SD>
                    <SD GID="EnableTracing">true</SD>
                  </SDG>
                 </SDGS>
              </ADMIN-DATA>
              <SERVICE-ID>255</SERVICE-ID>
              <IS-REENTRANT>false</IS-REENTRANT>
              <IS-SYNCHRONOUS>true</IS-SYNCHRONOUS>
              <CALL-TYPE>REGULAR</CALL-TYPE>
              <EXECUTION-CONTEXT>TASK</EXECUTION-CONTEXT>
              <SW-SERVICE-IMPL-POLICY>STANDARD</SW-SERVICE-IMPL-POLICY>
              <ARGUMENTS>
              </ARGUMENTS>
            </BSW-MODULE-ENTRY>
  [!IF "as:modconf('ComM')[1]/ComMGeneral/ComMPncSupport = 'true'"!]
            <BSW-MODULE-ENTRY>
              <SHORT-NAME>ComM_User_To_MasterPnc_DataSntFnct</SHORT-NAME>
              <ADMIN-DATA>
                <SDGS>
                  <SDG GID="EB:DnT">
                    <SD GID="FunctionGroup">Extern</SD>
                    <SD GID="EnableTracing">true</SD>
                  </SDG>
                 </SDGS>
              </ADMIN-DATA>
              <SERVICE-ID>255</SERVICE-ID>
              <IS-REENTRANT>false</IS-REENTRANT>
              <IS-SYNCHRONOUS>true</IS-SYNCHRONOUS>
              <CALL-TYPE>REGULAR</CALL-TYPE>
              <EXECUTION-CONTEXT>TASK</EXECUTION-CONTEXT>
              <SW-SERVICE-IMPL-POLICY>STANDARD</SW-SERVICE-IMPL-POLICY>
              <ARGUMENTS>
              </ARGUMENTS>
            </BSW-MODULE-ENTRY>
    [!FOR "Idx1" = "1" TO "count(text:split($UserToMasterPncFromOsApp_ToOsApp,' '))"!]
      [!VAR "FromOsApplicationToOsApplication" = "string(text:split($UserToMasterPncFromOsApp_ToOsApp,' ')[position() = $Idx1])"!]
      [!VAR "FromOsApplication" = "string(text:split($FromOsApplicationToOsApplication,'->')[position() = 1])"!]
      [!VAR "ToOsApplication" = "string(text:split($FromOsApplicationToOsApplication,'->')[position() = 2])"!]
            <BSW-MODULE-ENTRY>
              <SHORT-NAME>ComM_User_To_MasterPnc_From_[!"$FromOsApplication"!]_To_[!"$ToOsApplication"!]_RcvFnct</SHORT-NAME>
              <ADMIN-DATA>
                <SDGS>
                  <SDG GID="EB:DnT">
                    <SD GID="FunctionGroup">Extern</SD>
                    <SD GID="EnableTracing">true</SD>
                  </SDG>
                 </SDGS>
              </ADMIN-DATA>
              <SERVICE-ID>255</SERVICE-ID>
              <IS-REENTRANT>false</IS-REENTRANT>
              <IS-SYNCHRONOUS>true</IS-SYNCHRONOUS>
              <CALL-TYPE>SCHEDULED</CALL-TYPE>
              <EXECUTION-CONTEXT>TASK</EXECUTION-CONTEXT>
              <SW-SERVICE-IMPL-POLICY>STANDARD</SW-SERVICE-IMPL-POLICY>
              <ARGUMENTS>
              </ARGUMENTS>
            </BSW-MODULE-ENTRY>
    [!ENDFOR!] [!/*[!FOR "Idx1" = "1" TO "count(text:split($UserToMasterPncFromOsApp_ToOsApp,' '))"!]*/!]
  [!ENDIF!] [!/* [!IF "as:modconf('ComM')[1]/ComMGeneral/ComMPncSupport = 'true'"!] */!]
[!ENDIF!] [!/*[!IF "num:i(count(as:modconf('ComM')[1]/ComMConfigSet/*[1]/ComMUser/*)) > 0"!]*/!]

[!IF "as:modconf('ComM')[1]/ComMGeneral/ComMPncSupport = 'true'"!]
            <BSW-MODULE-ENTRY>
              <SHORT-NAME>ComM_MainFunction_MasterPnc</SHORT-NAME>
              <SERVICE-ID>255</SERVICE-ID>
              <IS-REENTRANT>false</IS-REENTRANT>
              <IS-SYNCHRONOUS>true</IS-SYNCHRONOUS>
              <CALL-TYPE>SCHEDULED</CALL-TYPE>
              <EXECUTION-CONTEXT>TASK</EXECUTION-CONTEXT>
              <SW-SERVICE-IMPL-POLICY>STANDARD</SW-SERVICE-IMPL-POLICY>
            </BSW-MODULE-ENTRY>
  [!IF "count(text:split($FoundMasterPncPlusSignalsOsApplications,' ')) > 1 "!]
            <BSW-MODULE-ENTRY>
              <SHORT-NAME>ComM_SgnMasterPnc_DataSntFnct</SHORT-NAME>
              <ADMIN-DATA>
                <SDGS>
                  <SDG GID="EB:DnT">
                    <SD GID="FunctionGroup">Extern</SD>
                    <SD GID="EnableTracing">true</SD>
                  </SDG>
                 </SDGS>
              </ADMIN-DATA>
              <SERVICE-ID>255</SERVICE-ID>
              <IS-REENTRANT>false</IS-REENTRANT>
              <IS-SYNCHRONOUS>true</IS-SYNCHRONOUS>
              <CALL-TYPE>REGULAR</CALL-TYPE>
              <EXECUTION-CONTEXT>TASK</EXECUTION-CONTEXT>
              <SW-SERVICE-IMPL-POLICY>STANDARD</SW-SERVICE-IMPL-POLICY>
              <ARGUMENTS>
              </ARGUMENTS>
            </BSW-MODULE-ENTRY>
    [!LOOP "util:distinct(node:order(util:distinct(node:refs(as:modconf('ComM')[1]/ComMConfigSet/*[1]/ComMPnc/*/ComMPncComSignal/*[ComMPncComSignalDirection='TX']/ComMPncComSignalRef)), 'ComHandleId'))"!]
      [!CALL "GetSignalOsApplication","SignalHandle"="ComHandleId","Direction"="'TX'"!]
      [!IF "($SignalOsApplication) != ($MasterPncOsApplication)"!]
            <BSW-MODULE-ENTRY>
              <SHORT-NAME>ComM_SgnSlavePnc_From_[!"$MasterPncOsApplication"!]_To_[!"$SignalOsApplication"!]_RcvFnct_[!"node:name(.)"!]</SHORT-NAME>
              <ADMIN-DATA>
                <SDGS>
                  <SDG GID="EB:DnT">
                    <SD GID="FunctionGroup">Extern</SD>
                    <SD GID="EnableTracing">true</SD>
                  </SDG>
                 </SDGS>
              </ADMIN-DATA>
              <SERVICE-ID>255</SERVICE-ID>
              <IS-REENTRANT>true</IS-REENTRANT>
              <IS-SYNCHRONOUS>false</IS-SYNCHRONOUS>
              <CALL-TYPE>SCHEDULED</CALL-TYPE>
              <EXECUTION-CONTEXT>TASK</EXECUTION-CONTEXT>
              <SW-SERVICE-IMPL-POLICY>STANDARD</SW-SERVICE-IMPL-POLICY>
              <ARGUMENTS>
              </ARGUMENTS>
            </BSW-MODULE-ENTRY>
      [!ENDIF!]
    [!ENDLOOP!]

    [!LOOP "util:distinct(node:order(util:distinct(node:refs(as:modconf('ComM')[1]/ComMConfigSet/*[1]/ComMPnc/*/ComMPncComSignal/*[ComMPncComSignalDirection='RX']/ComMPncComSignalRef)), 'ComHandleId'))"!]
      [!CALL "GetSignalOsApplication","SignalHandle"="ComHandleId","Direction"="'RX'"!]
      [!IF "($SignalOsApplication) != ($MasterPncOsApplication)"!]
            <BSW-MODULE-ENTRY>
              <SHORT-NAME>ComM_SgnMasterPnc_From_[!"$SignalOsApplication"!]_To_[!"$MasterPncOsApplication"!]_RcvFnct_[!"node:name(.)"!]</SHORT-NAME>
              <ADMIN-DATA>
                <SDGS>
                  <SDG GID="EB:DnT">
                    <SD GID="FunctionGroup">Extern</SD>
                    <SD GID="EnableTracing">true</SD>
                  </SDG>
                 </SDGS>
              </ADMIN-DATA>
              <SERVICE-ID>255</SERVICE-ID>
              <IS-REENTRANT>true</IS-REENTRANT>
              <IS-SYNCHRONOUS>false</IS-SYNCHRONOUS>
              <CALL-TYPE>SCHEDULED</CALL-TYPE>
              <EXECUTION-CONTEXT>TASK</EXECUTION-CONTEXT>
              <SW-SERVICE-IMPL-POLICY>STANDARD</SW-SERVICE-IMPL-POLICY>
              <ARGUMENTS>
              </ARGUMENTS>
            </BSW-MODULE-ENTRY>

            <BSW-MODULE-ENTRY>
              <SHORT-NAME>ComM_COMCbk_[!"node:name(.)"!]</SHORT-NAME>
              <ADMIN-DATA>
                <SDGS>
                  <SDG GID="EB:DnT">
                    <SD GID="FunctionGroup">Extern</SD>
                    <SD GID="EnableTracing">true</SD>
                  </SDG>
                 </SDGS>
              </ADMIN-DATA>
              <SERVICE-ID>255</SERVICE-ID>
              <IS-REENTRANT>true</IS-REENTRANT>
              <IS-SYNCHRONOUS>false</IS-SYNCHRONOUS>
              <CALL-TYPE>REGULAR</CALL-TYPE>
              <EXECUTION-CONTEXT>TASK</EXECUTION-CONTEXT>
              <SW-SERVICE-IMPL-POLICY>STANDARD</SW-SERVICE-IMPL-POLICY>
              <ARGUMENTS>
              </ARGUMENTS>
            </BSW-MODULE-ENTRY>
      [!ENDIF!]
    [!ENDLOOP!]
  [!ENDIF!] [!/* [!IF "count(text:split($FoundMasterPncPlusSignalsOsApplications,' ')) > 1 "!] */!]
[!ENDIF!] [!/*[!IF "as:modconf('ComM')[1]/ComMGeneral/ComMPncSupport = 'true'"!]*/!]
[!FOR "Idx1" = "1" TO "count(text:split($ChToChFromOsApp_ToOsApp,' '))"!]
  [!VAR "FromOsApplicationToOsApplication" = "string(text:split($ChToChFromOsApp_ToOsApp,' ')[position() = $Idx1])"!]
  [!VAR "FromOsApplication" = "string(text:split($FromOsApplicationToOsApplication,'->')[position() = 1])"!]
  [!VAR "ToOsApplication" = "string(text:split($FromOsApplicationToOsApplication,'->')[position() = 2])"!]
            <BSW-MODULE-ENTRY>
              <SHORT-NAME>ComM_Ch_To_Ch_From_[!"$FromOsApplication"!]_To_[!"$ToOsApplication"!]_RcvFnct</SHORT-NAME>
              <ADMIN-DATA>
                <SDGS>
                  <SDG GID="EB:DnT">
                    <SD GID="FunctionGroup">Extern</SD>
                    <SD GID="EnableTracing">true</SD>
                  </SDG>
                 </SDGS>
              </ADMIN-DATA>
              <SERVICE-ID>255</SERVICE-ID>
              <IS-REENTRANT>true</IS-REENTRANT>
              <IS-SYNCHRONOUS>false</IS-SYNCHRONOUS>
              <CALL-TYPE>SCHEDULED</CALL-TYPE>
              <EXECUTION-CONTEXT>TASK</EXECUTION-CONTEXT>
              <SW-SERVICE-IMPL-POLICY>STANDARD</SW-SERVICE-IMPL-POLICY>
              <ARGUMENTS>
              </ARGUMENTS>
            </BSW-MODULE-ENTRY>
[!ENDFOR!] [!/*[!FOR "Idx1" = "1" TO "count(text:split($ChToChFromOsApp_ToOsApp,' '))"!]*/!]
            <BSW-MODULE-ENTRY>
              <SHORT-NAME>ComM_Ch_To_Ch_DataSntFnct</SHORT-NAME>
              <ADMIN-DATA>
                <SDGS>
                  <SDG GID="EB:DnT">
                    <SD GID="FunctionGroup">Extern</SD>
                    <SD GID="EnableTracing">true</SD>
                  </SDG>
                 </SDGS>
              </ADMIN-DATA>
              <SERVICE-ID>255</SERVICE-ID>
              <IS-REENTRANT>true</IS-REENTRANT>
              <IS-SYNCHRONOUS>false</IS-SYNCHRONOUS>
              <CALL-TYPE>REGULAR</CALL-TYPE>
              <EXECUTION-CONTEXT>TASK</EXECUTION-CONTEXT>
              <SW-SERVICE-IMPL-POLICY>STANDARD</SW-SERVICE-IMPL-POLICY>
              <ARGUMENTS>
                <SW-SERVICE-ARG>
                  <SHORT-NAME>inData</SHORT-NAME>
                  <DIRECTION>IN</DIRECTION>
                  <SW-DATA-DEF-PROPS>
                    <SW-DATA-DEF-PROPS-VARIANTS>
                      <SW-DATA-DEF-PROPS-CONDITIONAL>
                        <IMPLEMENTATION-DATA-TYPE-REF DEST="IMPLEMENTATION-DATA-TYPE">/AUTOSAR_ComM/ImplementationDataTypes/ComM_Ch_To_Ch_DataType</IMPLEMENTATION-DATA-TYPE-REF>
                      </SW-DATA-DEF-PROPS-CONDITIONAL>
                    </SW-DATA-DEF-PROPS-VARIANTS>
                  </SW-DATA-DEF-PROPS>
                </SW-SERVICE-ARG>
              </ARGUMENTS>
            </BSW-MODULE-ENTRY>
[!IF "as:modconf('ComM')[1]/ComMGeneral/ComMPncSupport = 'true'"!]
  [!FOR "Idx1" = "1" TO "count(text:split($ChToMasterPncFromOsApp_ToOsApp,' '))"!]
    [!VAR "FromOsApplicationToOsApplication" = "string(text:split($ChToMasterPncFromOsApp_ToOsApp,' ')[position() = $Idx1])"!]
    [!VAR "FromOsApplication" = "string(text:split($FromOsApplicationToOsApplication,'->')[position() = 1])"!]
    [!VAR "ToOsApplication" = "string(text:split($FromOsApplicationToOsApplication,'->')[position() = 2])"!]
            <BSW-MODULE-ENTRY>
              <SHORT-NAME>ComM_Ch_To_MasterPnc_From_[!"$FromOsApplication"!]_To_[!"$ToOsApplication"!]_RcvFnct</SHORT-NAME>
              <ADMIN-DATA>
                <SDGS>
                  <SDG GID="EB:DnT">
                    <SD GID="FunctionGroup">Extern</SD>
                    <SD GID="EnableTracing">true</SD>
                  </SDG>
                 </SDGS>
              </ADMIN-DATA>
              <SERVICE-ID>255</SERVICE-ID>
              <IS-REENTRANT>true</IS-REENTRANT>
              <IS-SYNCHRONOUS>false</IS-SYNCHRONOUS>
              <CALL-TYPE>SCHEDULED</CALL-TYPE>
              <EXECUTION-CONTEXT>TASK</EXECUTION-CONTEXT>
              <SW-SERVICE-IMPL-POLICY>STANDARD</SW-SERVICE-IMPL-POLICY>
              <ARGUMENTS>
              </ARGUMENTS>
            </BSW-MODULE-ENTRY>
  [!ENDFOR!][!/*[!FOR "Idx1" = "1" TO "count(text:split($ChToMasterPncFromOsApp_ToOsApp,' '))"!]*/!]
            <BSW-MODULE-ENTRY>
              <SHORT-NAME>ComM_Ch_To_MasterPnc_DataSntFnct</SHORT-NAME>
              <ADMIN-DATA>
                <SDGS>
                  <SDG GID="EB:DnT">
                    <SD GID="FunctionGroup">Extern</SD>
                    <SD GID="EnableTracing">true</SD>
                  </SDG>
                 </SDGS>
              </ADMIN-DATA>
              <SERVICE-ID>255</SERVICE-ID>
              <IS-REENTRANT>true</IS-REENTRANT>
              <IS-SYNCHRONOUS>false</IS-SYNCHRONOUS>
              <CALL-TYPE>REGULAR</CALL-TYPE>
              <EXECUTION-CONTEXT>TASK</EXECUTION-CONTEXT>
              <SW-SERVICE-IMPL-POLICY>STANDARD</SW-SERVICE-IMPL-POLICY>
              <ARGUMENTS>
                <SW-SERVICE-ARG>
                  <SHORT-NAME>inData</SHORT-NAME>
                  <DIRECTION>IN</DIRECTION>
                  <SW-DATA-DEF-PROPS>
                    <SW-DATA-DEF-PROPS-VARIANTS>
                      <SW-DATA-DEF-PROPS-CONDITIONAL>
                        <IMPLEMENTATION-DATA-TYPE-REF DEST="IMPLEMENTATION-DATA-TYPE">/AUTOSAR_Platform/ImplementationDataTypes/uint8</IMPLEMENTATION-DATA-TYPE-REF>
                      </SW-DATA-DEF-PROPS-CONDITIONAL>
                    </SW-DATA-DEF-PROPS-VARIANTS>
                  </SW-DATA-DEF-PROPS>
                </SW-SERVICE-ARG>
              </ARGUMENTS>
            </BSW-MODULE-ENTRY>
[!ENDIF!] [!/*[!IF "as:modconf('ComM')[1]/ComMGeneral/ComMPncSupport = 'true'"!]*/!]

[!IF "node:exists(as:modconf('ComM')[1]/ComMGeneral/ComMSynchronizedPncShutdownEnabled) and (as:modconf('ComM')[1]/ComMGeneral/ComMSynchronizedPncShutdownEnabled = 'true')"!]
  [!FOR "Idx1" = "1" TO "count(text:split($SynchShutDownChToMasterPncFromOsApp_ToOsApp,' '))"!]
    [!VAR "FromOsApplicationToOsApplication" = "string(text:split($SynchShutDownChToMasterPncFromOsApp_ToOsApp,' ')[position() = $Idx1])"!]
    [!VAR "FromOsApplication" = "string(text:split($FromOsApplicationToOsApplication,'->')[position() = 1])"!]
    [!VAR "ToOsApplication" = "string(text:split($FromOsApplicationToOsApplication,'->')[position() = 2])"!]
            <BSW-MODULE-ENTRY>
              <SHORT-NAME>ComM_SynchShutDownCh_To_MasterPnc_From_[!"$FromOsApplication"!]_To_[!"$ToOsApplication"!]_RcvFnct</SHORT-NAME>
              <ADMIN-DATA>
                <SDGS>
                  <SDG GID="EB:DnT">
                    <SD GID="FunctionGroup">Extern</SD>
                    <SD GID="EnableTracing">true</SD>
                  </SDG>
                 </SDGS>
              </ADMIN-DATA>
              <SERVICE-ID>255</SERVICE-ID>
              <IS-REENTRANT>true</IS-REENTRANT>
              <IS-SYNCHRONOUS>false</IS-SYNCHRONOUS>
              <CALL-TYPE>SCHEDULED</CALL-TYPE>
              <EXECUTION-CONTEXT>TASK</EXECUTION-CONTEXT>
              <SW-SERVICE-IMPL-POLICY>STANDARD</SW-SERVICE-IMPL-POLICY>
              <ARGUMENTS>
              </ARGUMENTS>
            </BSW-MODULE-ENTRY>
  [!ENDFOR!][!/*[!FOR "Idx1" = "1" TO "count(text:split($SynchShutDownChToMasterPncFromOsApp_ToOsApp,' '))"!]*/!]
            <BSW-MODULE-ENTRY>
              <SHORT-NAME>ComM_SynchShutDownCh_To_MasterPnc_DataSntFnct</SHORT-NAME>
              <ADMIN-DATA>
                <SDGS>
                  <SDG GID="EB:DnT">
                    <SD GID="FunctionGroup">Extern</SD>
                    <SD GID="EnableTracing">true</SD>
                  </SDG>
                 </SDGS>
              </ADMIN-DATA>
              <SERVICE-ID>255</SERVICE-ID>
              <IS-REENTRANT>true</IS-REENTRANT>
              <IS-SYNCHRONOUS>false</IS-SYNCHRONOUS>
              <CALL-TYPE>REGULAR</CALL-TYPE>
              <EXECUTION-CONTEXT>TASK</EXECUTION-CONTEXT>
              <SW-SERVICE-IMPL-POLICY>STANDARD</SW-SERVICE-IMPL-POLICY>
              <ARGUMENTS>
                <SW-SERVICE-ARG>
                  <SHORT-NAME>inData</SHORT-NAME>
                  <DIRECTION>IN</DIRECTION>
                  <SW-DATA-DEF-PROPS>
                    <SW-DATA-DEF-PROPS-VARIANTS>
                      <SW-DATA-DEF-PROPS-CONDITIONAL>
                        <IMPLEMENTATION-DATA-TYPE-REF DEST="IMPLEMENTATION-DATA-TYPE">/AUTOSAR_ComM/ImplementationDataTypes/ComM_SynchShutDown_Ch_To_MasterPnc_DataType</IMPLEMENTATION-DATA-TYPE-REF>
                      </SW-DATA-DEF-PROPS-CONDITIONAL>
                    </SW-DATA-DEF-PROPS-VARIANTS>
                  </SW-DATA-DEF-PROPS>
                </SW-SERVICE-ARG>
              </ARGUMENTS>
            </BSW-MODULE-ENTRY>

[!ENDIF!] [!/*[!IF "node:exists(as:modconf('ComM')[1]/ComMGeneral/ComMSynchronizedPncShutdownEnabled) and (as:modconf('ComM')[1]/ComMGeneral/ComMSynchronizedPncShutdownEnabled = 'true')"!]*/!]
[!IF "(as:modconf('ComM')[1]/ComMGeneral/ComMRteUsage = 'true') or (as:modconf('ComM')[1]/ComMGeneral/ComMModeLimitationEnabled = 'true')"!]
  [!IF "num:i(count(as:modconf('ComM')[1]/ComMConfigSet/*[1]/ComMUser/*)) > 0"!]
            <BSW-MODULE-ENTRY>
              <SHORT-NAME>ComM_Ch_To_User_DataSntFnct</SHORT-NAME>
              <ADMIN-DATA>
                <SDGS>
                  <SDG GID="EB:DnT">
                    <SD GID="FunctionGroup">Extern</SD>
                    <SD GID="EnableTracing">true</SD>
                  </SDG>
                 </SDGS>
              </ADMIN-DATA>
              <SERVICE-ID>255</SERVICE-ID>
              <IS-REENTRANT>true</IS-REENTRANT>
              <IS-SYNCHRONOUS>false</IS-SYNCHRONOUS>
              <CALL-TYPE>REGULAR</CALL-TYPE>
              <EXECUTION-CONTEXT>TASK</EXECUTION-CONTEXT>
              <SW-SERVICE-IMPL-POLICY>STANDARD</SW-SERVICE-IMPL-POLICY>
              <ARGUMENTS>
                <SW-SERVICE-ARG>
                  <SHORT-NAME>inData</SHORT-NAME>
                  <DIRECTION>IN</DIRECTION>
                  <SW-DATA-DEF-PROPS>
                    <SW-DATA-DEF-PROPS-VARIANTS>
                      <SW-DATA-DEF-PROPS-CONDITIONAL>
                        <IMPLEMENTATION-DATA-TYPE-REF DEST="IMPLEMENTATION-DATA-TYPE">/AUTOSAR_ComM/ImplementationDataTypes/ComM_Ch_To_User_DataType</IMPLEMENTATION-DATA-TYPE-REF>
                      </SW-DATA-DEF-PROPS-CONDITIONAL>
                    </SW-DATA-DEF-PROPS-VARIANTS>
                  </SW-DATA-DEF-PROPS>
                </SW-SERVICE-ARG>
              </ARGUMENTS>
            </BSW-MODULE-ENTRY>
    [!FOR "Idx1" = "1" TO "count(text:split($FoundUserOsApplications,' '))"!]
      [!VAR "CurrentOsApplication" = "string(text:split($FoundUserOsApplications,' ')[position() = $Idx1])"!]
      [!FOR "Idx2" = "1" TO "count(text:split($ChToUserFromOsApp_ToOsApp,' '))"!]
        [!VAR "FromOsApplicationToOsApplication" = "string(text:split($ChToUserFromOsApp_ToOsApp,' ')[position() = $Idx2])"!]
        [!VAR "FromOsApplication" = "string(text:split($FromOsApplicationToOsApplication,'->')[position() = 1])"!]
        [!VAR "ToOsApplication" = "string(text:split($FromOsApplicationToOsApplication,'->')[position() = 2])"!]
        [!IF "$CurrentOsApplication = $ToOsApplication"!]
            <BSW-MODULE-ENTRY>
              <SHORT-NAME>ComM_Ch_To_User_From_[!"$FromOsApplication"!]_To_[!"$ToOsApplication"!]_RcvFnct</SHORT-NAME>
              <ADMIN-DATA>
                <SDGS>
                  <SDG GID="EB:DnT">
                    <SD GID="FunctionGroup">Extern</SD>
                    <SD GID="EnableTracing">true</SD>
                  </SDG>
                 </SDGS>
              </ADMIN-DATA>
              <SERVICE-ID>255</SERVICE-ID>
              <IS-REENTRANT>true</IS-REENTRANT>
              <IS-SYNCHRONOUS>false</IS-SYNCHRONOUS>
              <CALL-TYPE>SCHEDULED</CALL-TYPE>
              <EXECUTION-CONTEXT>TASK</EXECUTION-CONTEXT>
              <SW-SERVICE-IMPL-POLICY>STANDARD</SW-SERVICE-IMPL-POLICY>
              <ARGUMENTS>
              </ARGUMENTS>
            </BSW-MODULE-ENTRY>
        [!ENDIF!] [!/*[!IF "$CurrentOsApplication = $ToOsApplication"!]*/!]
      [!ENDFOR!] [!/*[!FOR "Idx2" = "1" TO "count(text:split($ChToUserFromOsApp_ToOsApp,' '))"!]*/!]
    [!ENDFOR!] [!/*[!FOR "Idx1" = "1" TO "count(text:split($FoundUserOsApplications,' '))"!] */!]
  [!ENDIF!] [!/*[!IF "num:i(count(as:modconf('ComM')[1]/ComMConfigSet/*[1]/ComMUser/*)) > 0"!]*/!]
[!ENDIF!] [!/*[!IF "(as:modconf('ComM')[1]/ComMGeneral/ComMRteUsage = 'true') or (as:modconf('ComM')[1]/ComMGeneral/ComMModeLimitationEnabled = 'true')"!]*/!]

[!IF "as:modconf('ComM')[1]/ComMGeneral/ComMPncSupport = 'true'"!]
            <BSW-MODULE-ENTRY>
              <SHORT-NAME>ComM_MasterPnc_To_Ch_DataSntFnct</SHORT-NAME>
              <ADMIN-DATA>
                <SDGS>
                  <SDG GID="EB:DnT">
                    <SD GID="FunctionGroup">Extern</SD>
                    <SD GID="EnableTracing">true</SD>
                  </SDG>
                 </SDGS>
              </ADMIN-DATA>
              <SERVICE-ID>255</SERVICE-ID>
              <IS-REENTRANT>true</IS-REENTRANT>
              <IS-SYNCHRONOUS>false</IS-SYNCHRONOUS>
              <CALL-TYPE>REGULAR</CALL-TYPE>
              <EXECUTION-CONTEXT>TASK</EXECUTION-CONTEXT>
              <SW-SERVICE-IMPL-POLICY>STANDARD</SW-SERVICE-IMPL-POLICY>
              <ARGUMENTS>
                <SW-SERVICE-ARG>
                  <SHORT-NAME>inData</SHORT-NAME>
                  <DIRECTION>IN</DIRECTION>
                  <SW-DATA-DEF-PROPS>
                    <SW-DATA-DEF-PROPS-VARIANTS>
                      <SW-DATA-DEF-PROPS-CONDITIONAL>
                        <IMPLEMENTATION-DATA-TYPE-REF DEST="IMPLEMENTATION-DATA-TYPE">/AUTOSAR_ComM/ImplementationDataTypes/ComM_MasterPnc_To_Ch_DataType</IMPLEMENTATION-DATA-TYPE-REF>
                      </SW-DATA-DEF-PROPS-CONDITIONAL>
                    </SW-DATA-DEF-PROPS-VARIANTS>
                  </SW-DATA-DEF-PROPS>
                </SW-SERVICE-ARG>
              </ARGUMENTS>
            </BSW-MODULE-ENTRY>

            <BSW-MODULE-ENTRY>
              <SHORT-NAME>ComM_EvaluateChannel_MasterPnc_To_Ch_DataSntFnct</SHORT-NAME>
              <ADMIN-DATA>
                <SDGS>
                  <SDG GID="EB:DnT">
                    <SD GID="FunctionGroup">Extern</SD>
                    <SD GID="EnableTracing">true</SD>
                  </SDG>
                 </SDGS>
              </ADMIN-DATA>
              <SERVICE-ID>255</SERVICE-ID>
              <IS-REENTRANT>true</IS-REENTRANT>
              <IS-SYNCHRONOUS>false</IS-SYNCHRONOUS>
              <CALL-TYPE>REGULAR</CALL-TYPE>
              <EXECUTION-CONTEXT>TASK</EXECUTION-CONTEXT>
              <SW-SERVICE-IMPL-POLICY>STANDARD</SW-SERVICE-IMPL-POLICY>
              <ARGUMENTS>
                <SW-SERVICE-ARG>
                  <SHORT-NAME>inData</SHORT-NAME>
                  <DIRECTION>IN</DIRECTION>
                  <SW-DATA-DEF-PROPS>
                    <SW-DATA-DEF-PROPS-VARIANTS>
                      <SW-DATA-DEF-PROPS-CONDITIONAL>
                        <IMPLEMENTATION-DATA-TYPE-REF DEST="IMPLEMENTATION-DATA-TYPE">/AUTOSAR_ComM/ImplementationDataTypes/ComM_EvaluateChannel_MasterPnc_To_Ch_DataType</IMPLEMENTATION-DATA-TYPE-REF>
                      </SW-DATA-DEF-PROPS-CONDITIONAL>
                    </SW-DATA-DEF-PROPS-VARIANTS>
                  </SW-DATA-DEF-PROPS>
                </SW-SERVICE-ARG>
              </ARGUMENTS>
            </BSW-MODULE-ENTRY>
  [!IF "node:exists(as:modconf('ComM')[1]/ComMGeneral/ComMSynchronizedPncShutdownEnabled) and (as:modconf('ComM')[1]/ComMGeneral/ComMSynchronizedPncShutdownEnabled = 'true')"!]
            <BSW-MODULE-ENTRY>
              <SHORT-NAME>ComM_SynchShutDown_MasterPnc_To_Ch_DataSntFnct</SHORT-NAME>
              <ADMIN-DATA>
                <SDGS>
                  <SDG GID="EB:DnT">
                    <SD GID="FunctionGroup">Extern</SD>
                    <SD GID="EnableTracing">true</SD>
                  </SDG>
                 </SDGS>
              </ADMIN-DATA>
              <SERVICE-ID>255</SERVICE-ID>
              <IS-REENTRANT>true</IS-REENTRANT>
              <IS-SYNCHRONOUS>false</IS-SYNCHRONOUS>
              <CALL-TYPE>REGULAR</CALL-TYPE>
              <EXECUTION-CONTEXT>TASK</EXECUTION-CONTEXT>
              <SW-SERVICE-IMPL-POLICY>STANDARD</SW-SERVICE-IMPL-POLICY>
              <ARGUMENTS>
                <SW-SERVICE-ARG>
                  <SHORT-NAME>inData</SHORT-NAME>
                  <DIRECTION>IN</DIRECTION>
                  <SW-DATA-DEF-PROPS>
                    <SW-DATA-DEF-PROPS-VARIANTS>
                      <SW-DATA-DEF-PROPS-CONDITIONAL>
                        <IMPLEMENTATION-DATA-TYPE-REF DEST="IMPLEMENTATION-DATA-TYPE">/AUTOSAR_ComM/ImplementationDataTypes/ComM_SynchShutDown_MasterPnc_To_Ch_DataType</IMPLEMENTATION-DATA-TYPE-REF>
                      </SW-DATA-DEF-PROPS-CONDITIONAL>
                    </SW-DATA-DEF-PROPS-VARIANTS>
                  </SW-DATA-DEF-PROPS>
                </SW-SERVICE-ARG>
              </ARGUMENTS>
            </BSW-MODULE-ENTRY>            
  [!ENDIF!] [!/* [!IF "node:exists(as:modconf('ComM')[1]/ComMGeneral/ComMSynchronizedPncShutdownEnabled) and (as:modconf('ComM')[1]/ComMGeneral/ComMSynchronizedPncShutdownEnabled = 'true')"!] */!]
  [!FOR "Idx1" = "1" TO "count(text:split($MasterPncToChFromOsApp_ToOsApp,' '))"!]
    [!VAR "FromOsApplicationToOsApplication" = "string(text:split($MasterPncToChFromOsApp_ToOsApp,' ')[position() = $Idx1])"!]
    [!VAR "FromOsApplication" = "string(text:split($FromOsApplicationToOsApplication,'->')[position() = 1])"!]
    [!VAR "ToOsApplication" = "string(text:split($FromOsApplicationToOsApplication,'->')[position() = 2])"!]
          <BSW-MODULE-ENTRY>
            <SHORT-NAME>ComM_MasterPnc_To_Ch_From_[!"$FromOsApplication"!]_To_[!"$ToOsApplication"!]_RcvFnct</SHORT-NAME>
            <ADMIN-DATA>
              <SDGS>
                <SDG GID="EB:DnT">
                  <SD GID="FunctionGroup">Extern</SD>
                  <SD GID="EnableTracing">true</SD>
                </SDG>
               </SDGS>
            </ADMIN-DATA>
            <SERVICE-ID>255</SERVICE-ID>
            <IS-REENTRANT>true</IS-REENTRANT>
            <IS-SYNCHRONOUS>false</IS-SYNCHRONOUS>
            <CALL-TYPE>SCHEDULED</CALL-TYPE>
            <EXECUTION-CONTEXT>TASK</EXECUTION-CONTEXT>
            <SW-SERVICE-IMPL-POLICY>STANDARD</SW-SERVICE-IMPL-POLICY>
            <ARGUMENTS>
            </ARGUMENTS>
          </BSW-MODULE-ENTRY>
  [!ENDFOR!] [!/*[!FOR "Idx1" = "1" TO "count(text:split($MasterPncToChFromOsApp_ToOsApp,' '))"!]*/!]
  
  [!FOR "Idx1" = "1" TO "count(text:split($EvaluateChannelMasterPncToChFromOsApp_ToOsApp,' '))"!]
    [!VAR "FromOsApplicationToOsApplication" = "string(text:split($EvaluateChannelMasterPncToChFromOsApp_ToOsApp,' ')[position() = $Idx1])"!]
    [!VAR "FromOsApplication" = "string(text:split($FromOsApplicationToOsApplication,'->')[position() = 1])"!]
    [!VAR "ToOsApplication" = "string(text:split($FromOsApplicationToOsApplication,'->')[position() = 2])"!]
          <BSW-MODULE-ENTRY>
            <SHORT-NAME>ComM_EvaluateChannel_MasterPnc_To_Ch_From_[!"$FromOsApplication"!]_To_[!"$ToOsApplication"!]_RcvFnct</SHORT-NAME>
            <ADMIN-DATA>
              <SDGS>
                <SDG GID="EB:DnT">
                  <SD GID="FunctionGroup">Extern</SD>
                  <SD GID="EnableTracing">true</SD>
                </SDG>
               </SDGS>
            </ADMIN-DATA>
            <SERVICE-ID>255</SERVICE-ID>
            <IS-REENTRANT>true</IS-REENTRANT>
            <IS-SYNCHRONOUS>false</IS-SYNCHRONOUS>
            <CALL-TYPE>SCHEDULED</CALL-TYPE>
            <EXECUTION-CONTEXT>TASK</EXECUTION-CONTEXT>
            <SW-SERVICE-IMPL-POLICY>STANDARD</SW-SERVICE-IMPL-POLICY>
            <ARGUMENTS>
            </ARGUMENTS>
          </BSW-MODULE-ENTRY>
  [!ENDFOR!] [!/*[!FOR "Idx1" = "1" TO "count(text:split($EvaluateChannelMasterPncToChFromOsApp_ToOsApp,' '))"!]*/!]  
  
  [!FOR "Idx1" = "1" TO "count(text:split($SynchShutDownMasterPncToChFromOsApp_ToOsApp,' '))"!]
    [!VAR "FromOsApplicationToOsApplication" = "string(text:split($SynchShutDownMasterPncToChFromOsApp_ToOsApp,' ')[position() = $Idx1])"!]
    [!VAR "FromOsApplication" = "string(text:split($FromOsApplicationToOsApplication,'->')[position() = 1])"!]
    [!VAR "ToOsApplication" = "string(text:split($FromOsApplicationToOsApplication,'->')[position() = 2])"!]
          <BSW-MODULE-ENTRY>
            <SHORT-NAME>ComM_SynchShutDown_MasterPnc_To_Ch_From_[!"$FromOsApplication"!]_To_[!"$ToOsApplication"!]_RcvFnct</SHORT-NAME>
            <ADMIN-DATA>
              <SDGS>
                <SDG GID="EB:DnT">
                  <SD GID="FunctionGroup">Extern</SD>
                  <SD GID="EnableTracing">true</SD>
                </SDG>
               </SDGS>
            </ADMIN-DATA>
            <SERVICE-ID>255</SERVICE-ID>
            <IS-REENTRANT>true</IS-REENTRANT>
            <IS-SYNCHRONOUS>false</IS-SYNCHRONOUS>
            <CALL-TYPE>SCHEDULED</CALL-TYPE>
            <EXECUTION-CONTEXT>TASK</EXECUTION-CONTEXT>
            <SW-SERVICE-IMPL-POLICY>STANDARD</SW-SERVICE-IMPL-POLICY>
            <ARGUMENTS>
            </ARGUMENTS>
          </BSW-MODULE-ENTRY>
  [!ENDFOR!] [!/*[!FOR "Idx1" = "1" TO "count(text:split($SynchShutDownMasterPncToChFromOsApp_ToOsApp,' '))"!]*/!]  
  
[!ENDIF!] [!/*[!IF "as:modconf('ComM')[1]/ComMGeneral/ComMPncSupport = 'true'"!]*/!]
          </ELEMENTS>
        </AR-PACKAGE>
[!IF "ComMGeneral/ComMRteUsage = 'true'"!]
        <AR-PACKAGE>
          <SHORT-NAME>SwcBswMappings</SHORT-NAME>
          <ELEMENTS>
  [!FOR "Idx1" = "1" TO "count(text:split($FoundChannelsOsApplications,' '))"!]
    [!VAR "CurrentOsApplication" = "string(text:split($FoundChannelsOsApplications,' ')[position() = $Idx1])"!]
            <SWC-BSW-MAPPING>
              <SHORT-NAME>SwcBswMapping_Ch_OsApplication_[!"$CurrentOsApplication"!]</SHORT-NAME>
              <BSW-BEHAVIOR-REF DEST="BSW-INTERNAL-BEHAVIOR">/AUTOSAR_ComM/BswModuleDescriptions/ComM/InternalBehavior_Ch_OsApplication_[!"$CurrentOsApplication"!]</BSW-BEHAVIOR-REF>
              <RUNNABLE-MAPPINGS>
    [!LOOP "ComMConfigSet/*[1]/ComMChannel/*"!]
      [!CALL "GetChannelOsApplication","ChannelEcuCPartitionRef"="ComMChannelPartitionRef"!]
      [!IF "$ChannelOsApplication = $CurrentOsApplication"!]
                <SWC-BSW-RUNNABLE-MAPPING>
                  <BSW-ENTITY-REF DEST="BSW-SCHEDULABLE-ENTITY">/AUTOSAR_ComM/BswModuleDescriptions/ComM/InternalBehavior_Ch_OsApplication_[!"$CurrentOsApplication"!]/ComM_1_Ch_OsApplication_[!"$ChannelOsApplication"!]_ComM_MainFunction_[!"ComMChannelId"!]</BSW-ENTITY-REF>
                  <SWC-RUNNABLE-REF DEST="RUNNABLE-ENTITY">/AUTOSAR_ComM/[!"$swComponentTypePackageName"!]/ComM_Channel_[!"$CurrentOsApplication"!]/SwcInternalBehavior_Channel_[!"$CurrentOsApplication"!]/RE_Main_[!"ComMChannelId"!]</SWC-RUNNABLE-REF>
                </SWC-BSW-RUNNABLE-MAPPING>
      [!ENDIF!] [!/*[!IF "$ChannelOsApplication = $CurrentOsApplication"!]*/!]
    [!ENDLOOP!] [!/* [!LOOP "ComMConfigSet/*[1]/ComMChannel/*"!] */!]
              </RUNNABLE-MAPPINGS>
              <SWC-BEHAVIOR-REF DEST="SWC-INTERNAL-BEHAVIOR">/AUTOSAR_ComM/[!"$swComponentTypePackageName"!]/ComM_Channel_[!"$CurrentOsApplication"!]/SwcInternalBehavior_Channel_[!"$CurrentOsApplication"!]</SWC-BEHAVIOR-REF>
            </SWC-BSW-MAPPING>
  [!ENDFOR!] [!/* [!FOR "Idx1" = "1" TO "count(text:split($FoundChannelsOsApplications,' '))"!] */!]

  [!IF "count(as:modconf('ComM')[1]/ComMConfigSet/*/ComMUser/*) != 0"!]
    [!CALL "GetUsedUserOsApplications"!]
    [!FOR "Idx1" = "1" TO "count(text:split($FoundUserOsApplications,' '))"!]
      [!VAR "CurrentOsApplication" = "string(text:split($FoundUserOsApplications,' ')[position() = $Idx1])"!]
            <SWC-BSW-MAPPING>
              <SHORT-NAME>SwcBswMapping_User_OsApplication_[!"$CurrentOsApplication"!]</SHORT-NAME>
              <BSW-BEHAVIOR-REF DEST="BSW-INTERNAL-BEHAVIOR">/AUTOSAR_ComM/BswModuleDescriptions/ComM/InternalBehavior_User_[!"$CurrentOsApplication"!]</BSW-BEHAVIOR-REF>
              <RUNNABLE-MAPPINGS>
      [!LOOP "as:modconf('ComM')[1]/ComMConfigSet/*[1]/ComMUser/*"!]
        [!CALL "GetUserOsApplication","UserEcuCPartitionRef"="ComMUserEcucPartitionRef"!]
        [!IF "$CurrentOsApplication = $UserOsApplication"!]
                <SWC-BSW-RUNNABLE-MAPPING>
                  <BSW-ENTITY-REF DEST="BSW-SCHEDULABLE-ENTITY">/AUTOSAR_ComM/BswModuleDescriptions/ComM/InternalBehavior_User_[!"$CurrentOsApplication"!]/ComM_1_User_[!"$UserOsApplication"!]_ComM_MainFunction_User_[!"ComMUserIdentifier"!]</BSW-ENTITY-REF>
                  <SWC-RUNNABLE-REF DEST="RUNNABLE-ENTITY">/AUTOSAR_ComM/[!"$swComponentTypePackageName"!]/ComM_User_[!"$CurrentOsApplication"!]/SwcInternalBehavior_User_[!"$CurrentOsApplication"!]/RE_Main_User_[!"ComMUserIdentifier"!]</SWC-RUNNABLE-REF>
                </SWC-BSW-RUNNABLE-MAPPING>
        [!ENDIF!] [!/*[!IF "$CurrentOsApplication = $UserOsApplication"!]       */!]
      [!ENDLOOP!] [!/*[!LOOP "as:modconf('ComM')[1]/ComMConfigSet/*[1]/ComMUser/*"!]*/!]
              </RUNNABLE-MAPPINGS>
              <SWC-BEHAVIOR-REF DEST="SWC-INTERNAL-BEHAVIOR">/AUTOSAR_ComM/[!"$swComponentTypePackageName"!]/ComM_User_[!"$CurrentOsApplication"!]/SwcInternalBehavior_User_[!"$CurrentOsApplication"!]</SWC-BEHAVIOR-REF>
            </SWC-BSW-MAPPING>
    [!ENDFOR!] [!/*[!FOR "Idx1" = "1" TO "count(text:split($FoundUserOsApplications,' '))"!]*/!]
  [!ENDIF!] [!/*[!IF "count(as:modconf('ComM')[1]/ComMConfigSet/*/ComMUser/*) != 0"!]*/!]

  [!IF "as:modconf('ComM')[1]/ComMGeneral/ComMModeLimitationEnabled = 'true'"!]
            <SWC-BSW-MAPPING>
              <SHORT-NAME>SwcBswMapping_Inhibition_OsApplication_[!"$InhibitionOsApplication"!]</SHORT-NAME>
              <BSW-BEHAVIOR-REF DEST="BSW-INTERNAL-BEHAVIOR">/AUTOSAR_ComM/BswModuleDescriptions/ComM/InternalBehavior_Inhibition</BSW-BEHAVIOR-REF>
              <SWC-BEHAVIOR-REF DEST="SWC-INTERNAL-BEHAVIOR">/AUTOSAR_ComM/[!"$swComponentTypePackageName"!]/ComM_Inhibition_[!"$InhibitionOsApplication"!]/SwcInternalBehavior_Inhibition_[!"$InhibitionOsApplication"!]</SWC-BEHAVIOR-REF>
            </SWC-BSW-MAPPING>
  [!ENDIF!] [!/*[!IF "as:modconf('ComM')[1]/ComMGeneral/ComMModeLimitationEnabled = 'true'"!]*/!]
          </ELEMENTS>
        </AR-PACKAGE>
[!ENDIF!]
      </AR-PACKAGES>
    </AR-PACKAGE>
    <AR-PACKAGE>
      <SHORT-NAME>EB_ComM</SHORT-NAME>
      <AR-PACKAGES>
        <AR-PACKAGE>
          <SHORT-NAME>Implementations</SHORT-NAME>
          <ELEMENTS>
            <BSW-IMPLEMENTATION>
              <SHORT-NAME>BswImplementation_0</SHORT-NAME>
              <CODE-DESCRIPTORS>
                <CODE>
                  <SHORT-NAME>Files</SHORT-NAME>
                  <ARTIFACT-DESCRIPTORS>
                    <AUTOSAR-ENGINEERING-OBJECT>
                      <SHORT-LABEL>Autosar::include::ComM.h</SHORT-LABEL>
                      <CATEGORY>SWHDR</CATEGORY>
                    </AUTOSAR-ENGINEERING-OBJECT>
                    <AUTOSAR-ENGINEERING-OBJECT>
                      <SHORT-LABEL>Autosar::include::ComM_BSW.h</SHORT-LABEL>
                      <CATEGORY>SWHDR</CATEGORY>
                    </AUTOSAR-ENGINEERING-OBJECT>
                    <AUTOSAR-ENGINEERING-OBJECT>
                      <SHORT-LABEL>Autosar::include::ComM_BSW_Cfg.h</SHORT-LABEL>
                      <CATEGORY>SWHDR</CATEGORY>
                    </AUTOSAR-ENGINEERING-OBJECT>
                    <AUTOSAR-ENGINEERING-OBJECT>
                      <SHORT-LABEL>Autosar::include::ComM_BSW_Types.h</SHORT-LABEL>
                      <CATEGORY>SWHDR</CATEGORY>
                    </AUTOSAR-ENGINEERING-OBJECT>
                    <AUTOSAR-ENGINEERING-OBJECT>
                      <SHORT-LABEL>Autosar::include::ComM_BusSm.h</SHORT-LABEL>
                      <CATEGORY>SWHDR</CATEGORY>
                    </AUTOSAR-ENGINEERING-OBJECT>
                    <AUTOSAR-ENGINEERING-OBJECT>
                      <SHORT-LABEL>Autosar::include::ComM_Dcm.h</SHORT-LABEL>
                      <CATEGORY>SWHDR</CATEGORY>
                    </AUTOSAR-ENGINEERING-OBJECT>
                    <AUTOSAR-ENGINEERING-OBJECT>
                      <SHORT-LABEL>Autosar::include::ComM_EcuMBswM.h</SHORT-LABEL>
                      <CATEGORY>SWHDR</CATEGORY>
                    </AUTOSAR-ENGINEERING-OBJECT>
                    <AUTOSAR-ENGINEERING-OBJECT>
                      <SHORT-LABEL>Autosar::include::ComM_Hsm.h</SHORT-LABEL>
                      <CATEGORY>SWHDR</CATEGORY>
                    </AUTOSAR-ENGINEERING-OBJECT>
                    <AUTOSAR-ENGINEERING-OBJECT>
                      <SHORT-LABEL>Autosar::include::ComM_HsmCfg.h</SHORT-LABEL>
                      <CATEGORY>SWHDR</CATEGORY>
                    </AUTOSAR-ENGINEERING-OBJECT>
                    <AUTOSAR-ENGINEERING-OBJECT>
                      <SHORT-LABEL>Autosar::include::ComM_HsmComM.h</SHORT-LABEL>
                      <CATEGORY>SWHDR</CATEGORY>
                    </AUTOSAR-ENGINEERING-OBJECT>
                    <AUTOSAR-ENGINEERING-OBJECT>
                      <SHORT-LABEL>Autosar::include::ComM_HsmComMInt.h</SHORT-LABEL>
                      <CATEGORY>SWHDR</CATEGORY>
                    </AUTOSAR-ENGINEERING-OBJECT>
                    <AUTOSAR-ENGINEERING-OBJECT>
                      <SHORT-LABEL>Autosar::include::ComM_HsmComMPnc.h</SHORT-LABEL>
                      <CATEGORY>SWHDR</CATEGORY>
                    </AUTOSAR-ENGINEERING-OBJECT>
                    <AUTOSAR-ENGINEERING-OBJECT>
                      <SHORT-LABEL>Autosar::include::ComM_HsmComMPncInt.h</SHORT-LABEL>
                      <CATEGORY>SWHDR</CATEGORY>
                    </AUTOSAR-ENGINEERING-OBJECT>
                    <AUTOSAR-ENGINEERING-OBJECT>
                      <SHORT-LABEL>Autosar::include::ComM_Int.h</SHORT-LABEL>
                      <CATEGORY>SWHDR</CATEGORY>
                    </AUTOSAR-ENGINEERING-OBJECT>
                    <AUTOSAR-ENGINEERING-OBJECT>
                      <SHORT-LABEL>Autosar::include::ComM_Nm.h</SHORT-LABEL>
                      <CATEGORY>SWHDR</CATEGORY>
                    </AUTOSAR-ENGINEERING-OBJECT>
                    <AUTOSAR-ENGINEERING-OBJECT>
                      <SHORT-LABEL>Autosar::include::ComM_Trace.h</SHORT-LABEL>
                      <CATEGORY>SWHDR</CATEGORY>
                    </AUTOSAR-ENGINEERING-OBJECT>
                    <AUTOSAR-ENGINEERING-OBJECT>
                      <SHORT-LABEL>Autosar::include::ComM_Trace_Internal.h</SHORT-LABEL>
                      <CATEGORY>SWHDR</CATEGORY>
                    </AUTOSAR-ENGINEERING-OBJECT>
                    <AUTOSAR-ENGINEERING-OBJECT>
                      <SHORT-LABEL>Autosar::include::ComM_Version.h</SHORT-LABEL>
                      <CATEGORY>SWHDR</CATEGORY>
                    </AUTOSAR-ENGINEERING-OBJECT>
                    <AUTOSAR-ENGINEERING-OBJECT>
                      <SHORT-LABEL>Autosar::src::ComM.c</SHORT-LABEL>
                      <CATEGORY>SWSRC</CATEGORY>
                    </AUTOSAR-ENGINEERING-OBJECT>
                    <AUTOSAR-ENGINEERING-OBJECT>
                      <SHORT-LABEL>Autosar::src::ComM_ASR32_Rte.c</SHORT-LABEL>
                      <CATEGORY>SWSRC</CATEGORY>
                    </AUTOSAR-ENGINEERING-OBJECT>
                    <AUTOSAR-ENGINEERING-OBJECT>
                      <SHORT-LABEL>Autosar::src::ComM_ASR40_Rte.c</SHORT-LABEL>
                      <CATEGORY>SWSRC</CATEGORY>
                    </AUTOSAR-ENGINEERING-OBJECT>
                    <AUTOSAR-ENGINEERING-OBJECT>
                      <SHORT-LABEL>Autosar::src::ComM_Hsm.c</SHORT-LABEL>
                      <CATEGORY>SWSRC</CATEGORY>
                    </AUTOSAR-ENGINEERING-OBJECT>
                    <AUTOSAR-ENGINEERING-OBJECT>
                      <SHORT-LABEL>Autosar::src::ComM_HsmComMData.c</SHORT-LABEL>
                      <CATEGORY>SWSRC</CATEGORY>
                    </AUTOSAR-ENGINEERING-OBJECT>
                    <AUTOSAR-ENGINEERING-OBJECT>
                      <SHORT-LABEL>Autosar::src::ComM_HsmComMFnct.c</SHORT-LABEL>
                      <CATEGORY>SWSRC</CATEGORY>
                    </AUTOSAR-ENGINEERING-OBJECT>
                    <AUTOSAR-ENGINEERING-OBJECT>
                      <SHORT-LABEL>Autosar::src::ComM_HsmComMPncData.c</SHORT-LABEL>
                      <CATEGORY>SWSRC</CATEGORY>
                    </AUTOSAR-ENGINEERING-OBJECT>
                    <AUTOSAR-ENGINEERING-OBJECT>
                      <SHORT-LABEL>Autosar::src::ComM_HsmComMPncFnct.c</SHORT-LABEL>
                      <CATEGORY>SWSRC</CATEGORY>
                    </AUTOSAR-ENGINEERING-OBJECT>
                    <AUTOSAR-ENGINEERING-OBJECT>
                      <SHORT-LABEL>Autosar::src::ComM_Rte.c</SHORT-LABEL>
                      <CATEGORY>SWSRC</CATEGORY>
                    </AUTOSAR-ENGINEERING-OBJECT>
                  </ARTIFACT-DESCRIPTORS>
                </CODE>
              </CODE-DESCRIPTORS>
              <PROGRAMMING-LANGUAGE>C</PROGRAMMING-LANGUAGE>
              <RESOURCE-CONSUMPTION>
                <SHORT-NAME>ResourceConsumption</SHORT-NAME>
                <MEMORY-SECTIONS>
                  <MEMORY-SECTION>
                    <SHORT-NAME>VAR_CLEARED_16</SHORT-NAME>
                    <ALIGNMENT>16</ALIGNMENT>
                    <SW-ADDRMETHOD-REF DEST="SW-ADDR-METHOD">/AUTOSAR_MemMap/SwAddrMethods/VAR_CLEARED</SW-ADDRMETHOD-REF>
                  </MEMORY-SECTION>
                  <MEMORY-SECTION>
                    <SHORT-NAME>VAR_INIT_16</SHORT-NAME>
                    <ALIGNMENT>16</ALIGNMENT>
                    <SW-ADDRMETHOD-REF DEST="SW-ADDR-METHOD">/AUTOSAR_MemMap/SwAddrMethods/VAR</SW-ADDRMETHOD-REF>
                  </MEMORY-SECTION>
                  <MEMORY-SECTION>
                    <SHORT-NAME>VAR_INIT_8</SHORT-NAME>
                    <ALIGNMENT>8</ALIGNMENT>
                    <SW-ADDRMETHOD-REF DEST="SW-ADDR-METHOD">/AUTOSAR_MemMap/SwAddrMethods/VAR</SW-ADDRMETHOD-REF>
                  </MEMORY-SECTION>
                  <MEMORY-SECTION>
                    <SHORT-NAME>CONST_32</SHORT-NAME>
                    <ALIGNMENT>32</ALIGNMENT>
                    <SW-ADDRMETHOD-REF DEST="SW-ADDR-METHOD">/AUTOSAR_MemMap/SwAddrMethods/CONST</SW-ADDRMETHOD-REF>
                  </MEMORY-SECTION>
                  <MEMORY-SECTION>
                    <SHORT-NAME>CONST_16</SHORT-NAME>
                    <ALIGNMENT>16</ALIGNMENT>
                    <SW-ADDRMETHOD-REF DEST="SW-ADDR-METHOD">/AUTOSAR_MemMap/SwAddrMethods/CONST</SW-ADDRMETHOD-REF>
                  </MEMORY-SECTION>
                  <MEMORY-SECTION>
                    <SHORT-NAME>CONST_8</SHORT-NAME>
                    <ALIGNMENT>8</ALIGNMENT>
                    <SW-ADDRMETHOD-REF DEST="SW-ADDR-METHOD">/AUTOSAR_MemMap/SwAddrMethods/CONST</SW-ADDRMETHOD-REF>
                  </MEMORY-SECTION>
                  <MEMORY-SECTION>
                    <SHORT-NAME>VAR_CLEARED_8</SHORT-NAME>
                    <ALIGNMENT>8</ALIGNMENT>
                    <SW-ADDRMETHOD-REF DEST="SW-ADDR-METHOD">/AUTOSAR_MemMap/SwAddrMethods/VAR_CLEARED</SW-ADDRMETHOD-REF>
                  </MEMORY-SECTION>
                  <MEMORY-SECTION>
                    <SHORT-NAME>VAR_CLEARED_UNSPECIFIED</SHORT-NAME>
                    <ALIGNMENT>UNSPECIFIED</ALIGNMENT>
                    <SW-ADDRMETHOD-REF DEST="SW-ADDR-METHOD">/AUTOSAR_MemMap/SwAddrMethods/VAR_CLEARED</SW-ADDRMETHOD-REF>
                  </MEMORY-SECTION>
                  <MEMORY-SECTION>
                    <SHORT-NAME>VAR_INIT_UNSPECIFIED</SHORT-NAME>
                    <ALIGNMENT>UNSPECIFIED</ALIGNMENT>
                    <SW-ADDRMETHOD-REF DEST="SW-ADDR-METHOD">/AUTOSAR_MemMap/SwAddrMethods/VAR</SW-ADDRMETHOD-REF>
                  </MEMORY-SECTION>
                  <MEMORY-SECTION>
                    <SHORT-NAME>VAR_POWER_ON_CLEARED_UNSPECIFIED</SHORT-NAME>
                    <ALIGNMENT>UNSPECIFIED</ALIGNMENT>
                    <SW-ADDRMETHOD-REF DEST="SW-ADDR-METHOD">/AUTOSAR_MemMap/SwAddrMethods/VAR_POWER_ON_CLEARED</SW-ADDRMETHOD-REF>
                  </MEMORY-SECTION>
                  <MEMORY-SECTION>
                    <SHORT-NAME>CONFIG_DATA_UNSPECIFIED</SHORT-NAME>
                    <ALIGNMENT>UNSPECIFIED</ALIGNMENT>
                    <SW-ADDRMETHOD-REF DEST="SW-ADDR-METHOD">/AUTOSAR_MemMap/SwAddrMethods/CONFIG_DATA</SW-ADDRMETHOD-REF>
                  </MEMORY-SECTION>
                  <MEMORY-SECTION>
                    <SHORT-NAME>CONST_UNSPECIFIED</SHORT-NAME>
                    <ALIGNMENT>UNSPECIFIED</ALIGNMENT>
                    <SW-ADDRMETHOD-REF DEST="SW-ADDR-METHOD">/AUTOSAR_MemMap/SwAddrMethods/CONST</SW-ADDRMETHOD-REF>
                  </MEMORY-SECTION>
                  <MEMORY-SECTION>
                    <SHORT-NAME>CODE</SHORT-NAME>
                    <SW-ADDRMETHOD-REF DEST="SW-ADDR-METHOD">/AUTOSAR_MemMap/SwAddrMethods/CODE</SW-ADDRMETHOD-REF>
                  </MEMORY-SECTION>
                </MEMORY-SECTIONS>
              </RESOURCE-CONSUMPTION>
              <!-- !LINKSTO ComM.ASR403.SWS_ComM_00280,1 -->
              <SW-VERSION>5.21.4</SW-VERSION>
              <VENDOR-ID>1</VENDOR-ID>
              <AR-RELEASE-VERSION>4.1.3</AR-RELEASE-VERSION>
              <BEHAVIOR-REF DEST="BSW-INTERNAL-BEHAVIOR">/AUTOSAR_ComM/BswModuleDescriptions/ComM/InternalBehavior_0</BEHAVIOR-REF>
              <VENDOR-SPECIFIC-MODULE-DEF-REFS>
                <VENDOR-SPECIFIC-MODULE-DEF-REF DEST="ECUC-MODULE-DEF">/TS_TxDxM5I21R0/ComM</VENDOR-SPECIFIC-MODULE-DEF-REF>
              </VENDOR-SPECIFIC-MODULE-DEF-REFS>
            </BSW-IMPLEMENTATION>

[!IF "(as:modconf('ComM')[1]/ComMGeneral/ComMModeLimitationEnabled = 'true') or (as:modconf('ComM')[1]/ComMGeneral/ComMWakeupInhibitionEnabled = 'true')"!]
            <BSW-IMPLEMENTATION>
              <SHORT-NAME>BswImplementation_Inhibition</SHORT-NAME>
              <CODE-DESCRIPTORS>
                <CODE>
                  <SHORT-NAME>Files</SHORT-NAME>
                  <ARTIFACT-DESCRIPTORS>
                    <AUTOSAR-ENGINEERING-OBJECT>
                      <SHORT-LABEL>Autosar::include::ComM.h</SHORT-LABEL>
                      <CATEGORY>SWHDR</CATEGORY>
                    </AUTOSAR-ENGINEERING-OBJECT>
                    <AUTOSAR-ENGINEERING-OBJECT>
                      <SHORT-LABEL>Autosar::include::ComM_BSW.h</SHORT-LABEL>
                      <CATEGORY>SWHDR</CATEGORY>
                    </AUTOSAR-ENGINEERING-OBJECT>
                    <AUTOSAR-ENGINEERING-OBJECT>
                      <SHORT-LABEL>Autosar::include::ComM_BSW_Cfg.h</SHORT-LABEL>
                      <CATEGORY>SWHDR</CATEGORY>
                    </AUTOSAR-ENGINEERING-OBJECT>
                    <AUTOSAR-ENGINEERING-OBJECT>
                      <SHORT-LABEL>Autosar::include::ComM_BSW_Types.h</SHORT-LABEL>
                      <CATEGORY>SWHDR</CATEGORY>
                    </AUTOSAR-ENGINEERING-OBJECT>
                    <AUTOSAR-ENGINEERING-OBJECT>
                      <SHORT-LABEL>Autosar::include::ComM_BusSm.h</SHORT-LABEL>
                      <CATEGORY>SWHDR</CATEGORY>
                    </AUTOSAR-ENGINEERING-OBJECT>
                    <AUTOSAR-ENGINEERING-OBJECT>
                      <SHORT-LABEL>Autosar::include::ComM_Dcm.h</SHORT-LABEL>
                      <CATEGORY>SWHDR</CATEGORY>
                    </AUTOSAR-ENGINEERING-OBJECT>
                    <AUTOSAR-ENGINEERING-OBJECT>
                      <SHORT-LABEL>Autosar::include::ComM_EcuMBswM.h</SHORT-LABEL>
                      <CATEGORY>SWHDR</CATEGORY>
                    </AUTOSAR-ENGINEERING-OBJECT>
                    <AUTOSAR-ENGINEERING-OBJECT>
                      <SHORT-LABEL>Autosar::include::ComM_Hsm.h</SHORT-LABEL>
                      <CATEGORY>SWHDR</CATEGORY>
                    </AUTOSAR-ENGINEERING-OBJECT>
                    <AUTOSAR-ENGINEERING-OBJECT>
                      <SHORT-LABEL>Autosar::include::ComM_HsmCfg.h</SHORT-LABEL>
                      <CATEGORY>SWHDR</CATEGORY>
                    </AUTOSAR-ENGINEERING-OBJECT>
                    <AUTOSAR-ENGINEERING-OBJECT>
                      <SHORT-LABEL>Autosar::include::ComM_HsmComM.h</SHORT-LABEL>
                      <CATEGORY>SWHDR</CATEGORY>
                    </AUTOSAR-ENGINEERING-OBJECT>
                    <AUTOSAR-ENGINEERING-OBJECT>
                      <SHORT-LABEL>Autosar::include::ComM_HsmComMInt.h</SHORT-LABEL>
                      <CATEGORY>SWHDR</CATEGORY>
                    </AUTOSAR-ENGINEERING-OBJECT>
                    <AUTOSAR-ENGINEERING-OBJECT>
                      <SHORT-LABEL>Autosar::include::ComM_HsmComMPnc.h</SHORT-LABEL>
                      <CATEGORY>SWHDR</CATEGORY>
                    </AUTOSAR-ENGINEERING-OBJECT>
                    <AUTOSAR-ENGINEERING-OBJECT>
                      <SHORT-LABEL>Autosar::include::ComM_HsmComMPncInt.h</SHORT-LABEL>
                      <CATEGORY>SWHDR</CATEGORY>
                    </AUTOSAR-ENGINEERING-OBJECT>
                    <AUTOSAR-ENGINEERING-OBJECT>
                      <SHORT-LABEL>Autosar::include::ComM_Int.h</SHORT-LABEL>
                      <CATEGORY>SWHDR</CATEGORY>
                    </AUTOSAR-ENGINEERING-OBJECT>
                    <AUTOSAR-ENGINEERING-OBJECT>
                      <SHORT-LABEL>Autosar::include::ComM_Nm.h</SHORT-LABEL>
                      <CATEGORY>SWHDR</CATEGORY>
                    </AUTOSAR-ENGINEERING-OBJECT>
                    <AUTOSAR-ENGINEERING-OBJECT>
                      <SHORT-LABEL>Autosar::include::ComM_Trace.h</SHORT-LABEL>
                      <CATEGORY>SWHDR</CATEGORY>
                    </AUTOSAR-ENGINEERING-OBJECT>
                    <AUTOSAR-ENGINEERING-OBJECT>
                      <SHORT-LABEL>Autosar::include::ComM_Trace_Internal.h</SHORT-LABEL>
                      <CATEGORY>SWHDR</CATEGORY>
                    </AUTOSAR-ENGINEERING-OBJECT>
                    <AUTOSAR-ENGINEERING-OBJECT>
                      <SHORT-LABEL>Autosar::include::ComM_Version.h</SHORT-LABEL>
                      <CATEGORY>SWHDR</CATEGORY>
                    </AUTOSAR-ENGINEERING-OBJECT>
                    <AUTOSAR-ENGINEERING-OBJECT>
                      <SHORT-LABEL>Autosar::src::ComM.c</SHORT-LABEL>
                      <CATEGORY>SWSRC</CATEGORY>
                    </AUTOSAR-ENGINEERING-OBJECT>
                    <AUTOSAR-ENGINEERING-OBJECT>
                      <SHORT-LABEL>Autosar::src::ComM_ASR32_Rte.c</SHORT-LABEL>
                      <CATEGORY>SWSRC</CATEGORY>
                    </AUTOSAR-ENGINEERING-OBJECT>
                    <AUTOSAR-ENGINEERING-OBJECT>
                      <SHORT-LABEL>Autosar::src::ComM_ASR40_Rte.c</SHORT-LABEL>
                      <CATEGORY>SWSRC</CATEGORY>
                    </AUTOSAR-ENGINEERING-OBJECT>
                    <AUTOSAR-ENGINEERING-OBJECT>
                      <SHORT-LABEL>Autosar::src::ComM_Hsm.c</SHORT-LABEL>
                      <CATEGORY>SWSRC</CATEGORY>
                    </AUTOSAR-ENGINEERING-OBJECT>
                    <AUTOSAR-ENGINEERING-OBJECT>
                      <SHORT-LABEL>Autosar::src::ComM_HsmComMData.c</SHORT-LABEL>
                      <CATEGORY>SWSRC</CATEGORY>
                    </AUTOSAR-ENGINEERING-OBJECT>
                    <AUTOSAR-ENGINEERING-OBJECT>
                      <SHORT-LABEL>Autosar::src::ComM_HsmComMFnct.c</SHORT-LABEL>
                      <CATEGORY>SWSRC</CATEGORY>
                    </AUTOSAR-ENGINEERING-OBJECT>
                    <AUTOSAR-ENGINEERING-OBJECT>
                      <SHORT-LABEL>Autosar::src::ComM_HsmComMPncData.c</SHORT-LABEL>
                      <CATEGORY>SWSRC</CATEGORY>
                    </AUTOSAR-ENGINEERING-OBJECT>
                    <AUTOSAR-ENGINEERING-OBJECT>
                      <SHORT-LABEL>Autosar::src::ComM_HsmComMPncFnct.c</SHORT-LABEL>
                      <CATEGORY>SWSRC</CATEGORY>
                    </AUTOSAR-ENGINEERING-OBJECT>
                    <AUTOSAR-ENGINEERING-OBJECT>
                      <SHORT-LABEL>Autosar::src::ComM_Rte.c</SHORT-LABEL>
                      <CATEGORY>SWSRC</CATEGORY>
                    </AUTOSAR-ENGINEERING-OBJECT>
                  </ARTIFACT-DESCRIPTORS>
                </CODE>
              </CODE-DESCRIPTORS>
              <PROGRAMMING-LANGUAGE>C</PROGRAMMING-LANGUAGE>
              <RESOURCE-CONSUMPTION>
                <SHORT-NAME>ResourceConsumption</SHORT-NAME>
                <MEMORY-SECTIONS>
                  <MEMORY-SECTION>
                    <SHORT-NAME>VAR_CLEARED_16</SHORT-NAME>
                    <ALIGNMENT>16</ALIGNMENT>
                    <SW-ADDRMETHOD-REF DEST="SW-ADDR-METHOD">/AUTOSAR_MemMap/SwAddrMethods/VAR_CLEARED</SW-ADDRMETHOD-REF>
                  </MEMORY-SECTION>
                  <MEMORY-SECTION>
                    <SHORT-NAME>VAR_INIT_16</SHORT-NAME>
                    <ALIGNMENT>16</ALIGNMENT>
                    <SW-ADDRMETHOD-REF DEST="SW-ADDR-METHOD">/AUTOSAR_MemMap/SwAddrMethods/VAR</SW-ADDRMETHOD-REF>
                  </MEMORY-SECTION>
                  <MEMORY-SECTION>
                    <SHORT-NAME>VAR_INIT_8</SHORT-NAME>
                    <ALIGNMENT>8</ALIGNMENT>
                    <SW-ADDRMETHOD-REF DEST="SW-ADDR-METHOD">/AUTOSAR_MemMap/SwAddrMethods/VAR</SW-ADDRMETHOD-REF>
                  </MEMORY-SECTION>
                  <MEMORY-SECTION>
                    <SHORT-NAME>CONST_32</SHORT-NAME>
                    <ALIGNMENT>32</ALIGNMENT>
                    <SW-ADDRMETHOD-REF DEST="SW-ADDR-METHOD">/AUTOSAR_MemMap/SwAddrMethods/CONST</SW-ADDRMETHOD-REF>
                  </MEMORY-SECTION>
                  <MEMORY-SECTION>
                    <SHORT-NAME>CONST_16</SHORT-NAME>
                    <ALIGNMENT>16</ALIGNMENT>
                    <SW-ADDRMETHOD-REF DEST="SW-ADDR-METHOD">/AUTOSAR_MemMap/SwAddrMethods/CONST</SW-ADDRMETHOD-REF>
                  </MEMORY-SECTION>
                  <MEMORY-SECTION>
                    <SHORT-NAME>CONST_8</SHORT-NAME>
                    <ALIGNMENT>8</ALIGNMENT>
                    <SW-ADDRMETHOD-REF DEST="SW-ADDR-METHOD">/AUTOSAR_MemMap/SwAddrMethods/CONST</SW-ADDRMETHOD-REF>
                  </MEMORY-SECTION>
                  <MEMORY-SECTION>
                    <SHORT-NAME>VAR_CLEARED_8</SHORT-NAME>
                    <ALIGNMENT>8</ALIGNMENT>
                    <SW-ADDRMETHOD-REF DEST="SW-ADDR-METHOD">/AUTOSAR_MemMap/SwAddrMethods/VAR_CLEARED</SW-ADDRMETHOD-REF>
                  </MEMORY-SECTION>
                  <MEMORY-SECTION>
                    <SHORT-NAME>VAR_CLEARED_UNSPECIFIED</SHORT-NAME>
                    <ALIGNMENT>UNSPECIFIED</ALIGNMENT>
                    <SW-ADDRMETHOD-REF DEST="SW-ADDR-METHOD">/AUTOSAR_MemMap/SwAddrMethods/VAR_CLEARED</SW-ADDRMETHOD-REF>
                  </MEMORY-SECTION>
                  <MEMORY-SECTION>
                    <SHORT-NAME>VAR_INIT_UNSPECIFIED</SHORT-NAME>
                    <ALIGNMENT>UNSPECIFIED</ALIGNMENT>
                    <SW-ADDRMETHOD-REF DEST="SW-ADDR-METHOD">/AUTOSAR_MemMap/SwAddrMethods/VAR</SW-ADDRMETHOD-REF>
                  </MEMORY-SECTION>
                  <MEMORY-SECTION>
                    <SHORT-NAME>VAR_POWER_ON_CLEARED_UNSPECIFIED</SHORT-NAME>
                    <ALIGNMENT>UNSPECIFIED</ALIGNMENT>
                    <SW-ADDRMETHOD-REF DEST="SW-ADDR-METHOD">/AUTOSAR_MemMap/SwAddrMethods/VAR_POWER_ON_CLEARED</SW-ADDRMETHOD-REF>
                  </MEMORY-SECTION>
                  <MEMORY-SECTION>
                    <SHORT-NAME>CONFIG_DATA_UNSPECIFIED</SHORT-NAME>
                    <ALIGNMENT>UNSPECIFIED</ALIGNMENT>
                    <SW-ADDRMETHOD-REF DEST="SW-ADDR-METHOD">/AUTOSAR_MemMap/SwAddrMethods/CONFIG_DATA</SW-ADDRMETHOD-REF>
                  </MEMORY-SECTION>
                  <MEMORY-SECTION>
                    <SHORT-NAME>CONST_UNSPECIFIED</SHORT-NAME>
                    <ALIGNMENT>UNSPECIFIED</ALIGNMENT>
                    <SW-ADDRMETHOD-REF DEST="SW-ADDR-METHOD">/AUTOSAR_MemMap/SwAddrMethods/CONST</SW-ADDRMETHOD-REF>
                  </MEMORY-SECTION>
                  <MEMORY-SECTION>
                    <SHORT-NAME>CODE</SHORT-NAME>
                    <SW-ADDRMETHOD-REF DEST="SW-ADDR-METHOD">/AUTOSAR_MemMap/SwAddrMethods/CODE</SW-ADDRMETHOD-REF>
                  </MEMORY-SECTION>
                </MEMORY-SECTIONS>
              </RESOURCE-CONSUMPTION>
              <!-- !LINKSTO ComM.ASR403.SWS_ComM_00280,1 -->
              <SW-VERSION>5.21.4</SW-VERSION>
              <VENDOR-ID>1</VENDOR-ID>
              <AR-RELEASE-VERSION>4.1.3</AR-RELEASE-VERSION>
              <BEHAVIOR-REF DEST="BSW-INTERNAL-BEHAVIOR">/AUTOSAR_ComM/BswModuleDescriptions/ComM/InternalBehavior_Inhibition</BEHAVIOR-REF>
              <VENDOR-API-INFIX>Inhibition</VENDOR-API-INFIX>
              <VENDOR-SPECIFIC-MODULE-DEF-REFS>
                <VENDOR-SPECIFIC-MODULE-DEF-REF DEST="ECUC-MODULE-DEF">/TS_TxDxM5I21R0/ComM</VENDOR-SPECIFIC-MODULE-DEF-REF>
              </VENDOR-SPECIFIC-MODULE-DEF-REFS>
            </BSW-IMPLEMENTATION>
[!ENDIF!] [!/*[!IF "(as:modconf('ComM')[1]/ComMGeneral/ComMModeLimitationEnabled = 'true') or (as:modconf('ComM')[1]/ComMGeneral/ComMWakeupInhibitionEnabled = 'true')"!]*/!]

