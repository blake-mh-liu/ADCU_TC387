<?xml version="1.0" encoding="UTF-8"?>
[!AUTOSPACING!]
<AUTOSAR xmlns="http://autosar.org/schema/r4.0"
  xmlns:xsi="http://www.w3.org/2001/XMLSchema-instance"
  xsi:schemaLocation="http://autosar.org/schema/r4.0 AUTOSAR_4-0-3.xsd">
[!IF "not(node:exists(as:modconf('ComM')[1]/ComMConfigSet/*[1]))"!][!//
[!ERROR "Configuration not exist!"!][!//
[!ENDIF!][!//
[!/* do not generate this file if RTE is not used */!]
[!SKIPFILE "ComMGeneral/ComMRteUsage = 'false'"!][!//
[!IF "ComMGeneral/ComMServiceAPI/ComMDefaultASRServiceAPI = 'AUTOSAR_32'"!][!//
[!VAR "swComponentTypePackageName" = "'ComponentTypes'"!][!//
[!VAR "swcImplementationPackageName" = "'Implementations'"!][!//
[!VAR "swcImplementationDataTypesPackageName" = "'Datatypes'"!][!//
[!VAR "ReRequestedComModeName" = "'RE_GetRequestedMode'"!][!//
[!VAR "ReRequestedComModeSymbolName" = "'ComM_Rte_GetRequestedMode'"!][!//
[!ELSE!][!//
[!VAR "swComponentTypePackageName" = "'SwComponentTypes'"!][!//
[!VAR "swcImplementationPackageName" = "'SwcImplementations'"!][!//
[!VAR "swcImplementationDataTypesPackageName" = "'ImplementationDataTypes'"!][!//
[!VAR "ReRequestedComModeName" = "'RE_GetRequestedComMode'"!][!//
[!VAR "ReRequestedComModeSymbolName" = "'ComM_Rte_GetRequestedComMode'"!][!//
[!ENDIF!][!//
[!INCLUDE "ComM_Functions.m"!][!//
[!CALL "GetUsedUserPlusChannelPlusMasterPncPlusInhibitionOsApplications"!][!//
[!IF "(count(text:split($FoundUserPlusChannePlusMasterPncPlusInhibitionOsApplications,' ')) > 1) and (as:modconf('ComM')[1]/ComMGeneral/ComMMultiCoreSupport = 'false')"!]
  <AR-PACKAGES>
    <AR-PACKAGE>
      <SHORT-NAME>AUTOSAR_ComM</SHORT-NAME>
      <AR-PACKAGES>
        <AR-PACKAGE>
          <SHORT-NAME>[!"$swComponentTypePackageName"!]</SHORT-NAME>
          <ELEMENTS>
[!IF "count(as:modconf('ComM')[1]/ComMConfigSet/*/ComMUser/*) != 0"!]
  [!CALL "GetUsedUserOsApplications"!]
  [!FOR "Idx1" = "1" TO "count(text:split($FoundUserOsApplications,' '))"!]
    [!VAR "CurrentOsApplication" = "string(text:split($FoundUserOsApplications,' ')[position() = $Idx1])"!]
            <SERVICE-SW-COMPONENT-TYPE>
              <SHORT-NAME>ComM_User_[!"$CurrentOsApplication"!]</SHORT-NAME>
              <!-- All per-user client-server ports have a queue
                   length of 1 as we do not expect a single SW-Cs
                   to call the same operation repeatedly in very
                   short cycles. -->
              <PORTS>
    [!LOOP "as:modconf('ComM')[1]/ComMConfigSet/*[1]/ComMUser/*"!]
      [!CALL "GetUserOsApplication","UserEcuCPartitionRef"="ComMUserEcucPartitionRef"!]
      [!IF "$CurrentOsApplication = $UserOsApplication"!]
                <!-- Instance of ComM_CurrentMode -->
                <!-- !LINKSTO ComM.SWS_ComM_01010,1 -->
                <P-PORT-PROTOTYPE>
                  <SHORT-NAME>UM_[!"as:name(.)"!]</SHORT-NAME>
                  <PROVIDED-COM-SPECS>
                    <MODE-SWITCH-SENDER-COM-SPEC>
                      <MODE-GROUP-REF DEST="MODE-DECLARATION-GROUP-PROTOTYPE">/AUTOSAR_ComM/PortInterfaces/ComM_CurrentMode/currentMode</MODE-GROUP-REF>
                      <QUEUE-LENGTH>3</QUEUE-LENGTH>
                    </MODE-SWITCH-SENDER-COM-SPEC>
                  </PROVIDED-COM-SPECS>
                  <PROVIDED-INTERFACE-TREF DEST="MODE-SWITCH-INTERFACE">/AUTOSAR_ComM/PortInterfaces/ComM_CurrentMode</PROVIDED-INTERFACE-TREF>
                </P-PORT-PROTOTYPE>
                <!-- Instance of ComM_UserRequest -->
                <!-- !LINKSTO ComM.SWS_ComM_01011,1 -->
                <P-PORT-PROTOTYPE>
                  <SHORT-NAME>UR_[!"as:name(.)"!]</SHORT-NAME>
                  <PROVIDED-COM-SPECS>
                    <SERVER-COM-SPEC>
                      <OPERATION-REF DEST="CLIENT-SERVER-OPERATION">/AUTOSAR_ComM/PortInterfaces/ComM_UserRequest/RequestComMode</OPERATION-REF>
                      <QUEUE-LENGTH>1</QUEUE-LENGTH>
                    </SERVER-COM-SPEC>
                    <SERVER-COM-SPEC>
                      <OPERATION-REF DEST="CLIENT-SERVER-OPERATION">/AUTOSAR_ComM/PortInterfaces/ComM_UserRequest/GetCurrentComMode</OPERATION-REF>
                      <QUEUE-LENGTH>1</QUEUE-LENGTH>
                    </SERVER-COM-SPEC>
[!IF "as:modconf('ComM')[1]/ComMGeneral/ComMEnableGetCurrentPNCComMode = 'true'"!]
                    <SERVER-COM-SPEC>
                      <OPERATION-REF DEST="CLIENT-SERVER-OPERATION">/AUTOSAR_ComM/PortInterfaces/ComM_UserRequest/GetCurrentPNCComMode</OPERATION-REF>
                      <QUEUE-LENGTH>1</QUEUE-LENGTH>
                    </SERVER-COM-SPEC>
[!ENDIF!]
                    <SERVER-COM-SPEC>
                      <OPERATION-REF DEST="CLIENT-SERVER-OPERATION">/AUTOSAR_ComM/PortInterfaces/ComM_UserRequest/GetMaxComMode</OPERATION-REF>
                      <QUEUE-LENGTH>1</QUEUE-LENGTH>
                    </SERVER-COM-SPEC>
                    <SERVER-COM-SPEC>
                      <OPERATION-REF DEST="CLIENT-SERVER-OPERATION">/AUTOSAR_ComM/PortInterfaces/ComM_UserRequest/GetRequestedComMode</OPERATION-REF>
                      <QUEUE-LENGTH>1</QUEUE-LENGTH>
                    </SERVER-COM-SPEC>
                  </PROVIDED-COM-SPECS>
                  <PROVIDED-INTERFACE-TREF DEST="CLIENT-SERVER-INTERFACE">/AUTOSAR_ComM/PortInterfaces/ComM_UserRequest</PROVIDED-INTERFACE-TREF>
                </P-PORT-PROTOTYPE>
      [!ENDIF!] [!/*[!IF "$CurrentOsApplication = $UserOsApplication"!]*/!]
    [!ENDLOOP!] [!/*[!LOOP "as:modconf('ComM')[1]/ComMConfigSet/*[1]/ComMUser/*"!]*/!]
              </PORTS>
              <INTERNAL-BEHAVIORS>
                <!-- !LINKSTO ComM.SWS_ComM_00745,1 -->
                <SWC-INTERNAL-BEHAVIOR>
                  <SHORT-NAME>SwcInternalBehavior_User_[!"$CurrentOsApplication"!]</SHORT-NAME>
                  <DATA-TYPE-MAPPING-REFS>
<!-- Provide default DataTypeMappings -->
                    <DATA-TYPE-MAPPING-REF DEST="DATA-TYPE-MAPPING-SET">/AUTOSAR_ComM/DataTypeMappingSets/DataTypeMappingSet_0</DATA-TYPE-MAPPING-REF>
                  </DATA-TYPE-MAPPING-REFS>
                  <EVENTS>
                    <!-- Standard events -->
    [!LOOP "as:modconf('ComM')[1]/ComMConfigSet/*[1]/ComMUser/*"!]
      [!CALL "GetUserOsApplication","UserEcuCPartitionRef"="ComMUserEcucPartitionRef"!]
      [!IF "$CurrentOsApplication = $UserOsApplication"!]
                    <OPERATION-INVOKED-EVENT>
                      <SHORT-NAME>EV_RequestComMode_[!"as:name(.)"!]</SHORT-NAME>
                      <START-ON-EVENT-REF DEST="RUNNABLE-ENTITY">/AUTOSAR_ComM/[!"$swComponentTypePackageName"!]/ComM_User_[!"$CurrentOsApplication"!]/SwcInternalBehavior_User_[!"$CurrentOsApplication"!]/RE_RequestComMode</START-ON-EVENT-REF>
                      <OPERATION-IREF>
                        <CONTEXT-P-PORT-REF DEST="P-PORT-PROTOTYPE">/AUTOSAR_ComM/[!"$swComponentTypePackageName"!]/ComM_User_[!"$CurrentOsApplication"!]/UR_[!"as:name(.)"!]</CONTEXT-P-PORT-REF>
                        <TARGET-PROVIDED-OPERATION-REF DEST="CLIENT-SERVER-OPERATION">/AUTOSAR_ComM/PortInterfaces/ComM_UserRequest/RequestComMode</TARGET-PROVIDED-OPERATION-REF>
                      </OPERATION-IREF>
                    </OPERATION-INVOKED-EVENT>
                    <OPERATION-INVOKED-EVENT>
                      <SHORT-NAME>EV_GetCurrentComMode_[!"as:name(.)"!]</SHORT-NAME>
                      <START-ON-EVENT-REF DEST="RUNNABLE-ENTITY">/AUTOSAR_ComM/[!"$swComponentTypePackageName"!]/ComM_User_[!"$CurrentOsApplication"!]/SwcInternalBehavior_User_[!"$CurrentOsApplication"!]/RE_GetCurrentComMode</START-ON-EVENT-REF>
                      <OPERATION-IREF>
                        <CONTEXT-P-PORT-REF DEST="P-PORT-PROTOTYPE">/AUTOSAR_ComM/[!"$swComponentTypePackageName"!]/ComM_User_[!"$CurrentOsApplication"!]/UR_[!"as:name(.)"!]</CONTEXT-P-PORT-REF>
                        <TARGET-PROVIDED-OPERATION-REF DEST="CLIENT-SERVER-OPERATION">/AUTOSAR_ComM/PortInterfaces/ComM_UserRequest/GetCurrentComMode</TARGET-PROVIDED-OPERATION-REF>
                      </OPERATION-IREF>
                    </OPERATION-INVOKED-EVENT>
[!IF "as:modconf('ComM')[1]/ComMGeneral/ComMEnableGetCurrentPNCComMode = 'true'"!]
                    <OPERATION-INVOKED-EVENT>
                      <SHORT-NAME>EV_GetCurrentPNCComMode_[!"as:name(.)"!]</SHORT-NAME>
                      <START-ON-EVENT-REF DEST="RUNNABLE-ENTITY">/AUTOSAR_ComM/[!"$swComponentTypePackageName"!]/ComM_User_[!"$CurrentOsApplication"!]/SwcInternalBehavior_User_[!"$CurrentOsApplication"!]/RE_GetCurrentPNCComMode</START-ON-EVENT-REF>
                      <OPERATION-IREF>
                        <CONTEXT-P-PORT-REF DEST="P-PORT-PROTOTYPE">/AUTOSAR_ComM/[!"$swComponentTypePackageName"!]/ComM_User_[!"$CurrentOsApplication"!]/UR_[!"as:name(.)"!]</CONTEXT-P-PORT-REF>
                        <TARGET-PROVIDED-OPERATION-REF DEST="CLIENT-SERVER-OPERATION">/AUTOSAR_ComM/PortInterfaces/ComM_UserRequest/GetCurrentPNCComMode</TARGET-PROVIDED-OPERATION-REF>
                      </OPERATION-IREF>
                    </OPERATION-INVOKED-EVENT>
[!ENDIF!]
                    <OPERATION-INVOKED-EVENT>
                      <SHORT-NAME>EV_GetMaxComMode_[!"as:name(.)"!]</SHORT-NAME>
                      <START-ON-EVENT-REF DEST="RUNNABLE-ENTITY">/AUTOSAR_ComM/[!"$swComponentTypePackageName"!]/ComM_User_[!"$CurrentOsApplication"!]/SwcInternalBehavior_User_[!"$CurrentOsApplication"!]/RE_GetMaxComMode</START-ON-EVENT-REF>
                      <OPERATION-IREF>
                        <CONTEXT-P-PORT-REF DEST="P-PORT-PROTOTYPE">/AUTOSAR_ComM/[!"$swComponentTypePackageName"!]/ComM_User_[!"$CurrentOsApplication"!]/UR_[!"as:name(.)"!]</CONTEXT-P-PORT-REF>
                        <TARGET-PROVIDED-OPERATION-REF DEST="CLIENT-SERVER-OPERATION">/AUTOSAR_ComM/PortInterfaces/ComM_UserRequest/GetMaxComMode</TARGET-PROVIDED-OPERATION-REF>
                      </OPERATION-IREF>
                    </OPERATION-INVOKED-EVENT>
                    <OPERATION-INVOKED-EVENT>
                      <SHORT-NAME>EV_GetRequestedComMode_[!"as:name(.)"!]</SHORT-NAME>
                      <START-ON-EVENT-REF DEST="RUNNABLE-ENTITY">/AUTOSAR_ComM/[!"$swComponentTypePackageName"!]/ComM_User_[!"$CurrentOsApplication"!]/SwcInternalBehavior_User_[!"$CurrentOsApplication"!]/RE_GetRequestedComMode</START-ON-EVENT-REF>
                      <OPERATION-IREF>
                        <CONTEXT-P-PORT-REF DEST="P-PORT-PROTOTYPE">/AUTOSAR_ComM/[!"$swComponentTypePackageName"!]/ComM_User_[!"$CurrentOsApplication"!]/UR_[!"as:name(.)"!]</CONTEXT-P-PORT-REF>
                        <TARGET-PROVIDED-OPERATION-REF DEST="CLIENT-SERVER-OPERATION">/AUTOSAR_ComM/PortInterfaces/ComM_UserRequest/GetRequestedComMode</TARGET-PROVIDED-OPERATION-REF>
                      </OPERATION-IREF>
                    </OPERATION-INVOKED-EVENT>
      [!ENDIF!] [!/*[!IF "$CurrentOsApplication = $UserOsApplication"!]*/!]
    [!ENDLOOP!] [!/*[!LOOP "as:modconf('ComM')[1]/ComMConfigSet/*[1]/ComMUser/*"!]*/!]
                  </EVENTS>
                  <HANDLE-TERMINATION-AND-RESTART>NO-SUPPORT</HANDLE-TERMINATION-AND-RESTART>
                  <INCLUDED-DATA-TYPE-SETS>
                  	<INCLUDED-DATA-TYPE-SET>
                      <DATA-TYPE-REFS>
                        <DATA-TYPE-REF DEST="IMPLEMENTATION-DATA-TYPE">/AUTOSAR_ComM/ImplementationDataTypes/ComM_ModeType</DATA-TYPE-REF>
                      </DATA-TYPE-REFS>
                    </INCLUDED-DATA-TYPE-SET>
                  </INCLUDED-DATA-TYPE-SETS>
                  <PORT-API-OPTIONS>
                    <!-- Port API options for default AUTOSAR version -->
    [!LOOP "as:modconf('ComM')[1]/ComMConfigSet/*[1]/ComMUser/*"!]
      [!CALL "GetUserOsApplication","UserEcuCPartitionRef"="ComMUserEcucPartitionRef"!]
      [!IF "$CurrentOsApplication = $UserOsApplication"!]
                    <!-- UM-port [!"as:name(.)"!], switch functions must be accessible via function pointer -->
                    <PORT-API-OPTION>
                      <ENABLE-TAKE-ADDRESS>true</ENABLE-TAKE-ADDRESS>
                      <INDIRECT-API>false</INDIRECT-API>
                      <PORT-REF DEST="P-PORT-PROTOTYPE">/AUTOSAR_ComM/[!"$swComponentTypePackageName"!]/ComM_User_[!"$CurrentOsApplication"!]/UM_[!"as:name(.)"!]</PORT-REF>
                    </PORT-API-OPTION>
                    <!-- UR-port [!"as:name(.)"!]: Port defined argument values + no indirect API -->
                    <PORT-API-OPTION>
                      <ENABLE-TAKE-ADDRESS>false</ENABLE-TAKE-ADDRESS>
                      <INDIRECT-API>false</INDIRECT-API>
                      <PORT-ARG-VALUES>
                        <PORT-DEFINED-ARGUMENT-VALUE>
                          <VALUE>
                            <NUMERICAL-VALUE-SPECIFICATION>
                              <VALUE>[!"num:integer(ComMUserIdentifier)"!]</VALUE>
                            </NUMERICAL-VALUE-SPECIFICATION>
                          </VALUE>
                          <VALUE-TYPE-TREF DEST="IMPLEMENTATION-DATA-TYPE">/AUTOSAR_ComM/ImplementationDataTypes/ComM_UserHandleType</VALUE-TYPE-TREF>
                        </PORT-DEFINED-ARGUMENT-VALUE>
                      </PORT-ARG-VALUES>
                      <PORT-REF DEST="P-PORT-PROTOTYPE">/AUTOSAR_ComM/[!"$swComponentTypePackageName"!]/ComM_User_[!"$CurrentOsApplication"!]/UR_[!"as:name(.)"!]</PORT-REF>
                    </PORT-API-OPTION>
      [!ENDIF!] [!/*[!IF "$CurrentOsApplication = $UserOsApplication"!]*/!]
    [!ENDLOOP!] [!/*[!LOOP "as:modconf('ComM')[1]/ComMConfigSet/*[1]/ComMUser/*"!]*/!]
                  </PORT-API-OPTIONS>
                  <RUNNABLES>
                    <!-- Standard runnables -->
                    <RUNNABLE-ENTITY>
                      <SHORT-NAME>RE_RequestComMode</SHORT-NAME>
                      <MINIMUM-START-INTERVAL>0</MINIMUM-START-INTERVAL>
                      <ARGUMENTS>
                        <RUNNABLE-ENTITY-ARGUMENT>
                          <SYMBOL>pdav0</SYMBOL>
                        </RUNNABLE-ENTITY-ARGUMENT>
                        <RUNNABLE-ENTITY-ARGUMENT>
                          <SYMBOL>ComMode</SYMBOL>
                        </RUNNABLE-ENTITY-ARGUMENT>
                      </ARGUMENTS>
                      <CAN-BE-INVOKED-CONCURRENTLY>true</CAN-BE-INVOKED-CONCURRENTLY>
                      <SYMBOL>ComM_Rte_RequestComMode_[!"$CurrentOsApplication"!]</SYMBOL>
                    </RUNNABLE-ENTITY>
                    <RUNNABLE-ENTITY>
                      <SHORT-NAME>RE_GetCurrentComMode</SHORT-NAME>
                      <MINIMUM-START-INTERVAL>0</MINIMUM-START-INTERVAL>
                      <ARGUMENTS>
                        <RUNNABLE-ENTITY-ARGUMENT>
                          <SYMBOL>pdav0</SYMBOL>
                        </RUNNABLE-ENTITY-ARGUMENT>
                        <RUNNABLE-ENTITY-ARGUMENT>
                          <SYMBOL>ComMode</SYMBOL>
                        </RUNNABLE-ENTITY-ARGUMENT>
                      </ARGUMENTS>
                      <CAN-BE-INVOKED-CONCURRENTLY>true</CAN-BE-INVOKED-CONCURRENTLY>
                      <SYMBOL>ComM_Rte_GetCurrentComMode_[!"$CurrentOsApplication"!]</SYMBOL>
                    </RUNNABLE-ENTITY>
[!IF "as:modconf('ComM')[1]/ComMGeneral/ComMEnableGetCurrentPNCComMode = 'true'"!]
                    <RUNNABLE-ENTITY>
                      <SHORT-NAME>RE_GetCurrentPNCComMode</SHORT-NAME>
                      <MINIMUM-START-INTERVAL>0</MINIMUM-START-INTERVAL>
                      <ARGUMENTS>
                        <RUNNABLE-ENTITY-ARGUMENT>
                          <SYMBOL>pdav0</SYMBOL>
                        </RUNNABLE-ENTITY-ARGUMENT>
                        <RUNNABLE-ENTITY-ARGUMENT>
                          <SYMBOL>ComMode</SYMBOL>
                        </RUNNABLE-ENTITY-ARGUMENT>
                      </ARGUMENTS>
                      <CAN-BE-INVOKED-CONCURRENTLY>true</CAN-BE-INVOKED-CONCURRENTLY>
                      <SYMBOL>ComM_Rte_GetCurrentPNCComMode_[!"$CurrentOsApplication"!]</SYMBOL>
                    </RUNNABLE-ENTITY>
[!ENDIF!]
                    <RUNNABLE-ENTITY>
                      <SHORT-NAME>RE_GetMaxComMode</SHORT-NAME>
                      <MINIMUM-START-INTERVAL>0</MINIMUM-START-INTERVAL>
                      <ARGUMENTS>
                        <RUNNABLE-ENTITY-ARGUMENT>
                          <SYMBOL>pdav0</SYMBOL>
                        </RUNNABLE-ENTITY-ARGUMENT>
                        <RUNNABLE-ENTITY-ARGUMENT>
                          <SYMBOL>ComMode</SYMBOL>
                        </RUNNABLE-ENTITY-ARGUMENT>
                      </ARGUMENTS>
                      <CAN-BE-INVOKED-CONCURRENTLY>true</CAN-BE-INVOKED-CONCURRENTLY>
                      <SYMBOL>ComM_Rte_GetMaxComMode_[!"$CurrentOsApplication"!]</SYMBOL>
                    </RUNNABLE-ENTITY>
                    <RUNNABLE-ENTITY>
                      <SHORT-NAME>RE_GetRequestedComMode</SHORT-NAME>
                      <MINIMUM-START-INTERVAL>0</MINIMUM-START-INTERVAL>
                      <ARGUMENTS>
                        <RUNNABLE-ENTITY-ARGUMENT>
                          <SYMBOL>pdav0</SYMBOL>
                        </RUNNABLE-ENTITY-ARGUMENT>
                        <RUNNABLE-ENTITY-ARGUMENT>
                          <SYMBOL>ComMode</SYMBOL>
                        </RUNNABLE-ENTITY-ARGUMENT>
                      </ARGUMENTS>
                      <CAN-BE-INVOKED-CONCURRENTLY>true</CAN-BE-INVOKED-CONCURRENTLY>
                      <SYMBOL>ComM_Rte_GetRequestedComMode_[!"$CurrentOsApplication"!]</SYMBOL>
                    </RUNNABLE-ENTITY>
    [!LOOP "as:modconf('ComM')[1]/ComMConfigSet/*[1]/ComMUser/*"!]
      [!CALL "GetUserOsApplication","UserEcuCPartitionRef"="ComMUserEcucPartitionRef"!]
      [!IF "$CurrentOsApplication = $UserOsApplication"!]
                    <RUNNABLE-ENTITY>
                      <SHORT-NAME>RE_Main_User_[!"ComMUserIdentifier"!]</SHORT-NAME>
                      <MINIMUM-START-INTERVAL>0</MINIMUM-START-INTERVAL>
                      <CAN-BE-INVOKED-CONCURRENTLY>false</CAN-BE-INVOKED-CONCURRENTLY>
                      <MODE-SWITCH-POINTS>
                        <MODE-SWITCH-POINT>
                          <SHORT-NAME>MSP_[!"as:name(.)"!]</SHORT-NAME>
                          <MODE-GROUP-IREF>
                            <CONTEXT-P-PORT-REF DEST="P-PORT-PROTOTYPE">/AUTOSAR_ComM/[!"$swComponentTypePackageName"!]/ComM_User_[!"$CurrentOsApplication"!]/UM_[!"as:name(.)"!]</CONTEXT-P-PORT-REF>
                            <TARGET-MODE-GROUP-REF DEST="MODE-DECLARATION-GROUP-PROTOTYPE">/AUTOSAR_ComM/PortInterfaces/ComM_CurrentMode/currentMode</TARGET-MODE-GROUP-REF>
                          </MODE-GROUP-IREF>
                        </MODE-SWITCH-POINT>
                      </MODE-SWITCH-POINTS>
                      <SYMBOL>ComM_1_User_[!"$UserOsApplication"!]_ComM_MainFunction_User_[!"ComMUserIdentifier"!]</SYMBOL>
                    </RUNNABLE-ENTITY>
      [!ENDIF!] [!/*[!IF "$CurrentOsApplication = $UserOsApplication"!]*/!]
    [!ENDLOOP!] [!/*[!LOOP "as:modconf('ComM')[1]/ComMConfigSet/*[1]/ComMUser/*"!]*/!]
                  </RUNNABLES>
                  <SUPPORTS-MULTIPLE-INSTANTIATION>false</SUPPORTS-MULTIPLE-INSTANTIATION>
                </SWC-INTERNAL-BEHAVIOR>
              </INTERNAL-BEHAVIORS>
            </SERVICE-SW-COMPONENT-TYPE>
  [!ENDFOR!] [!/*[!FOR "Idx1" = "1" TO "count(text:split($FoundUserOsApplications,' '))"!]*/!]
[!ENDIF!] [!/*[!IF "count(as:modconf('ComM')[1]/ComMConfigSet/*/ComMUser/*) != 0"!]*/!]

[!CALL "GetUsedChannelsOsApplications"!]
[!FOR "Idx1" = "1" TO "count(text:split($FoundChannelsOsApplications,' '))"!]
  [!VAR "CurrentOsApplication" = "string(text:split($FoundChannelsOsApplications,' ')[position() = $Idx1])"!]
            <SERVICE-SW-COMPONENT-TYPE>
              <SHORT-NAME>ComM_Channel_[!"$CurrentOsApplication"!]</SHORT-NAME>
              <!-- All per-user client-server ports have a queue
                   length of 1 as we do not expect a single SW-Cs
                   to call the same operation repeatedly in very
                   short cycles. -->
              <PORTS>
  [!LOOP "as:modconf('ComM')[1]/ComMConfigSet/*[1]/ComMChannel/*[ComMFullCommRequestNotificationEnabled = 'true']"!]
    [!CALL "GetChannelOsApplication","ChannelEcuCPartitionRef"="ComMChannelPartitionRef"!]
    [!IF "$ChannelOsApplication = $CurrentOsApplication"!]
                <!-- Instance of ComM_CurrentChannelRequest -->
                <!-- !LINKSTO ComM.SWS_ComM_01007,1 -->
                <P-PORT-PROTOTYPE>
                  <SHORT-NAME>CR_[!"as:name(.)"!]</SHORT-NAME>
                  <PROVIDED-COM-SPECS>
                    <NONQUEUED-SENDER-COM-SPEC>
                      <DATA-ELEMENT-REF DEST="VARIABLE-DATA-PROTOTYPE">/AUTOSAR_ComM/PortInterfaces/ComM_CurrentChannelRequest/fullComRequestors</DATA-ELEMENT-REF>
                      <HANDLE-OUT-OF-RANGE>NONE</HANDLE-OUT-OF-RANGE>
                      <USES-END-TO-END-PROTECTION>false</USES-END-TO-END-PROTECTION>
                      <INIT-VALUE>
                        <CONSTANT-REFERENCE>
                          <CONSTANT-REF DEST="CONSTANT-SPECIFICATION">/AUTOSAR_ComM/ConstantSpecifications/ComM_InitConst_UserHandleArray</CONSTANT-REF>
                        </CONSTANT-REFERENCE>
                      </INIT-VALUE>
                    </NONQUEUED-SENDER-COM-SPEC>
                  </PROVIDED-COM-SPECS>
                  <PROVIDED-INTERFACE-TREF DEST="SENDER-RECEIVER-INTERFACE">/AUTOSAR_ComM/PortInterfaces/ComM_CurrentChannelRequest</PROVIDED-INTERFACE-TREF>
                </P-PORT-PROTOTYPE>
    [!ENDIF!] [!/*[!IF "$ChannelOsApplication = $CurrentOsApplication"!]*/!]
  [!ENDLOOP!] [!/*[!LOOP "as:modconf('ComM')[1]/ComMConfigSet/*[1]/ComMChannel/*[ComMFullCommRequestNotificationEnabled = 'true']"!]*/!]

  [!IF "as:modconf('ComM')[1]/ComMGeneral/ComMModeLimitationEnabled = 'true'"!]
    [!LOOP "as:modconf('ComM')[1]/ComMConfigSet/*[1]/ComMChannel/*"!]
      [!CALL "GetChannelOsApplication","ChannelEcuCPartitionRef"="ComMChannelPartitionRef"!]
      [!IF "$ChannelOsApplication = $CurrentOsApplication"!]
                <!-- Instance of ComM_ChannelLimitation -->
                <!-- !LINKSTO ComM.SWS_ComM_01006,1 -->
                <P-PORT-PROTOTYPE>
                  <SHORT-NAME>CL_[!"as:name(.)"!]</SHORT-NAME>
                  <PROVIDED-COM-SPECS>
                    <SERVER-COM-SPEC>
                      <OPERATION-REF DEST="CLIENT-SERVER-OPERATION">/AUTOSAR_ComM/PortInterfaces/ComM_ChannelLimitation/LimitChannelToNoComMode</OPERATION-REF>
                      <QUEUE-LENGTH>1</QUEUE-LENGTH>
                    </SERVER-COM-SPEC>
                    <SERVER-COM-SPEC>
                      <OPERATION-REF DEST="CLIENT-SERVER-OPERATION">/AUTOSAR_ComM/PortInterfaces/ComM_ChannelLimitation/GetInhibitionStatus</OPERATION-REF>
                      <QUEUE-LENGTH>1</QUEUE-LENGTH>
                    </SERVER-COM-SPEC>
                  </PROVIDED-COM-SPECS>
                  <PROVIDED-INTERFACE-TREF DEST="CLIENT-SERVER-INTERFACE">/AUTOSAR_ComM/PortInterfaces/ComM_ChannelLimitation</PROVIDED-INTERFACE-TREF>
                </P-PORT-PROTOTYPE>
      [!ENDIF!] [!/*[!IF "$ChannelOsApplication = $CurrentOsApplication"!]*/!]
    [!ENDLOOP!] [!/*as:modconf('ComM')[1]/ComMConfigSet/*[1]/ComMChannel/**/!]
  [!ENDIF!] [!/*[!IF "as:modconf('ComM')[1]/ComMGeneral/ComMModeLimitationEnabled = 'true'"!]*/!]
  [!IF "as:modconf('ComM')[1]/ComMGeneral/ComMWakeupInhibitionEnabled = 'true'"!]
    [!LOOP "as:modconf('ComM')[1]/ComMConfigSet/*[1]/ComMChannel/*"!]
      [!CALL "GetChannelOsApplication","ChannelEcuCPartitionRef"="ComMChannelPartitionRef"!]
      [!IF "$ChannelOsApplication = $CurrentOsApplication"!]
                <!-- Instance of ComM_ChannelWakeup -->
                <!-- !LINKSTO ComM.SWS_ComM_01008,1 -->
                <P-PORT-PROTOTYPE>
                  <SHORT-NAME>CW_[!"as:name(.)"!]</SHORT-NAME>
                  <PROVIDED-COM-SPECS>
                    <SERVER-COM-SPEC>
                      <OPERATION-REF DEST="CLIENT-SERVER-OPERATION">/AUTOSAR_ComM/PortInterfaces/ComM_ChannelWakeup/PreventWakeUp</OPERATION-REF>
                      <QUEUE-LENGTH>1</QUEUE-LENGTH>
                    </SERVER-COM-SPEC>
                    <SERVER-COM-SPEC>
                      <OPERATION-REF DEST="CLIENT-SERVER-OPERATION">/AUTOSAR_ComM/PortInterfaces/ComM_ChannelWakeup/GetInhibitionStatus</OPERATION-REF>
                      <QUEUE-LENGTH>1</QUEUE-LENGTH>
                    </SERVER-COM-SPEC>
                  </PROVIDED-COM-SPECS>
                  <PROVIDED-INTERFACE-TREF DEST="CLIENT-SERVER-INTERFACE">/AUTOSAR_ComM/PortInterfaces/ComM_ChannelWakeup</PROVIDED-INTERFACE-TREF>
                </P-PORT-PROTOTYPE>
      [!ENDIF!] [!/*[!IF "$ChannelOsApplication = $CurrentOsApplication"!]*/!]
    [!ENDLOOP!] [!/*[!LOOP "as:modconf('ComM')[1]/ComMConfigSet/*[1]/ComMChannel/*"!]*/!]
  [!ENDIF!] [!/*[!IF "as:modconf('ComM')[1]/ComMGeneral/ComMWakeupInhibitionEnabled = true'"!]*/!]
              </PORTS>
              <INTERNAL-BEHAVIORS>
              <!-- !LINKSTO ComM.SWS_ComM_00745,1 -->
                <SWC-INTERNAL-BEHAVIOR>
                  <SHORT-NAME>SwcInternalBehavior_Channel_[!"$CurrentOsApplication"!]</SHORT-NAME>
                  <DATA-TYPE-MAPPING-REFS>
<!-- Provide default DataTypeMappings -->
                    <DATA-TYPE-MAPPING-REF DEST="DATA-TYPE-MAPPING-SET">/AUTOSAR_ComM/DataTypeMappingSets/DataTypeMappingSet_0</DATA-TYPE-MAPPING-REF>
                  </DATA-TYPE-MAPPING-REFS>
                  <EVENTS>
  [!IF "as:modconf('ComM')[1]/ComMGeneral/ComMModeLimitationEnabled = 'true'"!]
    [!LOOP "as:modconf('ComM')[1]/ComMConfigSet/*[1]/ComMChannel/*"!]
      [!CALL "GetChannelOsApplication","ChannelEcuCPartitionRef"="ComMChannelPartitionRef"!]
      [!IF "$ChannelOsApplication = $CurrentOsApplication"!]
                    <!-- Conditionally existing events for interfance ComM_ChannelLimitation -->
                    <OPERATION-INVOKED-EVENT>
                      <SHORT-NAME>EV_LimitChannelToNoComMode_[!"as:name(.)"!]</SHORT-NAME>
                      <START-ON-EVENT-REF DEST="RUNNABLE-ENTITY">/AUTOSAR_ComM/[!"$swComponentTypePackageName"!]/ComM_Channel_[!"$CurrentOsApplication"!]/SwcInternalBehavior_Channel_[!"$CurrentOsApplication"!]/RE_LimitChannelToNoComMode</START-ON-EVENT-REF>
                      <OPERATION-IREF>
                        <CONTEXT-P-PORT-REF DEST="P-PORT-PROTOTYPE">/AUTOSAR_ComM/[!"$swComponentTypePackageName"!]/ComM_Channel_[!"$CurrentOsApplication"!]/CL_[!"as:name(.)"!]</CONTEXT-P-PORT-REF>
                        <TARGET-PROVIDED-OPERATION-REF DEST="CLIENT-SERVER-OPERATION">/AUTOSAR_ComM/PortInterfaces/ComM_ChannelLimitation/LimitChannelToNoComMode</TARGET-PROVIDED-OPERATION-REF>
                      </OPERATION-IREF>
                    </OPERATION-INVOKED-EVENT>
                    <OPERATION-INVOKED-EVENT>
                      <SHORT-NAME>EV_GetInhibitionStatus_[!"as:name(.)"!]</SHORT-NAME>
                      <START-ON-EVENT-REF DEST="RUNNABLE-ENTITY">/AUTOSAR_ComM/[!"$swComponentTypePackageName"!]/ComM_Channel_[!"$CurrentOsApplication"!]/SwcInternalBehavior_Channel_[!"$CurrentOsApplication"!]/RE_GetInhibitionStatus</START-ON-EVENT-REF>
                      <OPERATION-IREF>
                        <CONTEXT-P-PORT-REF DEST="P-PORT-PROTOTYPE">/AUTOSAR_ComM/[!"$swComponentTypePackageName"!]/ComM_Channel_[!"$CurrentOsApplication"!]/CL_[!"as:name(.)"!]</CONTEXT-P-PORT-REF>
                        <TARGET-PROVIDED-OPERATION-REF DEST="CLIENT-SERVER-OPERATION">/AUTOSAR_ComM/PortInterfaces/ComM_ChannelLimitation/GetInhibitionStatus</TARGET-PROVIDED-OPERATION-REF>
                      </OPERATION-IREF>
                    </OPERATION-INVOKED-EVENT>
      [!ENDIF!] [!/*[!IF "$ChannelOsApplication = $CurrentOsApplication"!]*/!]
    [!ENDLOOP!] [!/*[!LOOP "as:modconf('ComM')[1]/ComMConfigSet/*[1]/ComMChannel/*"!]*/!]
  [!ENDIF!] [!/*[!IF "as:modconf('ComM')[1]/ComMGeneral/ComMModeLimitationEnabled = 'true'"!]*/!]
  [!IF "as:modconf('ComM')[1]/ComMGeneral/ComMWakeupInhibitionEnabled = 'true'"!]
                    <!-- Conditionally existing events for interfance ComM_ChannelWakeup -->
    [!LOOP "as:modconf('ComM')[1]/ComMConfigSet/*[1]/ComMChannel/*"!]
      [!CALL "GetChannelOsApplication","ChannelEcuCPartitionRef"="ComMChannelPartitionRef"!]
      [!IF "$ChannelOsApplication = $CurrentOsApplication"!]
                    <OPERATION-INVOKED-EVENT>
                      <SHORT-NAME>EV_PreventWakeup_[!"as:name(.)"!]</SHORT-NAME>
                      <START-ON-EVENT-REF DEST="RUNNABLE-ENTITY">/AUTOSAR_ComM/[!"$swComponentTypePackageName"!]/ComM_Channel_[!"$CurrentOsApplication"!]/SwcInternalBehavior_Channel_[!"$CurrentOsApplication"!]/RE_PreventWakeUp</START-ON-EVENT-REF>
                      <OPERATION-IREF>
                        <CONTEXT-P-PORT-REF DEST="P-PORT-PROTOTYPE">/AUTOSAR_ComM/[!"$swComponentTypePackageName"!]/ComM_Channel_[!"$CurrentOsApplication"!]/CW_[!"as:name(.)"!]</CONTEXT-P-PORT-REF>
                        <TARGET-PROVIDED-OPERATION-REF DEST="CLIENT-SERVER-OPERATION">/AUTOSAR_ComM/PortInterfaces/ComM_ChannelWakeup/PreventWakeUp</TARGET-PROVIDED-OPERATION-REF>
                      </OPERATION-IREF>
                    </OPERATION-INVOKED-EVENT>
                    <OPERATION-INVOKED-EVENT>
                      <SHORT-NAME>EV_GetInhibitionStatus_ChannelWakeup_[!"as:name(.)"!]</SHORT-NAME>
                      <START-ON-EVENT-REF DEST="RUNNABLE-ENTITY">/AUTOSAR_ComM/[!"$swComponentTypePackageName"!]/ComM_Channel_[!"$CurrentOsApplication"!]/SwcInternalBehavior_Channel_[!"$CurrentOsApplication"!]/RE_GetInhibitionStatus</START-ON-EVENT-REF>
                      <OPERATION-IREF>
                        <CONTEXT-P-PORT-REF DEST="P-PORT-PROTOTYPE">/AUTOSAR_ComM/[!"$swComponentTypePackageName"!]/ComM_Channel_[!"$CurrentOsApplication"!]/CW_[!"as:name(.)"!]</CONTEXT-P-PORT-REF>
                        <TARGET-PROVIDED-OPERATION-REF DEST="CLIENT-SERVER-OPERATION">/AUTOSAR_ComM/PortInterfaces/ComM_ChannelWakeup/GetInhibitionStatus</TARGET-PROVIDED-OPERATION-REF>
                      </OPERATION-IREF>
                    </OPERATION-INVOKED-EVENT>
      [!ENDIF!] [!/*[!IF "$ChannelOsApplication = $CurrentOsApplication"!]*/!]
    [!ENDLOOP!] [!/*[!LOOP "as:modconf('ComM')[1]/ComMConfigSet/*[1]/ComMChannel/*"!]*/!]
  [!ENDIF!] [!/*[!IF "as:modconf('ComM')[1]/ComMGeneral/ComMWakeupInhibitionEnabled = 'true'"!]*/!]
                    <!-- Standard events -->
                  </EVENTS>
                  <HANDLE-TERMINATION-AND-RESTART>NO-SUPPORT</HANDLE-TERMINATION-AND-RESTART>
                  <PORT-API-OPTIONS>
  [!LOOP "as:modconf('ComM')[1]/ComMConfigSet/*[1]/ComMChannel/*[ComMFullCommRequestNotificationEnabled = 'true']"!]
    [!CALL "GetChannelOsApplication","ChannelEcuCPartitionRef"="ComMChannelPartitionRef"!]
    [!IF "$ChannelOsApplication = $CurrentOsApplication"!]
                    <!-- CR-port [!"as:name(.)"!], write functions must be accessible via function pointer -->
                    <PORT-API-OPTION>
                      <ENABLE-TAKE-ADDRESS>true</ENABLE-TAKE-ADDRESS>
                      <INDIRECT-API>false</INDIRECT-API>
                      <PORT-REF DEST="P-PORT-PROTOTYPE">/AUTOSAR_ComM/[!"$swComponentTypePackageName"!]/ComM_Channel_[!"$CurrentOsApplication"!]/CR_[!"as:name(.)"!]</PORT-REF>
                    </PORT-API-OPTION>
    [!ENDIF!] [!/*[!IF "$ChannelOsApplication = $CurrentOsApplication"!] */!]
  [!ENDLOOP!] [!/*[!LOOP "as:modconf('ComM')[1]/ComMConfigSet/*[1]/ComMChannel/*[ComMFullCommRequestNotificationEnabled = 'true']"!]*/!]
  [!IF "as:modconf('ComM')[1]/ComMGeneral/ComMWakeupInhibitionEnabled = 'true'"!]
    [!LOOP "as:modconf('ComM')[1]/ComMConfigSet/*[1]/ComMChannel/*"!]
      [!CALL "GetChannelOsApplication","ChannelEcuCPartitionRef"="ComMChannelPartitionRef"!]
      [!IF "$ChannelOsApplication = $CurrentOsApplication"!]
                    <!-- CW-port [!"as:name(.)"!] -->
                    <PORT-API-OPTION>
                      <ENABLE-TAKE-ADDRESS>false</ENABLE-TAKE-ADDRESS>
                      <INDIRECT-API>false</INDIRECT-API>
                      <PORT-ARG-VALUES>
                        <PORT-DEFINED-ARGUMENT-VALUE>
                          <VALUE>
                            <NUMERICAL-VALUE-SPECIFICATION>
                              <VALUE>[!"num:integer(ComMChannelId)"!]</VALUE>
                            </NUMERICAL-VALUE-SPECIFICATION>
                          </VALUE>
                          <VALUE-TYPE-TREF DEST="IMPLEMENTATION-DATA-TYPE">/AUTOSAR_ComM/ImplementationDataTypes/ComM_UserHandleType</VALUE-TYPE-TREF>
                        </PORT-DEFINED-ARGUMENT-VALUE>
                      </PORT-ARG-VALUES>
                      <PORT-REF DEST="P-PORT-PROTOTYPE">/AUTOSAR_ComM/[!"$swComponentTypePackageName"!]/ComM_Channel_[!"$CurrentOsApplication"!]/CW_[!"as:name(.)"!]</PORT-REF>
                    </PORT-API-OPTION>
      [!ENDIF!] [!/*[!IF "$ChannelOsApplication = $CurrentOsApplication"!]*/!]
    [!ENDLOOP!] [!/*[!LOOP "as:modconf('ComM')[1]/ComMConfigSet/*[1]/ComMChannel/*"!]*/!]
  [!ENDIF!] [!/*[!IF "as:modconf('ComM')[1]/ComMGeneral/ComMWakeupInhibitionEnabled = 'true'"!]*/!]
  [!IF "as:modconf('ComM')[1]/ComMGeneral/ComMModeLimitationEnabled = 'true'"!]
    [!LOOP "as:modconf('ComM')[1]/ComMConfigSet/*[1]/ComMChannel/*"!]
      [!CALL "GetChannelOsApplication","ChannelEcuCPartitionRef"="ComMChannelPartitionRef"!]
      [!IF "$ChannelOsApplication = $CurrentOsApplication"!]
                    <!-- CL-port [!"as:name(.)"!] -->
                    <PORT-API-OPTION>
                      <ENABLE-TAKE-ADDRESS>false</ENABLE-TAKE-ADDRESS>
                      <INDIRECT-API>false</INDIRECT-API>
                      <PORT-ARG-VALUES>
                        <PORT-DEFINED-ARGUMENT-VALUE>
                          <VALUE>
                            <NUMERICAL-VALUE-SPECIFICATION>
                              <VALUE>[!"num:integer(ComMChannelId)"!]</VALUE>
                            </NUMERICAL-VALUE-SPECIFICATION>
                          </VALUE>
                          <VALUE-TYPE-TREF DEST="IMPLEMENTATION-DATA-TYPE">/AUTOSAR_ComM/ImplementationDataTypes/ComM_UserHandleType</VALUE-TYPE-TREF>
                        </PORT-DEFINED-ARGUMENT-VALUE>
                      </PORT-ARG-VALUES>
                      <PORT-REF DEST="P-PORT-PROTOTYPE">/AUTOSAR_ComM/[!"$swComponentTypePackageName"!]/ComM_Channel_[!"$CurrentOsApplication"!]/CL_[!"as:name(.)"!]</PORT-REF>
                    </PORT-API-OPTION>
      [!ENDIF!] [!/*[!IF "$ChannelOsApplication = $CurrentOsApplication"!]*/!]
    [!ENDLOOP!] [!/*[!LOOP "as:modconf('ComM')[1]/ComMConfigSet/*[1]/ComMChannel/*"!]*/!]
  [!ENDIF!] [!/*[!IF "as:modconf('ComM')[1]/ComMGeneral/ComMModeLimitationEnabled = 'true'"!]*/!]
                  </PORT-API-OPTIONS>
                  <RUNNABLES>
  [!IF "as:modconf('ComM')[1]/ComMGeneral/ComMModeLimitationEnabled = 'true'"!]
                    <!-- Conditionally existing runnables for interface ComM_ChannelLimitation -->
                    <RUNNABLE-ENTITY>
                      <SHORT-NAME>RE_LimitChannelToNoComMode</SHORT-NAME>
                      <MINIMUM-START-INTERVAL>0</MINIMUM-START-INTERVAL>
                      <ARGUMENTS>
                        <RUNNABLE-ENTITY-ARGUMENT>
                          <SYMBOL>pdav0</SYMBOL>
                        </RUNNABLE-ENTITY-ARGUMENT>
                        <RUNNABLE-ENTITY-ARGUMENT>
                          <SYMBOL>Status</SYMBOL>
                        </RUNNABLE-ENTITY-ARGUMENT>
                      </ARGUMENTS>
                      <CAN-BE-INVOKED-CONCURRENTLY>true</CAN-BE-INVOKED-CONCURRENTLY>
                      <SYMBOL>ComM_Rte_LimitChannelToNoComMode_[!"$CurrentOsApplication"!]</SYMBOL>
                    </RUNNABLE-ENTITY>
                    <RUNNABLE-ENTITY>
                      <SHORT-NAME>RE_GetInhibitionStatus</SHORT-NAME>
                      <MINIMUM-START-INTERVAL>0</MINIMUM-START-INTERVAL>
                      <ARGUMENTS>
                        <RUNNABLE-ENTITY-ARGUMENT>
                          <SYMBOL>pdav0</SYMBOL>
                        </RUNNABLE-ENTITY-ARGUMENT>
                        <RUNNABLE-ENTITY-ARGUMENT>
                          <SYMBOL>Status</SYMBOL>
                        </RUNNABLE-ENTITY-ARGUMENT>
                      </ARGUMENTS>
                      <CAN-BE-INVOKED-CONCURRENTLY>true</CAN-BE-INVOKED-CONCURRENTLY>
                      <SYMBOL>ComM_Rte_GetInhibitionStatus_[!"$CurrentOsApplication"!]</SYMBOL>
                    </RUNNABLE-ENTITY>
  [!ENDIF!] [!/*[!IF "as:modconf('ComM')[1]/ComMGeneral/ComMModeLimitationEnabled = 'true'"!]*/!]
  [!IF "as:modconf('ComM')[1]/ComMGeneral/ComMWakeupInhibitionEnabled = 'true'"!]
                    <!-- Conditionally existing runnables for interface ComM_ChannelWakeup -->
                    <RUNNABLE-ENTITY>
                      <SHORT-NAME>RE_PreventWakeUp</SHORT-NAME>
                      <MINIMUM-START-INTERVAL>0</MINIMUM-START-INTERVAL>
                      <ARGUMENTS>
                        <RUNNABLE-ENTITY-ARGUMENT>
                          <SYMBOL>pdav0</SYMBOL>
                        </RUNNABLE-ENTITY-ARGUMENT>
                        <RUNNABLE-ENTITY-ARGUMENT>
                          <SYMBOL>Status</SYMBOL>
                        </RUNNABLE-ENTITY-ARGUMENT>
                      </ARGUMENTS>
                      <CAN-BE-INVOKED-CONCURRENTLY>true</CAN-BE-INVOKED-CONCURRENTLY>
                      <SYMBOL>ComM_Rte_PreventWakeUp_[!"$CurrentOsApplication"!]</SYMBOL>
                    </RUNNABLE-ENTITY>
  [!ENDIF!] [!/*[!IF "as:modconf('ComM')[1]/ComMGeneral/ComMWakeupInhibitionEnabled = 'true'"!]*/!]
  [!LOOP "as:modconf('ComM')[1]/ComMConfigSet/*[1]/ComMChannel/*"!]
    [!CALL "GetChannelOsApplication","ChannelEcuCPartitionRef"="ComMChannelPartitionRef"!]
    [!IF "$ChannelOsApplication = $CurrentOsApplication"!]
                    <RUNNABLE-ENTITY>
                      <SHORT-NAME>RE_Main_[!"ComMChannelId"!]</SHORT-NAME>
                      <MINIMUM-START-INTERVAL>0</MINIMUM-START-INTERVAL>
                      <CAN-BE-INVOKED-CONCURRENTLY>false</CAN-BE-INVOKED-CONCURRENTLY>
      [!IF "ComMFullCommRequestNotificationEnabled = 'true'"!]
                      <DATA-SEND-POINTS>
                        <VARIABLE-ACCESS>
                          <SHORT-NAME>DSP_RE_Main_[!"ComMChannelId"!]</SHORT-NAME>
                          <ACCESSED-VARIABLE>
                            <AUTOSAR-VARIABLE-IREF>
                              <PORT-PROTOTYPE-REF DEST="P-PORT-PROTOTYPE">/AUTOSAR_ComM/[!"$swComponentTypePackageName"!]/ComM_Channel_[!"$CurrentOsApplication"!]/CR_[!"as:name(.)"!]</PORT-PROTOTYPE-REF>
                              <TARGET-DATA-PROTOTYPE-REF DEST="VARIABLE-DATA-PROTOTYPE">/AUTOSAR_ComM/PortInterfaces/ComM_CurrentChannelRequest/fullComRequestors</TARGET-DATA-PROTOTYPE-REF>
                            </AUTOSAR-VARIABLE-IREF>
                          </ACCESSED-VARIABLE>
                        </VARIABLE-ACCESS>
                      </DATA-SEND-POINTS>
      [!ENDIF!] [!/*[!IF "ComMFullCommRequestNotificationEnabled = 'true'"!]*/!]
                      <MODE-SWITCH-POINTS>
<!-- Create switch points for the Users which are directly mapped to a channel -->
                      </MODE-SWITCH-POINTS>
                      <SYMBOL>ComM_1_Ch_OsApplication_[!"$ChannelOsApplication"!]_ComM_MainFunction_[!"ComMChannelId"!]</SYMBOL>
                    </RUNNABLE-ENTITY>
    [!ENDIF!] [!/*[!IF "$ChannelOsApplication = $CurrentOsApplication"!]*/!]
  [!ENDLOOP!] [!/*[!LOOP "as:modconf('ComM')[1]/ComMConfigSet/*[1]/ComMChannel/*"!]*/!]
                  </RUNNABLES>
                  <SUPPORTS-MULTIPLE-INSTANTIATION>false</SUPPORTS-MULTIPLE-INSTANTIATION>
                </SWC-INTERNAL-BEHAVIOR>
              </INTERNAL-BEHAVIORS>
            </SERVICE-SW-COMPONENT-TYPE>
[!ENDFOR!] [!/*[!FOR "Idx1" = "1" TO "count(text:split($FoundChannelsOsApplications,' '))"!]*/!]
[!IF "as:modconf('ComM')[1]/ComMGeneral/ComMModeLimitationEnabled = 'true'"!]
  [!CALL "GetInhibitionOsApplication"!]
            <SERVICE-SW-COMPONENT-TYPE>
              <SHORT-NAME>ComM_Inhibition_[!"$InhibitionOsApplication"!]</SHORT-NAME>
              <!-- All per-user client-server ports have a queue
                   length of 1 as we do not expect a single SW-Cs
                   to call the same operation repeatedly in very
                   short cycles. -->
              <PORTS>
                <!-- Instance of ComM_ECUModeLimitation -->
                <!-- !LINKSTO ComM.SWS_ComM_01009,1 -->
                <P-PORT-PROTOTYPE>
                  <SHORT-NAME>ComM_ECUModeLimitation</SHORT-NAME>
                  <!-- Let the Rte decide on the optimal queue
                       length depending on the number of connected
                       clients. -->
                  <PROVIDED-INTERFACE-TREF DEST="CLIENT-SERVER-INTERFACE">/AUTOSAR_ComM/PortInterfaces/ComM_ECUModeLimitation</PROVIDED-INTERFACE-TREF>
                </P-PORT-PROTOTYPE>
              </PORTS>
              <INTERNAL-BEHAVIORS>
              <!-- !LINKSTO ComM.SWS_ComM_00745,1 -->
                <SWC-INTERNAL-BEHAVIOR>
                  <SHORT-NAME>SwcInternalBehavior_Inhibition_[!"$InhibitionOsApplication"!]</SHORT-NAME>
                  <DATA-TYPE-MAPPING-REFS>
<!-- Provide default DataTypeMappings -->
                    <DATA-TYPE-MAPPING-REF DEST="DATA-TYPE-MAPPING-SET">/AUTOSAR_ComM/DataTypeMappingSets/DataTypeMappingSet_0</DATA-TYPE-MAPPING-REF>
                  </DATA-TYPE-MAPPING-REFS>
                  <EVENTS>
                    <!-- Conditionally existing events for interface ComM_ECUModeLimitation -->
                    <OPERATION-INVOKED-EVENT>
                      <SHORT-NAME>EV_LimitECUToNoComMode</SHORT-NAME>
                      <START-ON-EVENT-REF DEST="RUNNABLE-ENTITY">/AUTOSAR_ComM/[!"$swComponentTypePackageName"!]/ComM_Inhibition_[!"$InhibitionOsApplication"!]/SwcInternalBehavior_Inhibition_[!"$InhibitionOsApplication"!]/RE_LimitECUToNoComMode</START-ON-EVENT-REF>
                      <OPERATION-IREF>
                        <CONTEXT-P-PORT-REF DEST="P-PORT-PROTOTYPE">/AUTOSAR_ComM/[!"$swComponentTypePackageName"!]/ComM_Inhibition_[!"$InhibitionOsApplication"!]/ComM_ECUModeLimitation</CONTEXT-P-PORT-REF>
                        <TARGET-PROVIDED-OPERATION-REF DEST="CLIENT-SERVER-OPERATION">/AUTOSAR_ComM/PortInterfaces/ComM_ECUModeLimitation/LimitECUToNoComMode</TARGET-PROVIDED-OPERATION-REF>
                      </OPERATION-IREF>
                    </OPERATION-INVOKED-EVENT>
                    <OPERATION-INVOKED-EVENT>
                      <SHORT-NAME>EV_ReadInhibitCounter</SHORT-NAME>
                      <START-ON-EVENT-REF DEST="RUNNABLE-ENTITY">/AUTOSAR_ComM/[!"$swComponentTypePackageName"!]/ComM_Inhibition_[!"$InhibitionOsApplication"!]/SwcInternalBehavior_Inhibition_[!"$InhibitionOsApplication"!]/RE_ReadInhibitCounter</START-ON-EVENT-REF>
                      <OPERATION-IREF>
                        <CONTEXT-P-PORT-REF DEST="P-PORT-PROTOTYPE">/AUTOSAR_ComM/[!"$swComponentTypePackageName"!]/ComM_Inhibition_[!"$InhibitionOsApplication"!]/ComM_ECUModeLimitation</CONTEXT-P-PORT-REF>
                        <TARGET-PROVIDED-OPERATION-REF DEST="CLIENT-SERVER-OPERATION">/AUTOSAR_ComM/PortInterfaces/ComM_ECUModeLimitation/ReadInhibitCounter</TARGET-PROVIDED-OPERATION-REF>
                      </OPERATION-IREF>
                    </OPERATION-INVOKED-EVENT>
                    <OPERATION-INVOKED-EVENT>
                      <SHORT-NAME>EV_ResetInhibitCounter</SHORT-NAME>
                      <START-ON-EVENT-REF DEST="RUNNABLE-ENTITY">/AUTOSAR_ComM/[!"$swComponentTypePackageName"!]/ComM_Inhibition_[!"$InhibitionOsApplication"!]/SwcInternalBehavior_Inhibition_[!"$InhibitionOsApplication"!]/RE_ResetInhibitCounter</START-ON-EVENT-REF>
                      <OPERATION-IREF>
                        <CONTEXT-P-PORT-REF DEST="P-PORT-PROTOTYPE">/AUTOSAR_ComM/[!"$swComponentTypePackageName"!]/ComM_Inhibition_[!"$InhibitionOsApplication"!]/ComM_ECUModeLimitation</CONTEXT-P-PORT-REF>
                        <TARGET-PROVIDED-OPERATION-REF DEST="CLIENT-SERVER-OPERATION">/AUTOSAR_ComM/PortInterfaces/ComM_ECUModeLimitation/ResetInhibitCounter</TARGET-PROVIDED-OPERATION-REF>
                      </OPERATION-IREF>
                    </OPERATION-INVOKED-EVENT>
                    <OPERATION-INVOKED-EVENT>
                      <SHORT-NAME>EV_SetECUGroupClassification</SHORT-NAME>
                      <START-ON-EVENT-REF DEST="RUNNABLE-ENTITY">/AUTOSAR_ComM/[!"$swComponentTypePackageName"!]/ComM_Inhibition_[!"$InhibitionOsApplication"!]/SwcInternalBehavior_Inhibition_[!"$InhibitionOsApplication"!]/RE_SetECUGroupClassification</START-ON-EVENT-REF>
                      <OPERATION-IREF>
                        <CONTEXT-P-PORT-REF DEST="P-PORT-PROTOTYPE">/AUTOSAR_ComM/[!"$swComponentTypePackageName"!]/ComM_Inhibition_[!"$InhibitionOsApplication"!]/ComM_ECUModeLimitation</CONTEXT-P-PORT-REF>
                        <TARGET-PROVIDED-OPERATION-REF DEST="CLIENT-SERVER-OPERATION">/AUTOSAR_ComM/PortInterfaces/ComM_ECUModeLimitation/SetECUGroupClassification</TARGET-PROVIDED-OPERATION-REF>
                      </OPERATION-IREF>
                    </OPERATION-INVOKED-EVENT>
                  </EVENTS>
                  <HANDLE-TERMINATION-AND-RESTART>NO-SUPPORT</HANDLE-TERMINATION-AND-RESTART>
                  <RUNNABLES>
                    <!-- Conditionally existing runnables for interface ComM_ECUModeLimitation -->
                    <RUNNABLE-ENTITY>
                      <SHORT-NAME>RE_LimitECUToNoComMode</SHORT-NAME>
                      <MINIMUM-START-INTERVAL>0</MINIMUM-START-INTERVAL>
                      <CAN-BE-INVOKED-CONCURRENTLY>true</CAN-BE-INVOKED-CONCURRENTLY>
                      <SYMBOL>ComM_Rte_LimitECUToNoComMode_[!"$InhibitionOsApplication"!]</SYMBOL>
                    </RUNNABLE-ENTITY>
                    <RUNNABLE-ENTITY>
                      <SHORT-NAME>RE_ReadInhibitCounter</SHORT-NAME>
                      <MINIMUM-START-INTERVAL>0</MINIMUM-START-INTERVAL>
                      <CAN-BE-INVOKED-CONCURRENTLY>true</CAN-BE-INVOKED-CONCURRENTLY>
                      <SYMBOL>ComM_Rte_ReadInhibitCounter_[!"$InhibitionOsApplication"!]</SYMBOL>
                    </RUNNABLE-ENTITY>
                    <RUNNABLE-ENTITY>
                      <SHORT-NAME>RE_ResetInhibitCounter</SHORT-NAME>
                      <MINIMUM-START-INTERVAL>0</MINIMUM-START-INTERVAL>
                      <CAN-BE-INVOKED-CONCURRENTLY>true</CAN-BE-INVOKED-CONCURRENTLY>
                      <SYMBOL>ComM_Rte_ResetInhibitCounter_[!"$InhibitionOsApplication"!]</SYMBOL>
                    </RUNNABLE-ENTITY>
                    <RUNNABLE-ENTITY>
                      <SHORT-NAME>RE_SetECUGroupClassification</SHORT-NAME>
                      <MINIMUM-START-INTERVAL>0</MINIMUM-START-INTERVAL>
                      <CAN-BE-INVOKED-CONCURRENTLY>true</CAN-BE-INVOKED-CONCURRENTLY>
                      <SYMBOL>ComM_Rte_SetECUGroupClassification_[!"$InhibitionOsApplication"!]</SYMBOL>
                    </RUNNABLE-ENTITY>
                    <!-- Conditionally existing runnables for interface ComM_ChannelLimitation -->
                  </RUNNABLES>
                  <SUPPORTS-MULTIPLE-INSTANTIATION>false</SUPPORTS-MULTIPLE-INSTANTIATION>
                </SWC-INTERNAL-BEHAVIOR>
              </INTERNAL-BEHAVIORS>
            </SERVICE-SW-COMPONENT-TYPE>
[!ENDIF!] [!/*[!IF "as:modconf('ComM')[1]/ComMGeneral/ComMModeLimitationEnabled = 'true'"!]*/!]
          </ELEMENTS>
        </AR-PACKAGE>
      </AR-PACKAGES>
    </AR-PACKAGE>

    <AR-PACKAGE>
      <SHORT-NAME>EB_ComM</SHORT-NAME>
      <AR-PACKAGES>
        <AR-PACKAGE>
          <SHORT-NAME>[!"$swcImplementationPackageName"!]</SHORT-NAME>
          <ELEMENTS>
[!IF "count(as:modconf('ComM')[1]/ComMConfigSet/*/ComMUser/*) != 0"!]
  [!CALL "GetUsedUserOsApplications"!]
  [!FOR "Idx1" = "1" TO "count(text:split($FoundUserOsApplications,' '))"!]
    [!VAR "CurrentOsApplication" = "string(text:split($FoundUserOsApplications,' ')[position() = $Idx1])"!]
            <SWC-IMPLEMENTATION>
              <SHORT-NAME>SwcImplementation_User_[!"$CurrentOsApplication"!]</SHORT-NAME>
              <CODE-DESCRIPTORS>
                <CODE>
                  <SHORT-NAME>ComM_User_[!"$CurrentOsApplication"!]_Code</SHORT-NAME>
                  <ARTIFACT-DESCRIPTORS>
                    <AUTOSAR-ENGINEERING-OBJECT>
                      <SHORT-LABEL>EngObject</SHORT-LABEL>
                      <CATEGORY>SWSRC</CATEGORY>
                    </AUTOSAR-ENGINEERING-OBJECT>
                  </ARTIFACT-DESCRIPTORS>
                </CODE>
              </CODE-DESCRIPTORS>
              <PROGRAMMING-LANGUAGE>C</PROGRAMMING-LANGUAGE>
              <RESOURCE-CONSUMPTION>
                <SHORT-NAME>Resources</SHORT-NAME>
                <MEMORY-SECTIONS>
                  <MEMORY-SECTION>
                    <SHORT-NAME>CODE</SHORT-NAME>
                    <SW-ADDRMETHOD-REF DEST="SW-ADDR-METHOD">/AUTOSAR_MemMap/SwAddrMethods/CODE</SW-ADDRMETHOD-REF>
                  </MEMORY-SECTION>
                </MEMORY-SECTIONS>
              </RESOURCE-CONSUMPTION>
              <SW-VERSION>5.21.4</SW-VERSION>
              <VENDOR-ID>1</VENDOR-ID>
              <BEHAVIOR-REF DEST="SWC-INTERNAL-BEHAVIOR">/AUTOSAR_ComM/[!"$swComponentTypePackageName"!]/ComM_User_[!"$CurrentOsApplication"!]/SwcInternalBehavior_User_[!"$CurrentOsApplication"!]</BEHAVIOR-REF>
            </SWC-IMPLEMENTATION>
  [!ENDFOR!] [!/*[!FOR "Idx1" = "1" TO "count(text:split($FoundUserOsApplications,' '))"!]*/!]
[!ENDIF!] [!/*[!IF "count(as:modconf('ComM')[1]/ComMConfigSet/*/ComMUser/*) != 0"!]*/!]
[!CALL "GetUsedChannelsOsApplications"!]
[!FOR "Idx1" = "1" TO "count(text:split($FoundChannelsOsApplications,' '))"!]
  [!VAR "CurrentOsApplication" = "string(text:split($FoundChannelsOsApplications,' ')[position() = $Idx1])"!]
            <SWC-IMPLEMENTATION>
              <SHORT-NAME>SwcImplementation_Channel_[!"$CurrentOsApplication"!]</SHORT-NAME>
              <CODE-DESCRIPTORS>
                <CODE>
                  <SHORT-NAME>ComM_Channel_[!"$CurrentOsApplication"!]_Code</SHORT-NAME>
                  <ARTIFACT-DESCRIPTORS>
                    <AUTOSAR-ENGINEERING-OBJECT>
                      <SHORT-LABEL>EngObject</SHORT-LABEL>
                      <CATEGORY>SWSRC</CATEGORY>
                    </AUTOSAR-ENGINEERING-OBJECT>
                  </ARTIFACT-DESCRIPTORS>
                </CODE>
              </CODE-DESCRIPTORS>
              <PROGRAMMING-LANGUAGE>C</PROGRAMMING-LANGUAGE>
              <RESOURCE-CONSUMPTION>
                <SHORT-NAME>Resources</SHORT-NAME>
                <MEMORY-SECTIONS>
                  <MEMORY-SECTION>
                    <SHORT-NAME>CODE</SHORT-NAME>
                    <SW-ADDRMETHOD-REF DEST="SW-ADDR-METHOD">/AUTOSAR_MemMap/SwAddrMethods/CODE</SW-ADDRMETHOD-REF>
                  </MEMORY-SECTION>
                </MEMORY-SECTIONS>
              </RESOURCE-CONSUMPTION>
              <SW-VERSION>5.21.4</SW-VERSION>
              <VENDOR-ID>1</VENDOR-ID>
              <BEHAVIOR-REF DEST="SWC-INTERNAL-BEHAVIOR">/AUTOSAR_ComM/[!"$swComponentTypePackageName"!]/ComM_Channel_[!"$CurrentOsApplication"!]/SwcInternalBehavior_Channel_[!"$CurrentOsApplication"!]</BEHAVIOR-REF>
            </SWC-IMPLEMENTATION>
[!ENDFOR!] [!/*[!FOR "Idx1" = "1" TO "count(text:split($FoundChannelsOsApplications,' '))"!]*/!]
[!IF "as:modconf('ComM')[1]/ComMGeneral/ComMModeLimitationEnabled = 'true'"!]
  [!CALL "GetInhibitionOsApplication"!]
            <SWC-IMPLEMENTATION>
              <SHORT-NAME>SwcImplementation_Inhibition_[!"$InhibitionOsApplication"!]</SHORT-NAME>
              <CODE-DESCRIPTORS>
                <CODE>
                  <SHORT-NAME>ComM_Inhibition_[!"$InhibitionOsApplication"!]_Code</SHORT-NAME>
                  <ARTIFACT-DESCRIPTORS>
                    <AUTOSAR-ENGINEERING-OBJECT>
                      <SHORT-LABEL>EngObject</SHORT-LABEL>
                      <CATEGORY>SWSRC</CATEGORY>
                    </AUTOSAR-ENGINEERING-OBJECT>
                  </ARTIFACT-DESCRIPTORS>
                </CODE>
              </CODE-DESCRIPTORS>
              <PROGRAMMING-LANGUAGE>C</PROGRAMMING-LANGUAGE>
              <RESOURCE-CONSUMPTION>
                <SHORT-NAME>Resources</SHORT-NAME>
                <MEMORY-SECTIONS>
                  <MEMORY-SECTION>
                    <SHORT-NAME>CODE</SHORT-NAME>
                    <SW-ADDRMETHOD-REF DEST="SW-ADDR-METHOD">/AUTOSAR_MemMap/SwAddrMethods/CODE</SW-ADDRMETHOD-REF>
                  </MEMORY-SECTION>
                </MEMORY-SECTIONS>
              </RESOURCE-CONSUMPTION>
              <SW-VERSION>5.21.4</SW-VERSION>
              <VENDOR-ID>1</VENDOR-ID>
              <BEHAVIOR-REF DEST="SWC-INTERNAL-BEHAVIOR">/AUTOSAR_ComM/[!"$swComponentTypePackageName"!]/ComM_Inhibition_[!"$InhibitionOsApplication"!]/SwcInternalBehavior_Inhibition_[!"$InhibitionOsApplication"!]</BEHAVIOR-REF>
            </SWC-IMPLEMENTATION>
[!ENDIF!] [!/*[!IF "as:modconf('ComM')[1]/ComMGeneral/ComMModeLimitationEnabled = 'true'"!]*/!]
          </ELEMENTS>
        </AR-PACKAGE>
      </AR-PACKAGES>
    </AR-PACKAGE>
  </AR-PACKAGES>
[!ELSE!] [!/*[!IF "(count(text:split($FoundUserPlusChannePlusMasterPncPlusInhibitionOsApplications,' ')) > 1) and (as:modconf('ComM')[1]/ComMGeneral/ComMMultiCoreSupport = 'false')"!]*/!]
<AR-PACKAGES>
    <AR-PACKAGE>
      <SHORT-NAME>AUTOSAR_ComM</SHORT-NAME>
      <AR-PACKAGES>
        <AR-PACKAGE>
          <SHORT-NAME>[!"$swComponentTypePackageName"!]</SHORT-NAME>
          <ELEMENTS>
            <SERVICE-SW-COMPONENT-TYPE>
              <SHORT-NAME>ComM</SHORT-NAME>
              <!-- All per-user client-server ports have a queue
                   length of 1 as we do not expect a single SW-Cs
                   to call the same operation repeatedly in very
                   short cycles. -->
              <PORTS>
[!IF "ComMGeneral/ComMServiceAPI/ComMEnableASR32ServiceAPI = 'true'"!]
[!LOOP "ComMConfigSet/*[1]/ComMUser/*"!]
                <!-- Instance of ComM_CurrentMode -->
                <!-- !LINKSTO ComM.SWS_ComM_01010,1 -->
                <P-PORT-PROTOTYPE>
                  <SHORT-NAME>UM_ASR32_[!"as:name(.)"!]</SHORT-NAME>
                  <PROVIDED-COM-SPECS>
                    <MODE-SWITCH-SENDER-COM-SPEC>
                      <MODE-GROUP-REF DEST="MODE-DECLARATION-GROUP-PROTOTYPE">/AUTOSAR_ComM/ASR32/PortInterfaces/ComM_ASR32_CurrentMode/currentMode</MODE-GROUP-REF>
                      <QUEUE-LENGTH>3</QUEUE-LENGTH>
                    </MODE-SWITCH-SENDER-COM-SPEC>
                  </PROVIDED-COM-SPECS>
                  <PROVIDED-INTERFACE-TREF DEST="MODE-SWITCH-INTERFACE">/AUTOSAR_ComM/ASR32/PortInterfaces/ComM_ASR32_CurrentMode</PROVIDED-INTERFACE-TREF>
                </P-PORT-PROTOTYPE>
                <!-- Instance of ComM_UserRequest -->
                <!-- !LINKSTO ComM.SWS_ComM_01011,1 -->
                <P-PORT-PROTOTYPE>
                  <SHORT-NAME>UR_ASR32_[!"as:name(.)"!]</SHORT-NAME>
                  <PROVIDED-COM-SPECS>
                    <SERVER-COM-SPEC>
                      <OPERATION-REF DEST="CLIENT-SERVER-OPERATION">/AUTOSAR_ComM/ASR32/PortInterfaces/ComM_ASR32_UserRequest/RequestComMode</OPERATION-REF>
                      <QUEUE-LENGTH>1</QUEUE-LENGTH>
                    </SERVER-COM-SPEC>
                    <SERVER-COM-SPEC>
                      <OPERATION-REF DEST="CLIENT-SERVER-OPERATION">/AUTOSAR_ComM/ASR32/PortInterfaces/ComM_ASR32_UserRequest/GetCurrentComMode</OPERATION-REF>
                      <QUEUE-LENGTH>1</QUEUE-LENGTH>
                    </SERVER-COM-SPEC>
                    <SERVER-COM-SPEC>
                      <OPERATION-REF DEST="CLIENT-SERVER-OPERATION">/AUTOSAR_ComM/ASR32/PortInterfaces/ComM_ASR32_UserRequest/GetMaxComMode</OPERATION-REF>
                      <QUEUE-LENGTH>1</QUEUE-LENGTH>
                    </SERVER-COM-SPEC>
                    <SERVER-COM-SPEC>
                      <OPERATION-REF DEST="CLIENT-SERVER-OPERATION">/AUTOSAR_ComM/ASR32/PortInterfaces/ComM_ASR32_UserRequest/GetRequestedMode</OPERATION-REF>
                      <QUEUE-LENGTH>1</QUEUE-LENGTH>
                    </SERVER-COM-SPEC>
                  </PROVIDED-COM-SPECS>
                  <PROVIDED-INTERFACE-TREF DEST="CLIENT-SERVER-INTERFACE">/AUTOSAR_ComM/ASR32/PortInterfaces/ComM_ASR32_UserRequest</PROVIDED-INTERFACE-TREF>
                </P-PORT-PROTOTYPE>
[!ENDLOOP!]
[!IF "ComMGeneral/ComMModeLimitationEnabled = 'true'"!]
                <!-- Instance of ComM_ECUModeLimitation -->
                <!-- !LINKSTO ComM.SWS_ComM_01009,1 -->
                <P-PORT-PROTOTYPE>
                  <SHORT-NAME>ComM_ASR32_ECUModeLimitation</SHORT-NAME>
                  <!-- Let the Rte decide on the optimal queue
                       length depending on the number of connected
                       clients. -->
                  <PROVIDED-INTERFACE-TREF DEST="CLIENT-SERVER-INTERFACE">/AUTOSAR_ComM/ASR32/PortInterfaces/ComM_ASR32_ECUModeLimitation</PROVIDED-INTERFACE-TREF>
                </P-PORT-PROTOTYPE>
[!LOOP "ComMConfigSet/*[1]/ComMChannel/*"!]
                <!-- Instance of ComM_ChannelLimitation -->
                <!-- !LINKSTO ComM.SWS_ComM_01006,1 -->
                <P-PORT-PROTOTYPE>
                  <SHORT-NAME>CL_ASR32_[!"as:name(.)"!]</SHORT-NAME>
                  <PROVIDED-COM-SPECS>
                    <SERVER-COM-SPEC>
                      <OPERATION-REF DEST="CLIENT-SERVER-OPERATION">/AUTOSAR_ComM/ASR32/PortInterfaces/ComM_ASR32_ChannelLimitation/LimitChannelToNoComMode</OPERATION-REF>
                      <QUEUE-LENGTH>1</QUEUE-LENGTH>
                    </SERVER-COM-SPEC>
                    <SERVER-COM-SPEC>
                      <OPERATION-REF DEST="CLIENT-SERVER-OPERATION">/AUTOSAR_ComM/ASR32/PortInterfaces/ComM_ASR32_ChannelLimitation/GetInhibitionStatus</OPERATION-REF>
                      <QUEUE-LENGTH>1</QUEUE-LENGTH>
                    </SERVER-COM-SPEC>
                  </PROVIDED-COM-SPECS>
                  <PROVIDED-INTERFACE-TREF DEST="CLIENT-SERVER-INTERFACE">/AUTOSAR_ComM/ASR32/PortInterfaces/ComM_ASR32_ChannelLimitation</PROVIDED-INTERFACE-TREF>
                </P-PORT-PROTOTYPE>
[!ENDLOOP!]
[!ENDIF!]
[!IF "ComMGeneral/ComMWakeupInhibitionEnabled = 'true'"!]
[!LOOP "ComMConfigSet/*[1]/ComMChannel/*"!]
                <!-- Instance of ComM_ChannelWakeup -->
                <!-- !LINKSTO ComM.SWS_ComM_01008,1 -->
                <P-PORT-PROTOTYPE>
                  <SHORT-NAME>CW_ASR32_[!"as:name(.)"!]</SHORT-NAME>
                  <PROVIDED-COM-SPECS>
                    <SERVER-COM-SPEC>
                      <OPERATION-REF DEST="CLIENT-SERVER-OPERATION">/AUTOSAR_ComM/ASR32/PortInterfaces/ComM_ASR32_ChannelWakeup/PreventWakeUp</OPERATION-REF>
                      <QUEUE-LENGTH>1</QUEUE-LENGTH>
                    </SERVER-COM-SPEC>
                    <SERVER-COM-SPEC>
                      <OPERATION-REF DEST="CLIENT-SERVER-OPERATION">/AUTOSAR_ComM/ASR32/PortInterfaces/ComM_ASR32_ChannelWakeup/GetInhibitionStatus</OPERATION-REF>
                      <QUEUE-LENGTH>1</QUEUE-LENGTH>
                    </SERVER-COM-SPEC>
                  </PROVIDED-COM-SPECS>
                  <PROVIDED-INTERFACE-TREF DEST="CLIENT-SERVER-INTERFACE">/AUTOSAR_ComM/ASR32/PortInterfaces/ComM_ASR32_ChannelWakeup</PROVIDED-INTERFACE-TREF>
                </P-PORT-PROTOTYPE>
[!ENDLOOP!]
[!ENDIF!]
[!ENDIF!]
[!IF "ComMGeneral/ComMServiceAPI/ComMEnableASR40ServiceAPI = 'true'"!]
[!LOOP "ComMConfigSet/*[1]/ComMUser/*"!]
                <!-- Instance of ComM_CurrentMode -->
                <!-- !LINKSTO ComM.SWS_ComM_01010,1 -->
                <P-PORT-PROTOTYPE>
                  <SHORT-NAME>UM_ASR40_[!"as:name(.)"!]</SHORT-NAME>
                  <PROVIDED-COM-SPECS>
                    <MODE-SWITCH-SENDER-COM-SPEC>
                      <MODE-GROUP-REF DEST="MODE-DECLARATION-GROUP-PROTOTYPE">/AUTOSAR_ComM/ASR40/PortInterfaces/ComM_ASR40_CurrentMode/currentMode</MODE-GROUP-REF>
                      <QUEUE-LENGTH>3</QUEUE-LENGTH>
                    </MODE-SWITCH-SENDER-COM-SPEC>
                  </PROVIDED-COM-SPECS>
                  <PROVIDED-INTERFACE-TREF DEST="MODE-SWITCH-INTERFACE">/AUTOSAR_ComM/ASR40/PortInterfaces/ComM_ASR40_CurrentMode</PROVIDED-INTERFACE-TREF>
                </P-PORT-PROTOTYPE>
                <!-- Instance of ComM_UserRequest -->
                <!-- !LINKSTO ComM.SWS_ComM_01011,1 -->
                <P-PORT-PROTOTYPE>
                  <SHORT-NAME>UR_ASR40_[!"as:name(.)"!]</SHORT-NAME>
                  <PROVIDED-COM-SPECS>
                    <SERVER-COM-SPEC>
                      <OPERATION-REF DEST="CLIENT-SERVER-OPERATION">/AUTOSAR_ComM/ASR40/PortInterfaces/ComM_ASR40_UserRequest/RequestComMode</OPERATION-REF>
                      <QUEUE-LENGTH>1</QUEUE-LENGTH>
                    </SERVER-COM-SPEC>
                    <SERVER-COM-SPEC>
                      <OPERATION-REF DEST="CLIENT-SERVER-OPERATION">/AUTOSAR_ComM/ASR40/PortInterfaces/ComM_ASR40_UserRequest/GetCurrentComMode</OPERATION-REF>
                      <QUEUE-LENGTH>1</QUEUE-LENGTH>
                    </SERVER-COM-SPEC>
[!IF "as:modconf('ComM')[1]/ComMGeneral/ComMEnableGetCurrentPNCComMode = 'true'"!]
                    <SERVER-COM-SPEC>
                      <OPERATION-REF DEST="CLIENT-SERVER-OPERATION">/AUTOSAR_ComM/ASR40/PortInterfaces/ComM_ASR40_UserRequest/GetCurrentPNCComMode</OPERATION-REF>
                      <QUEUE-LENGTH>1</QUEUE-LENGTH>
                    </SERVER-COM-SPEC>
[!ENDIF!]
                    <SERVER-COM-SPEC>
                      <OPERATION-REF DEST="CLIENT-SERVER-OPERATION">/AUTOSAR_ComM/ASR40/PortInterfaces/ComM_ASR40_UserRequest/GetMaxComMode</OPERATION-REF>
                      <QUEUE-LENGTH>1</QUEUE-LENGTH>
                    </SERVER-COM-SPEC>
                    <SERVER-COM-SPEC>
                      <OPERATION-REF DEST="CLIENT-SERVER-OPERATION">/AUTOSAR_ComM/ASR40/PortInterfaces/ComM_ASR40_UserRequest/GetRequestedComMode</OPERATION-REF>
                      <QUEUE-LENGTH>1</QUEUE-LENGTH>
                    </SERVER-COM-SPEC>
                  </PROVIDED-COM-SPECS>
                  <PROVIDED-INTERFACE-TREF DEST="CLIENT-SERVER-INTERFACE">/AUTOSAR_ComM/ASR40/PortInterfaces/ComM_ASR40_UserRequest</PROVIDED-INTERFACE-TREF>
                </P-PORT-PROTOTYPE>
[!ENDLOOP!]
[!LOOP "ComMConfigSet/*[1]/ComMChannel/*[ComMFullCommRequestNotificationEnabled = 'true']"!]
                <!-- Instance of ComM_CurrentChannelRequest -->
                <!-- !LINKSTO ComM.SWS_ComM_01007,1 -->
                <P-PORT-PROTOTYPE>
                  <SHORT-NAME>CR_ASR40_[!"as:name(.)"!]</SHORT-NAME>
                  <PROVIDED-COM-SPECS>
                    <NONQUEUED-SENDER-COM-SPEC>
                      <DATA-ELEMENT-REF DEST="VARIABLE-DATA-PROTOTYPE">/AUTOSAR_ComM/ASR40/PortInterfaces/ComM_ASR40_CurrentChannelRequest/fullComRequestors</DATA-ELEMENT-REF>
                      <HANDLE-OUT-OF-RANGE>NONE</HANDLE-OUT-OF-RANGE>
                      <USES-END-TO-END-PROTECTION>false</USES-END-TO-END-PROTECTION>
                      <INIT-VALUE>
                        <CONSTANT-REFERENCE>
                          <CONSTANT-REF DEST="CONSTANT-SPECIFICATION">/AUTOSAR_ComM/ASR40/ConstantSpecifications/ComM_ASR40_InitConst_UserHandleArray</CONSTANT-REF>
                        </CONSTANT-REFERENCE>
                      </INIT-VALUE>
                    </NONQUEUED-SENDER-COM-SPEC>
                  </PROVIDED-COM-SPECS>
                  <PROVIDED-INTERFACE-TREF DEST="SENDER-RECEIVER-INTERFACE">/AUTOSAR_ComM/ASR40/PortInterfaces/ComM_ASR40_CurrentChannelRequest</PROVIDED-INTERFACE-TREF>
                </P-PORT-PROTOTYPE>
[!ENDLOOP!]
[!IF "ComMGeneral/ComMModeLimitationEnabled = 'true'"!]
                <!-- Instance of ComM_ECUModeLimitation -->
                <!-- !LINKSTO ComM.SWS_ComM_01009,1 -->
                <P-PORT-PROTOTYPE>
                  <SHORT-NAME>ComM_ASR40_ECUModeLimitation</SHORT-NAME>
                  <!-- Let the Rte decide on the optimal queue
                       length depending on the number of connected
                       clients. -->
                  <PROVIDED-INTERFACE-TREF DEST="CLIENT-SERVER-INTERFACE">/AUTOSAR_ComM/ASR40/PortInterfaces/ComM_ASR40_ECUModeLimitation</PROVIDED-INTERFACE-TREF>
                </P-PORT-PROTOTYPE>
[!LOOP "ComMConfigSet/*[1]/ComMChannel/*"!]
                <!-- Instance of ComM_ChannelLimitation -->
                <!-- !LINKSTO ComM.SWS_ComM_01006,1 -->
                <P-PORT-PROTOTYPE>
                  <SHORT-NAME>CL_ASR40_[!"as:name(.)"!]</SHORT-NAME>
                  <PROVIDED-COM-SPECS>
                    <SERVER-COM-SPEC>
                      <OPERATION-REF DEST="CLIENT-SERVER-OPERATION">/AUTOSAR_ComM/ASR40/PortInterfaces/ComM_ASR40_ChannelLimitation/LimitChannelToNoComMode</OPERATION-REF>
                      <QUEUE-LENGTH>1</QUEUE-LENGTH>
                    </SERVER-COM-SPEC>
                    <SERVER-COM-SPEC>
                      <OPERATION-REF DEST="CLIENT-SERVER-OPERATION">/AUTOSAR_ComM/ASR40/PortInterfaces/ComM_ASR40_ChannelLimitation/GetInhibitionStatus</OPERATION-REF>
                      <QUEUE-LENGTH>1</QUEUE-LENGTH>
                    </SERVER-COM-SPEC>
                  </PROVIDED-COM-SPECS>
                  <PROVIDED-INTERFACE-TREF DEST="CLIENT-SERVER-INTERFACE">/AUTOSAR_ComM/ASR40/PortInterfaces/ComM_ASR40_ChannelLimitation</PROVIDED-INTERFACE-TREF>
                </P-PORT-PROTOTYPE>
[!ENDLOOP!]
[!ENDIF!]
[!IF "ComMGeneral/ComMWakeupInhibitionEnabled = 'true'"!]
[!LOOP "ComMConfigSet/*[1]/ComMChannel/*"!]
                <!-- Instance of ComM_ChannelWakeup -->
                <!-- !LINKSTO ComM.SWS_ComM_01008,1 -->
                <P-PORT-PROTOTYPE>
                  <SHORT-NAME>CW_ASR40_[!"as:name(.)"!]</SHORT-NAME>
                  <PROVIDED-COM-SPECS>
                    <SERVER-COM-SPEC>
                      <OPERATION-REF DEST="CLIENT-SERVER-OPERATION">/AUTOSAR_ComM/ASR40/PortInterfaces/ComM_ASR40_ChannelWakeup/PreventWakeUp</OPERATION-REF>
                      <QUEUE-LENGTH>1</QUEUE-LENGTH>
                    </SERVER-COM-SPEC>
                    <SERVER-COM-SPEC>
                      <OPERATION-REF DEST="CLIENT-SERVER-OPERATION">/AUTOSAR_ComM/ASR40/PortInterfaces/ComM_ASR40_ChannelWakeup/GetInhibitionStatus</OPERATION-REF>
                      <QUEUE-LENGTH>1</QUEUE-LENGTH>
                    </SERVER-COM-SPEC>
                  </PROVIDED-COM-SPECS>
                  <PROVIDED-INTERFACE-TREF DEST="CLIENT-SERVER-INTERFACE">/AUTOSAR_ComM/ASR40/PortInterfaces/ComM_ASR40_ChannelWakeup</PROVIDED-INTERFACE-TREF>
                </P-PORT-PROTOTYPE>
[!ENDLOOP!]
[!ENDIF!]
[!ENDIF!]
[!IF "ComMGeneral/ComMServiceAPI/ComMDefaultASRServiceAPI != 'NONE'"!]
[!LOOP "ComMConfigSet/*[1]/ComMUser/*"!]
                <!-- Instance of ComM_CurrentMode -->
                <!-- !LINKSTO ComM.SWS_ComM_01010,1 -->
                <P-PORT-PROTOTYPE>
                  <SHORT-NAME>UM_[!"as:name(.)"!]</SHORT-NAME>
                  <PROVIDED-COM-SPECS>
                    <MODE-SWITCH-SENDER-COM-SPEC>
                      <MODE-GROUP-REF DEST="MODE-DECLARATION-GROUP-PROTOTYPE">/AUTOSAR_ComM/PortInterfaces/ComM_CurrentMode/currentMode</MODE-GROUP-REF>
                      <QUEUE-LENGTH>3</QUEUE-LENGTH>
                    </MODE-SWITCH-SENDER-COM-SPEC>
                  </PROVIDED-COM-SPECS>
                  <PROVIDED-INTERFACE-TREF DEST="MODE-SWITCH-INTERFACE">/AUTOSAR_ComM/PortInterfaces/ComM_CurrentMode</PROVIDED-INTERFACE-TREF>
                </P-PORT-PROTOTYPE>
                <!-- Instance of ComM_UserRequest -->
                <!-- !LINKSTO ComM.SWS_ComM_01011,1 -->
                <P-PORT-PROTOTYPE>
                  <SHORT-NAME>UR_[!"as:name(.)"!]</SHORT-NAME>
                  <PROVIDED-COM-SPECS>
                    <SERVER-COM-SPEC>
                      <OPERATION-REF DEST="CLIENT-SERVER-OPERATION">/AUTOSAR_ComM/PortInterfaces/ComM_UserRequest/RequestComMode</OPERATION-REF>
                      <QUEUE-LENGTH>1</QUEUE-LENGTH>
                    </SERVER-COM-SPEC>
                    <SERVER-COM-SPEC>
                      <OPERATION-REF DEST="CLIENT-SERVER-OPERATION">/AUTOSAR_ComM/PortInterfaces/ComM_UserRequest/GetCurrentComMode</OPERATION-REF>
                      <QUEUE-LENGTH>1</QUEUE-LENGTH>
                    </SERVER-COM-SPEC>
[!IF "../../../../ComMGeneral/ComMServiceAPI/ComMDefaultASRServiceAPI = 'AUTOSAR_40'"!]
[!IF "as:modconf('ComM')[1]/ComMGeneral/ComMEnableGetCurrentPNCComMode = 'true'"!]
                    <SERVER-COM-SPEC>
                      <OPERATION-REF DEST="CLIENT-SERVER-OPERATION">/AUTOSAR_ComM/PortInterfaces/ComM_UserRequest/GetCurrentPNCComMode</OPERATION-REF>
                      <QUEUE-LENGTH>1</QUEUE-LENGTH>
                    </SERVER-COM-SPEC>
[!ENDIF!]
[!ENDIF!]
                    <SERVER-COM-SPEC>
                      <OPERATION-REF DEST="CLIENT-SERVER-OPERATION">/AUTOSAR_ComM/PortInterfaces/ComM_UserRequest/GetMaxComMode</OPERATION-REF>
                      <QUEUE-LENGTH>1</QUEUE-LENGTH>
                    </SERVER-COM-SPEC>
[!IF "../../../../ComMGeneral/ComMServiceAPI/ComMDefaultASRServiceAPI = 'AUTOSAR_32'"!]
                    <SERVER-COM-SPEC>
                      <OPERATION-REF DEST="CLIENT-SERVER-OPERATION">/AUTOSAR_ComM/PortInterfaces/ComM_UserRequest/GetRequestedMode</OPERATION-REF>
                      <QUEUE-LENGTH>1</QUEUE-LENGTH>
                    </SERVER-COM-SPEC>
[!ELSE!][!//
                    <SERVER-COM-SPEC>
                      <OPERATION-REF DEST="CLIENT-SERVER-OPERATION">/AUTOSAR_ComM/PortInterfaces/ComM_UserRequest/GetRequestedComMode</OPERATION-REF>
                      <QUEUE-LENGTH>1</QUEUE-LENGTH>
                    </SERVER-COM-SPEC>
[!ENDIF!]

                  </PROVIDED-COM-SPECS>
                  <PROVIDED-INTERFACE-TREF DEST="CLIENT-SERVER-INTERFACE">/AUTOSAR_ComM/PortInterfaces/ComM_UserRequest</PROVIDED-INTERFACE-TREF>
                </P-PORT-PROTOTYPE>
[!ENDLOOP!]
[!IF "ComMGeneral/ComMServiceAPI/ComMDefaultASRServiceAPI = 'AUTOSAR_40'"!]
[!LOOP "ComMConfigSet/*[1]/ComMChannel/*[ComMFullCommRequestNotificationEnabled = 'true']"!]
                <!-- Instance of ComM_CurrentChannelRequest -->
                <!-- !LINKSTO ComM.SWS_ComM_01007,1 -->
                <P-PORT-PROTOTYPE>
                  <SHORT-NAME>CR_[!"as:name(.)"!]</SHORT-NAME>
                  <PROVIDED-COM-SPECS>
                    <NONQUEUED-SENDER-COM-SPEC>
                      <DATA-ELEMENT-REF DEST="VARIABLE-DATA-PROTOTYPE">/AUTOSAR_ComM/PortInterfaces/ComM_CurrentChannelRequest/fullComRequestors</DATA-ELEMENT-REF>
                      <HANDLE-OUT-OF-RANGE>NONE</HANDLE-OUT-OF-RANGE>
                      <USES-END-TO-END-PROTECTION>false</USES-END-TO-END-PROTECTION>
                      <INIT-VALUE>
                        <CONSTANT-REFERENCE>
                          <CONSTANT-REF DEST="CONSTANT-SPECIFICATION">/AUTOSAR_ComM/ConstantSpecifications/ComM_InitConst_UserHandleArray</CONSTANT-REF>
                        </CONSTANT-REFERENCE>
                      </INIT-VALUE>
                    </NONQUEUED-SENDER-COM-SPEC>
                  </PROVIDED-COM-SPECS>
                  <PROVIDED-INTERFACE-TREF DEST="SENDER-RECEIVER-INTERFACE">/AUTOSAR_ComM/PortInterfaces/ComM_CurrentChannelRequest</PROVIDED-INTERFACE-TREF>
                </P-PORT-PROTOTYPE>
[!ENDLOOP!]
[!ENDIF!]
[!IF "ComMGeneral/ComMModeLimitationEnabled = 'true'"!]
                <!-- Instance of ComM_ECUModeLimitation -->
                <!-- !LINKSTO ComM.SWS_ComM_01009,1 -->
                <P-PORT-PROTOTYPE>
                  <SHORT-NAME>ComM_ECUModeLimitation</SHORT-NAME>
                  <!-- Let the Rte decide on the optimal queue
                       length depending on the number of connected
                       clients. -->
                  <PROVIDED-INTERFACE-TREF DEST="CLIENT-SERVER-INTERFACE">/AUTOSAR_ComM/PortInterfaces/ComM_ECUModeLimitation</PROVIDED-INTERFACE-TREF>
                </P-PORT-PROTOTYPE>
[!LOOP "ComMConfigSet/*[1]/ComMChannel/*"!]
                <!-- Instance of ComM_ChannelLimitation -->
                <!-- !LINKSTO ComM.SWS_ComM_01006,1 -->
                <P-PORT-PROTOTYPE>
                  <SHORT-NAME>CL_[!"as:name(.)"!]</SHORT-NAME>
                  <PROVIDED-COM-SPECS>
                    <SERVER-COM-SPEC>
                      <OPERATION-REF DEST="CLIENT-SERVER-OPERATION">/AUTOSAR_ComM/PortInterfaces/ComM_ChannelLimitation/LimitChannelToNoComMode</OPERATION-REF>
                      <QUEUE-LENGTH>1</QUEUE-LENGTH>
                    </SERVER-COM-SPEC>
                    <SERVER-COM-SPEC>
                      <OPERATION-REF DEST="CLIENT-SERVER-OPERATION">/AUTOSAR_ComM/PortInterfaces/ComM_ChannelLimitation/GetInhibitionStatus</OPERATION-REF>
                      <QUEUE-LENGTH>1</QUEUE-LENGTH>
                    </SERVER-COM-SPEC>
                  </PROVIDED-COM-SPECS>
                  <PROVIDED-INTERFACE-TREF DEST="CLIENT-SERVER-INTERFACE">/AUTOSAR_ComM/PortInterfaces/ComM_ChannelLimitation</PROVIDED-INTERFACE-TREF>
                </P-PORT-PROTOTYPE>
[!ENDLOOP!]
[!ENDIF!]
[!IF "ComMGeneral/ComMWakeupInhibitionEnabled = 'true'"!]
[!LOOP "ComMConfigSet/*[1]/ComMChannel/*"!]
                <!-- Instance of ComM_ChannelWakeup -->
                <!-- !LINKSTO ComM.SWS_ComM_01008,1 -->
                <P-PORT-PROTOTYPE>
                  <SHORT-NAME>CW_[!"as:name(.)"!]</SHORT-NAME>
                  <PROVIDED-COM-SPECS>
                    <SERVER-COM-SPEC>
                      <OPERATION-REF DEST="CLIENT-SERVER-OPERATION">/AUTOSAR_ComM/PortInterfaces/ComM_ChannelWakeup/PreventWakeUp</OPERATION-REF>
                      <QUEUE-LENGTH>1</QUEUE-LENGTH>
                    </SERVER-COM-SPEC>
                    <SERVER-COM-SPEC>
                      <OPERATION-REF DEST="CLIENT-SERVER-OPERATION">/AUTOSAR_ComM/PortInterfaces/ComM_ChannelWakeup/GetInhibitionStatus</OPERATION-REF>
                      <QUEUE-LENGTH>1</QUEUE-LENGTH>
                    </SERVER-COM-SPEC>
                  </PROVIDED-COM-SPECS>
                  <PROVIDED-INTERFACE-TREF DEST="CLIENT-SERVER-INTERFACE">/AUTOSAR_ComM/PortInterfaces/ComM_ChannelWakeup</PROVIDED-INTERFACE-TREF>
                </P-PORT-PROTOTYPE>
[!ENDLOOP!]
[!ENDIF!]
[!ENDIF!]
              </PORTS>
              <INTERNAL-BEHAVIORS>
              <!-- !LINKSTO ComM.SWS_ComM_00745,1 -->
                <SWC-INTERNAL-BEHAVIOR>
                  <SHORT-NAME>SwcInternalBehavior_0</SHORT-NAME>
                  <DATA-TYPE-MAPPING-REFS>
[!IF "ComMGeneral/ComMServiceAPI/ComMEnableASR32ServiceAPI = 'true'"!]
<!-- Provide AUTOSAR 3.2 DataTypeMappings -->
                    <DATA-TYPE-MAPPING-REF DEST="DATA-TYPE-MAPPING-SET">/AUTOSAR_ComM/ASR32/DataTypeMappingSets/ComM_ASR32_DataTypeMappingSet_0</DATA-TYPE-MAPPING-REF>
[!ENDIF!]
[!IF "ComMGeneral/ComMServiceAPI/ComMEnableASR40ServiceAPI = 'true'"!]
<!-- Provide AUTOSAR 4.0 DataTypeMappings -->
                    <DATA-TYPE-MAPPING-REF DEST="DATA-TYPE-MAPPING-SET">/AUTOSAR_ComM/ASR40/DataTypeMappingSets/ComM_ASR40_DataTypeMappingSet_0</DATA-TYPE-MAPPING-REF>
[!ENDIF!]
[!IF "ComMGeneral/ComMServiceAPI/ComMDefaultASRServiceAPI != 'NONE'"!]
<!-- Provide default DataTypeMappings -->
                    <DATA-TYPE-MAPPING-REF DEST="DATA-TYPE-MAPPING-SET">/AUTOSAR_ComM/DataTypeMappingSets/DataTypeMappingSet_0</DATA-TYPE-MAPPING-REF>
[!ENDIF!]
                  </DATA-TYPE-MAPPING-REFS>
                  <EVENTS>
[!IF "ComMGeneral/ComMServiceAPI/ComMEnableASR32ServiceAPI = 'true'"!]
[!IF "ComMGeneral/ComMModeLimitationEnabled = 'true'"!]
                    <!-- Conditionally existing events for interface ComM_ECUModeLimitation -->
                    <OPERATION-INVOKED-EVENT>
                      <SHORT-NAME>EV_ASR32_LimitECUToNoComMode</SHORT-NAME>
                      <START-ON-EVENT-REF DEST="RUNNABLE-ENTITY">/AUTOSAR_ComM/[!"$swComponentTypePackageName"!]/ComM/SwcInternalBehavior_0/RE_ASR32_LimitECUToNoComMode</START-ON-EVENT-REF>
                      <OPERATION-IREF>
                        <CONTEXT-P-PORT-REF DEST="P-PORT-PROTOTYPE">/AUTOSAR_ComM/[!"$swComponentTypePackageName"!]/ComM/ComM_ASR32_ECUModeLimitation</CONTEXT-P-PORT-REF>
                        <TARGET-PROVIDED-OPERATION-REF DEST="CLIENT-SERVER-OPERATION">/AUTOSAR_ComM/ASR32/PortInterfaces/ComM_ASR32_ECUModeLimitation/LimitECUToNoComMode</TARGET-PROVIDED-OPERATION-REF>
                      </OPERATION-IREF>
                    </OPERATION-INVOKED-EVENT>
                    <OPERATION-INVOKED-EVENT>
                      <SHORT-NAME>EV_ASR32_ReadInhibitCounter</SHORT-NAME>
                      <START-ON-EVENT-REF DEST="RUNNABLE-ENTITY">/AUTOSAR_ComM/[!"$swComponentTypePackageName"!]/ComM/SwcInternalBehavior_0/RE_ASR32_ReadInhibitCounter</START-ON-EVENT-REF>
                      <OPERATION-IREF>
                        <CONTEXT-P-PORT-REF DEST="P-PORT-PROTOTYPE">/AUTOSAR_ComM/[!"$swComponentTypePackageName"!]/ComM/ComM_ASR32_ECUModeLimitation</CONTEXT-P-PORT-REF>
                        <TARGET-PROVIDED-OPERATION-REF DEST="CLIENT-SERVER-OPERATION">/AUTOSAR_ComM/ASR32/PortInterfaces/ComM_ASR32_ECUModeLimitation/ReadInhibitCounter</TARGET-PROVIDED-OPERATION-REF>
                      </OPERATION-IREF>
                    </OPERATION-INVOKED-EVENT>
                    <OPERATION-INVOKED-EVENT>
                      <SHORT-NAME>EV_ASR32_ResetInhibitCounter</SHORT-NAME>
                      <START-ON-EVENT-REF DEST="RUNNABLE-ENTITY">/AUTOSAR_ComM/[!"$swComponentTypePackageName"!]/ComM/SwcInternalBehavior_0/RE_ASR32_ResetInhibitCounter</START-ON-EVENT-REF>
                      <OPERATION-IREF>
                        <CONTEXT-P-PORT-REF DEST="P-PORT-PROTOTYPE">/AUTOSAR_ComM/[!"$swComponentTypePackageName"!]/ComM/ComM_ASR32_ECUModeLimitation</CONTEXT-P-PORT-REF>
                        <TARGET-PROVIDED-OPERATION-REF DEST="CLIENT-SERVER-OPERATION">/AUTOSAR_ComM/ASR32/PortInterfaces/ComM_ASR32_ECUModeLimitation/ResetInhibitCounter</TARGET-PROVIDED-OPERATION-REF>
                      </OPERATION-IREF>
                    </OPERATION-INVOKED-EVENT>
                    <OPERATION-INVOKED-EVENT>
                      <SHORT-NAME>EV_ASR32_SetECUGroupClassification</SHORT-NAME>
                      <START-ON-EVENT-REF DEST="RUNNABLE-ENTITY">/AUTOSAR_ComM/[!"$swComponentTypePackageName"!]/ComM/SwcInternalBehavior_0/RE_ASR32_SetECUGroupClassification</START-ON-EVENT-REF>
                      <OPERATION-IREF>
                        <CONTEXT-P-PORT-REF DEST="P-PORT-PROTOTYPE">/AUTOSAR_ComM/[!"$swComponentTypePackageName"!]/ComM/ComM_ASR32_ECUModeLimitation</CONTEXT-P-PORT-REF>
                        <TARGET-PROVIDED-OPERATION-REF DEST="CLIENT-SERVER-OPERATION">/AUTOSAR_ComM/ASR32/PortInterfaces/ComM_ASR32_ECUModeLimitation/SetECUGroupClassification</TARGET-PROVIDED-OPERATION-REF>
                      </OPERATION-IREF>
                    </OPERATION-INVOKED-EVENT>
[!LOOP "ComMConfigSet/*[1]/ComMChannel/*"!]
                    <!-- Conditionally existing events for interfance ComM_ChannelLimitation -->
                    <OPERATION-INVOKED-EVENT>
                      <SHORT-NAME>EV_ASR32_LimitChannelToNoComMode_[!"as:name(.)"!]</SHORT-NAME>
                      <START-ON-EVENT-REF DEST="RUNNABLE-ENTITY">/AUTOSAR_ComM/[!"$swComponentTypePackageName"!]/ComM/SwcInternalBehavior_0/RE_ASR32_LimitChannelToNoComMode</START-ON-EVENT-REF>
                      <OPERATION-IREF>
                        <CONTEXT-P-PORT-REF DEST="P-PORT-PROTOTYPE">/AUTOSAR_ComM/[!"$swComponentTypePackageName"!]/ComM/CL_ASR32_[!"as:name(.)"!]</CONTEXT-P-PORT-REF>
                        <TARGET-PROVIDED-OPERATION-REF DEST="CLIENT-SERVER-OPERATION">/AUTOSAR_ComM/ASR32/PortInterfaces/ComM_ASR32_ChannelLimitation/LimitChannelToNoComMode</TARGET-PROVIDED-OPERATION-REF>
                      </OPERATION-IREF>
                    </OPERATION-INVOKED-EVENT>
                    <OPERATION-INVOKED-EVENT>
                      <SHORT-NAME>EV_ASR32_GetInhibitionStatus_[!"as:name(.)"!]</SHORT-NAME>
                      <START-ON-EVENT-REF DEST="RUNNABLE-ENTITY">/AUTOSAR_ComM/[!"$swComponentTypePackageName"!]/ComM/SwcInternalBehavior_0/RE_ASR32_GetInhibitionStatus</START-ON-EVENT-REF>
                      <OPERATION-IREF>
                        <CONTEXT-P-PORT-REF DEST="P-PORT-PROTOTYPE">/AUTOSAR_ComM/[!"$swComponentTypePackageName"!]/ComM/CL_ASR32_[!"as:name(.)"!]</CONTEXT-P-PORT-REF>
                        <TARGET-PROVIDED-OPERATION-REF DEST="CLIENT-SERVER-OPERATION">/AUTOSAR_ComM/ASR32/PortInterfaces/ComM_ASR32_ChannelLimitation/GetInhibitionStatus</TARGET-PROVIDED-OPERATION-REF>
                      </OPERATION-IREF>
                    </OPERATION-INVOKED-EVENT>
[!ENDLOOP!]
[!ENDIF!]
[!IF "ComMGeneral/ComMWakeupInhibitionEnabled = 'true'"!]
                    <!-- Conditionally existing events for interfance ComM_ChannelWakeup -->
[!LOOP "ComMConfigSet/*[1]/ComMChannel/*"!]
                    <OPERATION-INVOKED-EVENT>
                      <SHORT-NAME>EV_ASR32_PreventWakeup_[!"as:name(.)"!]</SHORT-NAME>
                      <START-ON-EVENT-REF DEST="RUNNABLE-ENTITY">/AUTOSAR_ComM/[!"$swComponentTypePackageName"!]/ComM/SwcInternalBehavior_0/RE_ASR32_PreventWakeUp</START-ON-EVENT-REF>
                      <OPERATION-IREF>
                        <CONTEXT-P-PORT-REF DEST="P-PORT-PROTOTYPE">/AUTOSAR_ComM/[!"$swComponentTypePackageName"!]/ComM/CW_ASR32_[!"as:name(.)"!]</CONTEXT-P-PORT-REF>
                        <TARGET-PROVIDED-OPERATION-REF DEST="CLIENT-SERVER-OPERATION">/AUTOSAR_ComM/ASR32/PortInterfaces/ComM_ASR32_ChannelWakeup/PreventWakeUp</TARGET-PROVIDED-OPERATION-REF>
                      </OPERATION-IREF>
                    </OPERATION-INVOKED-EVENT>
                    <OPERATION-INVOKED-EVENT>
                      <SHORT-NAME>EV_ASR32_GetInhibitionStatus_ChannelWakeup_[!"as:name(.)"!]</SHORT-NAME>
                      <START-ON-EVENT-REF DEST="RUNNABLE-ENTITY">/AUTOSAR_ComM/[!"$swComponentTypePackageName"!]/ComM/SwcInternalBehavior_0/RE_ASR32_GetInhibitionStatus</START-ON-EVENT-REF>
                      <OPERATION-IREF>
                        <CONTEXT-P-PORT-REF DEST="P-PORT-PROTOTYPE">/AUTOSAR_ComM/[!"$swComponentTypePackageName"!]/ComM/CW_ASR32_[!"as:name(.)"!]</CONTEXT-P-PORT-REF>
                        <TARGET-PROVIDED-OPERATION-REF DEST="CLIENT-SERVER-OPERATION">/AUTOSAR_ComM/ASR32/PortInterfaces/ComM_ASR32_ChannelWakeup/GetInhibitionStatus</TARGET-PROVIDED-OPERATION-REF>
                      </OPERATION-IREF>
                    </OPERATION-INVOKED-EVENT>
[!ENDLOOP!]
[!ENDIF!]
                    <!-- Standard events -->
[!LOOP "ComMConfigSet/*[1]/ComMUser/*"!]
                    <OPERATION-INVOKED-EVENT>
                      <SHORT-NAME>EV_ASR32_RequestComMode_[!"as:name(.)"!]</SHORT-NAME>
                      <START-ON-EVENT-REF DEST="RUNNABLE-ENTITY">/AUTOSAR_ComM/[!"$swComponentTypePackageName"!]/ComM/SwcInternalBehavior_0/RE_ASR32_RequestComMode</START-ON-EVENT-REF>
                      <OPERATION-IREF>
                        <CONTEXT-P-PORT-REF DEST="P-PORT-PROTOTYPE">/AUTOSAR_ComM/[!"$swComponentTypePackageName"!]/ComM/UR_ASR32_[!"as:name(.)"!]</CONTEXT-P-PORT-REF>
                        <TARGET-PROVIDED-OPERATION-REF DEST="CLIENT-SERVER-OPERATION">/AUTOSAR_ComM/ASR32/PortInterfaces/ComM_ASR32_UserRequest/RequestComMode</TARGET-PROVIDED-OPERATION-REF>
                      </OPERATION-IREF>
                    </OPERATION-INVOKED-EVENT>
                    <OPERATION-INVOKED-EVENT>
                      <SHORT-NAME>EV_ASR32_GetCurrentComMode_[!"as:name(.)"!]</SHORT-NAME>
                      <START-ON-EVENT-REF DEST="RUNNABLE-ENTITY">/AUTOSAR_ComM/[!"$swComponentTypePackageName"!]/ComM/SwcInternalBehavior_0/RE_ASR32_GetCurrentComMode</START-ON-EVENT-REF>
                      <OPERATION-IREF>
                        <CONTEXT-P-PORT-REF DEST="P-PORT-PROTOTYPE">/AUTOSAR_ComM/[!"$swComponentTypePackageName"!]/ComM/UR_ASR32_[!"as:name(.)"!]</CONTEXT-P-PORT-REF>
                        <TARGET-PROVIDED-OPERATION-REF DEST="CLIENT-SERVER-OPERATION">/AUTOSAR_ComM/ASR32/PortInterfaces/ComM_ASR32_UserRequest/GetCurrentComMode</TARGET-PROVIDED-OPERATION-REF>
                      </OPERATION-IREF>
                    </OPERATION-INVOKED-EVENT>
                    <OPERATION-INVOKED-EVENT>
                      <SHORT-NAME>EV_ASR32_GetMaxComMode_[!"as:name(.)"!]</SHORT-NAME>
                      <START-ON-EVENT-REF DEST="RUNNABLE-ENTITY">/AUTOSAR_ComM/[!"$swComponentTypePackageName"!]/ComM/SwcInternalBehavior_0/RE_ASR32_GetMaxComMode</START-ON-EVENT-REF>
                      <OPERATION-IREF>
                        <CONTEXT-P-PORT-REF DEST="P-PORT-PROTOTYPE">/AUTOSAR_ComM/[!"$swComponentTypePackageName"!]/ComM/UR_ASR32_[!"as:name(.)"!]</CONTEXT-P-PORT-REF>
                        <TARGET-PROVIDED-OPERATION-REF DEST="CLIENT-SERVER-OPERATION">/AUTOSAR_ComM/ASR32/PortInterfaces/ComM_ASR32_UserRequest/GetMaxComMode</TARGET-PROVIDED-OPERATION-REF>
                      </OPERATION-IREF>
                    </OPERATION-INVOKED-EVENT>
                    <OPERATION-INVOKED-EVENT>
                      <SHORT-NAME>EV_ASR32_GetRequestedMode_[!"as:name(.)"!]</SHORT-NAME>
                      <START-ON-EVENT-REF DEST="RUNNABLE-ENTITY">/AUTOSAR_ComM/[!"$swComponentTypePackageName"!]/ComM/SwcInternalBehavior_0/RE_ASR32_GetRequestedMode</START-ON-EVENT-REF>
                      <OPERATION-IREF>
                        <CONTEXT-P-PORT-REF DEST="P-PORT-PROTOTYPE">/AUTOSAR_ComM/[!"$swComponentTypePackageName"!]/ComM/UR_ASR32_[!"as:name(.)"!]</CONTEXT-P-PORT-REF>
                        <TARGET-PROVIDED-OPERATION-REF DEST="CLIENT-SERVER-OPERATION">/AUTOSAR_ComM/ASR32/PortInterfaces/ComM_ASR32_UserRequest/GetRequestedMode</TARGET-PROVIDED-OPERATION-REF>
                      </OPERATION-IREF>
                    </OPERATION-INVOKED-EVENT>
[!ENDLOOP!]
[!ENDIF!]
[!IF "ComMGeneral/ComMServiceAPI/ComMEnableASR40ServiceAPI = 'true'"!]
[!IF "ComMGeneral/ComMModeLimitationEnabled = 'true'"!]
                    <!-- Conditionally existing events for interface ComM_ECUModeLimitation -->
                    <OPERATION-INVOKED-EVENT>
                      <SHORT-NAME>EV_ASR40_LimitECUToNoComMode</SHORT-NAME>
                      <START-ON-EVENT-REF DEST="RUNNABLE-ENTITY">/AUTOSAR_ComM/[!"$swComponentTypePackageName"!]/ComM/SwcInternalBehavior_0/RE_ASR40_LimitECUToNoComMode</START-ON-EVENT-REF>
                      <OPERATION-IREF>
                        <CONTEXT-P-PORT-REF DEST="P-PORT-PROTOTYPE">/AUTOSAR_ComM/[!"$swComponentTypePackageName"!]/ComM/ComM_ASR40_ECUModeLimitation</CONTEXT-P-PORT-REF>
                        <TARGET-PROVIDED-OPERATION-REF DEST="CLIENT-SERVER-OPERATION">/AUTOSAR_ComM/ASR40/PortInterfaces/ComM_ASR40_ECUModeLimitation/LimitECUToNoComMode</TARGET-PROVIDED-OPERATION-REF>
                      </OPERATION-IREF>
                    </OPERATION-INVOKED-EVENT>
                    <OPERATION-INVOKED-EVENT>
                      <SHORT-NAME>EV_ASR40_ReadInhibitCounter</SHORT-NAME>
                      <START-ON-EVENT-REF DEST="RUNNABLE-ENTITY">/AUTOSAR_ComM/[!"$swComponentTypePackageName"!]/ComM/SwcInternalBehavior_0/RE_ASR40_ReadInhibitCounter</START-ON-EVENT-REF>
                      <OPERATION-IREF>
                        <CONTEXT-P-PORT-REF DEST="P-PORT-PROTOTYPE">/AUTOSAR_ComM/[!"$swComponentTypePackageName"!]/ComM/ComM_ASR40_ECUModeLimitation</CONTEXT-P-PORT-REF>
                        <TARGET-PROVIDED-OPERATION-REF DEST="CLIENT-SERVER-OPERATION">/AUTOSAR_ComM/ASR40/PortInterfaces/ComM_ASR40_ECUModeLimitation/ReadInhibitCounter</TARGET-PROVIDED-OPERATION-REF>
                      </OPERATION-IREF>
                    </OPERATION-INVOKED-EVENT>
                    <OPERATION-INVOKED-EVENT>
                      <SHORT-NAME>EV_ASR40_ResetInhibitCounter</SHORT-NAME>
                      <START-ON-EVENT-REF DEST="RUNNABLE-ENTITY">/AUTOSAR_ComM/[!"$swComponentTypePackageName"!]/ComM/SwcInternalBehavior_0/RE_ASR40_ResetInhibitCounter</START-ON-EVENT-REF>
                      <OPERATION-IREF>
                        <CONTEXT-P-PORT-REF DEST="P-PORT-PROTOTYPE">/AUTOSAR_ComM/[!"$swComponentTypePackageName"!]/ComM/ComM_ASR40_ECUModeLimitation</CONTEXT-P-PORT-REF>
                        <TARGET-PROVIDED-OPERATION-REF DEST="CLIENT-SERVER-OPERATION">/AUTOSAR_ComM/ASR40/PortInterfaces/ComM_ASR40_ECUModeLimitation/ResetInhibitCounter</TARGET-PROVIDED-OPERATION-REF>
                      </OPERATION-IREF>
                    </OPERATION-INVOKED-EVENT>
                    <OPERATION-INVOKED-EVENT>
                      <SHORT-NAME>EV_ASR40_SetECUGroupClassification</SHORT-NAME>
                      <START-ON-EVENT-REF DEST="RUNNABLE-ENTITY">/AUTOSAR_ComM/[!"$swComponentTypePackageName"!]/ComM/SwcInternalBehavior_0/RE_ASR40_SetECUGroupClassification</START-ON-EVENT-REF>
                      <OPERATION-IREF>
                        <CONTEXT-P-PORT-REF DEST="P-PORT-PROTOTYPE">/AUTOSAR_ComM/[!"$swComponentTypePackageName"!]/ComM/ComM_ASR40_ECUModeLimitation</CONTEXT-P-PORT-REF>
                        <TARGET-PROVIDED-OPERATION-REF DEST="CLIENT-SERVER-OPERATION">/AUTOSAR_ComM/ASR40/PortInterfaces/ComM_ASR40_ECUModeLimitation/SetECUGroupClassification</TARGET-PROVIDED-OPERATION-REF>
                      </OPERATION-IREF>
                    </OPERATION-INVOKED-EVENT>
[!LOOP "ComMConfigSet/*[1]/ComMChannel/*"!]
                    <!-- Conditionally existing events for interfance ComM_ChannelLimitation -->
                    <OPERATION-INVOKED-EVENT>
                      <SHORT-NAME>EV_ASR40_LimitChannelToNoComMode_[!"as:name(.)"!]</SHORT-NAME>
                      <START-ON-EVENT-REF DEST="RUNNABLE-ENTITY">/AUTOSAR_ComM/[!"$swComponentTypePackageName"!]/ComM/SwcInternalBehavior_0/RE_ASR40_LimitChannelToNoComMode</START-ON-EVENT-REF>
                      <OPERATION-IREF>
                        <CONTEXT-P-PORT-REF DEST="P-PORT-PROTOTYPE">/AUTOSAR_ComM/[!"$swComponentTypePackageName"!]/ComM/CL_ASR40_[!"as:name(.)"!]</CONTEXT-P-PORT-REF>
                        <TARGET-PROVIDED-OPERATION-REF DEST="CLIENT-SERVER-OPERATION">/AUTOSAR_ComM/ASR40/PortInterfaces/ComM_ASR40_ChannelLimitation/LimitChannelToNoComMode</TARGET-PROVIDED-OPERATION-REF>
                      </OPERATION-IREF>
                    </OPERATION-INVOKED-EVENT>
                    <OPERATION-INVOKED-EVENT>
                      <SHORT-NAME>EV_ASR40_GetInhibitionStatus_[!"as:name(.)"!]</SHORT-NAME>
                      <START-ON-EVENT-REF DEST="RUNNABLE-ENTITY">/AUTOSAR_ComM/[!"$swComponentTypePackageName"!]/ComM/SwcInternalBehavior_0/RE_ASR40_GetInhibitionStatus</START-ON-EVENT-REF>
                      <OPERATION-IREF>
                        <CONTEXT-P-PORT-REF DEST="P-PORT-PROTOTYPE">/AUTOSAR_ComM/[!"$swComponentTypePackageName"!]/ComM/CL_ASR40_[!"as:name(.)"!]</CONTEXT-P-PORT-REF>
                        <TARGET-PROVIDED-OPERATION-REF DEST="CLIENT-SERVER-OPERATION">/AUTOSAR_ComM/ASR40/PortInterfaces/ComM_ASR40_ChannelLimitation/GetInhibitionStatus</TARGET-PROVIDED-OPERATION-REF>
                      </OPERATION-IREF>
                    </OPERATION-INVOKED-EVENT>
[!ENDLOOP!]
[!ENDIF!]
[!IF "ComMGeneral/ComMWakeupInhibitionEnabled = 'true'"!]
                    <!-- Conditionally existing events for interfance ComM_ChannelWakeup -->
[!LOOP "ComMConfigSet/*[1]/ComMChannel/*"!]
                    <OPERATION-INVOKED-EVENT>
                      <SHORT-NAME>EV_ASR40_PreventWakeup_[!"as:name(.)"!]</SHORT-NAME>
                      <START-ON-EVENT-REF DEST="RUNNABLE-ENTITY">/AUTOSAR_ComM/[!"$swComponentTypePackageName"!]/ComM/SwcInternalBehavior_0/RE_ASR40_PreventWakeUp</START-ON-EVENT-REF>
                      <OPERATION-IREF>
                        <CONTEXT-P-PORT-REF DEST="P-PORT-PROTOTYPE">/AUTOSAR_ComM/[!"$swComponentTypePackageName"!]/ComM/CW_ASR40_[!"as:name(.)"!]</CONTEXT-P-PORT-REF>
                        <TARGET-PROVIDED-OPERATION-REF DEST="CLIENT-SERVER-OPERATION">/AUTOSAR_ComM/ASR40/PortInterfaces/ComM_ASR40_ChannelWakeup/PreventWakeUp</TARGET-PROVIDED-OPERATION-REF>
                      </OPERATION-IREF>
                    </OPERATION-INVOKED-EVENT>
                    <OPERATION-INVOKED-EVENT>
                      <SHORT-NAME>EV_ASR40_GetInhibitionStatus_ChannelWakeup_[!"as:name(.)"!]</SHORT-NAME>
                      <START-ON-EVENT-REF DEST="RUNNABLE-ENTITY">/AUTOSAR_ComM/[!"$swComponentTypePackageName"!]/ComM/SwcInternalBehavior_0/RE_ASR40_GetInhibitionStatus</START-ON-EVENT-REF>
                      <OPERATION-IREF>
                        <CONTEXT-P-PORT-REF DEST="P-PORT-PROTOTYPE">/AUTOSAR_ComM/[!"$swComponentTypePackageName"!]/ComM/CW_ASR40_[!"as:name(.)"!]</CONTEXT-P-PORT-REF>
                        <TARGET-PROVIDED-OPERATION-REF DEST="CLIENT-SERVER-OPERATION">/AUTOSAR_ComM/ASR40/PortInterfaces/ComM_ASR40_ChannelWakeup/GetInhibitionStatus</TARGET-PROVIDED-OPERATION-REF>
                      </OPERATION-IREF>
                    </OPERATION-INVOKED-EVENT>
[!ENDLOOP!]
[!ENDIF!]
                    <!-- Standard events -->
[!LOOP "ComMConfigSet/*[1]/ComMUser/*"!]
                    <OPERATION-INVOKED-EVENT>
                      <SHORT-NAME>EV_ASR40_RequestComMode_[!"as:name(.)"!]</SHORT-NAME>
                      <START-ON-EVENT-REF DEST="RUNNABLE-ENTITY">/AUTOSAR_ComM/[!"$swComponentTypePackageName"!]/ComM/SwcInternalBehavior_0/RE_ASR40_RequestComMode</START-ON-EVENT-REF>
                      <OPERATION-IREF>
                        <CONTEXT-P-PORT-REF DEST="P-PORT-PROTOTYPE">/AUTOSAR_ComM/[!"$swComponentTypePackageName"!]/ComM/UR_ASR40_[!"as:name(.)"!]</CONTEXT-P-PORT-REF>
                        <TARGET-PROVIDED-OPERATION-REF DEST="CLIENT-SERVER-OPERATION">/AUTOSAR_ComM/ASR40/PortInterfaces/ComM_ASR40_UserRequest/RequestComMode</TARGET-PROVIDED-OPERATION-REF>
                      </OPERATION-IREF>
                    </OPERATION-INVOKED-EVENT>
                    <OPERATION-INVOKED-EVENT>
                      <SHORT-NAME>EV_ASR40_GetCurrentComMode_[!"as:name(.)"!]</SHORT-NAME>
                      <START-ON-EVENT-REF DEST="RUNNABLE-ENTITY">/AUTOSAR_ComM/[!"$swComponentTypePackageName"!]/ComM/SwcInternalBehavior_0/RE_ASR40_GetCurrentComMode</START-ON-EVENT-REF>
                      <OPERATION-IREF>
                        <CONTEXT-P-PORT-REF DEST="P-PORT-PROTOTYPE">/AUTOSAR_ComM/[!"$swComponentTypePackageName"!]/ComM/UR_ASR40_[!"as:name(.)"!]</CONTEXT-P-PORT-REF>
                        <TARGET-PROVIDED-OPERATION-REF DEST="CLIENT-SERVER-OPERATION">/AUTOSAR_ComM/ASR40/PortInterfaces/ComM_ASR40_UserRequest/GetCurrentComMode</TARGET-PROVIDED-OPERATION-REF>
                      </OPERATION-IREF>
                    </OPERATION-INVOKED-EVENT>
[!IF "as:modconf('ComM')[1]/ComMGeneral/ComMEnableGetCurrentPNCComMode = 'true'"!]
                    <OPERATION-INVOKED-EVENT>
                      <SHORT-NAME>EV_ASR40_GetCurrentPNCComMode_[!"as:name(.)"!]</SHORT-NAME>
                      <START-ON-EVENT-REF DEST="RUNNABLE-ENTITY">/AUTOSAR_ComM/[!"$swComponentTypePackageName"!]/ComM/SwcInternalBehavior_0/RE_ASR40_GetCurrentPNCComMode</START-ON-EVENT-REF>
                      <OPERATION-IREF>
                        <CONTEXT-P-PORT-REF DEST="P-PORT-PROTOTYPE">/AUTOSAR_ComM/[!"$swComponentTypePackageName"!]/ComM/UR_ASR40_[!"as:name(.)"!]</CONTEXT-P-PORT-REF>
                        <TARGET-PROVIDED-OPERATION-REF DEST="CLIENT-SERVER-OPERATION">/AUTOSAR_ComM/ASR40/PortInterfaces/ComM_ASR40_UserRequest/GetCurrentPNCComMode</TARGET-PROVIDED-OPERATION-REF>
                      </OPERATION-IREF>
                    </OPERATION-INVOKED-EVENT>
[!ENDIF!]
                    <OPERATION-INVOKED-EVENT>
                      <SHORT-NAME>EV_ASR40_GetMaxComMode_[!"as:name(.)"!]</SHORT-NAME>
                      <START-ON-EVENT-REF DEST="RUNNABLE-ENTITY">/AUTOSAR_ComM/[!"$swComponentTypePackageName"!]/ComM/SwcInternalBehavior_0/RE_ASR40_GetMaxComMode</START-ON-EVENT-REF>
                      <OPERATION-IREF>
                        <CONTEXT-P-PORT-REF DEST="P-PORT-PROTOTYPE">/AUTOSAR_ComM/[!"$swComponentTypePackageName"!]/ComM/UR_ASR40_[!"as:name(.)"!]</CONTEXT-P-PORT-REF>
                        <TARGET-PROVIDED-OPERATION-REF DEST="CLIENT-SERVER-OPERATION">/AUTOSAR_ComM/ASR40/PortInterfaces/ComM_ASR40_UserRequest/GetMaxComMode</TARGET-PROVIDED-OPERATION-REF>
                      </OPERATION-IREF>
                    </OPERATION-INVOKED-EVENT>
                    <OPERATION-INVOKED-EVENT>
                      <SHORT-NAME>EV_ASR40_GetRequestedComMode_[!"as:name(.)"!]</SHORT-NAME>
                      <START-ON-EVENT-REF DEST="RUNNABLE-ENTITY">/AUTOSAR_ComM/[!"$swComponentTypePackageName"!]/ComM/SwcInternalBehavior_0/RE_ASR40_GetRequestedComMode</START-ON-EVENT-REF>
                      <OPERATION-IREF>
                        <CONTEXT-P-PORT-REF DEST="P-PORT-PROTOTYPE">/AUTOSAR_ComM/[!"$swComponentTypePackageName"!]/ComM/UR_ASR40_[!"as:name(.)"!]</CONTEXT-P-PORT-REF>
                        <TARGET-PROVIDED-OPERATION-REF DEST="CLIENT-SERVER-OPERATION">/AUTOSAR_ComM/ASR40/PortInterfaces/ComM_ASR40_UserRequest/GetRequestedComMode</TARGET-PROVIDED-OPERATION-REF>
                      </OPERATION-IREF>
                    </OPERATION-INVOKED-EVENT>
[!ENDLOOP!]
[!ENDIF!]
[!IF "ComMGeneral/ComMServiceAPI/ComMDefaultASRServiceAPI != 'NONE'"!]
[!IF "ComMGeneral/ComMModeLimitationEnabled = 'true'"!]
                    <!-- Conditionally existing events for interface ComM_ECUModeLimitation -->
                    <OPERATION-INVOKED-EVENT>
                      <SHORT-NAME>EV_LimitECUToNoComMode</SHORT-NAME>
                      <START-ON-EVENT-REF DEST="RUNNABLE-ENTITY">/AUTOSAR_ComM/[!"$swComponentTypePackageName"!]/ComM/SwcInternalBehavior_0/RE_LimitECUToNoComMode</START-ON-EVENT-REF>
                      <OPERATION-IREF>
                        <CONTEXT-P-PORT-REF DEST="P-PORT-PROTOTYPE">/AUTOSAR_ComM/[!"$swComponentTypePackageName"!]/ComM/ComM_ECUModeLimitation</CONTEXT-P-PORT-REF>
                        <TARGET-PROVIDED-OPERATION-REF DEST="CLIENT-SERVER-OPERATION">/AUTOSAR_ComM/PortInterfaces/ComM_ECUModeLimitation/LimitECUToNoComMode</TARGET-PROVIDED-OPERATION-REF>
                      </OPERATION-IREF>
                    </OPERATION-INVOKED-EVENT>
                    <OPERATION-INVOKED-EVENT>
                      <SHORT-NAME>EV_ReadInhibitCounter</SHORT-NAME>
                      <START-ON-EVENT-REF DEST="RUNNABLE-ENTITY">/AUTOSAR_ComM/[!"$swComponentTypePackageName"!]/ComM/SwcInternalBehavior_0/RE_ReadInhibitCounter</START-ON-EVENT-REF>
                      <OPERATION-IREF>
                        <CONTEXT-P-PORT-REF DEST="P-PORT-PROTOTYPE">/AUTOSAR_ComM/[!"$swComponentTypePackageName"!]/ComM/ComM_ECUModeLimitation</CONTEXT-P-PORT-REF>
                        <TARGET-PROVIDED-OPERATION-REF DEST="CLIENT-SERVER-OPERATION">/AUTOSAR_ComM/PortInterfaces/ComM_ECUModeLimitation/ReadInhibitCounter</TARGET-PROVIDED-OPERATION-REF>
                      </OPERATION-IREF>
                    </OPERATION-INVOKED-EVENT>
                    <OPERATION-INVOKED-EVENT>
                      <SHORT-NAME>EV_ResetInhibitCounter</SHORT-NAME>
                      <START-ON-EVENT-REF DEST="RUNNABLE-ENTITY">/AUTOSAR_ComM/[!"$swComponentTypePackageName"!]/ComM/SwcInternalBehavior_0/RE_ResetInhibitCounter</START-ON-EVENT-REF>
                      <OPERATION-IREF>
                        <CONTEXT-P-PORT-REF DEST="P-PORT-PROTOTYPE">/AUTOSAR_ComM/[!"$swComponentTypePackageName"!]/ComM/ComM_ECUModeLimitation</CONTEXT-P-PORT-REF>
                        <TARGET-PROVIDED-OPERATION-REF DEST="CLIENT-SERVER-OPERATION">/AUTOSAR_ComM/PortInterfaces/ComM_ECUModeLimitation/ResetInhibitCounter</TARGET-PROVIDED-OPERATION-REF>
                      </OPERATION-IREF>
                    </OPERATION-INVOKED-EVENT>
                    <OPERATION-INVOKED-EVENT>
                      <SHORT-NAME>EV_SetECUGroupClassification</SHORT-NAME>
                      <START-ON-EVENT-REF DEST="RUNNABLE-ENTITY">/AUTOSAR_ComM/[!"$swComponentTypePackageName"!]/ComM/SwcInternalBehavior_0/RE_SetECUGroupClassification</START-ON-EVENT-REF>
                      <OPERATION-IREF>
                        <CONTEXT-P-PORT-REF DEST="P-PORT-PROTOTYPE">/AUTOSAR_ComM/[!"$swComponentTypePackageName"!]/ComM/ComM_ECUModeLimitation</CONTEXT-P-PORT-REF>
                        <TARGET-PROVIDED-OPERATION-REF DEST="CLIENT-SERVER-OPERATION">/AUTOSAR_ComM/PortInterfaces/ComM_ECUModeLimitation/SetECUGroupClassification</TARGET-PROVIDED-OPERATION-REF>
                      </OPERATION-IREF>
                    </OPERATION-INVOKED-EVENT>
[!LOOP "ComMConfigSet/*[1]/ComMChannel/*"!]
                    <!-- Conditionally existing events for interfance ComM_ChannelLimitation -->
                    <OPERATION-INVOKED-EVENT>
                      <SHORT-NAME>EV_LimitChannelToNoComMode_[!"as:name(.)"!]</SHORT-NAME>
                      <START-ON-EVENT-REF DEST="RUNNABLE-ENTITY">/AUTOSAR_ComM/[!"$swComponentTypePackageName"!]/ComM/SwcInternalBehavior_0/RE_LimitChannelToNoComMode</START-ON-EVENT-REF>
                      <OPERATION-IREF>
                        <CONTEXT-P-PORT-REF DEST="P-PORT-PROTOTYPE">/AUTOSAR_ComM/[!"$swComponentTypePackageName"!]/ComM/CL_[!"as:name(.)"!]</CONTEXT-P-PORT-REF>
                        <TARGET-PROVIDED-OPERATION-REF DEST="CLIENT-SERVER-OPERATION">/AUTOSAR_ComM/PortInterfaces/ComM_ChannelLimitation/LimitChannelToNoComMode</TARGET-PROVIDED-OPERATION-REF>
                      </OPERATION-IREF>
                    </OPERATION-INVOKED-EVENT>
                    <OPERATION-INVOKED-EVENT>
                      <SHORT-NAME>EV_GetInhibitionStatus_[!"as:name(.)"!]</SHORT-NAME>
                      <START-ON-EVENT-REF DEST="RUNNABLE-ENTITY">/AUTOSAR_ComM/[!"$swComponentTypePackageName"!]/ComM/SwcInternalBehavior_0/RE_GetInhibitionStatus</START-ON-EVENT-REF>
                      <OPERATION-IREF>
                        <CONTEXT-P-PORT-REF DEST="P-PORT-PROTOTYPE">/AUTOSAR_ComM/[!"$swComponentTypePackageName"!]/ComM/CL_[!"as:name(.)"!]</CONTEXT-P-PORT-REF>
                        <TARGET-PROVIDED-OPERATION-REF DEST="CLIENT-SERVER-OPERATION">/AUTOSAR_ComM/PortInterfaces/ComM_ChannelLimitation/GetInhibitionStatus</TARGET-PROVIDED-OPERATION-REF>
                      </OPERATION-IREF>
                    </OPERATION-INVOKED-EVENT>
[!ENDLOOP!]
[!ENDIF!]
[!IF "ComMGeneral/ComMWakeupInhibitionEnabled = 'true'"!]
                    <!-- Conditionally existing events for interfance ComM_ChannelWakeup -->
[!LOOP "ComMConfigSet/*[1]/ComMChannel/*"!]
                    <OPERATION-INVOKED-EVENT>
                      <SHORT-NAME>EV_PreventWakeup_[!"as:name(.)"!]</SHORT-NAME>
                      <START-ON-EVENT-REF DEST="RUNNABLE-ENTITY">/AUTOSAR_ComM/[!"$swComponentTypePackageName"!]/ComM/SwcInternalBehavior_0/RE_PreventWakeUp</START-ON-EVENT-REF>
                      <OPERATION-IREF>
                        <CONTEXT-P-PORT-REF DEST="P-PORT-PROTOTYPE">/AUTOSAR_ComM/[!"$swComponentTypePackageName"!]/ComM/CW_[!"as:name(.)"!]</CONTEXT-P-PORT-REF>
                        <TARGET-PROVIDED-OPERATION-REF DEST="CLIENT-SERVER-OPERATION">/AUTOSAR_ComM/PortInterfaces/ComM_ChannelWakeup/PreventWakeUp</TARGET-PROVIDED-OPERATION-REF>
                      </OPERATION-IREF>
                    </OPERATION-INVOKED-EVENT>
                    <OPERATION-INVOKED-EVENT>
                      <SHORT-NAME>EV_GetInhibitionStatus_ChannelWakeup_[!"as:name(.)"!]</SHORT-NAME>
                      <START-ON-EVENT-REF DEST="RUNNABLE-ENTITY">/AUTOSAR_ComM/[!"$swComponentTypePackageName"!]/ComM/SwcInternalBehavior_0/RE_GetInhibitionStatus</START-ON-EVENT-REF>
                      <OPERATION-IREF>
                        <CONTEXT-P-PORT-REF DEST="P-PORT-PROTOTYPE">/AUTOSAR_ComM/[!"$swComponentTypePackageName"!]/ComM/CW_[!"as:name(.)"!]</CONTEXT-P-PORT-REF>
                        <TARGET-PROVIDED-OPERATION-REF DEST="CLIENT-SERVER-OPERATION">/AUTOSAR_ComM/PortInterfaces/ComM_ChannelWakeup/GetInhibitionStatus</TARGET-PROVIDED-OPERATION-REF>
                      </OPERATION-IREF>
                    </OPERATION-INVOKED-EVENT>
[!ENDLOOP!]
[!ENDIF!]
                    <!-- Standard events -->
[!LOOP "ComMConfigSet/*[1]/ComMUser/*"!]
                    <OPERATION-INVOKED-EVENT>
                      <SHORT-NAME>EV_RequestComMode_[!"as:name(.)"!]</SHORT-NAME>
                      <START-ON-EVENT-REF DEST="RUNNABLE-ENTITY">/AUTOSAR_ComM/[!"$swComponentTypePackageName"!]/ComM/SwcInternalBehavior_0/RE_RequestComMode</START-ON-EVENT-REF>
                      <OPERATION-IREF>
                        <CONTEXT-P-PORT-REF DEST="P-PORT-PROTOTYPE">/AUTOSAR_ComM/[!"$swComponentTypePackageName"!]/ComM/UR_[!"as:name(.)"!]</CONTEXT-P-PORT-REF>
                        <TARGET-PROVIDED-OPERATION-REF DEST="CLIENT-SERVER-OPERATION">/AUTOSAR_ComM/PortInterfaces/ComM_UserRequest/RequestComMode</TARGET-PROVIDED-OPERATION-REF>
                      </OPERATION-IREF>
                    </OPERATION-INVOKED-EVENT>
                    <OPERATION-INVOKED-EVENT>
                      <SHORT-NAME>EV_GetCurrentComMode_[!"as:name(.)"!]</SHORT-NAME>
                      <START-ON-EVENT-REF DEST="RUNNABLE-ENTITY">/AUTOSAR_ComM/[!"$swComponentTypePackageName"!]/ComM/SwcInternalBehavior_0/RE_GetCurrentComMode</START-ON-EVENT-REF>
                      <OPERATION-IREF>
                        <CONTEXT-P-PORT-REF DEST="P-PORT-PROTOTYPE">/AUTOSAR_ComM/[!"$swComponentTypePackageName"!]/ComM/UR_[!"as:name(.)"!]</CONTEXT-P-PORT-REF>
                        <TARGET-PROVIDED-OPERATION-REF DEST="CLIENT-SERVER-OPERATION">/AUTOSAR_ComM/PortInterfaces/ComM_UserRequest/GetCurrentComMode</TARGET-PROVIDED-OPERATION-REF>
                      </OPERATION-IREF>
                    </OPERATION-INVOKED-EVENT>
[!IF "../../../../ComMGeneral/ComMServiceAPI/ComMDefaultASRServiceAPI = 'AUTOSAR_40'"!]
[!IF "as:modconf('ComM')[1]/ComMGeneral/ComMEnableGetCurrentPNCComMode = 'true'"!]
                    <OPERATION-INVOKED-EVENT>
                      <SHORT-NAME>EV_GetCurrentPNCComMode_[!"as:name(.)"!]</SHORT-NAME>
                      <START-ON-EVENT-REF DEST="RUNNABLE-ENTITY">/AUTOSAR_ComM/[!"$swComponentTypePackageName"!]/ComM/SwcInternalBehavior_0/RE_GetCurrentPNCComMode</START-ON-EVENT-REF>
                      <OPERATION-IREF>
                        <CONTEXT-P-PORT-REF DEST="P-PORT-PROTOTYPE">/AUTOSAR_ComM/[!"$swComponentTypePackageName"!]/ComM/UR_[!"as:name(.)"!]</CONTEXT-P-PORT-REF>
                        <TARGET-PROVIDED-OPERATION-REF DEST="CLIENT-SERVER-OPERATION">/AUTOSAR_ComM/PortInterfaces/ComM_UserRequest/GetCurrentPNCComMode</TARGET-PROVIDED-OPERATION-REF>
                      </OPERATION-IREF>
                    </OPERATION-INVOKED-EVENT>
[!ENDIF!]
[!ENDIF!]
                    <OPERATION-INVOKED-EVENT>
                      <SHORT-NAME>EV_GetMaxComMode_[!"as:name(.)"!]</SHORT-NAME>
                      <START-ON-EVENT-REF DEST="RUNNABLE-ENTITY">/AUTOSAR_ComM/[!"$swComponentTypePackageName"!]/ComM/SwcInternalBehavior_0/RE_GetMaxComMode</START-ON-EVENT-REF>
                      <OPERATION-IREF>
                        <CONTEXT-P-PORT-REF DEST="P-PORT-PROTOTYPE">/AUTOSAR_ComM/[!"$swComponentTypePackageName"!]/ComM/UR_[!"as:name(.)"!]</CONTEXT-P-PORT-REF>
                        <TARGET-PROVIDED-OPERATION-REF DEST="CLIENT-SERVER-OPERATION">/AUTOSAR_ComM/PortInterfaces/ComM_UserRequest/GetMaxComMode</TARGET-PROVIDED-OPERATION-REF>
                      </OPERATION-IREF>
                    </OPERATION-INVOKED-EVENT>
[!IF "../../../../ComMGeneral/ComMServiceAPI/ComMDefaultASRServiceAPI = 'AUTOSAR_32'"!]
                    <OPERATION-INVOKED-EVENT>
                      <SHORT-NAME>EV_GetRequestedMode_[!"as:name(.)"!]</SHORT-NAME>
                      <START-ON-EVENT-REF DEST="RUNNABLE-ENTITY">/AUTOSAR_ComM/[!"$swComponentTypePackageName"!]/ComM/SwcInternalBehavior_0/[!"$ReRequestedComModeName"!]</START-ON-EVENT-REF>
                      <OPERATION-IREF>
                        <CONTEXT-P-PORT-REF DEST="P-PORT-PROTOTYPE">/AUTOSAR_ComM/[!"$swComponentTypePackageName"!]/ComM/UR_[!"as:name(.)"!]</CONTEXT-P-PORT-REF>
                        <TARGET-PROVIDED-OPERATION-REF DEST="CLIENT-SERVER-OPERATION">/AUTOSAR_ComM/PortInterfaces/ComM_UserRequest/GetRequestedMode</TARGET-PROVIDED-OPERATION-REF>
                      </OPERATION-IREF>
                    </OPERATION-INVOKED-EVENT>
[!ELSE!][!//
                    <OPERATION-INVOKED-EVENT>
                      <SHORT-NAME>EV_GetRequestedComMode_[!"as:name(.)"!]</SHORT-NAME>
                      <START-ON-EVENT-REF DEST="RUNNABLE-ENTITY">/AUTOSAR_ComM/[!"$swComponentTypePackageName"!]/ComM/SwcInternalBehavior_0/[!"$ReRequestedComModeName"!]</START-ON-EVENT-REF>
                      <OPERATION-IREF>
                        <CONTEXT-P-PORT-REF DEST="P-PORT-PROTOTYPE">/AUTOSAR_ComM/[!"$swComponentTypePackageName"!]/ComM/UR_[!"as:name(.)"!]</CONTEXT-P-PORT-REF>
                        <TARGET-PROVIDED-OPERATION-REF DEST="CLIENT-SERVER-OPERATION">/AUTOSAR_ComM/PortInterfaces/ComM_UserRequest/GetRequestedComMode</TARGET-PROVIDED-OPERATION-REF>
                      </OPERATION-IREF>
                    </OPERATION-INVOKED-EVENT>
[!ENDIF!]
[!ENDLOOP!]
[!ENDIF!]
                  </EVENTS>
                  <HANDLE-TERMINATION-AND-RESTART>NO-SUPPORT</HANDLE-TERMINATION-AND-RESTART>
[!IF "count(as:modconf('ComM')[1]/ComMConfigSet/*/ComMUser/*) = 0"!]
                  <INCLUDED-DATA-TYPE-SETS>
[!IF "ComMGeneral/ComMServiceAPI/ComMEnableASR32ServiceAPI = 'true'"!]
                  	<INCLUDED-DATA-TYPE-SET>
                      <DATA-TYPE-REFS>
                        <DATA-TYPE-REF DEST="IMPLEMENTATION-DATA-TYPE">/AUTOSAR_ComM/ASR32/ImplementationDataTypes/ComM_ASR32_ModeType</DATA-TYPE-REF>
                      </DATA-TYPE-REFS>
                    </INCLUDED-DATA-TYPE-SET>
[!ENDIF!]
[!IF "ComMGeneral/ComMServiceAPI/ComMEnableASR40ServiceAPI = 'true'"!]
                  	<INCLUDED-DATA-TYPE-SET>
                      <DATA-TYPE-REFS>
                        <DATA-TYPE-REF DEST="IMPLEMENTATION-DATA-TYPE">/AUTOSAR_ComM/ASR40/ImplementationDataTypes/ComM_ASR40_ModeType</DATA-TYPE-REF>
                      </DATA-TYPE-REFS>
                    </INCLUDED-DATA-TYPE-SET>
[!ENDIF!]
[!IF "ComMGeneral/ComMServiceAPI/ComMDefaultASRServiceAPI != 'NONE'"!]
                  	<INCLUDED-DATA-TYPE-SET>
                      <DATA-TYPE-REFS>
                        <DATA-TYPE-REF DEST="IMPLEMENTATION-DATA-TYPE">/AUTOSAR_ComM/ImplementationDataTypes/ComM_ModeType</DATA-TYPE-REF>
                      </DATA-TYPE-REFS>
                    </INCLUDED-DATA-TYPE-SET>
[!ENDIF!]
                  </INCLUDED-DATA-TYPE-SETS>
[!ENDIF!]
                  <PORT-API-OPTIONS>
[!IF "ComMGeneral/ComMServiceAPI/ComMEnableASR32ServiceAPI = 'true'"!]
<!-- Port API options for AUTOSAR 3.2 -->
[!LOOP "ComMConfigSet/*[1]/ComMUser/*"!]
                    <!-- UM-port [!"as:name(.)"!], switch functions must be accessible via function pointer -->
                    <PORT-API-OPTION>
                      <ENABLE-TAKE-ADDRESS>true</ENABLE-TAKE-ADDRESS>
                      <INDIRECT-API>false</INDIRECT-API>
                      <PORT-REF DEST="P-PORT-PROTOTYPE">/AUTOSAR_ComM/[!"$swComponentTypePackageName"!]/ComM/UM_ASR32_[!"as:name(.)"!]</PORT-REF>
                    </PORT-API-OPTION>
                    <!-- UR-port [!"as:name(.)"!]: Port defined argument values + no indirect API -->
                    <PORT-API-OPTION>
                      <ENABLE-TAKE-ADDRESS>false</ENABLE-TAKE-ADDRESS>
                      <INDIRECT-API>false</INDIRECT-API>
                      <PORT-ARG-VALUES>
                        <PORT-DEFINED-ARGUMENT-VALUE>
                          <VALUE>
                            <NUMERICAL-VALUE-SPECIFICATION>
                              <VALUE>[!"num:integer(ComMUserIdentifier)"!]</VALUE>
                            </NUMERICAL-VALUE-SPECIFICATION>
                          </VALUE>
                          <VALUE-TYPE-TREF DEST="IMPLEMENTATION-DATA-TYPE">/AUTOSAR_Platform/ImplementationDataTypes/uint8</VALUE-TYPE-TREF>
                        </PORT-DEFINED-ARGUMENT-VALUE>
                      </PORT-ARG-VALUES>
                      <PORT-REF DEST="P-PORT-PROTOTYPE">/AUTOSAR_ComM/[!"$swComponentTypePackageName"!]/ComM/UR_ASR32_[!"as:name(.)"!]</PORT-REF>
                    </PORT-API-OPTION>
[!ENDLOOP!]
[!IF "ComMGeneral/ComMWakeupInhibitionEnabled = 'true'"!]
[!LOOP "ComMConfigSet/*[1]/ComMChannel/*"!]
                    <!-- CW-port [!"as:name(.)"!] -->
                    <PORT-API-OPTION>
                      <ENABLE-TAKE-ADDRESS>false</ENABLE-TAKE-ADDRESS>
                      <INDIRECT-API>false</INDIRECT-API>
                      <PORT-ARG-VALUES>
                        <PORT-DEFINED-ARGUMENT-VALUE>
                          <VALUE>
                            <NUMERICAL-VALUE-SPECIFICATION>
                              <VALUE>[!"num:integer(ComMChannelId)"!]</VALUE>
                            </NUMERICAL-VALUE-SPECIFICATION>
                          </VALUE>
                          <VALUE-TYPE-TREF DEST="IMPLEMENTATION-DATA-TYPE">/AUTOSAR_Platform/ImplementationDataTypes/uint8</VALUE-TYPE-TREF>
                        </PORT-DEFINED-ARGUMENT-VALUE>
                      </PORT-ARG-VALUES>
                      <PORT-REF DEST="P-PORT-PROTOTYPE">/AUTOSAR_ComM/[!"$swComponentTypePackageName"!]/ComM/CW_ASR32_[!"as:name(.)"!]</PORT-REF>
                    </PORT-API-OPTION>
[!ENDLOOP!]
[!ENDIF!]
[!IF "ComMGeneral/ComMModeLimitationEnabled = 'true'"!]
[!LOOP "ComMConfigSet/*[1]/ComMChannel/*"!]
                    <!-- CL-port [!"as:name(.)"!] -->
                    <PORT-API-OPTION>
                      <ENABLE-TAKE-ADDRESS>false</ENABLE-TAKE-ADDRESS>
                      <INDIRECT-API>false</INDIRECT-API>
                      <PORT-ARG-VALUES>
                        <PORT-DEFINED-ARGUMENT-VALUE>
                          <VALUE>
                            <NUMERICAL-VALUE-SPECIFICATION>
                              <VALUE>[!"num:integer(ComMChannelId)"!]</VALUE>
                            </NUMERICAL-VALUE-SPECIFICATION>
                          </VALUE>
                          <VALUE-TYPE-TREF DEST="IMPLEMENTATION-DATA-TYPE">/AUTOSAR_Platform/ImplementationDataTypes/uint8</VALUE-TYPE-TREF>
                        </PORT-DEFINED-ARGUMENT-VALUE>
                      </PORT-ARG-VALUES>
                      <PORT-REF DEST="P-PORT-PROTOTYPE">/AUTOSAR_ComM/[!"$swComponentTypePackageName"!]/ComM/CL_ASR32_[!"as:name(.)"!]</PORT-REF>
                    </PORT-API-OPTION>
[!ENDLOOP!]
[!ENDIF!]
[!ENDIF!]
[!IF "ComMGeneral/ComMServiceAPI/ComMEnableASR40ServiceAPI = 'true'"!]
<!-- Port API options for AUTOSAR 4.0 -->
[!LOOP "ComMConfigSet/*[1]/ComMUser/*"!]
                    <!-- UM-port [!"as:name(.)"!], switch functions must be accessible via function pointer -->
                    <PORT-API-OPTION>
                      <ENABLE-TAKE-ADDRESS>true</ENABLE-TAKE-ADDRESS>
                      <INDIRECT-API>false</INDIRECT-API>
                      <PORT-REF DEST="P-PORT-PROTOTYPE">/AUTOSAR_ComM/[!"$swComponentTypePackageName"!]/ComM/UM_ASR40_[!"as:name(.)"!]</PORT-REF>
                    </PORT-API-OPTION>
                    <!-- UR-port [!"as:name(.)"!]: Port defined argument values + no indirect API -->
                    <PORT-API-OPTION>
                      <ENABLE-TAKE-ADDRESS>false</ENABLE-TAKE-ADDRESS>
                      <INDIRECT-API>false</INDIRECT-API>
                      <PORT-ARG-VALUES>
                        <PORT-DEFINED-ARGUMENT-VALUE>
                          <VALUE>
                            <NUMERICAL-VALUE-SPECIFICATION>
                              <VALUE>[!"num:integer(ComMUserIdentifier)"!]</VALUE>
                            </NUMERICAL-VALUE-SPECIFICATION>
                          </VALUE>
                          <VALUE-TYPE-TREF DEST="IMPLEMENTATION-DATA-TYPE">/AUTOSAR_ComM/ASR40/ImplementationDataTypes/ComM_ASR40_UserHandleType</VALUE-TYPE-TREF>
                        </PORT-DEFINED-ARGUMENT-VALUE>
                      </PORT-ARG-VALUES>
                      <PORT-REF DEST="P-PORT-PROTOTYPE">/AUTOSAR_ComM/[!"$swComponentTypePackageName"!]/ComM/UR_ASR40_[!"as:name(.)"!]</PORT-REF>
                    </PORT-API-OPTION>
[!ENDLOOP!]
[!LOOP "ComMConfigSet/*[1]/ComMChannel/*[ComMFullCommRequestNotificationEnabled = 'true']"!]
                    <!-- CR-port [!"as:name(.)"!], write functions must be accessible via function pointer -->
                    <PORT-API-OPTION>
                      <ENABLE-TAKE-ADDRESS>true</ENABLE-TAKE-ADDRESS>
                      <INDIRECT-API>false</INDIRECT-API>
                      <PORT-REF DEST="P-PORT-PROTOTYPE">/AUTOSAR_ComM/[!"$swComponentTypePackageName"!]/ComM/CR_ASR40_[!"as:name(.)"!]</PORT-REF>
                    </PORT-API-OPTION>
[!ENDLOOP!]
[!IF "ComMGeneral/ComMWakeupInhibitionEnabled = 'true'"!]
[!LOOP "ComMConfigSet/*[1]/ComMChannel/*"!]
                    <!-- CW-port [!"as:name(.)"!] -->
                    <PORT-API-OPTION>
                      <ENABLE-TAKE-ADDRESS>false</ENABLE-TAKE-ADDRESS>
                      <INDIRECT-API>false</INDIRECT-API>
                      <PORT-ARG-VALUES>
                        <PORT-DEFINED-ARGUMENT-VALUE>
                          <VALUE>
                            <NUMERICAL-VALUE-SPECIFICATION>
                              <VALUE>[!"num:integer(ComMChannelId)"!]</VALUE>
                            </NUMERICAL-VALUE-SPECIFICATION>
                          </VALUE>
                          <VALUE-TYPE-TREF DEST="IMPLEMENTATION-DATA-TYPE">/AUTOSAR_ComM/ASR40/ImplementationDataTypes/ComM_ASR40_UserHandleType</VALUE-TYPE-TREF>
                        </PORT-DEFINED-ARGUMENT-VALUE>
                      </PORT-ARG-VALUES>
                      <PORT-REF DEST="P-PORT-PROTOTYPE">/AUTOSAR_ComM/[!"$swComponentTypePackageName"!]/ComM/CW_ASR40_[!"as:name(.)"!]</PORT-REF>
                    </PORT-API-OPTION>
[!ENDLOOP!]
[!ENDIF!]
[!IF "ComMGeneral/ComMModeLimitationEnabled = 'true'"!]
[!LOOP "ComMConfigSet/*[1]/ComMChannel/*"!]
                    <!-- CL-port [!"as:name(.)"!] -->
                    <PORT-API-OPTION>
                      <ENABLE-TAKE-ADDRESS>false</ENABLE-TAKE-ADDRESS>
                      <INDIRECT-API>false</INDIRECT-API>
                      <PORT-ARG-VALUES>
                        <PORT-DEFINED-ARGUMENT-VALUE>
                          <VALUE>
                            <NUMERICAL-VALUE-SPECIFICATION>
                              <VALUE>[!"num:integer(ComMChannelId)"!]</VALUE>
                            </NUMERICAL-VALUE-SPECIFICATION>
                          </VALUE>
                          <VALUE-TYPE-TREF DEST="IMPLEMENTATION-DATA-TYPE">/AUTOSAR_ComM/ASR40/ImplementationDataTypes/ComM_ASR40_UserHandleType</VALUE-TYPE-TREF>
                        </PORT-DEFINED-ARGUMENT-VALUE>
                      </PORT-ARG-VALUES>
                      <PORT-REF DEST="P-PORT-PROTOTYPE">/AUTOSAR_ComM/[!"$swComponentTypePackageName"!]/ComM/CL_ASR40_[!"as:name(.)"!]</PORT-REF>
                    </PORT-API-OPTION>
[!ENDLOOP!]
[!ENDIF!]
[!ENDIF!]
[!IF "ComMGeneral/ComMServiceAPI/ComMDefaultASRServiceAPI != 'NONE'"!]
                    <!-- Port API options for default AUTOSAR version -->
[!LOOP "ComMConfigSet/*[1]/ComMUser/*"!]
                    <!-- UM-port [!"as:name(.)"!], switch functions must be accessible via function pointer -->
                    <PORT-API-OPTION>
                      <ENABLE-TAKE-ADDRESS>true</ENABLE-TAKE-ADDRESS>
                      <INDIRECT-API>false</INDIRECT-API>
                      <PORT-REF DEST="P-PORT-PROTOTYPE">/AUTOSAR_ComM/[!"$swComponentTypePackageName"!]/ComM/UM_[!"as:name(.)"!]</PORT-REF>
                    </PORT-API-OPTION>
                    <!-- UR-port [!"as:name(.)"!]: Port defined argument values + no indirect API -->
                    <PORT-API-OPTION>
                      <ENABLE-TAKE-ADDRESS>false</ENABLE-TAKE-ADDRESS>
                      <INDIRECT-API>false</INDIRECT-API>
                      <PORT-ARG-VALUES>
                        <PORT-DEFINED-ARGUMENT-VALUE>
                          <VALUE>
                            <NUMERICAL-VALUE-SPECIFICATION>
                              <VALUE>[!"num:integer(ComMUserIdentifier)"!]</VALUE>
                            </NUMERICAL-VALUE-SPECIFICATION>
                          </VALUE>
[!IF "../../../../ComMGeneral/ComMServiceAPI/ComMDefaultASRServiceAPI = 'AUTOSAR_32'"!][!//
                          <VALUE-TYPE-TREF DEST="IMPLEMENTATION-DATA-TYPE">/AUTOSAR_Platform/ImplementationDataTypes/uint8</VALUE-TYPE-TREF>
[!ELSE!][!//
                          <VALUE-TYPE-TREF DEST="IMPLEMENTATION-DATA-TYPE">/AUTOSAR_ComM/ImplementationDataTypes/ComM_UserHandleType</VALUE-TYPE-TREF>
[!ENDIF!]
                        </PORT-DEFINED-ARGUMENT-VALUE>
                      </PORT-ARG-VALUES>
                      <PORT-REF DEST="P-PORT-PROTOTYPE">/AUTOSAR_ComM/[!"$swComponentTypePackageName"!]/ComM/UR_[!"as:name(.)"!]</PORT-REF>
                    </PORT-API-OPTION>
[!ENDLOOP!]
[!IF "ComMGeneral/ComMServiceAPI/ComMDefaultASRServiceAPI = 'AUTOSAR_40'"!]
[!LOOP "ComMConfigSet/*[1]/ComMChannel/*[ComMFullCommRequestNotificationEnabled = 'true']"!]
                    <!-- CR-port [!"as:name(.)"!], write functions must be accessible via function pointer -->
                    <PORT-API-OPTION>
                      <ENABLE-TAKE-ADDRESS>true</ENABLE-TAKE-ADDRESS>
                      <INDIRECT-API>false</INDIRECT-API>
                      <PORT-REF DEST="P-PORT-PROTOTYPE">/AUTOSAR_ComM/[!"$swComponentTypePackageName"!]/ComM/CR_[!"as:name(.)"!]</PORT-REF>
                    </PORT-API-OPTION>
[!ENDLOOP!]
[!ENDIF!]
[!IF "ComMGeneral/ComMWakeupInhibitionEnabled = 'true'"!]
[!LOOP "ComMConfigSet/*[1]/ComMChannel/*"!]
                    <!-- CW-port [!"as:name(.)"!] -->
                    <PORT-API-OPTION>
                      <ENABLE-TAKE-ADDRESS>false</ENABLE-TAKE-ADDRESS>
                      <INDIRECT-API>false</INDIRECT-API>
                      <PORT-ARG-VALUES>
                        <PORT-DEFINED-ARGUMENT-VALUE>
                          <VALUE>
                            <NUMERICAL-VALUE-SPECIFICATION>
                              <VALUE>[!"num:integer(ComMChannelId)"!]</VALUE>
                            </NUMERICAL-VALUE-SPECIFICATION>
                          </VALUE>
[!IF "../../../../ComMGeneral/ComMServiceAPI/ComMDefaultASRServiceAPI = 'AUTOSAR_32'"!][!//
                          <VALUE-TYPE-TREF DEST="IMPLEMENTATION-DATA-TYPE">/AUTOSAR_Platform/ImplementationDataTypes/uint8</VALUE-TYPE-TREF>
[!ELSE!][!//
                          <VALUE-TYPE-TREF DEST="IMPLEMENTATION-DATA-TYPE">/AUTOSAR_ComM/ImplementationDataTypes/ComM_UserHandleType</VALUE-TYPE-TREF>
[!ENDIF!]
                        </PORT-DEFINED-ARGUMENT-VALUE>
                      </PORT-ARG-VALUES>
                      <PORT-REF DEST="P-PORT-PROTOTYPE">/AUTOSAR_ComM/[!"$swComponentTypePackageName"!]/ComM/CW_[!"as:name(.)"!]</PORT-REF>
                    </PORT-API-OPTION>
[!ENDLOOP!]
[!ENDIF!]
[!IF "ComMGeneral/ComMModeLimitationEnabled = 'true'"!]
[!LOOP "ComMConfigSet/*[1]/ComMChannel/*"!]
                    <!-- CL-port [!"as:name(.)"!] -->
                    <PORT-API-OPTION>
                      <ENABLE-TAKE-ADDRESS>false</ENABLE-TAKE-ADDRESS>
                      <INDIRECT-API>false</INDIRECT-API>
                      <PORT-ARG-VALUES>
                        <PORT-DEFINED-ARGUMENT-VALUE>
                          <VALUE>
                            <NUMERICAL-VALUE-SPECIFICATION>
                              <VALUE>[!"num:integer(ComMChannelId)"!]</VALUE>
                            </NUMERICAL-VALUE-SPECIFICATION>
                          </VALUE>
[!IF "../../../../ComMGeneral/ComMServiceAPI/ComMDefaultASRServiceAPI = 'AUTOSAR_32'"!][!//
                          <VALUE-TYPE-TREF DEST="IMPLEMENTATION-DATA-TYPE">/AUTOSAR_Platform/ImplementationDataTypes/uint8</VALUE-TYPE-TREF>
[!ELSE!][!//
                          <VALUE-TYPE-TREF DEST="IMPLEMENTATION-DATA-TYPE">/AUTOSAR_ComM/ImplementationDataTypes/ComM_UserHandleType</VALUE-TYPE-TREF>
[!ENDIF!]
                        </PORT-DEFINED-ARGUMENT-VALUE>
                      </PORT-ARG-VALUES>
                      <PORT-REF DEST="P-PORT-PROTOTYPE">/AUTOSAR_ComM/[!"$swComponentTypePackageName"!]/ComM/CL_[!"as:name(.)"!]</PORT-REF>
                    </PORT-API-OPTION>
[!ENDLOOP!]
[!ENDIF!]
[!ENDIF!]
                  </PORT-API-OPTIONS>
                  <RUNNABLES>
                    <!-- Standard runnables -->
[!IF "ComMGeneral/ComMServiceAPI/ComMEnableASR32ServiceAPI = 'true'"!]
[!IF "count(as:modconf('ComM')[1]/ComMConfigSet/*/ComMUser/*) != 0"!]
                    <RUNNABLE-ENTITY>
                      <SHORT-NAME>RE_ASR32_RequestComMode</SHORT-NAME>
                      <MINIMUM-START-INTERVAL>0</MINIMUM-START-INTERVAL>
                      <ARGUMENTS>
                        <RUNNABLE-ENTITY-ARGUMENT>
                          <SYMBOL>pdav0</SYMBOL>
                        </RUNNABLE-ENTITY-ARGUMENT>
                        <RUNNABLE-ENTITY-ARGUMENT>
                          <SYMBOL>ComMode</SYMBOL>
                        </RUNNABLE-ENTITY-ARGUMENT>
                      </ARGUMENTS>
                      <CAN-BE-INVOKED-CONCURRENTLY>true</CAN-BE-INVOKED-CONCURRENTLY>
                      <SYMBOL>ComM_ASR32_Rte_RequestComMode</SYMBOL>
                    </RUNNABLE-ENTITY>
                    <RUNNABLE-ENTITY>
                      <SHORT-NAME>RE_ASR32_GetCurrentComMode</SHORT-NAME>
                      <MINIMUM-START-INTERVAL>0</MINIMUM-START-INTERVAL>
                      <ARGUMENTS>
                        <RUNNABLE-ENTITY-ARGUMENT>
                          <SYMBOL>pdav0</SYMBOL>
                        </RUNNABLE-ENTITY-ARGUMENT>
                        <RUNNABLE-ENTITY-ARGUMENT>
                          <SYMBOL>ComMode</SYMBOL>
                        </RUNNABLE-ENTITY-ARGUMENT>
                      </ARGUMENTS>
                      <CAN-BE-INVOKED-CONCURRENTLY>true</CAN-BE-INVOKED-CONCURRENTLY>
                      <SYMBOL>ComM_ASR32_Rte_GetCurrentComMode</SYMBOL>
                    </RUNNABLE-ENTITY>
                    <RUNNABLE-ENTITY>
                      <SHORT-NAME>RE_ASR32_GetMaxComMode</SHORT-NAME>
                      <MINIMUM-START-INTERVAL>0</MINIMUM-START-INTERVAL>
                      <ARGUMENTS>
                        <RUNNABLE-ENTITY-ARGUMENT>
                          <SYMBOL>pdav0</SYMBOL>
                        </RUNNABLE-ENTITY-ARGUMENT>
                        <RUNNABLE-ENTITY-ARGUMENT>
                          <SYMBOL>ComMode</SYMBOL>
                        </RUNNABLE-ENTITY-ARGUMENT>
                      </ARGUMENTS>
                      <CAN-BE-INVOKED-CONCURRENTLY>true</CAN-BE-INVOKED-CONCURRENTLY>
                      <SYMBOL>ComM_ASR32_Rte_GetMaxComMode</SYMBOL>
                    </RUNNABLE-ENTITY>
                    <RUNNABLE-ENTITY>
                      <SHORT-NAME>RE_ASR32_GetRequestedMode</SHORT-NAME>
                      <MINIMUM-START-INTERVAL>0</MINIMUM-START-INTERVAL>
                      <ARGUMENTS>
                        <RUNNABLE-ENTITY-ARGUMENT>
                          <SYMBOL>pdav0</SYMBOL>
                        </RUNNABLE-ENTITY-ARGUMENT>
                        <RUNNABLE-ENTITY-ARGUMENT>
                          <SYMBOL>ComMode</SYMBOL>
                        </RUNNABLE-ENTITY-ARGUMENT>
                      </ARGUMENTS>
                      <CAN-BE-INVOKED-CONCURRENTLY>true</CAN-BE-INVOKED-CONCURRENTLY>
                      <SYMBOL>ComM_ASR32_Rte_GetRequestedMode</SYMBOL>
                    </RUNNABLE-ENTITY>
[!ENDIF!]
[!IF "ComMGeneral/ComMModeLimitationEnabled = 'true'"!]
                    <!-- Conditionally existing runnables for interface ComM_ECUModeLimitation -->
                    <RUNNABLE-ENTITY>
                      <SHORT-NAME>RE_ASR32_LimitECUToNoComMode</SHORT-NAME>
                      <MINIMUM-START-INTERVAL>0</MINIMUM-START-INTERVAL>
                      <CAN-BE-INVOKED-CONCURRENTLY>true</CAN-BE-INVOKED-CONCURRENTLY>
                      <SYMBOL>ComM_ASR32_Rte_LimitECUToNoComMode</SYMBOL>
                    </RUNNABLE-ENTITY>
                    <RUNNABLE-ENTITY>
                      <SHORT-NAME>RE_ASR32_ReadInhibitCounter</SHORT-NAME>
                      <MINIMUM-START-INTERVAL>0</MINIMUM-START-INTERVAL>
                      <CAN-BE-INVOKED-CONCURRENTLY>true</CAN-BE-INVOKED-CONCURRENTLY>
                      <SYMBOL>ComM_ASR32_Rte_ReadInhibitCounter</SYMBOL>
                    </RUNNABLE-ENTITY>
                    <RUNNABLE-ENTITY>
                      <SHORT-NAME>RE_ASR32_ResetInhibitCounter</SHORT-NAME>
                      <MINIMUM-START-INTERVAL>0</MINIMUM-START-INTERVAL>
                      <CAN-BE-INVOKED-CONCURRENTLY>true</CAN-BE-INVOKED-CONCURRENTLY>
                      <SYMBOL>ComM_ASR32_Rte_ResetInhibitCounter</SYMBOL>
                    </RUNNABLE-ENTITY>
                    <RUNNABLE-ENTITY>
                      <SHORT-NAME>RE_ASR32_SetECUGroupClassification</SHORT-NAME>
                      <MINIMUM-START-INTERVAL>0</MINIMUM-START-INTERVAL>
                      <CAN-BE-INVOKED-CONCURRENTLY>true</CAN-BE-INVOKED-CONCURRENTLY>
                      <SYMBOL>ComM_ASR32_Rte_SetECUGroupClassification</SYMBOL>
                    </RUNNABLE-ENTITY>
                    <!-- Conditionally existing runnables for interface ComM_ChannelLimitation -->
                    <RUNNABLE-ENTITY>
                      <SHORT-NAME>RE_ASR32_LimitChannelToNoComMode</SHORT-NAME>
                      <MINIMUM-START-INTERVAL>0</MINIMUM-START-INTERVAL>
                      <ARGUMENTS>
                        <RUNNABLE-ENTITY-ARGUMENT>
                          <SYMBOL>pdav0</SYMBOL>
                        </RUNNABLE-ENTITY-ARGUMENT>
                        <RUNNABLE-ENTITY-ARGUMENT>
                          <SYMBOL>Status</SYMBOL>
                        </RUNNABLE-ENTITY-ARGUMENT>
                      </ARGUMENTS>
                      <CAN-BE-INVOKED-CONCURRENTLY>true</CAN-BE-INVOKED-CONCURRENTLY>
                      <SYMBOL>ComM_ASR32_Rte_LimitChannelToNoComMode</SYMBOL>
                    </RUNNABLE-ENTITY>
                    <RUNNABLE-ENTITY>
                      <SHORT-NAME>RE_ASR32_GetInhibitionStatus</SHORT-NAME>
                      <MINIMUM-START-INTERVAL>0</MINIMUM-START-INTERVAL>
                      <ARGUMENTS>
                        <RUNNABLE-ENTITY-ARGUMENT>
                          <SYMBOL>pdav0</SYMBOL>
                        </RUNNABLE-ENTITY-ARGUMENT>
                        <RUNNABLE-ENTITY-ARGUMENT>
                          <SYMBOL>Status</SYMBOL>
                        </RUNNABLE-ENTITY-ARGUMENT>
                      </ARGUMENTS>
                      <CAN-BE-INVOKED-CONCURRENTLY>true</CAN-BE-INVOKED-CONCURRENTLY>
                      <SYMBOL>ComM_ASR32_Rte_GetInhibitionStatus</SYMBOL>
                    </RUNNABLE-ENTITY>
[!ENDIF!]
[!IF "ComMGeneral/ComMWakeupInhibitionEnabled = 'true'"!]
                    <!-- Conditionally existing runnables for interface ComM_ChannelWakeup -->
                    <RUNNABLE-ENTITY>
                      <SHORT-NAME>RE_ASR32_PreventWakeUp</SHORT-NAME>
                      <MINIMUM-START-INTERVAL>0</MINIMUM-START-INTERVAL>
                      <ARGUMENTS>
                        <RUNNABLE-ENTITY-ARGUMENT>
                          <SYMBOL>pdav0</SYMBOL>
                        </RUNNABLE-ENTITY-ARGUMENT>
                        <RUNNABLE-ENTITY-ARGUMENT>
                          <SYMBOL>Status</SYMBOL>
                        </RUNNABLE-ENTITY-ARGUMENT>
                      </ARGUMENTS>
                      <CAN-BE-INVOKED-CONCURRENTLY>true</CAN-BE-INVOKED-CONCURRENTLY>
                      <SYMBOL>ComM_ASR32_Rte_PreventWakeUp</SYMBOL>
                    </RUNNABLE-ENTITY>
[!ENDIF!]
[!ENDIF!]
[!IF "ComMGeneral/ComMServiceAPI/ComMEnableASR40ServiceAPI = 'true'"!]
[!IF "count(as:modconf('ComM')[1]/ComMConfigSet/*/ComMUser/*) != 0"!]
                    <RUNNABLE-ENTITY>
                      <SHORT-NAME>RE_ASR40_RequestComMode</SHORT-NAME>
                      <MINIMUM-START-INTERVAL>0</MINIMUM-START-INTERVAL>
                      <ARGUMENTS>
                        <RUNNABLE-ENTITY-ARGUMENT>
                          <SYMBOL>pdav0</SYMBOL>
                        </RUNNABLE-ENTITY-ARGUMENT>
                        <RUNNABLE-ENTITY-ARGUMENT>
                          <SYMBOL>ComMode</SYMBOL>
                        </RUNNABLE-ENTITY-ARGUMENT>
                      </ARGUMENTS>
                      <CAN-BE-INVOKED-CONCURRENTLY>true</CAN-BE-INVOKED-CONCURRENTLY>
                      <SYMBOL>ComM_ASR40_Rte_RequestComMode</SYMBOL>
                    </RUNNABLE-ENTITY>
                    <RUNNABLE-ENTITY>
                      <SHORT-NAME>RE_ASR40_GetCurrentComMode</SHORT-NAME>
                      <MINIMUM-START-INTERVAL>0</MINIMUM-START-INTERVAL>
                      <ARGUMENTS>
                        <RUNNABLE-ENTITY-ARGUMENT>
                          <SYMBOL>pdav0</SYMBOL>
                        </RUNNABLE-ENTITY-ARGUMENT>
                        <RUNNABLE-ENTITY-ARGUMENT>
                          <SYMBOL>ComMode</SYMBOL>
                        </RUNNABLE-ENTITY-ARGUMENT>
                      </ARGUMENTS>
                      <CAN-BE-INVOKED-CONCURRENTLY>true</CAN-BE-INVOKED-CONCURRENTLY>
                      <SYMBOL>ComM_ASR40_Rte_GetCurrentComMode</SYMBOL>
                    </RUNNABLE-ENTITY>
[!IF "as:modconf('ComM')[1]/ComMGeneral/ComMEnableGetCurrentPNCComMode = 'true'"!]
                    <RUNNABLE-ENTITY>
                      <SHORT-NAME>RE_ASR40_GetCurrentPNCComMode</SHORT-NAME>
                      <MINIMUM-START-INTERVAL>0</MINIMUM-START-INTERVAL>
                      <ARGUMENTS>
                        <RUNNABLE-ENTITY-ARGUMENT>
                          <SYMBOL>pdav0</SYMBOL>
                        </RUNNABLE-ENTITY-ARGUMENT>
                        <RUNNABLE-ENTITY-ARGUMENT>
                          <SYMBOL>ComMode</SYMBOL>
                        </RUNNABLE-ENTITY-ARGUMENT>
                      </ARGUMENTS>
                      <CAN-BE-INVOKED-CONCURRENTLY>true</CAN-BE-INVOKED-CONCURRENTLY>
                      <SYMBOL>ComM_ASR40_Rte_GetCurrentPNCComMode</SYMBOL>
                    </RUNNABLE-ENTITY>
[!ENDIF!]
                    <RUNNABLE-ENTITY>
                      <SHORT-NAME>RE_ASR40_GetMaxComMode</SHORT-NAME>
                      <MINIMUM-START-INTERVAL>0</MINIMUM-START-INTERVAL>
                      <ARGUMENTS>
                        <RUNNABLE-ENTITY-ARGUMENT>
                          <SYMBOL>pdav0</SYMBOL>
                        </RUNNABLE-ENTITY-ARGUMENT>
                        <RUNNABLE-ENTITY-ARGUMENT>
                          <SYMBOL>ComMode</SYMBOL>
                        </RUNNABLE-ENTITY-ARGUMENT>
                      </ARGUMENTS>
                      <CAN-BE-INVOKED-CONCURRENTLY>true</CAN-BE-INVOKED-CONCURRENTLY>
                      <SYMBOL>ComM_ASR40_Rte_GetMaxComMode</SYMBOL>
                    </RUNNABLE-ENTITY>
                    <RUNNABLE-ENTITY>
                      <SHORT-NAME>RE_ASR40_GetRequestedComMode</SHORT-NAME>
                      <MINIMUM-START-INTERVAL>0</MINIMUM-START-INTERVAL>
                      <ARGUMENTS>
                        <RUNNABLE-ENTITY-ARGUMENT>
                          <SYMBOL>pdav0</SYMBOL>
                        </RUNNABLE-ENTITY-ARGUMENT>
                        <RUNNABLE-ENTITY-ARGUMENT>
                          <SYMBOL>ComMode</SYMBOL>
                        </RUNNABLE-ENTITY-ARGUMENT>
                      </ARGUMENTS>
                      <CAN-BE-INVOKED-CONCURRENTLY>true</CAN-BE-INVOKED-CONCURRENTLY>
                      <SYMBOL>ComM_ASR40_Rte_GetRequestedComMode</SYMBOL>
                    </RUNNABLE-ENTITY>
[!ENDIF!]
[!IF "ComMGeneral/ComMModeLimitationEnabled = 'true'"!]
                    <!-- Conditionally existing runnables for interface ComM_ECUModeLimitation -->
                    <RUNNABLE-ENTITY>
                      <SHORT-NAME>RE_ASR40_LimitECUToNoComMode</SHORT-NAME>
                      <MINIMUM-START-INTERVAL>0</MINIMUM-START-INTERVAL>
                      <CAN-BE-INVOKED-CONCURRENTLY>true</CAN-BE-INVOKED-CONCURRENTLY>
                      <SYMBOL>ComM_ASR40_Rte_LimitECUToNoComMode</SYMBOL>
                    </RUNNABLE-ENTITY>
                    <RUNNABLE-ENTITY>
                      <SHORT-NAME>RE_ASR40_ReadInhibitCounter</SHORT-NAME>
                      <MINIMUM-START-INTERVAL>0</MINIMUM-START-INTERVAL>
                      <CAN-BE-INVOKED-CONCURRENTLY>true</CAN-BE-INVOKED-CONCURRENTLY>
                      <SYMBOL>ComM_ASR40_Rte_ReadInhibitCounter</SYMBOL>
                    </RUNNABLE-ENTITY>
                    <RUNNABLE-ENTITY>
                      <SHORT-NAME>RE_ASR40_ResetInhibitCounter</SHORT-NAME>
                      <MINIMUM-START-INTERVAL>0</MINIMUM-START-INTERVAL>
                      <CAN-BE-INVOKED-CONCURRENTLY>true</CAN-BE-INVOKED-CONCURRENTLY>
                      <SYMBOL>ComM_ASR40_Rte_ResetInhibitCounter</SYMBOL>
                    </RUNNABLE-ENTITY>
                    <RUNNABLE-ENTITY>
                      <SHORT-NAME>RE_ASR40_SetECUGroupClassification</SHORT-NAME>
                      <MINIMUM-START-INTERVAL>0</MINIMUM-START-INTERVAL>
                      <CAN-BE-INVOKED-CONCURRENTLY>true</CAN-BE-INVOKED-CONCURRENTLY>
                      <SYMBOL>ComM_ASR40_Rte_SetECUGroupClassification</SYMBOL>
                    </RUNNABLE-ENTITY>
                    <!-- Conditionally existing runnables for interface ComM_ChannelLimitation -->
                    <RUNNABLE-ENTITY>
                      <SHORT-NAME>RE_ASR40_LimitChannelToNoComMode</SHORT-NAME>
                      <MINIMUM-START-INTERVAL>0</MINIMUM-START-INTERVAL>
                      <ARGUMENTS>
                        <RUNNABLE-ENTITY-ARGUMENT>
                          <SYMBOL>pdav0</SYMBOL>
                        </RUNNABLE-ENTITY-ARGUMENT>
                        <RUNNABLE-ENTITY-ARGUMENT>
                          <SYMBOL>Status</SYMBOL>
                        </RUNNABLE-ENTITY-ARGUMENT>
                      </ARGUMENTS>
                      <CAN-BE-INVOKED-CONCURRENTLY>true</CAN-BE-INVOKED-CONCURRENTLY>
                      <SYMBOL>ComM_ASR40_Rte_LimitChannelToNoComMode</SYMBOL>
                    </RUNNABLE-ENTITY>
                    <RUNNABLE-ENTITY>
                      <SHORT-NAME>RE_ASR40_GetInhibitionStatus</SHORT-NAME>
                      <MINIMUM-START-INTERVAL>0</MINIMUM-START-INTERVAL>
                      <ARGUMENTS>
                        <RUNNABLE-ENTITY-ARGUMENT>
                          <SYMBOL>pdav0</SYMBOL>
                        </RUNNABLE-ENTITY-ARGUMENT>
                        <RUNNABLE-ENTITY-ARGUMENT>
                          <SYMBOL>Status</SYMBOL>
                        </RUNNABLE-ENTITY-ARGUMENT>
                      </ARGUMENTS>
                      <CAN-BE-INVOKED-CONCURRENTLY>true</CAN-BE-INVOKED-CONCURRENTLY>
                      <SYMBOL>ComM_ASR40_Rte_GetInhibitionStatus</SYMBOL>
                    </RUNNABLE-ENTITY>
[!ENDIF!]
[!IF "ComMGeneral/ComMWakeupInhibitionEnabled = 'true'"!]
                    <!-- Conditionally existing runnables for interface ComM_ChannelWakeup -->
                    <RUNNABLE-ENTITY>
                      <SHORT-NAME>RE_ASR40_PreventWakeUp</SHORT-NAME>
                      <MINIMUM-START-INTERVAL>0</MINIMUM-START-INTERVAL>
                      <ARGUMENTS>
                        <RUNNABLE-ENTITY-ARGUMENT>
                          <SYMBOL>pdav0</SYMBOL>
                        </RUNNABLE-ENTITY-ARGUMENT>
                        <RUNNABLE-ENTITY-ARGUMENT>
                          <SYMBOL>Status</SYMBOL>
                        </RUNNABLE-ENTITY-ARGUMENT>
                      </ARGUMENTS>
                      <CAN-BE-INVOKED-CONCURRENTLY>true</CAN-BE-INVOKED-CONCURRENTLY>
                      <SYMBOL>ComM_ASR40_Rte_PreventWakeUp</SYMBOL>
                    </RUNNABLE-ENTITY>
[!ENDIF!]
[!ENDIF!]
[!IF "ComMGeneral/ComMServiceAPI/ComMDefaultASRServiceAPI != 'NONE'"!]
[!IF "count(as:modconf('ComM')[1]/ComMConfigSet/*/ComMUser/*) != 0"!]
                    <RUNNABLE-ENTITY>
                      <SHORT-NAME>RE_RequestComMode</SHORT-NAME>
                      <MINIMUM-START-INTERVAL>0</MINIMUM-START-INTERVAL>
                      <ARGUMENTS>
                        <RUNNABLE-ENTITY-ARGUMENT>
                          <SYMBOL>pdav0</SYMBOL>
                        </RUNNABLE-ENTITY-ARGUMENT>
                        <RUNNABLE-ENTITY-ARGUMENT>
                          <SYMBOL>ComMode</SYMBOL>
                        </RUNNABLE-ENTITY-ARGUMENT>
                      </ARGUMENTS>
                      <CAN-BE-INVOKED-CONCURRENTLY>true</CAN-BE-INVOKED-CONCURRENTLY>
                      <SYMBOL>ComM_Rte_RequestComMode</SYMBOL>
                    </RUNNABLE-ENTITY>
                    <RUNNABLE-ENTITY>
                      <SHORT-NAME>RE_GetCurrentComMode</SHORT-NAME>
                      <MINIMUM-START-INTERVAL>0</MINIMUM-START-INTERVAL>
                      <ARGUMENTS>
                        <RUNNABLE-ENTITY-ARGUMENT>
                          <SYMBOL>pdav0</SYMBOL>
                        </RUNNABLE-ENTITY-ARGUMENT>
                        <RUNNABLE-ENTITY-ARGUMENT>
                          <SYMBOL>ComMode</SYMBOL>
                        </RUNNABLE-ENTITY-ARGUMENT>
                      </ARGUMENTS>
                      <CAN-BE-INVOKED-CONCURRENTLY>true</CAN-BE-INVOKED-CONCURRENTLY>
                      <SYMBOL>ComM_Rte_GetCurrentComMode</SYMBOL>
                    </RUNNABLE-ENTITY>
[!IF "ComMGeneral/ComMServiceAPI/ComMDefaultASRServiceAPI = 'AUTOSAR_40'"!]
[!IF "as:modconf('ComM')[1]/ComMGeneral/ComMEnableGetCurrentPNCComMode = 'true'"!]
                    <RUNNABLE-ENTITY>
                      <SHORT-NAME>RE_GetCurrentPNCComMode</SHORT-NAME>
                      <MINIMUM-START-INTERVAL>0</MINIMUM-START-INTERVAL>
                      <ARGUMENTS>
                        <RUNNABLE-ENTITY-ARGUMENT>
                          <SYMBOL>pdav0</SYMBOL>
                        </RUNNABLE-ENTITY-ARGUMENT>
                        <RUNNABLE-ENTITY-ARGUMENT>
                          <SYMBOL>ComMode</SYMBOL>
                        </RUNNABLE-ENTITY-ARGUMENT>
                      </ARGUMENTS>
                      <CAN-BE-INVOKED-CONCURRENTLY>true</CAN-BE-INVOKED-CONCURRENTLY>
                      <SYMBOL>ComM_Rte_GetCurrentPNCComMode</SYMBOL>
                    </RUNNABLE-ENTITY>
[!ENDIF!]
[!ENDIF!]
                    <RUNNABLE-ENTITY>
                      <SHORT-NAME>RE_GetMaxComMode</SHORT-NAME>
                      <MINIMUM-START-INTERVAL>0</MINIMUM-START-INTERVAL>
                      <ARGUMENTS>
                        <RUNNABLE-ENTITY-ARGUMENT>
                          <SYMBOL>pdav0</SYMBOL>
                        </RUNNABLE-ENTITY-ARGUMENT>
                        <RUNNABLE-ENTITY-ARGUMENT>
                          <SYMBOL>ComMode</SYMBOL>
                        </RUNNABLE-ENTITY-ARGUMENT>
                      </ARGUMENTS>
                      <CAN-BE-INVOKED-CONCURRENTLY>true</CAN-BE-INVOKED-CONCURRENTLY>
                      <SYMBOL>ComM_Rte_GetMaxComMode</SYMBOL>
                    </RUNNABLE-ENTITY>
                    <RUNNABLE-ENTITY>
                      <SHORT-NAME>[!"$ReRequestedComModeName"!]</SHORT-NAME>
                      <MINIMUM-START-INTERVAL>0</MINIMUM-START-INTERVAL>
                      <ARGUMENTS>
                        <RUNNABLE-ENTITY-ARGUMENT>
                          <SYMBOL>pdav0</SYMBOL>
                        </RUNNABLE-ENTITY-ARGUMENT>
                        <RUNNABLE-ENTITY-ARGUMENT>
                          <SYMBOL>ComMode</SYMBOL>
                        </RUNNABLE-ENTITY-ARGUMENT>
                      </ARGUMENTS>
                      <CAN-BE-INVOKED-CONCURRENTLY>true</CAN-BE-INVOKED-CONCURRENTLY>
                      <SYMBOL>[!"$ReRequestedComModeSymbolName"!]</SYMBOL>
                    </RUNNABLE-ENTITY>
[!ENDIF!]
[!IF "ComMGeneral/ComMModeLimitationEnabled = 'true'"!]
                    <!-- Conditionally existing runnables for interface ComM_ECUModeLimitation -->
                    <RUNNABLE-ENTITY>
                      <SHORT-NAME>RE_LimitECUToNoComMode</SHORT-NAME>
                      <MINIMUM-START-INTERVAL>0</MINIMUM-START-INTERVAL>
                      <CAN-BE-INVOKED-CONCURRENTLY>true</CAN-BE-INVOKED-CONCURRENTLY>
                      <SYMBOL>ComM_Rte_LimitECUToNoComMode</SYMBOL>
                    </RUNNABLE-ENTITY>
                    <RUNNABLE-ENTITY>
                      <SHORT-NAME>RE_ReadInhibitCounter</SHORT-NAME>
                      <MINIMUM-START-INTERVAL>0</MINIMUM-START-INTERVAL>
                      <CAN-BE-INVOKED-CONCURRENTLY>true</CAN-BE-INVOKED-CONCURRENTLY>
                      <SYMBOL>ComM_Rte_ReadInhibitCounter</SYMBOL>
                    </RUNNABLE-ENTITY>
                    <RUNNABLE-ENTITY>
                      <SHORT-NAME>RE_ResetInhibitCounter</SHORT-NAME>
                      <MINIMUM-START-INTERVAL>0</MINIMUM-START-INTERVAL>
                      <CAN-BE-INVOKED-CONCURRENTLY>true</CAN-BE-INVOKED-CONCURRENTLY>
                      <SYMBOL>ComM_Rte_ResetInhibitCounter</SYMBOL>
                    </RUNNABLE-ENTITY>
                    <RUNNABLE-ENTITY>
                      <SHORT-NAME>RE_SetECUGroupClassification</SHORT-NAME>
                      <MINIMUM-START-INTERVAL>0</MINIMUM-START-INTERVAL>
                      <CAN-BE-INVOKED-CONCURRENTLY>true</CAN-BE-INVOKED-CONCURRENTLY>
                      <SYMBOL>ComM_Rte_SetECUGroupClassification</SYMBOL>
                    </RUNNABLE-ENTITY>
                    <!-- Conditionally existing runnables for interface ComM_ChannelLimitation -->
                    <RUNNABLE-ENTITY>
                      <SHORT-NAME>RE_LimitChannelToNoComMode</SHORT-NAME>
                      <MINIMUM-START-INTERVAL>0</MINIMUM-START-INTERVAL>
                      <ARGUMENTS>
                        <RUNNABLE-ENTITY-ARGUMENT>
                          <SYMBOL>pdav0</SYMBOL>
                        </RUNNABLE-ENTITY-ARGUMENT>
                        <RUNNABLE-ENTITY-ARGUMENT>
                          <SYMBOL>Status</SYMBOL>
                        </RUNNABLE-ENTITY-ARGUMENT>
                      </ARGUMENTS>
                      <CAN-BE-INVOKED-CONCURRENTLY>true</CAN-BE-INVOKED-CONCURRENTLY>
                      <SYMBOL>ComM_Rte_LimitChannelToNoComMode</SYMBOL>
                    </RUNNABLE-ENTITY>
                    <RUNNABLE-ENTITY>
                      <SHORT-NAME>RE_GetInhibitionStatus</SHORT-NAME>
                      <MINIMUM-START-INTERVAL>0</MINIMUM-START-INTERVAL>
                      <ARGUMENTS>
                        <RUNNABLE-ENTITY-ARGUMENT>
                          <SYMBOL>pdav0</SYMBOL>
                        </RUNNABLE-ENTITY-ARGUMENT>
                        <RUNNABLE-ENTITY-ARGUMENT>
                          <SYMBOL>Status</SYMBOL>
                        </RUNNABLE-ENTITY-ARGUMENT>
                      </ARGUMENTS>
                      <CAN-BE-INVOKED-CONCURRENTLY>true</CAN-BE-INVOKED-CONCURRENTLY>
                      <SYMBOL>ComM_Rte_GetInhibitionStatus</SYMBOL>
                    </RUNNABLE-ENTITY>
[!ENDIF!]
[!IF "ComMGeneral/ComMWakeupInhibitionEnabled = 'true'"!]
                    <!-- Conditionally existing runnables for interface ComM_ChannelWakeup -->
                    <RUNNABLE-ENTITY>
                      <SHORT-NAME>RE_PreventWakeUp</SHORT-NAME>
                      <MINIMUM-START-INTERVAL>0</MINIMUM-START-INTERVAL>
                      <ARGUMENTS>
                        <RUNNABLE-ENTITY-ARGUMENT>
                          <SYMBOL>pdav0</SYMBOL>
                        </RUNNABLE-ENTITY-ARGUMENT>
                        <RUNNABLE-ENTITY-ARGUMENT>
                          <SYMBOL>Status</SYMBOL>
                        </RUNNABLE-ENTITY-ARGUMENT>
                      </ARGUMENTS>
                      <CAN-BE-INVOKED-CONCURRENTLY>true</CAN-BE-INVOKED-CONCURRENTLY>
                      <SYMBOL>ComM_Rte_PreventWakeUp</SYMBOL>
                    </RUNNABLE-ENTITY>
[!ENDIF!]
[!ENDIF!]
[!LOOP "ComMConfigSet/*[1]/ComMChannel/*"!]
                    <RUNNABLE-ENTITY>
                      <SHORT-NAME>RE_Main_[!"ComMChannelId"!]</SHORT-NAME>
                      <MINIMUM-START-INTERVAL>0</MINIMUM-START-INTERVAL>
                      <CAN-BE-INVOKED-CONCURRENTLY>false</CAN-BE-INVOKED-CONCURRENTLY>
[!IF "ComMFullCommRequestNotificationEnabled = 'true'"!]
                      <DATA-SEND-POINTS>
[!IF "../../../../ComMGeneral/ComMServiceAPI/ComMEnableASR40ServiceAPI = 'true'"!]
                        <VARIABLE-ACCESS>
                          <SHORT-NAME>DSP_ASR40_RE_Main_[!"ComMChannelId"!]</SHORT-NAME>
                          <ACCESSED-VARIABLE>
                            <AUTOSAR-VARIABLE-IREF>
                              <PORT-PROTOTYPE-REF DEST="P-PORT-PROTOTYPE">/AUTOSAR_ComM/[!"$swComponentTypePackageName"!]/ComM/CR_ASR40_[!"as:name(.)"!]</PORT-PROTOTYPE-REF>
                              <TARGET-DATA-PROTOTYPE-REF DEST="VARIABLE-DATA-PROTOTYPE">/AUTOSAR_ComM/ASR40/PortInterfaces/ComM_ASR40_CurrentChannelRequest/fullComRequestors</TARGET-DATA-PROTOTYPE-REF>
                            </AUTOSAR-VARIABLE-IREF>
                          </ACCESSED-VARIABLE>
                        </VARIABLE-ACCESS>
[!ENDIF!]
[!IF "../../../../ComMGeneral/ComMServiceAPI/ComMDefaultASRServiceAPI = 'AUTOSAR_40'"!]
                        <VARIABLE-ACCESS>
                          <SHORT-NAME>DSP_RE_Main_[!"ComMChannelId"!]</SHORT-NAME>
                          <ACCESSED-VARIABLE>
                            <AUTOSAR-VARIABLE-IREF>
                              <PORT-PROTOTYPE-REF DEST="P-PORT-PROTOTYPE">/AUTOSAR_ComM/[!"$swComponentTypePackageName"!]/ComM/CR_[!"as:name(.)"!]</PORT-PROTOTYPE-REF>
                              <TARGET-DATA-PROTOTYPE-REF DEST="VARIABLE-DATA-PROTOTYPE">/AUTOSAR_ComM/PortInterfaces/ComM_CurrentChannelRequest/fullComRequestors</TARGET-DATA-PROTOTYPE-REF>
                            </AUTOSAR-VARIABLE-IREF>
                          </ACCESSED-VARIABLE>
                        </VARIABLE-ACCESS>
[!ENDIF!]
                      </DATA-SEND-POINTS>
[!ENDIF!]
                      <MODE-SWITCH-POINTS>
[!IF "../../../../ComMGeneral/ComMServiceAPI/ComMEnableASR32ServiceAPI = 'true'"!]
<!-- Create switch points for the Users which are directly mapped to a channel -->
[!IF "num:i(count(ComMUserPerChannel/*)) != 0"!]
[!LOOP "ComMUserPerChannel/*"!]
[!SELECT "as:ref(ComMUserChannel)"!]
                        <MODE-SWITCH-POINT>
                          <SHORT-NAME>MSP_ASR32_[!"as:name(.)"!]</SHORT-NAME>
                          <MODE-GROUP-IREF>
                            <CONTEXT-P-PORT-REF DEST="P-PORT-PROTOTYPE">/AUTOSAR_ComM/[!"$swComponentTypePackageName"!]/ComM/UM_ASR32_[!"as:name(.)"!]</CONTEXT-P-PORT-REF>
                            <TARGET-MODE-GROUP-REF DEST="MODE-DECLARATION-GROUP-PROTOTYPE">/AUTOSAR_ComM/ASR32/PortInterfaces/ComM_ASR32_CurrentMode/currentMode</TARGET-MODE-GROUP-REF>
                          </MODE-GROUP-IREF>
                        </MODE-SWITCH-POINT>
[!ENDSELECT!]
[!ENDLOOP!]
[!ENDIF!]
<!-- Create switch points for the Users which are mapped to a channel via PNCs -->
[!IF "num:i(count(util:distinct(node:refs(as:modconf('ComM')[1]/ComMConfigSet/*[1]/ComMPnc/*/ComMChannelPerPnc/*[(node:ref(.)/ComMChannelId=node:current()/ComMChannelId)]/../../ComMUserPerPnc/*)))) != 0"!]
[!LOOP "util:distinct(node:refs(as:modconf('ComM')[1]/ComMConfigSet/*[1]/ComMPnc/*/ComMChannelPerPnc/*[(node:ref(.)/ComMChannelId=node:current()/ComMChannelId)]/../../ComMUserPerPnc/*))"!]
                        <MODE-SWITCH-POINT>
                          <SHORT-NAME>MSP_ASR32_[!"as:name(.)"!]</SHORT-NAME>
                          <MODE-GROUP-IREF>
                            <CONTEXT-P-PORT-REF DEST="P-PORT-PROTOTYPE">/AUTOSAR_ComM/[!"$swComponentTypePackageName"!]/ComM/UM_ASR32_[!"as:name(.)"!]</CONTEXT-P-PORT-REF>
                            <TARGET-MODE-GROUP-REF DEST="MODE-DECLARATION-GROUP-PROTOTYPE">/AUTOSAR_ComM/ASR32/PortInterfaces/ComM_ASR32_CurrentMode/currentMode</TARGET-MODE-GROUP-REF>
                          </MODE-GROUP-IREF>
                        </MODE-SWITCH-POINT>
[!ENDLOOP!]
[!ENDIF!]
[!ENDIF!]
[!IF "../../../../ComMGeneral/ComMServiceAPI/ComMEnableASR40ServiceAPI = 'true'"!]
<!-- Create switch points for the Users which are directly mapped to a channel -->
[!IF "num:i(count(ComMUserPerChannel/*)) != 0"!]
[!LOOP "ComMUserPerChannel/*"!]
[!SELECT "as:ref(ComMUserChannel)"!]
                        <MODE-SWITCH-POINT>
                          <SHORT-NAME>MSP_ASR40_[!"as:name(.)"!]</SHORT-NAME>
                          <MODE-GROUP-IREF>
                            <CONTEXT-P-PORT-REF DEST="P-PORT-PROTOTYPE">/AUTOSAR_ComM/[!"$swComponentTypePackageName"!]/ComM/UM_ASR40_[!"as:name(.)"!]</CONTEXT-P-PORT-REF>
                            <TARGET-MODE-GROUP-REF DEST="MODE-DECLARATION-GROUP-PROTOTYPE">/AUTOSAR_ComM/ASR40/PortInterfaces/ComM_ASR40_CurrentMode/currentMode</TARGET-MODE-GROUP-REF>
                          </MODE-GROUP-IREF>
                        </MODE-SWITCH-POINT>
[!ENDSELECT!]
[!ENDLOOP!]
[!ENDIF!]
<!-- Create switch points for the Users which are mapped to a channel via PNCs -->
[!IF "num:i(count(util:distinct(node:refs(as:modconf('ComM')[1]/ComMConfigSet/*[1]/ComMPnc/*/ComMChannelPerPnc/*[(node:ref(.)/ComMChannelId=node:current()/ComMChannelId)]/../../ComMUserPerPnc/*)))) != 0"!]
[!LOOP "util:distinct(node:refs(as:modconf('ComM')[1]/ComMConfigSet/*[1]/ComMPnc/*/ComMChannelPerPnc/*[(node:ref(.)/ComMChannelId=node:current()/ComMChannelId)]/../../ComMUserPerPnc/*))"!]
                        <MODE-SWITCH-POINT>
                          <SHORT-NAME>MSP_ASR40_[!"as:name(.)"!]</SHORT-NAME>
                          <MODE-GROUP-IREF>
                            <CONTEXT-P-PORT-REF DEST="P-PORT-PROTOTYPE">/AUTOSAR_ComM/[!"$swComponentTypePackageName"!]/ComM/UM_ASR40_[!"as:name(.)"!]</CONTEXT-P-PORT-REF>
                            <TARGET-MODE-GROUP-REF DEST="MODE-DECLARATION-GROUP-PROTOTYPE">/AUTOSAR_ComM/ASR40/PortInterfaces/ComM_ASR40_CurrentMode/currentMode</TARGET-MODE-GROUP-REF>
                          </MODE-GROUP-IREF>
                        </MODE-SWITCH-POINT>
[!ENDLOOP!]
[!ENDIF!]
[!ENDIF!]
[!IF "../../../../ComMGeneral/ComMServiceAPI/ComMDefaultASRServiceAPI != 'NONE'"!]
<!-- Create switch points for the Users which are directly mapped to a channel -->
[!IF "num:i(count(ComMUserPerChannel/*)) != 0"!]
[!LOOP "ComMUserPerChannel/*"!]
[!SELECT "as:ref(ComMUserChannel)"!]
                        <MODE-SWITCH-POINT>
                          <SHORT-NAME>MSP_[!"as:name(.)"!]</SHORT-NAME>
                          <MODE-GROUP-IREF>
                            <CONTEXT-P-PORT-REF DEST="P-PORT-PROTOTYPE">/AUTOSAR_ComM/[!"$swComponentTypePackageName"!]/ComM/UM_[!"as:name(.)"!]</CONTEXT-P-PORT-REF>
                            <TARGET-MODE-GROUP-REF DEST="MODE-DECLARATION-GROUP-PROTOTYPE">/AUTOSAR_ComM/PortInterfaces/ComM_CurrentMode/currentMode</TARGET-MODE-GROUP-REF>
                          </MODE-GROUP-IREF>
                        </MODE-SWITCH-POINT>
[!ENDSELECT!]
[!ENDLOOP!]
[!ENDIF!]
<!-- Create switch points for the Users which are mapped to a channel via PNCs -->
[!IF "num:i(count(util:distinct(node:refs(as:modconf('ComM')[1]/ComMConfigSet/*[1]/ComMPnc/*/ComMChannelPerPnc/*[(node:ref(.)/ComMChannelId=node:current()/ComMChannelId)]/../../ComMUserPerPnc/*)))) != 0"!]
[!LOOP "util:distinct(node:refs(as:modconf('ComM')[1]/ComMConfigSet/*[1]/ComMPnc/*/ComMChannelPerPnc/*[(node:ref(.)/ComMChannelId=node:current()/ComMChannelId)]/../../ComMUserPerPnc/*))"!]
                        <MODE-SWITCH-POINT>
                          <SHORT-NAME>MSP_[!"as:name(.)"!]</SHORT-NAME>
                          <MODE-GROUP-IREF>
                            <CONTEXT-P-PORT-REF DEST="P-PORT-PROTOTYPE">/AUTOSAR_ComM/[!"$swComponentTypePackageName"!]/ComM/UM_[!"as:name(.)"!]</CONTEXT-P-PORT-REF>
                            <TARGET-MODE-GROUP-REF DEST="MODE-DECLARATION-GROUP-PROTOTYPE">/AUTOSAR_ComM/PortInterfaces/ComM_CurrentMode/currentMode</TARGET-MODE-GROUP-REF>
                          </MODE-GROUP-IREF>
                        </MODE-SWITCH-POINT>
[!ENDLOOP!]
[!ENDIF!]
[!ENDIF!]
                      </MODE-SWITCH-POINTS>
                      <SYMBOL>ComM_MainFunction_[!"ComMChannelId"!]</SYMBOL>
                    </RUNNABLE-ENTITY>
[!ENDLOOP!]
                  </RUNNABLES>
                  <SUPPORTS-MULTIPLE-INSTANTIATION>false</SUPPORTS-MULTIPLE-INSTANTIATION>
                </SWC-INTERNAL-BEHAVIOR>
              </INTERNAL-BEHAVIORS>
            </SERVICE-SW-COMPONENT-TYPE>
          </ELEMENTS>
        </AR-PACKAGE>
      </AR-PACKAGES>
    </AR-PACKAGE>

    <AR-PACKAGE>
      <SHORT-NAME>EB_ComM</SHORT-NAME>
      <AR-PACKAGES>
        <AR-PACKAGE>
          <SHORT-NAME>[!"$swcImplementationPackageName"!]</SHORT-NAME>
          <ELEMENTS>
            <SWC-IMPLEMENTATION>
              <SHORT-NAME>SwcImplementation_0</SHORT-NAME>
              <CODE-DESCRIPTORS>
                <CODE>
                  <SHORT-NAME>ComMCode</SHORT-NAME>
                  <ARTIFACT-DESCRIPTORS>
                    <AUTOSAR-ENGINEERING-OBJECT>
                      <SHORT-LABEL>EngObject</SHORT-LABEL>
                      <CATEGORY>SWSRC</CATEGORY>
                    </AUTOSAR-ENGINEERING-OBJECT>
                  </ARTIFACT-DESCRIPTORS>
                </CODE>
              </CODE-DESCRIPTORS>
              <PROGRAMMING-LANGUAGE>C</PROGRAMMING-LANGUAGE>
              <RESOURCE-CONSUMPTION>
                <SHORT-NAME>Resources</SHORT-NAME>
                <MEMORY-SECTIONS>
                  <MEMORY-SECTION>
                    <SHORT-NAME>CODE</SHORT-NAME>
                    <SW-ADDRMETHOD-REF DEST="SW-ADDR-METHOD">/AUTOSAR_MemMap/SwAddrMethods/CODE</SW-ADDRMETHOD-REF>
                  </MEMORY-SECTION>
                </MEMORY-SECTIONS>
              </RESOURCE-CONSUMPTION>
              <SW-VERSION>5.21.4</SW-VERSION>
              <VENDOR-ID>1</VENDOR-ID>
              <BEHAVIOR-REF DEST="SWC-INTERNAL-BEHAVIOR">/AUTOSAR_ComM/[!"$swComponentTypePackageName"!]/ComM/SwcInternalBehavior_0</BEHAVIOR-REF>
            </SWC-IMPLEMENTATION>
          </ELEMENTS>
        </AR-PACKAGE>
      </AR-PACKAGES>
    </AR-PACKAGE>
  </AR-PACKAGES>
[!ENDIF!] [!/*[!IF "(count(text:split($FoundUserPlusChannePlusMasterPncPlusInhibitionOsApplications,' ')) > 1) and (as:modconf('ComM')[1]/ComMGeneral/ComMMultiCoreSupport = 'false')"!]*/!]
</AUTOSAR>
