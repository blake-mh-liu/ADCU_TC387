AUTOSAR XML (schema 00046)
package /TS_TxDxM6I11R0
  module config CrcRecConfigurationCrc16Crc32: definition=Crc
    CrcGeneral: Crc16Mode=CRC_16_TABLE, Crc32Mode=CRC_32_TABLE
