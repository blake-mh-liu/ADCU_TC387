<?xml version="1.0" encoding="ISO-8859-1"?>
[!AUTOSPACING!][!//

[!INCLUDE "CanTSyn_Macros.m"!]

[!VAR "canTSynMulticoreSupported"="node:value(as:modconf('CanTSyn')[1]/CanTSynGeneral/CanTSynMultiCoreSupport)"!]
[!VAR "canTSynMainFunctionPeriod"="node:value(as:modconf('CanTSyn')[1]/CanTSynGeneral/CanTSynMainFunctionPeriod)"!]


<AUTOSAR xmlns="http://autosar.org/schema/r4.0"
  xmlns:xsi="http://www.w3.org/2001/XMLSchema-instance"
  xsi:schemaLocation="http://autosar.org/schema/r4.0 AUTOSAR_4-0-3.xsd">
  <AR-PACKAGES>
    <AR-PACKAGE>
      <SHORT-NAME>AUTOSAR_CanTSyn</SHORT-NAME>
      <AR-PACKAGES>
      
      
        <AR-PACKAGE>
          <SHORT-NAME>BswModuleDescriptions</SHORT-NAME>
          <ELEMENTS>
            <BSW-MODULE-DESCRIPTION>
              <SHORT-NAME>CanTSyn</SHORT-NAME>
              <MODULE-ID>161</MODULE-ID>
              
              

              <PROVIDED-ENTRYS>
              
[!IF "$canTSynMulticoreSupported = 'true'"!]
          
[!CALL "createMasterTimeDomainMFAlloc"!]
[!LOOP "text:split($createMasterTimeDomainMFAlloc,';')"!]
[!VAR "qNameTx" = "text:split(.,':')[1]"!]
[!VAR "qNameTx" = "concat('CanTSyn', $qNameTx)"!]
                <BSW-MODULE-ENTRY-REF-CONDITIONAL>
                  <BSW-MODULE-ENTRY-REF DEST="BSW-MODULE-ENTRY">/AUTOSAR_CanTSyn/BswModuleEntrys/[!"$qNameTx"!]</BSW-MODULE-ENTRY-REF>
                </BSW-MODULE-ENTRY-REF-CONDITIONAL>
[!ENDLOOP!][!//Tx

[!CALL "createSlaveTimeDomainMFAlloc"!]
[!LOOP "text:split($createSlaveTimeDomainMFAlloc,';')"!]
[!VAR "qNameRx" = "text:split(.,':')[1]"!]
[!VAR "qNameRx" = "concat('CanTSyn', $qNameRx)"!]
                <BSW-MODULE-ENTRY-REF-CONDITIONAL>
                  <BSW-MODULE-ENTRY-REF DEST="BSW-MODULE-ENTRY">/AUTOSAR_CanTSyn/BswModuleEntrys/[!"$qNameRx"!]</BSW-MODULE-ENTRY-REF>
                </BSW-MODULE-ENTRY-REF-CONDITIONAL>
[!ENDLOOP!][!//Rx
           
[!ENDIF!]
                <BSW-MODULE-ENTRY-REF-CONDITIONAL>
                  <BSW-MODULE-ENTRY-REF DEST="BSW-MODULE-ENTRY">/AUTOSAR_CanTSyn/BswModuleEntrys/CanTSyn_MainFunction</BSW-MODULE-ENTRY-REF>
                </BSW-MODULE-ENTRY-REF-CONDITIONAL>


              </PROVIDED-ENTRYS>

              
              
              
              
              <INTERNAL-BEHAVIORS>
              
              
[!IF "$canTSynMulticoreSupported = 'true'"!][!//

[!CALL "CreatePartitionRefList"!]

[!VAR "lastPartitionRef"!][!ENDVAR!][!//
[!LOOP "text:order(text:split($PartitionsRefList, ';'))"!][!//
  [!VAR "partitionRef" = "text:split(., ':')[1]"!][!//
  [!IF "not($lastPartitionRef = $partitionRef)"!][!//
                <BSW-INTERNAL-BEHAVIOR>
                  <SHORT-NAME>InternalBehavior_[!"$partitionRef"!]</SHORT-NAME>
                  
                  <EXCLUSIVE-AREAS>
                    <EXCLUSIVE-AREA>
                      <SHORT-NAME>SCHM_CANTSYN_EXCLUSIVE_AREA_0</SHORT-NAME>
                    </EXCLUSIVE-AREA>
                    <EXCLUSIVE-AREA>
                      <SHORT-NAME>SCHM_CANTSYN_EXCLUSIVE_AREA_1</SHORT-NAME>
                    </EXCLUSIVE-AREA>
                  </EXCLUSIVE-AREAS>
                  
                  
                  <ENTITYS>

[!LOOP "text:split($createMasterTimeDomainMFAlloc,';')"!]
[!VAR "qNameTx" = "text:split(.,':')[1]"!]
[!VAR "qNameTx" = "concat('CanTSyn', $qNameTx)"!]
[!VAR "partitionName" = "text:split(.,':')[2]"!]
  [!IF "$partitionName = $partitionRef"!]
                    <BSW-SCHEDULABLE-ENTITY>
                      <SHORT-NAME>[!"$qNameTx"!]</SHORT-NAME>
                      <CAN-ENTER-EXCLUSIVE-AREA-REFS>
                        <CAN-ENTER-EXCLUSIVE-AREA-REF
                          DEST="EXCLUSIVE-AREA">/AUTOSAR_CanTSyn/BswModuleDescriptions/CanTSyn/InternalBehavior_[!"$partitionRef"!]/SCHM_CANTSYN_EXCLUSIVE_AREA_0</CAN-ENTER-EXCLUSIVE-AREA-REF>
                        <CAN-ENTER-EXCLUSIVE-AREA-REF
                          DEST="EXCLUSIVE-AREA">/AUTOSAR_CanTSyn/BswModuleDescriptions/CanTSyn/InternalBehavior_[!"$partitionRef"!]/SCHM_CANTSYN_EXCLUSIVE_AREA_1</CAN-ENTER-EXCLUSIVE-AREA-REF>
                      </CAN-ENTER-EXCLUSIVE-AREA-REFS>
                      <MINIMUM-START-INTERVAL>0.0</MINIMUM-START-INTERVAL>
                      <IMPLEMENTED-ENTRY-REF DEST="BSW-MODULE-ENTRY">/AUTOSAR_CanTSyn/BswModuleEntrys/[!"$qNameTx"!]</IMPLEMENTED-ENTRY-REF>
                    </BSW-SCHEDULABLE-ENTITY>
  [!ENDIF!]
[!ENDLOOP!][!//Tx


[!LOOP "text:split($createSlaveTimeDomainMFAlloc,';')"!]
[!VAR "qNameRx" = "text:split(.,':')[1]"!]
[!VAR "qNameRx" = "concat('CanTSyn', $qNameRx)"!]
[!VAR "partitionName" = "text:split(.,':')[2]"!]
  [!IF "$partitionName = $partitionRef"!]
                    <BSW-SCHEDULABLE-ENTITY>
                      <SHORT-NAME>[!"$qNameRx"!]</SHORT-NAME>
                      <CAN-ENTER-EXCLUSIVE-AREA-REFS>
                        <CAN-ENTER-EXCLUSIVE-AREA-REF
                          DEST="EXCLUSIVE-AREA">/AUTOSAR_CanTSyn/BswModuleDescriptions/CanTSyn/InternalBehavior_[!"$partitionRef"!]/SCHM_CANTSYN_EXCLUSIVE_AREA_0</CAN-ENTER-EXCLUSIVE-AREA-REF>
                        <CAN-ENTER-EXCLUSIVE-AREA-REF
                          DEST="EXCLUSIVE-AREA">/AUTOSAR_CanTSyn/BswModuleDescriptions/CanTSyn/InternalBehavior_[!"$partitionRef"!]/SCHM_CANTSYN_EXCLUSIVE_AREA_1</CAN-ENTER-EXCLUSIVE-AREA-REF>
                      </CAN-ENTER-EXCLUSIVE-AREA-REFS>
                      <MINIMUM-START-INTERVAL>0.0</MINIMUM-START-INTERVAL>
                      <IMPLEMENTED-ENTRY-REF DEST="BSW-MODULE-ENTRY">/AUTOSAR_CanTSyn/BswModuleEntrys/[!"$qNameRx"!]</IMPLEMENTED-ENTRY-REF>
                    </BSW-SCHEDULABLE-ENTITY>
  [!ENDIF!]
[!ENDLOOP!][!//Rx
                  </ENTITYS>
                  
                  
                  
                  
                  <EVENTS>

[!LOOP "text:split($createMasterTimeDomainMFAlloc,';')"!]
[!VAR "qNameTx" = "text:split(.,':')[1]"!]
[!VAR "qNameTx" = "concat('CanTSyn', $qNameTx)"!]
[!VAR "partitionName" = "text:split(.,':')[2]"!]
  [!IF "$partitionName = $partitionRef"!]
                    <BSW-TIMING-EVENT>
                      <SHORT-NAME>TimingEvent_[!"$qNameTx"!]</SHORT-NAME>
                      <STARTS-ON-EVENT-REF DEST="BSW-SCHEDULABLE-ENTITY">/AUTOSAR_CanTSyn/BswModuleDescriptions/CanTSyn/InternalBehavior_[!"$partitionRef"!]/[!"$qNameTx"!]</STARTS-ON-EVENT-REF>
                      <PERIOD>[!"$canTSynMainFunctionPeriod"!]</PERIOD>
                    </BSW-TIMING-EVENT>
  [!ENDIF!]
[!ENDLOOP!][!//Tx

[!LOOP "text:split($createSlaveTimeDomainMFAlloc,';')"!]
[!VAR "qNameRx" = "text:split(.,':')[1]"!]
[!VAR "qNameRx" = "concat('CanTSyn', $qNameRx)"!]
[!VAR "partitionName" = "text:split(.,':')[2]"!]
  [!IF "$partitionName = $partitionRef"!]
                    <BSW-TIMING-EVENT>
                      <SHORT-NAME>TimingEvent_[!"$qNameRx"!]</SHORT-NAME>
                      <STARTS-ON-EVENT-REF DEST="BSW-SCHEDULABLE-ENTITY">/AUTOSAR_CanTSyn/BswModuleDescriptions/CanTSyn/InternalBehavior_[!"$partitionRef"!]/[!"$qNameRx"!]</STARTS-ON-EVENT-REF>
                      <PERIOD>[!"$canTSynMainFunctionPeriod"!]</PERIOD>
                    </BSW-TIMING-EVENT>
  [!ENDIF!]
[!ENDLOOP!][!//Rx
                  </EVENTS>
                  
                </BSW-INTERNAL-BEHAVIOR>
[!ENDIF!][!//
  [!VAR "lastPartitionRef" = "$partitionRef"!][!//
                
[!ENDLOOP!]


[!ENDIF!]


                <BSW-INTERNAL-BEHAVIOR>
                  <SHORT-NAME>InternalBehavior_0</SHORT-NAME>
                  
                  <EXCLUSIVE-AREAS>
                    <EXCLUSIVE-AREA>
                      <SHORT-NAME>SCHM_CANTSYN_EXCLUSIVE_AREA_0</SHORT-NAME>
                    </EXCLUSIVE-AREA>
                    <EXCLUSIVE-AREA>
                      <SHORT-NAME>SCHM_CANTSYN_EXCLUSIVE_AREA_1</SHORT-NAME>
                    </EXCLUSIVE-AREA>
                  </EXCLUSIVE-AREAS>
                  
                  <ENTITYS>

                    <BSW-SCHEDULABLE-ENTITY>
                      <SHORT-NAME>CanTSyn_MainFunction</SHORT-NAME>
                      <CAN-ENTER-EXCLUSIVE-AREA-REFS>
                        <CAN-ENTER-EXCLUSIVE-AREA-REF
                          DEST="EXCLUSIVE-AREA">/AUTOSAR_CanTSyn/BswModuleDescriptions/CanTSyn/InternalBehavior_0/SCHM_CANTSYN_EXCLUSIVE_AREA_0</CAN-ENTER-EXCLUSIVE-AREA-REF>
                        <CAN-ENTER-EXCLUSIVE-AREA-REF
                          DEST="EXCLUSIVE-AREA">/AUTOSAR_CanTSyn/BswModuleDescriptions/CanTSyn/InternalBehavior_0/SCHM_CANTSYN_EXCLUSIVE_AREA_1</CAN-ENTER-EXCLUSIVE-AREA-REF>
                      </CAN-ENTER-EXCLUSIVE-AREA-REFS>
                      <MINIMUM-START-INTERVAL>0.0</MINIMUM-START-INTERVAL>
                      <IMPLEMENTED-ENTRY-REF DEST="BSW-MODULE-ENTRY">/AUTOSAR_CanTSyn/BswModuleEntrys/CanTSyn_MainFunction</IMPLEMENTED-ENTRY-REF>
                    </BSW-SCHEDULABLE-ENTITY>

                  </ENTITYS>
                  
                  
                  
                  <EVENTS>
                  
                    <BSW-TIMING-EVENT>
                      <SHORT-NAME>TimingEvent_MainFunction</SHORT-NAME>
                      <STARTS-ON-EVENT-REF DEST="BSW-SCHEDULABLE-ENTITY">/AUTOSAR_CanTSyn/BswModuleDescriptions/CanTSyn/InternalBehavior_0/CanTSyn_MainFunction</STARTS-ON-EVENT-REF>
                      <PERIOD>[!"CanTSynGeneral/CanTSynMainFunctionPeriod"!]</PERIOD>
                    </BSW-TIMING-EVENT>
                    
                  </EVENTS>

                </BSW-INTERNAL-BEHAVIOR>


                
                
              </INTERNAL-BEHAVIORS>
              
              
              
            </BSW-MODULE-DESCRIPTION>
          </ELEMENTS>
        </AR-PACKAGE>
        
        
        
        
        <AR-PACKAGE>
          <SHORT-NAME>BswModuleEntrys</SHORT-NAME>
          <ELEMENTS>
          
          
[!IF "$canTSynMulticoreSupported = 'true'"!]


[!LOOP "text:split($createMasterTimeDomainMFAlloc,';')"!]
[!VAR "qNameTx" = "text:split(.,':')[1]"!]
[!VAR "qNameTx" = "concat('CanTSyn', $qNameTx)"!]
            <BSW-MODULE-ENTRY>
              <SHORT-NAME>[!"$qNameTx"!]</SHORT-NAME>
              <SERVICE-ID>255</SERVICE-ID>
              <IS-REENTRANT>false</IS-REENTRANT>
              <IS-SYNCHRONOUS>true</IS-SYNCHRONOUS>
              <CALL-TYPE>SCHEDULED</CALL-TYPE>
              <EXECUTION-CONTEXT>TASK</EXECUTION-CONTEXT>
              <SW-SERVICE-IMPL-POLICY>STANDARD</SW-SERVICE-IMPL-POLICY>
            </BSW-MODULE-ENTRY>
[!ENDLOOP!][!//Tx


[!LOOP "text:split($createSlaveTimeDomainMFAlloc,';')"!]
[!VAR "qNameRx" = "text:split(.,':')[1]"!]
[!VAR "qNameRx" = "concat('CanTSyn', $qNameRx)"!]
            <BSW-MODULE-ENTRY>
              <SHORT-NAME>[!"$qNameRx"!]</SHORT-NAME>
              <SERVICE-ID>256</SERVICE-ID>
              <IS-REENTRANT>false</IS-REENTRANT>
              <IS-SYNCHRONOUS>true</IS-SYNCHRONOUS>
              <CALL-TYPE>SCHEDULED</CALL-TYPE>
              <EXECUTION-CONTEXT>TASK</EXECUTION-CONTEXT>
              <SW-SERVICE-IMPL-POLICY>STANDARD</SW-SERVICE-IMPL-POLICY>
            </BSW-MODULE-ENTRY>
[!ENDLOOP!][!//Rx

[!ENDIF!]

            <BSW-MODULE-ENTRY>
              <SHORT-NAME>CanTSyn_MainFunction</SHORT-NAME>
              <SERVICE-ID>255</SERVICE-ID>
              <IS-REENTRANT>false</IS-REENTRANT>
              <IS-SYNCHRONOUS>true</IS-SYNCHRONOUS>
              <CALL-TYPE>SCHEDULED</CALL-TYPE>
              <EXECUTION-CONTEXT>TASK</EXECUTION-CONTEXT>
              <SW-SERVICE-IMPL-POLICY>STANDARD</SW-SERVICE-IMPL-POLICY>
            </BSW-MODULE-ENTRY>


            
          </ELEMENTS>
        </AR-PACKAGE>
        
        
        
      </AR-PACKAGES>
    </AR-PACKAGE>

    <AR-PACKAGE>
      <SHORT-NAME>EB_CanTSyn</SHORT-NAME>
      <AR-PACKAGES>
        <AR-PACKAGE>
          <SHORT-NAME>Implementations</SHORT-NAME>
          <ELEMENTS>
          
          
[!IF "$canTSynMulticoreSupported = 'true'"!][!//

[!VAR "lastPartitionRef"!][!ENDVAR!][!//
[!LOOP "text:order(text:split($PartitionsRefList, ';'))"!][!//
  [!VAR "partitionRef" = "text:split(., ':')[1]"!][!//
  [!IF "not($lastPartitionRef = $partitionRef)"!][!//
            <BSW-IMPLEMENTATION>
              <SHORT-NAME>BswImplementation_[!"$partitionRef"!]</SHORT-NAME>
              
              <CODE-DESCRIPTORS>
                <CODE>
                  <SHORT-NAME>Files</SHORT-NAME>
                  <ARTIFACT-DESCRIPTORS>
                    <AUTOSAR-ENGINEERING-OBJECT>
                      <SHORT-LABEL>Autosar::include::CanTSyn.h</SHORT-LABEL>
                      <CATEGORY>SWHDR</CATEGORY>
                    </AUTOSAR-ENGINEERING-OBJECT>
                    <AUTOSAR-ENGINEERING-OBJECT>
                      <SHORT-LABEL>Autosar::include::CanTSyn_Int.h</SHORT-LABEL>
                      <CATEGORY>SWHDR</CATEGORY>
                    </AUTOSAR-ENGINEERING-OBJECT>
                    <AUTOSAR-ENGINEERING-OBJECT>
                      <SHORT-LABEL>Autosar::include::CanTSyn_Int_Stc.h</SHORT-LABEL>
                      <CATEGORY>SWHDR</CATEGORY>
                    </AUTOSAR-ENGINEERING-OBJECT>
                    <AUTOSAR-ENGINEERING-OBJECT>
                      <SHORT-LABEL>Autosar::include::CanTSyn_Trace.h</SHORT-LABEL>
                      <CATEGORY>SWHDR</CATEGORY>
                    </AUTOSAR-ENGINEERING-OBJECT>
                    <AUTOSAR-ENGINEERING-OBJECT>
                      <SHORT-LABEL>Autosar::include::CanTSyn_Version.h</SHORT-LABEL>
                      <CATEGORY>SWHDR</CATEGORY>
                    </AUTOSAR-ENGINEERING-OBJECT>
                    <AUTOSAR-ENGINEERING-OBJECT>
                      <SHORT-LABEL>Autosar::src::CanTSyn.c</SHORT-LABEL>
                      <CATEGORY>SWSRC</CATEGORY>
                    </AUTOSAR-ENGINEERING-OBJECT>
                    <AUTOSAR-ENGINEERING-OBJECT>
                      <SHORT-LABEL>make::CanTSyn_defs.mak</SHORT-LABEL>
                      <CATEGORY>SWMAKE</CATEGORY>
                    </AUTOSAR-ENGINEERING-OBJECT>
                    <AUTOSAR-ENGINEERING-OBJECT>
                      <SHORT-LABEL>make::CanTSyn_rules.mak</SHORT-LABEL>
                      <CATEGORY>SWMAKE</CATEGORY>
                    </AUTOSAR-ENGINEERING-OBJECT>
                  </ARTIFACT-DESCRIPTORS>
                </CODE>
              </CODE-DESCRIPTORS>
              
              <PROGRAMMING-LANGUAGE>C</PROGRAMMING-LANGUAGE>
              
              <RESOURCE-CONSUMPTION>
                <SHORT-NAME>ResourceConsumption_[!"$partitionRef"!]</SHORT-NAME>
                <MEMORY-SECTIONS>
                  <MEMORY-SECTION>
                    <SHORT-NAME>CODE</SHORT-NAME>
                    <SW-ADDRMETHOD-REF DEST="SW-ADDR-METHOD">/AUTOSAR_MemMap/SwAddrMethods/CODE</SW-ADDRMETHOD-REF>
                  </MEMORY-SECTION>
                </MEMORY-SECTIONS>
              </RESOURCE-CONSUMPTION>
              
              <SW-VERSION>5.0.5</SW-VERSION>
              <VENDOR-ID>1</VENDOR-ID>
              <AR-RELEASE-VERSION>4.7.0</AR-RELEASE-VERSION>
              
              <BEHAVIOR-REF DEST="BSW-INTERNAL-BEHAVIOR">/AUTOSAR_CanTSyn/BswModuleDescriptions/CanTSyn/InternalBehavior_[!"$partitionRef"!]</BEHAVIOR-REF>
              
              <VENDOR-API-INFIX>[!"$partitionRef"!]</VENDOR-API-INFIX>
              
              <VENDOR-SPECIFIC-MODULE-DEF-REFS>
                <VENDOR-SPECIFIC-MODULE-DEF-REF DEST="ECUC-MODULE-DEF">/TS_TxDxM5I0R0/CanTSyn</VENDOR-SPECIFIC-MODULE-DEF-REF>
              </VENDOR-SPECIFIC-MODULE-DEF-REFS>
              
            </BSW-IMPLEMENTATION>
[!ENDIF!][!//
  [!VAR "lastPartitionRef" = "$partitionRef"!][!//
            
[!ENDLOOP!]

[!ENDIF!]


            <BSW-IMPLEMENTATION>
              <SHORT-NAME>BswImplementation_0</SHORT-NAME>
              <CODE-DESCRIPTORS>
                <CODE>
                  <SHORT-NAME>Files</SHORT-NAME>
                  <ARTIFACT-DESCRIPTORS>
                    <AUTOSAR-ENGINEERING-OBJECT>
                      <SHORT-LABEL>Autosar::include::CanTSyn.h</SHORT-LABEL>
                      <CATEGORY>SWHDR</CATEGORY>
                    </AUTOSAR-ENGINEERING-OBJECT>
                    <AUTOSAR-ENGINEERING-OBJECT>
                      <SHORT-LABEL>Autosar::include::CanTSyn_Int.h</SHORT-LABEL>
                      <CATEGORY>SWHDR</CATEGORY>
                    </AUTOSAR-ENGINEERING-OBJECT>
                    <AUTOSAR-ENGINEERING-OBJECT>
                      <SHORT-LABEL>Autosar::include::CanTSyn_Int_Stc.h</SHORT-LABEL>
                      <CATEGORY>SWHDR</CATEGORY>
                    </AUTOSAR-ENGINEERING-OBJECT>
                    <AUTOSAR-ENGINEERING-OBJECT>
                      <SHORT-LABEL>Autosar::include::CanTSyn_Trace.h</SHORT-LABEL>
                      <CATEGORY>SWHDR</CATEGORY>
                    </AUTOSAR-ENGINEERING-OBJECT>
                    <AUTOSAR-ENGINEERING-OBJECT>
                      <SHORT-LABEL>Autosar::include::CanTSyn_Version.h</SHORT-LABEL>
                      <CATEGORY>SWHDR</CATEGORY>
                    </AUTOSAR-ENGINEERING-OBJECT>
                    <AUTOSAR-ENGINEERING-OBJECT>
                      <SHORT-LABEL>Autosar::src::CanTSyn.c</SHORT-LABEL>
                      <CATEGORY>SWSRC</CATEGORY>
                    </AUTOSAR-ENGINEERING-OBJECT>
                    <AUTOSAR-ENGINEERING-OBJECT>
                      <SHORT-LABEL>make::CanTSyn_defs.mak</SHORT-LABEL>
                      <CATEGORY>SWMAKE</CATEGORY>
                    </AUTOSAR-ENGINEERING-OBJECT>
                    <AUTOSAR-ENGINEERING-OBJECT>
                      <SHORT-LABEL>make::CanTSyn_rules.mak</SHORT-LABEL>
                      <CATEGORY>SWMAKE</CATEGORY>
                    </AUTOSAR-ENGINEERING-OBJECT>
                  </ARTIFACT-DESCRIPTORS>
                </CODE>
              </CODE-DESCRIPTORS>
              <PROGRAMMING-LANGUAGE>C</PROGRAMMING-LANGUAGE>
              <RESOURCE-CONSUMPTION>
                <SHORT-NAME>ResourceConsumption</SHORT-NAME>
                <MEMORY-SECTIONS>
                  <MEMORY-SECTION>
                    <SHORT-NAME>CONFIG_DATA_UNSPECIFIED</SHORT-NAME>
                    <ALIGNMENT>UNSPECIFIED</ALIGNMENT>
                    <SW-ADDRMETHOD-REF DEST="SW-ADDR-METHOD">/AUTOSAR_MemMap/SwAddrMethods/CONFIG_DATA</SW-ADDRMETHOD-REF>
                  </MEMORY-SECTION>
		  <MEMORY-SECTION>
                    <SHORT-NAME>CONST_8</SHORT-NAME>
                    <ALIGNMENT>8</ALIGNMENT>
                    <SW-ADDRMETHOD-REF DEST="SW-ADDR-METHOD">/AUTOSAR_MemMap/SwAddrMethods/CONST</SW-ADDRMETHOD-REF>
                  </MEMORY-SECTION>
                  <MEMORY-SECTION>
                    <SHORT-NAME>VAR_INIT_8</SHORT-NAME>
                    <ALIGNMENT>8</ALIGNMENT>
                    <SW-ADDRMETHOD-REF DEST="SW-ADDR-METHOD">/AUTOSAR_MemMap/SwAddrMethods/VAR</SW-ADDRMETHOD-REF>
                  </MEMORY-SECTION>
                  <MEMORY-SECTION>
                    <SHORT-NAME>VAR_CLEARED_UNSPECIFIED</SHORT-NAME>
                    <ALIGNMENT>UNSPECIFIED</ALIGNMENT>
                    <SW-ADDRMETHOD-REF DEST="SW-ADDR-METHOD">/AUTOSAR_MemMap/SwAddrMethods/VAR_CLEARED</SW-ADDRMETHOD-REF>
                  </MEMORY-SECTION>
                  <MEMORY-SECTION>
                    <SHORT-NAME>VAR_CLEARED_8</SHORT-NAME>
                    <ALIGNMENT>8</ALIGNMENT>
                    <SW-ADDRMETHOD-REF DEST="SW-ADDR-METHOD">/AUTOSAR_MemMap/SwAddrMethods/VAR_CLEARED</SW-ADDRMETHOD-REF>
                  </MEMORY-SECTION>
                  <MEMORY-SECTION>
                    <SHORT-NAME>CODE</SHORT-NAME>
                    <SW-ADDRMETHOD-REF DEST="SW-ADDR-METHOD">/AUTOSAR_MemMap/SwAddrMethods/CODE</SW-ADDRMETHOD-REF>
                  </MEMORY-SECTION>
                </MEMORY-SECTIONS>
              </RESOURCE-CONSUMPTION>
              <SW-VERSION>5.0.5</SW-VERSION>
              <VENDOR-ID>1</VENDOR-ID>
              <AR-RELEASE-VERSION>4.7.0</AR-RELEASE-VERSION>
              <BEHAVIOR-REF DEST="BSW-INTERNAL-BEHAVIOR">/AUTOSAR_CanTSyn/BswModuleDescriptions/CanTSyn/InternalBehavior_0</BEHAVIOR-REF>
              <VENDOR-SPECIFIC-MODULE-DEF-REFS>
                <VENDOR-SPECIFIC-MODULE-DEF-REF DEST="ECUC-MODULE-DEF">/TS_TxDxM5I0R0/CanTSyn</VENDOR-SPECIFIC-MODULE-DEF-REF>
              </VENDOR-SPECIFIC-MODULE-DEF-REFS>
            </BSW-IMPLEMENTATION>
            

            
            
          </ELEMENTS>
        </AR-PACKAGE>
      </AR-PACKAGES>
    </AR-PACKAGE>
  </AR-PACKAGES>
</AUTOSAR>
