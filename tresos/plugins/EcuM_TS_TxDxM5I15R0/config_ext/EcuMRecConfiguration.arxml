AUTOSAR XML (schema 00046)
package /TS_TxDxM5I15R0
  module config EcuMRecConfiguration: definition=EcuM
    EcuM_Config_0 (EcuMConfiguration)
      EcuMFlexConfiguration
        4 x EcuMShutdownCause:
          ECUM_CAUSE_UNKNOWN: EcuMShutdownCauseId=0
          ECUM_CAUSE_ECU_STATE: EcuMShutdownCauseId=1
          ECUM_CAUSE_WDGM: EcuMShutdownCauseId=2
          ECUM_CAUSE_DCM: EcuMShutdownCauseId=3
        3 x EcuMResetMode:
          ECUM_RESET_MCU: EcuMResetModeId=0
          ECUM_RESET_WDG: EcuMResetModeId=1
          ECUM_RESET_IO: EcuMResetModeId=2
        3 x EcuMShutdownTarget:
          ECUM_STATE_SLEEP: EcuMShutdownTargetId=80
          ECUM_STATE_OFF: EcuMShutdownTargetId=128
          ECUM_STATE_RESET: EcuMShutdownTargetId=144
      EcuMCommonConfiguration
        5 x EcuMWakeupSource, all with EcuMValidationTimeout=0.0:
          ECUM_WKSOURCE_POWER: EcuMWakeupSourceId=0, EcuMComMChannelRef=(unset), EcuMResetReasonRef=MCU_POWER_ON_RESET
          ECUM_WKSOURCE_RESET: EcuMWakeupSourceId=1, EcuMComMChannelRef=(unset)
          ECUM_WKSOURCE_INTERNAL_RESET: EcuMWakeupSourceId=2, EcuMComMChannelRef=(unset)
          ECUM_WKSOURCE_INTERNAL_WDG: EcuMWakeupSourceId=3
          ECUM_WKSOURCE_EXTERNAL_WDG: EcuMWakeupSourceId=4, EcuMComMChannelRef=(unset)
