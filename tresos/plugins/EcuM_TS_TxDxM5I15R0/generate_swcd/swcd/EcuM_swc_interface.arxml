<?xml version="1.0" encoding="UTF-8"?>
<AUTOSAR xmlns="http://autosar.org/schema/r4.0"
         xmlns:xsi="http://www.w3.org/2001/XMLSchema-instance"
  xsi:schemaLocation="http://autosar.org/schema/r4.0 AUTOSAR_4-2-1.xsd">
[!/* do not generate this file if RTE is not used */!][!//
[!SKIPFILE "(node:existsAndFalse(EcuMGeneral/EcuMRteUsage))  or not(node:exists(EcuMGeneral/EcuMServiceAPI))"!][!//
  <AR-PACKAGES>
    <AR-PACKAGE>
      <SHORT-NAME>AUTOSAR_EcuM</SHORT-NAME>
      <AR-PACKAGES>
[!IF "node:exists(EcuMGeneral/EcuMServiceAPI) and (node:existsAndTrue(EcuMGeneral/EcuMServiceAPI/EcuMEnableASR32ServiceAPI))"!][!//
        <!-- Provide AUTOSAR 3.2 service interface -->
        <AR-PACKAGE> <!-- ASR32 -->
          <SHORT-NAME>ASR32</SHORT-NAME>
          <AR-PACKAGES>
            <AR-PACKAGE>
              <SHORT-NAME>CompuMethods</SHORT-NAME>
              <ELEMENTS>
                <COMPU-METHOD>
                  <SHORT-NAME>ASR32_STATES</SHORT-NAME>
                  <CATEGORY>TEXTTABLE</CATEGORY>
                  <COMPU-INTERNAL-TO-PHYS>
                    <COMPU-SCALES>
                      <COMPU-SCALE>
                        <LOWER-LIMIT INTERVAL-TYPE="CLOSED">16</LOWER-LIMIT>
                        <UPPER-LIMIT INTERVAL-TYPE="CLOSED">16</UPPER-LIMIT>
                        <COMPU-CONST>
                          <VT>ECUM_STATE_STARTUP</VT>
                        </COMPU-CONST>
                      </COMPU-SCALE>
                      <COMPU-SCALE>
                        <LOWER-LIMIT INTERVAL-TYPE="CLOSED">17</LOWER-LIMIT>
                        <UPPER-LIMIT INTERVAL-TYPE="CLOSED">17</UPPER-LIMIT>
                        <COMPU-CONST>
                          <VT>ECUM_STATE_STARTUP_ONE</VT>
                        </COMPU-CONST>
                      </COMPU-SCALE>
                      <COMPU-SCALE>
                        <LOWER-LIMIT INTERVAL-TYPE="CLOSED">18</LOWER-LIMIT>
                        <UPPER-LIMIT INTERVAL-TYPE="CLOSED">18</UPPER-LIMIT>
                        <COMPU-CONST>
                          <VT>ECUM_STATE_STARTUP_TWO</VT>
                        </COMPU-CONST>
                      </COMPU-SCALE>
                      <COMPU-SCALE>
                        <LOWER-LIMIT INTERVAL-TYPE="CLOSED">32</LOWER-LIMIT>
                        <UPPER-LIMIT INTERVAL-TYPE="CLOSED">32</UPPER-LIMIT>
                        <COMPU-CONST>
                          <VT>ECUM_STATE_WAKEUP</VT>
                        </COMPU-CONST>
                      </COMPU-SCALE>
                      <COMPU-SCALE>
                        <LOWER-LIMIT INTERVAL-TYPE="CLOSED">33</LOWER-LIMIT>
                        <UPPER-LIMIT INTERVAL-TYPE="CLOSED">33</UPPER-LIMIT>
                        <COMPU-CONST>
                          <VT>ECUM_STATE_WAKEUP_ONE</VT>
                        </COMPU-CONST>
                      </COMPU-SCALE>
                      <COMPU-SCALE>
                        <LOWER-LIMIT INTERVAL-TYPE="CLOSED">34</LOWER-LIMIT>
                        <UPPER-LIMIT INTERVAL-TYPE="CLOSED">34</UPPER-LIMIT>
                        <COMPU-CONST>
                          <VT>ECUM_STATE_WAKEUP_VALIDATION</VT>
                        </COMPU-CONST>
                      </COMPU-SCALE>
                      <COMPU-SCALE>
                        <LOWER-LIMIT INTERVAL-TYPE="CLOSED">35</LOWER-LIMIT>
                        <UPPER-LIMIT INTERVAL-TYPE="CLOSED">35</UPPER-LIMIT>
                        <COMPU-CONST>
                          <VT>ECUM_STATE_WAKEUP_REACTION</VT>
                        </COMPU-CONST>
                      </COMPU-SCALE>
                      <COMPU-SCALE>
                        <LOWER-LIMIT INTERVAL-TYPE="CLOSED">36</LOWER-LIMIT>
                        <UPPER-LIMIT INTERVAL-TYPE="CLOSED">36</UPPER-LIMIT>
                        <COMPU-CONST>
                          <VT>ECUM_STATE_WAKEUP_TWO</VT>
                        </COMPU-CONST>
                      </COMPU-SCALE>
                      <COMPU-SCALE>
                        <LOWER-LIMIT INTERVAL-TYPE="CLOSED">37</LOWER-LIMIT>
                        <UPPER-LIMIT INTERVAL-TYPE="CLOSED">37</UPPER-LIMIT>
                        <COMPU-CONST>
                          <VT>ECUM_STATE_WAKEUP_WAKESLEEP</VT>
                        </COMPU-CONST>
                      </COMPU-SCALE>
                      <COMPU-SCALE>
                        <LOWER-LIMIT INTERVAL-TYPE="CLOSED">38</LOWER-LIMIT>
                        <UPPER-LIMIT INTERVAL-TYPE="CLOSED">38</UPPER-LIMIT>
                        <COMPU-CONST>
                          <VT>ECUM_STATE_WAKEUP_TTII</VT>
                        </COMPU-CONST>
                      </COMPU-SCALE>
                      <COMPU-SCALE>
                        <LOWER-LIMIT INTERVAL-TYPE="CLOSED">48</LOWER-LIMIT>
                        <UPPER-LIMIT INTERVAL-TYPE="CLOSED">48</UPPER-LIMIT>
                        <COMPU-CONST>
                          <VT>ECUM_STATE_RUN</VT>
                        </COMPU-CONST>
                      </COMPU-SCALE>
                      <COMPU-SCALE>
                        <LOWER-LIMIT INTERVAL-TYPE="CLOSED">50</LOWER-LIMIT>
                        <UPPER-LIMIT INTERVAL-TYPE="CLOSED">50</UPPER-LIMIT>
                        <COMPU-CONST>
                          <VT>ECUM_STATE_APP_RUN</VT>
                        </COMPU-CONST>
                      </COMPU-SCALE>
                      <COMPU-SCALE>
                        <LOWER-LIMIT INTERVAL-TYPE="CLOSED">51</LOWER-LIMIT>
                        <UPPER-LIMIT INTERVAL-TYPE="CLOSED">51</UPPER-LIMIT>
                        <COMPU-CONST>
                          <VT>ECUM_STATE_APP_POST_RUN</VT>
                        </COMPU-CONST>
                      </COMPU-SCALE>
                      <COMPU-SCALE>
                        <LOWER-LIMIT INTERVAL-TYPE="CLOSED">64</LOWER-LIMIT>
                        <UPPER-LIMIT INTERVAL-TYPE="CLOSED">64</UPPER-LIMIT>
                        <COMPU-CONST>
                          <VT>ECUM_STATE_SHUTDOWN</VT>
                        </COMPU-CONST>
                      </COMPU-SCALE>
                      <COMPU-SCALE>
                        <LOWER-LIMIT INTERVAL-TYPE="CLOSED">68</LOWER-LIMIT>
                        <UPPER-LIMIT INTERVAL-TYPE="CLOSED">68</UPPER-LIMIT>
                        <COMPU-CONST>
                          <VT>ECUM_STATE_PREP_SHUTDOWN</VT>
                        </COMPU-CONST>
                      </COMPU-SCALE>
                      <COMPU-SCALE>
                        <LOWER-LIMIT INTERVAL-TYPE="CLOSED">73</LOWER-LIMIT>
                        <UPPER-LIMIT INTERVAL-TYPE="CLOSED">73</UPPER-LIMIT>
                        <COMPU-CONST>
                          <VT>ECUM_STATE_GO_SLEEP</VT>
                        </COMPU-CONST>
                      </COMPU-SCALE>
                      <COMPU-SCALE>
                        <LOWER-LIMIT INTERVAL-TYPE="CLOSED">77</LOWER-LIMIT>
                        <UPPER-LIMIT INTERVAL-TYPE="CLOSED">77</UPPER-LIMIT>
                        <COMPU-CONST>
                          <VT>ECUM_STATE_GO_OFF_ONE</VT>
                        </COMPU-CONST>
                      </COMPU-SCALE>
                      <COMPU-SCALE>
                        <LOWER-LIMIT INTERVAL-TYPE="CLOSED">78</LOWER-LIMIT>
                        <UPPER-LIMIT INTERVAL-TYPE="CLOSED">78</UPPER-LIMIT>
                        <COMPU-CONST>
                          <VT>ECUM_STATE_GO_OFF_TWO</VT>
                        </COMPU-CONST>
                      </COMPU-SCALE>
                      <COMPU-SCALE>
                        <LOWER-LIMIT INTERVAL-TYPE="CLOSED">80</LOWER-LIMIT>
                        <UPPER-LIMIT INTERVAL-TYPE="CLOSED">80</UPPER-LIMIT>
                        <COMPU-CONST>
                          <VT>ECUM_STATE_SLEEP</VT>
                        </COMPU-CONST>
                      </COMPU-SCALE>
                      <COMPU-SCALE>
                        <LOWER-LIMIT INTERVAL-TYPE="CLOSED">128</LOWER-LIMIT>
                        <UPPER-LIMIT INTERVAL-TYPE="CLOSED">128</UPPER-LIMIT>
                        <COMPU-CONST>
                          <VT>ECUM_STATE_OFF</VT>
                        </COMPU-CONST>
                      </COMPU-SCALE>
                      <COMPU-SCALE>
                        <LOWER-LIMIT INTERVAL-TYPE="CLOSED">144</LOWER-LIMIT>
                        <UPPER-LIMIT INTERVAL-TYPE="CLOSED">144</UPPER-LIMIT>
                        <COMPU-CONST>
                          <VT>ECUM_STATE_RESET</VT>
                        </COMPU-CONST>
                      </COMPU-SCALE>
                    </COMPU-SCALES>
                  </COMPU-INTERNAL-TO-PHYS>
                </COMPU-METHOD>

                <COMPU-METHOD>
                  <SHORT-NAME>ASR32_BOOTTARGET</SHORT-NAME>
                  <CATEGORY>TEXTTABLE</CATEGORY>
                  <COMPU-INTERNAL-TO-PHYS>
                    <COMPU-SCALES>
                      <COMPU-SCALE>
                        <LOWER-LIMIT INTERVAL-TYPE="CLOSED">0</LOWER-LIMIT>
                        <UPPER-LIMIT INTERVAL-TYPE="CLOSED">0</UPPER-LIMIT>
                        <COMPU-CONST>
                          <VT>ECUM_BOOT_TARGET_APP</VT>
                        </COMPU-CONST>
                      </COMPU-SCALE>
                      <COMPU-SCALE>
                        <LOWER-LIMIT INTERVAL-TYPE="CLOSED">1</LOWER-LIMIT>
                        <UPPER-LIMIT INTERVAL-TYPE="CLOSED">1</UPPER-LIMIT>
                        <COMPU-CONST>
                          <VT>ECUM_BOOT_TARGET_BOOTLOADER</VT>
                        </COMPU-CONST>
                      </COMPU-SCALE>
                    </COMPU-SCALES>
                  </COMPU-INTERNAL-TO-PHYS>
                    </COMPU-METHOD>
    [!IF "node:exists(EcuMConfiguration/eb-list::*[1]/EcuMFixedConfiguration)"!][!//
                    <COMPU-METHOD>
                      <SHORT-NAME>ASR32_USERTYPE</SHORT-NAME>
                      <CATEGORY>TEXTTABLE</CATEGORY>
                      <COMPU-INTERNAL-TO-PHYS>
                        <COMPU-SCALES>
    [!LOOP "EcuMConfiguration/eb-list::*[1]/EcuMFixedConfiguration/EcuMFixedUserConfig/eb-list::*"!][!//
                          <COMPU-SCALE>
                            <LOWER-LIMIT INTERVAL-TYPE="CLOSED">[!"node:value(EcuMFixedUser)"!]</LOWER-LIMIT>
                            <UPPER-LIMIT INTERVAL-TYPE="CLOSED">[!"node:value(EcuMFixedUser)"!]</UPPER-LIMIT>
                            <COMPU-CONST>
                              <VT>[!"as:name(.)"!]</VT>
                            </COMPU-CONST>
                          </COMPU-SCALE>
    [!ENDLOOP!][!//
                        </COMPU-SCALES>
                      </COMPU-INTERNAL-TO-PHYS>
                </COMPU-METHOD>
    [!ENDIF!][!//
              </ELEMENTS>
            </AR-PACKAGE>
            <AR-PACKAGE>
              <SHORT-NAME>ImplementationDataTypes</SHORT-NAME>
              <!--
                We do not use AUTOSAR 3.2.2 package name here for the sake of consistency, since for
                the SwServiceComponentType we _HAVE_ to use the AUTSOAR 4.0.3 package name unless 3.2.2
                has been selected as default (i.e., we _CANNOT_ replicate the SwServiceComponentType
                for each activated version (e.g., one for 3.2.2 and one for 4.0.3)
              -->
              <ELEMENTS>
                <IMPLEMENTATION-DATA-TYPE>
                  <SHORT-NAME>EcuM_ASR32_StateType</SHORT-NAME>
                  <CATEGORY>TYPE_REFERENCE</CATEGORY>
                  <SW-DATA-DEF-PROPS>
                    <SW-DATA-DEF-PROPS-VARIANTS>
                      <SW-DATA-DEF-PROPS-CONDITIONAL>
                        <COMPU-METHOD-REF DEST="COMPU-METHOD">/AUTOSAR_EcuM/ASR32/CompuMethods/ASR32_STATES</COMPU-METHOD-REF>
                        <IMPLEMENTATION-DATA-TYPE-REF DEST="IMPLEMENTATION-DATA-TYPE"
                          >/AUTOSAR_Platform/ImplementationDataTypes/uint8</IMPLEMENTATION-DATA-TYPE-REF>
                      </SW-DATA-DEF-PROPS-CONDITIONAL>
                    </SW-DATA-DEF-PROPS-VARIANTS>
                  </SW-DATA-DEF-PROPS>
                </IMPLEMENTATION-DATA-TYPE>

                <IMPLEMENTATION-DATA-TYPE>
                  <SHORT-NAME>EcuM_ASR32_BootTargetType</SHORT-NAME>
                  <CATEGORY>TYPE_REFERENCE</CATEGORY>
                  <SW-DATA-DEF-PROPS>
                    <SW-DATA-DEF-PROPS-VARIANTS>
                      <SW-DATA-DEF-PROPS-CONDITIONAL>
                        <COMPU-METHOD-REF DEST="COMPU-METHOD">/AUTOSAR_EcuM/ASR32/CompuMethods/ASR32_BOOTTARGET</COMPU-METHOD-REF>
                        <IMPLEMENTATION-DATA-TYPE-REF DEST="IMPLEMENTATION-DATA-TYPE"
                              >/AUTOSAR_Platform/ImplementationDataTypes/uint8</IMPLEMENTATION-DATA-TYPE-REF>
                          </SW-DATA-DEF-PROPS-CONDITIONAL>
                        </SW-DATA-DEF-PROPS-VARIANTS>
                      </SW-DATA-DEF-PROPS>
                    </IMPLEMENTATION-DATA-TYPE>
    [!IF "node:exists(EcuMConfiguration/eb-list::*[1]/EcuMFixedConfiguration)"!][!//
                    <IMPLEMENTATION-DATA-TYPE>
                      <SHORT-NAME>EcuM_ASR32_UserType</SHORT-NAME>
                      <CATEGORY>TYPE_REFERENCE</CATEGORY>
                      <SW-DATA-DEF-PROPS>
                        <SW-DATA-DEF-PROPS-VARIANTS>
                          <SW-DATA-DEF-PROPS-CONDITIONAL>
                            <COMPU-METHOD-REF DEST="COMPU-METHOD">/AUTOSAR_EcuM/ASR32/CompuMethods/ASR32_USERTYPE</COMPU-METHOD-REF>
                            <IMPLEMENTATION-DATA-TYPE-REF DEST="IMPLEMENTATION-DATA-TYPE"
                              >/AUTOSAR_Platform/ImplementationDataTypes/uint8</IMPLEMENTATION-DATA-TYPE-REF>
                      </SW-DATA-DEF-PROPS-CONDITIONAL>
                    </SW-DATA-DEF-PROPS-VARIANTS>
                  </SW-DATA-DEF-PROPS>
                </IMPLEMENTATION-DATA-TYPE>
    [!ENDIF!][!//
              </ELEMENTS>
            </AR-PACKAGE>
            <AR-PACKAGE>
              <SHORT-NAME>PortInterfaces</SHORT-NAME>
              <ELEMENTS>
    [!IF "node:exists(EcuMConfiguration/eb-list::*[1]/EcuMFixedConfiguration)"!][!//
                <CLIENT-SERVER-INTERFACE>
                  <SHORT-NAME>EcuM_ASR32_StateRequest</SHORT-NAME>
                  <IS-SERVICE>true</IS-SERVICE>
                  <OPERATIONS>
                    <CLIENT-SERVER-OPERATION>
                      <SHORT-NAME>RequestRUN</SHORT-NAME>
                      <POSSIBLE-ERROR-REFS>
                        <POSSIBLE-ERROR-REF DEST="APPLICATION-ERROR">/AUTOSAR_EcuM/ASR32/PortInterfaces/EcuM_ASR32_StateRequest/E_NOT_OK</POSSIBLE-ERROR-REF>
                      </POSSIBLE-ERROR-REFS>
                    </CLIENT-SERVER-OPERATION>
                    <CLIENT-SERVER-OPERATION>
                      <SHORT-NAME>ReleaseRUN</SHORT-NAME>
                      <POSSIBLE-ERROR-REFS>
                        <POSSIBLE-ERROR-REF DEST="APPLICATION-ERROR">/AUTOSAR_EcuM/ASR32/PortInterfaces/EcuM_ASR32_StateRequest/E_NOT_OK</POSSIBLE-ERROR-REF>
                      </POSSIBLE-ERROR-REFS>
                    </CLIENT-SERVER-OPERATION>
                    <CLIENT-SERVER-OPERATION>
                      <SHORT-NAME>RequestPOSTRUN</SHORT-NAME>
                      <POSSIBLE-ERROR-REFS>
                        <POSSIBLE-ERROR-REF DEST="APPLICATION-ERROR">/AUTOSAR_EcuM/ASR32/PortInterfaces/EcuM_ASR32_StateRequest/E_NOT_OK</POSSIBLE-ERROR-REF>
                      </POSSIBLE-ERROR-REFS>
                    </CLIENT-SERVER-OPERATION>
                    <CLIENT-SERVER-OPERATION>
                      <SHORT-NAME>ReleasePOSTRUN</SHORT-NAME>
                      <POSSIBLE-ERROR-REFS>
                        <POSSIBLE-ERROR-REF DEST="APPLICATION-ERROR">/AUTOSAR_EcuM/ASR32/PortInterfaces/EcuM_ASR32_StateRequest/E_NOT_OK</POSSIBLE-ERROR-REF>
                      </POSSIBLE-ERROR-REFS>
                    </CLIENT-SERVER-OPERATION>
                  </OPERATIONS>
                  <POSSIBLE-ERRORS>
                    <APPLICATION-ERROR>
                      <SHORT-NAME>E_NOT_OK</SHORT-NAME>
                      <ERROR-CODE>1</ERROR-CODE>
                    </APPLICATION-ERROR>
                  </POSSIBLE-ERRORS>
                </CLIENT-SERVER-INTERFACE>
                <MODE-SWITCH-INTERFACE>
                  <SHORT-NAME>EcuM_ASR32_CurrentMode</SHORT-NAME>
                  <IS-SERVICE>true</IS-SERVICE>
                  <MODE-GROUP>
                    <SHORT-NAME>currentMode</SHORT-NAME>
                    <TYPE-TREF DEST="MODE-DECLARATION-GROUP">/AUTOSAR_EcuM/ASR32/PortInterfaces/EcuM_ASR32_Mode</TYPE-TREF>
                  </MODE-GROUP>
                </MODE-SWITCH-INTERFACE>
                <DATA-TYPE-MAPPING-SET>
                  <SHORT-NAME>EcuM_ASR32_CurrentModeMap</SHORT-NAME>
                  <MODE-REQUEST-TYPE-MAPS>
                    <MODE-REQUEST-TYPE-MAP>
                      <IMPLEMENTATION-DATA-TYPE-REF DEST="IMPLEMENTATION-DATA-TYPE">/AUTOSAR_Platform/ImplementationDataTypes/uint8</IMPLEMENTATION-DATA-TYPE-REF>
                      <MODE-GROUP-REF DEST="MODE-DECLARATION-GROUP">/AUTOSAR_EcuM/ASR32/PortInterfaces/EcuM_ASR32_Mode</MODE-GROUP-REF>
                    </MODE-REQUEST-TYPE-MAP>
                  </MODE-REQUEST-TYPE-MAPS>
                </DATA-TYPE-MAPPING-SET>
                <MODE-DECLARATION-GROUP>
                  <SHORT-NAME>EcuM_ASR32_Mode</SHORT-NAME>
                  <INITIAL-MODE-REF DEST="MODE-DECLARATION">/AUTOSAR_EcuM/ASR32/PortInterfaces/EcuM_ASR32_Mode/STARTUP</INITIAL-MODE-REF>
                  <MODE-DECLARATIONS>
                    <MODE-DECLARATION>
                      <SHORT-NAME>STARTUP</SHORT-NAME>
                    </MODE-DECLARATION>
                    <MODE-DECLARATION>
                      <SHORT-NAME>RUN</SHORT-NAME>
                    </MODE-DECLARATION>
                    <MODE-DECLARATION>
                      <SHORT-NAME>POST_RUN</SHORT-NAME>
                    </MODE-DECLARATION>
                    <MODE-DECLARATION>
                      <SHORT-NAME>SLEEP</SHORT-NAME>
                    </MODE-DECLARATION>
                    <MODE-DECLARATION>
                      <SHORT-NAME>WAKE_SLEEP</SHORT-NAME>
                    </MODE-DECLARATION>
                    <MODE-DECLARATION>
                      <SHORT-NAME>SHUTDOWN</SHORT-NAME>
                    </MODE-DECLARATION>
                  </MODE-DECLARATIONS>
                </MODE-DECLARATION-GROUP>
    [!ENDIF!][!//
                <CLIENT-SERVER-INTERFACE>
                  <SHORT-NAME>EcuM_ASR32_ShutdownTarget</SHORT-NAME>
                  <IS-SERVICE>true</IS-SERVICE>
                  <OPERATIONS>

                    <CLIENT-SERVER-OPERATION>
                      <SHORT-NAME>SelectShutdownTarget</SHORT-NAME>
                      <ARGUMENTS>
                        <ARGUMENT-DATA-PROTOTYPE>
                          <SHORT-NAME>target</SHORT-NAME>
                          <TYPE-TREF DEST="IMPLEMENTATION-DATA-TYPE">/AUTOSAR_EcuM/ASR32/ImplementationDataTypes/EcuM_ASR32_StateType</TYPE-TREF>
                          <DIRECTION>IN</DIRECTION>
                        </ARGUMENT-DATA-PROTOTYPE>
                        <ARGUMENT-DATA-PROTOTYPE>
                          <SHORT-NAME>mode</SHORT-NAME>
                          <TYPE-TREF DEST="IMPLEMENTATION-DATA-TYPE">/AUTOSAR_Platform/ImplementationDataTypes/uint8</TYPE-TREF>
                          <DIRECTION>IN</DIRECTION>
                        </ARGUMENT-DATA-PROTOTYPE>
                      </ARGUMENTS>
                      <POSSIBLE-ERROR-REFS>
                        <POSSIBLE-ERROR-REF DEST="APPLICATION-ERROR">/AUTOSAR_EcuM/ASR32/PortInterfaces/EcuM_ASR32_ShutdownTarget/E_NOT_OK</POSSIBLE-ERROR-REF>
                      </POSSIBLE-ERROR-REFS>
                    </CLIENT-SERVER-OPERATION>

                    <CLIENT-SERVER-OPERATION>
                      <SHORT-NAME>GetShutdownTarget</SHORT-NAME>
                      <ARGUMENTS>
                        <ARGUMENT-DATA-PROTOTYPE>
                          <SHORT-NAME>target</SHORT-NAME>
                          <TYPE-TREF DEST="IMPLEMENTATION-DATA-TYPE">/AUTOSAR_EcuM/ASR32/ImplementationDataTypes/EcuM_ASR32_StateType</TYPE-TREF>
                          <DIRECTION>OUT</DIRECTION>
                        </ARGUMENT-DATA-PROTOTYPE>
                        <ARGUMENT-DATA-PROTOTYPE>
                          <SHORT-NAME>mode</SHORT-NAME>
                          <TYPE-TREF DEST="IMPLEMENTATION-DATA-TYPE">/AUTOSAR_Platform/ImplementationDataTypes/uint8</TYPE-TREF>
                          <DIRECTION>OUT</DIRECTION>
                        </ARGUMENT-DATA-PROTOTYPE>
                      </ARGUMENTS>
                      <POSSIBLE-ERROR-REFS>
                        <POSSIBLE-ERROR-REF DEST="APPLICATION-ERROR">/AUTOSAR_EcuM/ASR32/PortInterfaces/EcuM_ASR32_ShutdownTarget/E_NOT_OK</POSSIBLE-ERROR-REF>
                      </POSSIBLE-ERROR-REFS>
                    </CLIENT-SERVER-OPERATION>

                    <CLIENT-SERVER-OPERATION>
                      <SHORT-NAME>GetLastShutdownTarget</SHORT-NAME>
                      <ARGUMENTS>
                        <ARGUMENT-DATA-PROTOTYPE>
                          <SHORT-NAME>target</SHORT-NAME>
                          <TYPE-TREF DEST="IMPLEMENTATION-DATA-TYPE">/AUTOSAR_EcuM/ASR32/ImplementationDataTypes/EcuM_ASR32_StateType</TYPE-TREF>
                          <DIRECTION>OUT</DIRECTION>
                        </ARGUMENT-DATA-PROTOTYPE>
                        <ARGUMENT-DATA-PROTOTYPE>
                          <SHORT-NAME>mode</SHORT-NAME>
                          <TYPE-TREF DEST="IMPLEMENTATION-DATA-TYPE">/AUTOSAR_Platform/ImplementationDataTypes/uint8</TYPE-TREF>
                          <DIRECTION>OUT</DIRECTION>
                        </ARGUMENT-DATA-PROTOTYPE>
                      </ARGUMENTS>
                      <POSSIBLE-ERROR-REFS>
                        <POSSIBLE-ERROR-REF DEST="APPLICATION-ERROR">/AUTOSAR_EcuM/ASR32/PortInterfaces/EcuM_ASR32_ShutdownTarget/E_NOT_OK</POSSIBLE-ERROR-REF>
                      </POSSIBLE-ERROR-REFS>
                    </CLIENT-SERVER-OPERATION>

                  </OPERATIONS>
                  <POSSIBLE-ERRORS>
                    <APPLICATION-ERROR>
                      <SHORT-NAME>E_NOT_OK</SHORT-NAME>
                      <ERROR-CODE>1</ERROR-CODE>
                    </APPLICATION-ERROR>
                  </POSSIBLE-ERRORS>
                </CLIENT-SERVER-INTERFACE>

                <CLIENT-SERVER-INTERFACE>
                  <SHORT-NAME>EcuM_ASR32_BootTarget</SHORT-NAME>
                  <IS-SERVICE>true</IS-SERVICE>
                  <OPERATIONS>
                    <CLIENT-SERVER-OPERATION>
                      <SHORT-NAME>SelectBootTarget</SHORT-NAME>
                      <ARGUMENTS>
                        <ARGUMENT-DATA-PROTOTYPE>
                          <SHORT-NAME>target</SHORT-NAME>
                          <TYPE-TREF DEST="IMPLEMENTATION-DATA-TYPE">/AUTOSAR_EcuM/ASR32/ImplementationDataTypes/EcuM_ASR32_BootTargetType</TYPE-TREF>
                          <DIRECTION>IN</DIRECTION>
                        </ARGUMENT-DATA-PROTOTYPE>
                      </ARGUMENTS>
                      <POSSIBLE-ERROR-REFS>
                        <POSSIBLE-ERROR-REF DEST="APPLICATION-ERROR">/AUTOSAR_EcuM/ASR32/PortInterfaces/EcuM_ASR32_BootTarget/E_NOT_OK</POSSIBLE-ERROR-REF>
                      </POSSIBLE-ERROR-REFS>
                    </CLIENT-SERVER-OPERATION>
                    <CLIENT-SERVER-OPERATION>
                      <SHORT-NAME>GetBootTarget</SHORT-NAME>
                      <ARGUMENTS>
                        <ARGUMENT-DATA-PROTOTYPE>
                          <SHORT-NAME>target</SHORT-NAME>
                          <TYPE-TREF DEST="IMPLEMENTATION-DATA-TYPE">/AUTOSAR_EcuM/ASR32/ImplementationDataTypes/EcuM_ASR32_BootTargetType</TYPE-TREF>
                          <DIRECTION>OUT</DIRECTION>
                        </ARGUMENT-DATA-PROTOTYPE>
                      </ARGUMENTS>
                      <POSSIBLE-ERROR-REFS>
                        <POSSIBLE-ERROR-REF DEST="APPLICATION-ERROR">/AUTOSAR_EcuM/ASR32/PortInterfaces/EcuM_ASR32_BootTarget/E_NOT_OK</POSSIBLE-ERROR-REF>
                      </POSSIBLE-ERROR-REFS>
                    </CLIENT-SERVER-OPERATION>
                  </OPERATIONS>
                  <POSSIBLE-ERRORS>
                    <APPLICATION-ERROR>
                      <SHORT-NAME>E_NOT_OK</SHORT-NAME>
                      <ERROR-CODE>1</ERROR-CODE>
                    </APPLICATION-ERROR>
                  </POSSIBLE-ERRORS>
                </CLIENT-SERVER-INTERFACE>
              </ELEMENTS>
            </AR-PACKAGE>
          </AR-PACKAGES>
        </AR-PACKAGE>
[!ENDIF!][!//
[!IF "node:exists(EcuMGeneral/EcuMServiceAPI) and (node:existsAndTrue(EcuMGeneral/EcuMServiceAPI/EcuMEnableASR40ServiceAPI))"!][!//
        <!-- Provide AUTOSAR 4.0 service interface -->
        <AR-PACKAGE> <!-- ASR40 -->
          <SHORT-NAME>ASR40</SHORT-NAME>
          <AR-PACKAGES>
            <AR-PACKAGE>
              <SHORT-NAME>CompuMethods</SHORT-NAME>
              <ELEMENTS>

                <COMPU-METHOD>
                  <SHORT-NAME>ASR40_STATES</SHORT-NAME>
                  <CATEGORY>TEXTTABLE</CATEGORY>
                  <COMPU-INTERNAL-TO-PHYS>
                    <COMPU-SCALES>
                      <COMPU-SCALE>
                        <LOWER-LIMIT INTERVAL-TYPE="CLOSED">16</LOWER-LIMIT>
                        <UPPER-LIMIT INTERVAL-TYPE="CLOSED">16</UPPER-LIMIT>
                        <COMPU-CONST>
                          <VT>ECUM_STATE_STARTUP</VT>
                        </COMPU-CONST>
                      </COMPU-SCALE>
                      <COMPU-SCALE>
                        <LOWER-LIMIT INTERVAL-TYPE="CLOSED">17</LOWER-LIMIT>
                        <UPPER-LIMIT INTERVAL-TYPE="CLOSED">17</UPPER-LIMIT>
                        <COMPU-CONST>
                          <VT>ECUM_STATE_STARTUP_ONE</VT>
                        </COMPU-CONST>
                      </COMPU-SCALE>
                      <COMPU-SCALE>
                        <LOWER-LIMIT INTERVAL-TYPE="CLOSED">18</LOWER-LIMIT>
                        <UPPER-LIMIT INTERVAL-TYPE="CLOSED">18</UPPER-LIMIT>
                        <COMPU-CONST>
                          <VT>ECUM_STATE_STARTUP_TWO</VT>
                        </COMPU-CONST>
                      </COMPU-SCALE>
                      <COMPU-SCALE>
                        <LOWER-LIMIT INTERVAL-TYPE="CLOSED">32</LOWER-LIMIT>
                        <UPPER-LIMIT INTERVAL-TYPE="CLOSED">32</UPPER-LIMIT>
                        <COMPU-CONST>
                          <VT>ECUM_STATE_WAKEUP</VT>
                        </COMPU-CONST>
                      </COMPU-SCALE>
                      <COMPU-SCALE>
                        <LOWER-LIMIT INTERVAL-TYPE="CLOSED">33</LOWER-LIMIT>
                        <UPPER-LIMIT INTERVAL-TYPE="CLOSED">33</UPPER-LIMIT>
                        <COMPU-CONST>
                          <VT>ECUM_STATE_WAKEUP_ONE</VT>
                        </COMPU-CONST>
                      </COMPU-SCALE>
                      <COMPU-SCALE>
                        <LOWER-LIMIT INTERVAL-TYPE="CLOSED">34</LOWER-LIMIT>
                        <UPPER-LIMIT INTERVAL-TYPE="CLOSED">34</UPPER-LIMIT>
                        <COMPU-CONST>
                          <VT>ECUM_STATE_WAKEUP_VALIDATION</VT>
                        </COMPU-CONST>
                      </COMPU-SCALE>
                      <COMPU-SCALE>
                        <LOWER-LIMIT INTERVAL-TYPE="CLOSED">35</LOWER-LIMIT>
                        <UPPER-LIMIT INTERVAL-TYPE="CLOSED">35</UPPER-LIMIT>
                        <COMPU-CONST>
                          <VT>ECUM_STATE_WAKEUP_REACTION</VT>
                        </COMPU-CONST>
                      </COMPU-SCALE>
                      <COMPU-SCALE>
                        <LOWER-LIMIT INTERVAL-TYPE="CLOSED">36</LOWER-LIMIT>
                        <UPPER-LIMIT INTERVAL-TYPE="CLOSED">36</UPPER-LIMIT>
                        <COMPU-CONST>
                          <VT>ECUM_STATE_WAKEUP_TWO</VT>
                        </COMPU-CONST>
                      </COMPU-SCALE>
                      <COMPU-SCALE>
                        <LOWER-LIMIT INTERVAL-TYPE="CLOSED">37</LOWER-LIMIT>
                        <UPPER-LIMIT INTERVAL-TYPE="CLOSED">37</UPPER-LIMIT>
                        <COMPU-CONST>
                          <VT>ECUM_STATE_WAKEUP_WAKESLEEP</VT>
                        </COMPU-CONST>
                      </COMPU-SCALE>
                      <COMPU-SCALE>
                        <LOWER-LIMIT INTERVAL-TYPE="CLOSED">38</LOWER-LIMIT>
                        <UPPER-LIMIT INTERVAL-TYPE="CLOSED">38</UPPER-LIMIT>
                        <COMPU-CONST>
                          <VT>ECUM_STATE_WAKEUP_TTII</VT>
                        </COMPU-CONST>
                      </COMPU-SCALE>
                      <COMPU-SCALE>
                        <LOWER-LIMIT INTERVAL-TYPE="CLOSED">48</LOWER-LIMIT>
                        <UPPER-LIMIT INTERVAL-TYPE="CLOSED">48</UPPER-LIMIT>
                        <COMPU-CONST>
                          <VT>ECUM_STATE_RUN</VT>
                        </COMPU-CONST>
                      </COMPU-SCALE>
                      <COMPU-SCALE>
                        <LOWER-LIMIT INTERVAL-TYPE="CLOSED">50</LOWER-LIMIT>
                        <UPPER-LIMIT INTERVAL-TYPE="CLOSED">50</UPPER-LIMIT>
                        <COMPU-CONST>
                          <VT>ECUM_STATE_APP_RUN</VT>
                        </COMPU-CONST>
                      </COMPU-SCALE>
                      <COMPU-SCALE>
                        <LOWER-LIMIT INTERVAL-TYPE="CLOSED">51</LOWER-LIMIT>
                        <UPPER-LIMIT INTERVAL-TYPE="CLOSED">51</UPPER-LIMIT>
                        <COMPU-CONST>
                          <VT>ECUM_STATE_APP_POST_RUN</VT>
                        </COMPU-CONST>
                      </COMPU-SCALE>
                      <COMPU-SCALE>
                        <LOWER-LIMIT INTERVAL-TYPE="CLOSED">64</LOWER-LIMIT>
                        <UPPER-LIMIT INTERVAL-TYPE="CLOSED">64</UPPER-LIMIT>
                        <COMPU-CONST>
                          <VT>ECUM_STATE_SHUTDOWN</VT>
                        </COMPU-CONST>
                      </COMPU-SCALE>
                      <COMPU-SCALE>
                        <LOWER-LIMIT INTERVAL-TYPE="CLOSED">68</LOWER-LIMIT>
                        <UPPER-LIMIT INTERVAL-TYPE="CLOSED">68</UPPER-LIMIT>
                        <COMPU-CONST>
                          <VT>ECUM_STATE_PREP_SHUTDOWN</VT>
                        </COMPU-CONST>
                      </COMPU-SCALE>
                      <COMPU-SCALE>
                        <LOWER-LIMIT INTERVAL-TYPE="CLOSED">73</LOWER-LIMIT>
                        <UPPER-LIMIT INTERVAL-TYPE="CLOSED">73</UPPER-LIMIT>
                        <COMPU-CONST>
                          <VT>ECUM_STATE_GO_SLEEP</VT>
                        </COMPU-CONST>
                      </COMPU-SCALE>
                      <COMPU-SCALE>
                        <LOWER-LIMIT INTERVAL-TYPE="CLOSED">77</LOWER-LIMIT>
                        <UPPER-LIMIT INTERVAL-TYPE="CLOSED">77</UPPER-LIMIT>
                        <COMPU-CONST>
                          <VT>ECUM_STATE_GO_OFF_ONE</VT>
                        </COMPU-CONST>
                      </COMPU-SCALE>
                      <COMPU-SCALE>
                        <LOWER-LIMIT INTERVAL-TYPE="CLOSED">78</LOWER-LIMIT>
                        <UPPER-LIMIT INTERVAL-TYPE="CLOSED">78</UPPER-LIMIT>
                        <COMPU-CONST>
                          <VT>ECUM_STATE_GO_OFF_TWO</VT>
                        </COMPU-CONST>
                      </COMPU-SCALE>
                      <COMPU-SCALE>
                        <LOWER-LIMIT INTERVAL-TYPE="CLOSED">80</LOWER-LIMIT>
                        <UPPER-LIMIT INTERVAL-TYPE="CLOSED">80</UPPER-LIMIT>
                        <COMPU-CONST>
                          <VT>ECUM_STATE_SLEEP</VT>
                        </COMPU-CONST>
                      </COMPU-SCALE>
                      <COMPU-SCALE>
                        <LOWER-LIMIT INTERVAL-TYPE="CLOSED">128</LOWER-LIMIT>
                        <UPPER-LIMIT INTERVAL-TYPE="CLOSED">128</UPPER-LIMIT>
                        <COMPU-CONST>
                          <VT>ECUM_STATE_OFF</VT>
                        </COMPU-CONST>
                      </COMPU-SCALE>
                      <COMPU-SCALE>
                        <LOWER-LIMIT INTERVAL-TYPE="CLOSED">144</LOWER-LIMIT>
                        <UPPER-LIMIT INTERVAL-TYPE="CLOSED">144</UPPER-LIMIT>
                        <COMPU-CONST>
                          <VT>ECUM_STATE_RESET</VT>
                        </COMPU-CONST>
                      </COMPU-SCALE>
                    </COMPU-SCALES>
                  </COMPU-INTERNAL-TO-PHYS>
                </COMPU-METHOD>
                <COMPU-METHOD>
                  <SHORT-NAME>ASR40_SHUTDOWNCAUSE</SHORT-NAME>
                  <CATEGORY>TEXTTABLE</CATEGORY>
                  <COMPU-INTERNAL-TO-PHYS>
                    <COMPU-SCALES>
                      <COMPU-SCALE>
                        <LOWER-LIMIT INTERVAL-TYPE="CLOSED">0</LOWER-LIMIT>
                        <UPPER-LIMIT INTERVAL-TYPE="CLOSED">0</UPPER-LIMIT>
                        <COMPU-CONST>
                          <VT>ECUM_CAUSE_UNKNOWN</VT>
                        </COMPU-CONST>
                      </COMPU-SCALE>
                      <COMPU-SCALE>
                        <LOWER-LIMIT INTERVAL-TYPE="CLOSED">1</LOWER-LIMIT>
                        <UPPER-LIMIT INTERVAL-TYPE="CLOSED">1</UPPER-LIMIT>
                        <COMPU-CONST>
                          <VT>ECUM_CAUSE_ECU_STATE</VT>
                        </COMPU-CONST>
                      </COMPU-SCALE>
                      <COMPU-SCALE>
                        <LOWER-LIMIT INTERVAL-TYPE="CLOSED">2</LOWER-LIMIT>
                        <UPPER-LIMIT INTERVAL-TYPE="CLOSED">2</UPPER-LIMIT>
                        <COMPU-CONST>
                          <VT>ECUM_CAUSE_WDGM</VT>
                        </COMPU-CONST>
                      </COMPU-SCALE>
                      <COMPU-SCALE>
                        <LOWER-LIMIT INTERVAL-TYPE="CLOSED">3</LOWER-LIMIT>
                        <UPPER-LIMIT INTERVAL-TYPE="CLOSED">3</UPPER-LIMIT>
                        <COMPU-CONST>
                          <VT>ECUM_CAUSE_DCM</VT>
                        </COMPU-CONST>
                      </COMPU-SCALE>
                    </COMPU-SCALES>
                  </COMPU-INTERNAL-TO-PHYS>
                </COMPU-METHOD>

                <COMPU-METHOD>
                  <SHORT-NAME>ASR40_BOOTTARGET</SHORT-NAME>
                  <CATEGORY>TEXTTABLE</CATEGORY>
                  <COMPU-INTERNAL-TO-PHYS>
                    <COMPU-SCALES>
                      <COMPU-SCALE>
                        <LOWER-LIMIT INTERVAL-TYPE="CLOSED">0</LOWER-LIMIT>
                        <UPPER-LIMIT INTERVAL-TYPE="CLOSED">0</UPPER-LIMIT>
                        <COMPU-CONST>
                          <VT>ECUM_BOOT_TARGET_APP</VT>
                        </COMPU-CONST>
                      </COMPU-SCALE>
                      <COMPU-SCALE>
                        <LOWER-LIMIT INTERVAL-TYPE="CLOSED">1</LOWER-LIMIT>
                        <UPPER-LIMIT INTERVAL-TYPE="CLOSED">1</UPPER-LIMIT>
                        <COMPU-CONST>
                          <VT>ECUM_BOOT_TARGET_OEM_BOOTLOADER</VT>
                        </COMPU-CONST>
                      </COMPU-SCALE>
                      <COMPU-SCALE>
                        <LOWER-LIMIT INTERVAL-TYPE="CLOSED">2</LOWER-LIMIT>
                        <UPPER-LIMIT INTERVAL-TYPE="CLOSED">2</UPPER-LIMIT>
                        <COMPU-CONST>
                          <!-- This deviates from the SWS which
                               mentions
                               ECUM_BOOT_TARGET_SYSTEM_SUPPLIER_BOOTLOADER.
                               http://www.autosar.org/bugzilla/show_bug.cgi?id=48892 -->
                          <VT>ECUM_BOOT_TARGET_SYS_BOOTLOADER</VT>
                        </COMPU-CONST>
                      </COMPU-SCALE>
                    </COMPU-SCALES>
                  </COMPU-INTERNAL-TO-PHYS>
                    </COMPU-METHOD>
    [!IF "node:exists(EcuMConfiguration/eb-list::*[1]/EcuMFixedConfiguration)"!][!//
                    <COMPU-METHOD>
                      <SHORT-NAME>ASR40_USERTYPE</SHORT-NAME>
                      <CATEGORY>TEXTTABLE</CATEGORY>
                      <COMPU-INTERNAL-TO-PHYS>
                        <COMPU-SCALES>
    [!LOOP "EcuMConfiguration/eb-list::*[1]/EcuMFixedConfiguration/EcuMFixedUserConfig/eb-list::*"!][!//
                          <COMPU-SCALE>
                            <LOWER-LIMIT INTERVAL-TYPE="CLOSED">[!"node:value(EcuMFixedUser)"!]</LOWER-LIMIT>
                            <UPPER-LIMIT INTERVAL-TYPE="CLOSED">[!"node:value(EcuMFixedUser)"!]</UPPER-LIMIT>
                            <COMPU-CONST>
                              <VT>[!"as:name(.)"!]</VT>
                            </COMPU-CONST>
                          </COMPU-SCALE>
    [!ENDLOOP!][!//
                        </COMPU-SCALES>
                      </COMPU-INTERNAL-TO-PHYS>
                </COMPU-METHOD>
    [!ENDIF!][!//
              </ELEMENTS>
            </AR-PACKAGE>

                <!-- The data types 'EcuM_ModeType' and 'EcuM_TimeType' are not provided since
                     the definition is not available in AUTOSAR R4.0r2 document "Specification
                     of ECU State Manager" section 7.10.2.
                     http://www.autosar.org/bugzilla/show_bug.cgi?id=49743 -->
            <AR-PACKAGE>
              <SHORT-NAME>ImplementationDataTypes</SHORT-NAME>
              <ELEMENTS>            
                <IMPLEMENTATION-DATA-TYPE>
                  <SHORT-NAME>EcuM_ASR40_StateType</SHORT-NAME>
                  <CATEGORY>TYPE_REFERENCE</CATEGORY>
                  <SW-DATA-DEF-PROPS>
                    <SW-DATA-DEF-PROPS-VARIANTS>
                      <SW-DATA-DEF-PROPS-CONDITIONAL>
                        <COMPU-METHOD-REF DEST="COMPU-METHOD">/AUTOSAR_EcuM/ASR40/CompuMethods/ASR40_STATES</COMPU-METHOD-REF>
                        <IMPLEMENTATION-DATA-TYPE-REF DEST="IMPLEMENTATION-DATA-TYPE"
                          >/AUTOSAR_Platform/ImplementationDataTypes/uint8</IMPLEMENTATION-DATA-TYPE-REF>
                      </SW-DATA-DEF-PROPS-CONDITIONAL>
                    </SW-DATA-DEF-PROPS-VARIANTS>
                  </SW-DATA-DEF-PROPS>
                </IMPLEMENTATION-DATA-TYPE>

                <!-- The definition of the data type 'EcuM_ShutdownCauseType' is not specified in
                     AUTOSAR R4.0r2 document "Specification of ECU State Manager" section 7.10.2.
                     But it is mapped to uint8 in reference with the argument description of the
                     API EcuM_SelectShutdownCause().
                     http://www.autosar.org/bugzilla/show_bug.cgi?id=49743 -->  
                <IMPLEMENTATION-DATA-TYPE>
                  <SHORT-NAME>EcuM_ASR40_ShutdownCauseType</SHORT-NAME>
                  <CATEGORY>TYPE_REFERENCE</CATEGORY>
                  <SW-DATA-DEF-PROPS>
                    <SW-DATA-DEF-PROPS-VARIANTS>
                      <SW-DATA-DEF-PROPS-CONDITIONAL>
                        <COMPU-METHOD-REF DEST="COMPU-METHOD">/AUTOSAR_EcuM/ASR40/CompuMethods/ASR40_SHUTDOWNCAUSE</COMPU-METHOD-REF>
                        <IMPLEMENTATION-DATA-TYPE-REF DEST="IMPLEMENTATION-DATA-TYPE"
                          >/AUTOSAR_Platform/ImplementationDataTypes/uint8</IMPLEMENTATION-DATA-TYPE-REF>
                      </SW-DATA-DEF-PROPS-CONDITIONAL>
                    </SW-DATA-DEF-PROPS-VARIANTS>
                  </SW-DATA-DEF-PROPS>  
                </IMPLEMENTATION-DATA-TYPE>

                <IMPLEMENTATION-DATA-TYPE>
                  <SHORT-NAME>EcuM_ASR40_BootTargetType</SHORT-NAME>
                  <CATEGORY>TYPE_REFERENCE</CATEGORY>
                  <SW-DATA-DEF-PROPS>
                    <SW-DATA-DEF-PROPS-VARIANTS>
                      <SW-DATA-DEF-PROPS-CONDITIONAL>
                        <COMPU-METHOD-REF DEST="COMPU-METHOD">/AUTOSAR_EcuM/ASR40/CompuMethods/ASR40_BOOTTARGET</COMPU-METHOD-REF>
                        <IMPLEMENTATION-DATA-TYPE-REF DEST="IMPLEMENTATION-DATA-TYPE"
                              >/AUTOSAR_Platform/ImplementationDataTypes/uint8</IMPLEMENTATION-DATA-TYPE-REF>
                          </SW-DATA-DEF-PROPS-CONDITIONAL>
                        </SW-DATA-DEF-PROPS-VARIANTS>
                      </SW-DATA-DEF-PROPS>
                    </IMPLEMENTATION-DATA-TYPE>
    [!IF "node:exists(EcuMConfiguration/eb-list::*[1]/EcuMFixedConfiguration)"!][!//
                    <IMPLEMENTATION-DATA-TYPE>
                      <SHORT-NAME>EcuM_ASR40_UserType</SHORT-NAME>
                      <CATEGORY>TYPE_REFERENCE</CATEGORY>
                      <SW-DATA-DEF-PROPS>
                        <SW-DATA-DEF-PROPS-VARIANTS>
                          <SW-DATA-DEF-PROPS-CONDITIONAL>
                            <COMPU-METHOD-REF DEST="COMPU-METHOD">/AUTOSAR_EcuM/ASR40/CompuMethods/ASR40_USERTYPE</COMPU-METHOD-REF>
                            <IMPLEMENTATION-DATA-TYPE-REF DEST="IMPLEMENTATION-DATA-TYPE"
                              >/AUTOSAR_Platform/ImplementationDataTypes/uint8</IMPLEMENTATION-DATA-TYPE-REF>
                      </SW-DATA-DEF-PROPS-CONDITIONAL>
                    </SW-DATA-DEF-PROPS-VARIANTS>
                  </SW-DATA-DEF-PROPS>
                </IMPLEMENTATION-DATA-TYPE>
    [!ENDIF!][!//
              </ELEMENTS>
            </AR-PACKAGE>

            <AR-PACKAGE>
              <SHORT-NAME>PortInterfaces</SHORT-NAME>
              <ELEMENTS>
    [!IF "node:exists(EcuMConfiguration/eb-list::*[1]/EcuMFixedConfiguration)"!][!//
                <CLIENT-SERVER-INTERFACE>
                  <SHORT-NAME>EcuM_ASR40_StateRequest</SHORT-NAME>
                  <IS-SERVICE>true</IS-SERVICE>
                  <OPERATIONS>
                    <CLIENT-SERVER-OPERATION>
                      <SHORT-NAME>RequestRUN</SHORT-NAME>
                      <POSSIBLE-ERROR-REFS>
                        <POSSIBLE-ERROR-REF DEST="APPLICATION-ERROR">/AUTOSAR_EcuM/ASR40/PortInterfaces/EcuM_ASR40_StateRequest/E_NOT_OK</POSSIBLE-ERROR-REF>
                      </POSSIBLE-ERROR-REFS>
                    </CLIENT-SERVER-OPERATION>
                    <CLIENT-SERVER-OPERATION>
                      <SHORT-NAME>ReleaseRUN</SHORT-NAME>
                      <POSSIBLE-ERROR-REFS>
                        <POSSIBLE-ERROR-REF DEST="APPLICATION-ERROR">/AUTOSAR_EcuM/ASR40/PortInterfaces/EcuM_ASR40_StateRequest/E_NOT_OK</POSSIBLE-ERROR-REF>
                      </POSSIBLE-ERROR-REFS>
                    </CLIENT-SERVER-OPERATION>
                    <CLIENT-SERVER-OPERATION>
                      <SHORT-NAME>RequestPOSTRUN</SHORT-NAME>
                      <POSSIBLE-ERROR-REFS>
                        <POSSIBLE-ERROR-REF DEST="APPLICATION-ERROR">/AUTOSAR_EcuM/ASR40/PortInterfaces/EcuM_ASR40_StateRequest/E_NOT_OK</POSSIBLE-ERROR-REF>
                      </POSSIBLE-ERROR-REFS>
                    </CLIENT-SERVER-OPERATION>
                    <CLIENT-SERVER-OPERATION>
                      <SHORT-NAME>ReleasePOSTRUN</SHORT-NAME>
                      <POSSIBLE-ERROR-REFS>
                        <POSSIBLE-ERROR-REF DEST="APPLICATION-ERROR">/AUTOSAR_EcuM/ASR40/PortInterfaces/EcuM_ASR40_StateRequest/E_NOT_OK</POSSIBLE-ERROR-REF>
                      </POSSIBLE-ERROR-REFS>
                    </CLIENT-SERVER-OPERATION>
                  </OPERATIONS>
                  <POSSIBLE-ERRORS>
                    <APPLICATION-ERROR>
                      <SHORT-NAME>E_NOT_OK</SHORT-NAME>
                      <ERROR-CODE>1</ERROR-CODE>
                    </APPLICATION-ERROR>
                  </POSSIBLE-ERRORS>
                </CLIENT-SERVER-INTERFACE>
                <MODE-SWITCH-INTERFACE>
                  <SHORT-NAME>EcuM_ASR40_CurrentMode</SHORT-NAME>
                  <IS-SERVICE>true</IS-SERVICE>
                  <MODE-GROUP>
                    <SHORT-NAME>currentMode</SHORT-NAME>
                    <TYPE-TREF DEST="MODE-DECLARATION-GROUP">/AUTOSAR_EcuM/ASR40/PortInterfaces/EcuM_ASR40_Mode</TYPE-TREF>
                  </MODE-GROUP>
                </MODE-SWITCH-INTERFACE>
                <DATA-TYPE-MAPPING-SET>
                  <SHORT-NAME>EcuM_ASR40_CurrentModeMap</SHORT-NAME>
                  <MODE-REQUEST-TYPE-MAPS>
                    <MODE-REQUEST-TYPE-MAP>
                      <IMPLEMENTATION-DATA-TYPE-REF DEST="IMPLEMENTATION-DATA-TYPE">/AUTOSAR_Platform/ImplementationDataTypes/uint8</IMPLEMENTATION-DATA-TYPE-REF>
                      <MODE-GROUP-REF DEST="MODE-DECLARATION-GROUP">/AUTOSAR_EcuM/ASR40/PortInterfaces/EcuM_ASR40_Mode</MODE-GROUP-REF>
                    </MODE-REQUEST-TYPE-MAP>
                  </MODE-REQUEST-TYPE-MAPS>
                </DATA-TYPE-MAPPING-SET>
                <MODE-DECLARATION-GROUP>
                  <SHORT-NAME>EcuM_ASR40_Mode</SHORT-NAME>
                  <INITIAL-MODE-REF DEST="MODE-DECLARATION">/AUTOSAR_EcuM/ASR40/PortInterfaces/EcuM_ASR40_Mode/STARTUP</INITIAL-MODE-REF>
                  <MODE-DECLARATIONS>
                    <MODE-DECLARATION>
                      <SHORT-NAME>STARTUP</SHORT-NAME>
                    </MODE-DECLARATION>
                    <MODE-DECLARATION>
                      <SHORT-NAME>RUN</SHORT-NAME>
                    </MODE-DECLARATION>
                    <MODE-DECLARATION>
                      <SHORT-NAME>POST_RUN</SHORT-NAME>
                    </MODE-DECLARATION>
                    <MODE-DECLARATION>
                      <SHORT-NAME>SLEEP</SHORT-NAME>
                    </MODE-DECLARATION>
                    <MODE-DECLARATION>
                      <SHORT-NAME>WAKE_SLEEP</SHORT-NAME>
                    </MODE-DECLARATION>
                    <MODE-DECLARATION>
                      <SHORT-NAME>SHUTDOWN</SHORT-NAME>
                    </MODE-DECLARATION>
                  </MODE-DECLARATIONS>
                </MODE-DECLARATION-GROUP>
    [!ENDIF!][!//
                <CLIENT-SERVER-INTERFACE>
                  <SHORT-NAME>EcuM_ASR40_ShutdownTarget</SHORT-NAME>
                  <IS-SERVICE>true</IS-SERVICE>
                  <OPERATIONS>

                    <CLIENT-SERVER-OPERATION>
                      <SHORT-NAME>SelectShutdownTarget</SHORT-NAME>
                      <ARGUMENTS>
                        <ARGUMENT-DATA-PROTOTYPE>
                          <SHORT-NAME>target</SHORT-NAME>
                          <TYPE-TREF DEST="IMPLEMENTATION-DATA-TYPE">/AUTOSAR_EcuM/ASR40/ImplementationDataTypes/EcuM_ASR40_StateType</TYPE-TREF>
                          <DIRECTION>IN</DIRECTION>
                        </ARGUMENT-DATA-PROTOTYPE>
                        <ARGUMENT-DATA-PROTOTYPE>
                          <SHORT-NAME>mode</SHORT-NAME>
                          <TYPE-TREF DEST="IMPLEMENTATION-DATA-TYPE">/AUTOSAR_Platform/ImplementationDataTypes/uint8</TYPE-TREF>
                          <DIRECTION>IN</DIRECTION>
                        </ARGUMENT-DATA-PROTOTYPE>
                      </ARGUMENTS>
                      <POSSIBLE-ERROR-REFS>
                        <POSSIBLE-ERROR-REF DEST="APPLICATION-ERROR">/AUTOSAR_EcuM/ASR40/PortInterfaces/EcuM_ASR40_ShutdownTarget/E_NOT_OK</POSSIBLE-ERROR-REF>
                      </POSSIBLE-ERROR-REFS>
                    </CLIENT-SERVER-OPERATION>

                    <CLIENT-SERVER-OPERATION>
                      <SHORT-NAME>GetShutdownTarget</SHORT-NAME>
                      <ARGUMENTS>
                        <ARGUMENT-DATA-PROTOTYPE>
                          <SHORT-NAME>target</SHORT-NAME>
                          <TYPE-TREF DEST="IMPLEMENTATION-DATA-TYPE">/AUTOSAR_EcuM/ASR40/ImplementationDataTypes/EcuM_ASR40_StateType</TYPE-TREF>
                          <DIRECTION>OUT</DIRECTION>
                        </ARGUMENT-DATA-PROTOTYPE>
                        <ARGUMENT-DATA-PROTOTYPE>
                          <SHORT-NAME>mode</SHORT-NAME>
                          <TYPE-TREF DEST="IMPLEMENTATION-DATA-TYPE">/AUTOSAR_Platform/ImplementationDataTypes/uint8</TYPE-TREF>
                          <DIRECTION>OUT</DIRECTION>
                        </ARGUMENT-DATA-PROTOTYPE>
                      </ARGUMENTS>
                      <POSSIBLE-ERROR-REFS>
                        <POSSIBLE-ERROR-REF DEST="APPLICATION-ERROR">/AUTOSAR_EcuM/ASR40/PortInterfaces/EcuM_ASR40_ShutdownTarget/E_NOT_OK</POSSIBLE-ERROR-REF>
                      </POSSIBLE-ERROR-REFS>
                    </CLIENT-SERVER-OPERATION>

                    <CLIENT-SERVER-OPERATION>
                      <SHORT-NAME>GetLastShutdownTarget</SHORT-NAME>
                      <ARGUMENTS>
                        <ARGUMENT-DATA-PROTOTYPE>
                          <SHORT-NAME>target</SHORT-NAME>
                          <TYPE-TREF DEST="IMPLEMENTATION-DATA-TYPE">/AUTOSAR_EcuM/ASR40/ImplementationDataTypes/EcuM_ASR40_StateType</TYPE-TREF>
                          <DIRECTION>OUT</DIRECTION>
                        </ARGUMENT-DATA-PROTOTYPE>
                        <ARGUMENT-DATA-PROTOTYPE>
                          <SHORT-NAME>mode</SHORT-NAME>
                          <TYPE-TREF DEST="IMPLEMENTATION-DATA-TYPE">/AUTOSAR_Platform/ImplementationDataTypes/uint8</TYPE-TREF>
                          <DIRECTION>OUT</DIRECTION>
                        </ARGUMENT-DATA-PROTOTYPE>
                      </ARGUMENTS>
                      <POSSIBLE-ERROR-REFS>
                        <POSSIBLE-ERROR-REF DEST="APPLICATION-ERROR">/AUTOSAR_EcuM/ASR40/PortInterfaces/EcuM_ASR40_ShutdownTarget/E_NOT_OK</POSSIBLE-ERROR-REF>
                      </POSSIBLE-ERROR-REFS>
                    </CLIENT-SERVER-OPERATION>

                    <!-- shutdown cause -->
                    <CLIENT-SERVER-OPERATION>
                      <SHORT-NAME>SelectShutdownCause</SHORT-NAME>
                      <ARGUMENTS>
                        <ARGUMENT-DATA-PROTOTYPE>
                          <SHORT-NAME>target</SHORT-NAME>
                          <TYPE-TREF DEST="IMPLEMENTATION-DATA-TYPE">/AUTOSAR_EcuM/ASR40/ImplementationDataTypes/EcuM_ASR40_ShutdownCauseType</TYPE-TREF>
                          <DIRECTION>IN</DIRECTION>
                        </ARGUMENT-DATA-PROTOTYPE>
                      </ARGUMENTS>
                      <POSSIBLE-ERROR-REFS>
                        <POSSIBLE-ERROR-REF DEST="APPLICATION-ERROR">/AUTOSAR_EcuM/ASR40/PortInterfaces/EcuM_ASR40_ShutdownTarget/E_NOT_OK</POSSIBLE-ERROR-REF>
                      </POSSIBLE-ERROR-REFS>
                    </CLIENT-SERVER-OPERATION>

                    <CLIENT-SERVER-OPERATION>
                      <SHORT-NAME>GetShutdownCause</SHORT-NAME>
                      <ARGUMENTS>
                        <ARGUMENT-DATA-PROTOTYPE>
                          <SHORT-NAME>target</SHORT-NAME>
                          <TYPE-TREF DEST="IMPLEMENTATION-DATA-TYPE">/AUTOSAR_EcuM/ASR40/ImplementationDataTypes/EcuM_ASR40_ShutdownCauseType</TYPE-TREF>
                          <DIRECTION>OUT</DIRECTION>
                        </ARGUMENT-DATA-PROTOTYPE>
                      </ARGUMENTS>
                      <POSSIBLE-ERROR-REFS>
                        <POSSIBLE-ERROR-REF DEST="APPLICATION-ERROR">/AUTOSAR_EcuM/ASR40/PortInterfaces/EcuM_ASR40_ShutdownTarget/E_NOT_OK</POSSIBLE-ERROR-REF>
                      </POSSIBLE-ERROR-REFS>
                    </CLIENT-SERVER-OPERATION>

                    <CLIENT-SERVER-OPERATION>
                      <SHORT-NAME>GetMostRecentShutdown</SHORT-NAME>
                      <ARGUMENTS>
                        <ARGUMENT-DATA-PROTOTYPE>
                          <SHORT-NAME>target</SHORT-NAME>
                          <TYPE-TREF DEST="IMPLEMENTATION-DATA-TYPE">/AUTOSAR_EcuM/ASR40/ImplementationDataTypes/EcuM_ASR40_StateType</TYPE-TREF>
                          <DIRECTION>OUT</DIRECTION>
                        </ARGUMENT-DATA-PROTOTYPE>

                        <ARGUMENT-DATA-PROTOTYPE>
                          <SHORT-NAME>mode</SHORT-NAME>
                          <TYPE-TREF DEST="IMPLEMENTATION-DATA-TYPE">/AUTOSAR_Platform/ImplementationDataTypes/uint8</TYPE-TREF>
                          <DIRECTION>OUT</DIRECTION>
                        </ARGUMENT-DATA-PROTOTYPE>

                        <ARGUMENT-DATA-PROTOTYPE>
                          <SHORT-NAME>cause</SHORT-NAME>
                          <TYPE-TREF DEST="IMPLEMENTATION-DATA-TYPE">/AUTOSAR_EcuM/ASR40/ImplementationDataTypes/EcuM_ASR40_ShutdownCauseType</TYPE-TREF>
                          <DIRECTION>OUT</DIRECTION>
                        </ARGUMENT-DATA-PROTOTYPE>

                        <ARGUMENT-DATA-PROTOTYPE>
                          <SHORT-NAME>time</SHORT-NAME>
                          <TYPE-TREF DEST="IMPLEMENTATION-DATA-TYPE">/AUTOSAR_Platform/ImplementationDataTypes/uint32</TYPE-TREF>
                          <DIRECTION>OUT</DIRECTION>
                        </ARGUMENT-DATA-PROTOTYPE>
                      </ARGUMENTS>
                      <POSSIBLE-ERROR-REFS>
                        <POSSIBLE-ERROR-REF DEST="APPLICATION-ERROR">/AUTOSAR_EcuM/ASR40/PortInterfaces/EcuM_ASR40_ShutdownTarget/E_NOT_OK</POSSIBLE-ERROR-REF>
                      </POSSIBLE-ERROR-REFS>
                    </CLIENT-SERVER-OPERATION>

                    <CLIENT-SERVER-OPERATION>
                      <SHORT-NAME>GetNextRecentShutdown</SHORT-NAME>
                      <ARGUMENTS>
                        <ARGUMENT-DATA-PROTOTYPE>
                          <SHORT-NAME>target</SHORT-NAME>
                          <TYPE-TREF DEST="IMPLEMENTATION-DATA-TYPE">/AUTOSAR_EcuM/ASR40/ImplementationDataTypes/EcuM_ASR40_StateType</TYPE-TREF>
                          <DIRECTION>OUT</DIRECTION>
                        </ARGUMENT-DATA-PROTOTYPE>

                        <ARGUMENT-DATA-PROTOTYPE>
                          <SHORT-NAME>mode</SHORT-NAME>
                          <TYPE-TREF DEST="IMPLEMENTATION-DATA-TYPE">/AUTOSAR_Platform/ImplementationDataTypes/uint8</TYPE-TREF>
                          <DIRECTION>OUT</DIRECTION>
                        </ARGUMENT-DATA-PROTOTYPE>

                        <ARGUMENT-DATA-PROTOTYPE>
                          <SHORT-NAME>cause</SHORT-NAME>
                          <TYPE-TREF DEST="IMPLEMENTATION-DATA-TYPE">/AUTOSAR_EcuM/ASR40/ImplementationDataTypes/EcuM_ASR40_ShutdownCauseType</TYPE-TREF>
                          <DIRECTION>OUT</DIRECTION>
                        </ARGUMENT-DATA-PROTOTYPE>

                        <ARGUMENT-DATA-PROTOTYPE>
                          <SHORT-NAME>time</SHORT-NAME>
                          <TYPE-TREF DEST="IMPLEMENTATION-DATA-TYPE">/AUTOSAR_Platform/ImplementationDataTypes/uint32</TYPE-TREF>
                          <DIRECTION>OUT</DIRECTION>
                        </ARGUMENT-DATA-PROTOTYPE>
                      </ARGUMENTS>
                      <POSSIBLE-ERROR-REFS>
                        <POSSIBLE-ERROR-REF DEST="APPLICATION-ERROR">/AUTOSAR_EcuM/ASR40/PortInterfaces/EcuM_ASR40_ShutdownTarget/E_NOT_OK</POSSIBLE-ERROR-REF>
                      </POSSIBLE-ERROR-REFS>
                    </CLIENT-SERVER-OPERATION>
                  </OPERATIONS>
                  <POSSIBLE-ERRORS>
                    <APPLICATION-ERROR>
                      <SHORT-NAME>E_NOT_OK</SHORT-NAME>
                      <ERROR-CODE>1</ERROR-CODE>
                    </APPLICATION-ERROR>
                  </POSSIBLE-ERRORS>
                </CLIENT-SERVER-INTERFACE>

                <CLIENT-SERVER-INTERFACE>
                  <SHORT-NAME>EcuM_ASR40_BootTarget</SHORT-NAME>
                  <IS-SERVICE>true</IS-SERVICE>
                  <OPERATIONS>
                    <CLIENT-SERVER-OPERATION>
                      <SHORT-NAME>SelectBootTarget</SHORT-NAME>
                      <ARGUMENTS>
                        <ARGUMENT-DATA-PROTOTYPE>
                          <SHORT-NAME>target</SHORT-NAME>
                          <TYPE-TREF DEST="IMPLEMENTATION-DATA-TYPE">/AUTOSAR_EcuM/ASR40/ImplementationDataTypes/EcuM_ASR40_BootTargetType</TYPE-TREF>
                          <DIRECTION>IN</DIRECTION>
                        </ARGUMENT-DATA-PROTOTYPE>
                      </ARGUMENTS>
                      <POSSIBLE-ERROR-REFS>
                        <POSSIBLE-ERROR-REF DEST="APPLICATION-ERROR">/AUTOSAR_EcuM/ASR40/PortInterfaces/EcuM_ASR40_BootTarget/E_NOT_OK</POSSIBLE-ERROR-REF>
                      </POSSIBLE-ERROR-REFS>
                    </CLIENT-SERVER-OPERATION>
                    <CLIENT-SERVER-OPERATION>
                      <SHORT-NAME>GetBootTarget</SHORT-NAME>
                      <ARGUMENTS>
                        <ARGUMENT-DATA-PROTOTYPE>
                          <SHORT-NAME>target</SHORT-NAME>
                          <TYPE-TREF DEST="IMPLEMENTATION-DATA-TYPE">/AUTOSAR_EcuM/ASR40/ImplementationDataTypes/EcuM_ASR40_BootTargetType</TYPE-TREF>
                          <DIRECTION>OUT</DIRECTION>
                        </ARGUMENT-DATA-PROTOTYPE>
                      </ARGUMENTS>
                      <POSSIBLE-ERROR-REFS>
                        <POSSIBLE-ERROR-REF DEST="APPLICATION-ERROR">/AUTOSAR_EcuM/ASR40/PortInterfaces/EcuM_ASR40_BootTarget/E_NOT_OK</POSSIBLE-ERROR-REF>
                      </POSSIBLE-ERROR-REFS>
                    </CLIENT-SERVER-OPERATION>
                  </OPERATIONS>
                  <POSSIBLE-ERRORS>
                    <APPLICATION-ERROR>
                      <SHORT-NAME>E_NOT_OK</SHORT-NAME>
                      <ERROR-CODE>1</ERROR-CODE>
                    </APPLICATION-ERROR>
                  </POSSIBLE-ERRORS>
                </CLIENT-SERVER-INTERFACE>
              </ELEMENTS>
            </AR-PACKAGE>
          </AR-PACKAGES>
        </AR-PACKAGE>
[!ENDIF!][!//
[!IF "EcuMGeneral/EcuMServiceAPI/EcuMDefaultASRServiceAPI = 'AUTOSAR_32'"!][!//
        <AR-PACKAGE>
          <SHORT-NAME>CompuMethods</SHORT-NAME>
          <ELEMENTS>

            <COMPU-METHOD>
              <SHORT-NAME>BOOTTARGET</SHORT-NAME>
              <CATEGORY>TEXTTABLE</CATEGORY>
              <COMPU-INTERNAL-TO-PHYS>
                <COMPU-SCALES>
                  <COMPU-SCALE>
                    <LOWER-LIMIT INTERVAL-TYPE="CLOSED">0</LOWER-LIMIT>
                    <UPPER-LIMIT INTERVAL-TYPE="CLOSED">0</UPPER-LIMIT>
                    <COMPU-CONST>
                      <VT>ECUM_BOOT_TARGET_APP</VT>
                    </COMPU-CONST>
                  </COMPU-SCALE>
                  <COMPU-SCALE>
                    <LOWER-LIMIT INTERVAL-TYPE="CLOSED">1</LOWER-LIMIT>
                    <UPPER-LIMIT INTERVAL-TYPE="CLOSED">1</UPPER-LIMIT>
                    <COMPU-CONST>
                      <VT>ECUM_BOOT_TARGET_BOOTLOADER</VT>
                    </COMPU-CONST>
                  </COMPU-SCALE>
                </COMPU-SCALES>
              </COMPU-INTERNAL-TO-PHYS>
            </COMPU-METHOD>
[!IF "node:exists(EcuMConfiguration/eb-list::*[1]/EcuMFixedConfiguration)"!][!//
            <COMPU-METHOD>
              <SHORT-NAME>USERTYPE</SHORT-NAME>
              <CATEGORY>TEXTTABLE</CATEGORY>
              <COMPU-INTERNAL-TO-PHYS>
                <COMPU-SCALES>
[!LOOP "EcuMConfiguration/eb-list::*[1]/EcuMFixedConfiguration/EcuMFixedUserConfig/eb-list::*"!][!//
                <COMPU-SCALE>
                  <LOWER-LIMIT INTERVAL-TYPE="CLOSED">[!"node:value(EcuMFixedUser)"!]</LOWER-LIMIT>
                  <UPPER-LIMIT INTERVAL-TYPE="CLOSED">[!"node:value(EcuMFixedUser)"!]</UPPER-LIMIT>
                  <COMPU-CONST>
                    <VT>[!"as:name(.)"!]</VT>
                  </COMPU-CONST>
                </COMPU-SCALE>
[!ENDLOOP!][!//
                </COMPU-SCALES>
              </COMPU-INTERNAL-TO-PHYS>
            </COMPU-METHOD>
[!ENDIF!][!//
          </ELEMENTS>
        </AR-PACKAGE>

            <!-- The data types 'EcuM_ModeType' and 'EcuM_TimeType' are not provided since
                 the definition is not available in AUTOSAR R4.0r2 document "Specification
                 of ECU State Manager" section 7.10.2.
                 http://www.autosar.org/bugzilla/show_bug.cgi?id=49743 -->
        <AR-PACKAGE>
        <!-- We use AUTOSAR 3.2.2 package name here since the AUTOSAR 3.2.2 SWC will look in this package -->
          <SHORT-NAME>Datatypes</SHORT-NAME>
          <ELEMENTS>

            <IMPLEMENTATION-DATA-TYPE>
              <SHORT-NAME>EcuM_BootTargetType</SHORT-NAME>
              <CATEGORY>TYPE_REFERENCE</CATEGORY>
              <SW-DATA-DEF-PROPS>
                <SW-DATA-DEF-PROPS-VARIANTS>
                  <SW-DATA-DEF-PROPS-CONDITIONAL>
                    <COMPU-METHOD-REF DEST="COMPU-METHOD">/AUTOSAR_EcuM/CompuMethods/BOOTTARGET</COMPU-METHOD-REF>
                    <IMPLEMENTATION-DATA-TYPE-REF DEST="IMPLEMENTATION-DATA-TYPE"
                          >/AUTOSAR_Platform/ImplementationDataTypes/uint8</IMPLEMENTATION-DATA-TYPE-REF>
                      </SW-DATA-DEF-PROPS-CONDITIONAL>
                    </SW-DATA-DEF-PROPS-VARIANTS>
                  </SW-DATA-DEF-PROPS>
                </IMPLEMENTATION-DATA-TYPE>
[!IF "node:exists(EcuMConfiguration/eb-list::*[1]/EcuMFixedConfiguration)"!][!//
                <IMPLEMENTATION-DATA-TYPE>
                  <SHORT-NAME>EcuM_UserType</SHORT-NAME>
                  <CATEGORY>TYPE_REFERENCE</CATEGORY>
                  <SW-DATA-DEF-PROPS>
                    <SW-DATA-DEF-PROPS-VARIANTS>
                      <SW-DATA-DEF-PROPS-CONDITIONAL>
                        <COMPU-METHOD-REF DEST="COMPU-METHOD">/AUTOSAR_EcuM/CompuMethods/USERTYPE</COMPU-METHOD-REF>
                        <IMPLEMENTATION-DATA-TYPE-REF DEST="IMPLEMENTATION-DATA-TYPE"
                          >/AUTOSAR_Platform/ImplementationDataTypes/uint8</IMPLEMENTATION-DATA-TYPE-REF>
                  </SW-DATA-DEF-PROPS-CONDITIONAL>
                </SW-DATA-DEF-PROPS-VARIANTS>
              </SW-DATA-DEF-PROPS>
            </IMPLEMENTATION-DATA-TYPE>
[!ENDIF!][!//
          </ELEMENTS>
        </AR-PACKAGE>

        <AR-PACKAGE>
          <SHORT-NAME>PortInterfaces</SHORT-NAME>
          <ELEMENTS>
<!-- !LINKSTO EB.EcuM.EcuM2762,1 -->
[!IF "node:exists(EcuMConfiguration/eb-list::*[1]/EcuMFixedConfiguration)"!][!//
            <CLIENT-SERVER-INTERFACE>
              <SHORT-NAME>EcuM_StateRequest</SHORT-NAME>
              <IS-SERVICE>true</IS-SERVICE>
              <OPERATIONS>
                <CLIENT-SERVER-OPERATION>
                  <SHORT-NAME>RequestRUN</SHORT-NAME>
                  <POSSIBLE-ERROR-REFS>
                    <POSSIBLE-ERROR-REF DEST="APPLICATION-ERROR">/AUTOSAR_EcuM/PortInterfaces/EcuM_StateRequest/E_NOT_OK</POSSIBLE-ERROR-REF>
                  </POSSIBLE-ERROR-REFS>
                </CLIENT-SERVER-OPERATION>
                <CLIENT-SERVER-OPERATION>
                  <SHORT-NAME>ReleaseRUN</SHORT-NAME>
                  <POSSIBLE-ERROR-REFS>
                    <POSSIBLE-ERROR-REF DEST="APPLICATION-ERROR">/AUTOSAR_EcuM/PortInterfaces/EcuM_StateRequest/E_NOT_OK</POSSIBLE-ERROR-REF>
                  </POSSIBLE-ERROR-REFS>
                </CLIENT-SERVER-OPERATION>
                <CLIENT-SERVER-OPERATION>
                  <SHORT-NAME>RequestPOSTRUN</SHORT-NAME>
                  <POSSIBLE-ERROR-REFS>
                    <POSSIBLE-ERROR-REF DEST="APPLICATION-ERROR">/AUTOSAR_EcuM/PortInterfaces/EcuM_StateRequest/E_NOT_OK</POSSIBLE-ERROR-REF>
                  </POSSIBLE-ERROR-REFS>
                </CLIENT-SERVER-OPERATION>
                <CLIENT-SERVER-OPERATION>
                  <SHORT-NAME>ReleasePOSTRUN</SHORT-NAME>
                  <POSSIBLE-ERROR-REFS>
                    <POSSIBLE-ERROR-REF DEST="APPLICATION-ERROR">/AUTOSAR_EcuM/PortInterfaces/EcuM_StateRequest/E_NOT_OK</POSSIBLE-ERROR-REF>
                  </POSSIBLE-ERROR-REFS>
                </CLIENT-SERVER-OPERATION>
              </OPERATIONS>
              <POSSIBLE-ERRORS>
                <APPLICATION-ERROR>
                  <SHORT-NAME>E_NOT_OK</SHORT-NAME>
                  <ERROR-CODE>1</ERROR-CODE>
                </APPLICATION-ERROR>
              </POSSIBLE-ERRORS>
            </CLIENT-SERVER-INTERFACE>
            <MODE-SWITCH-INTERFACE>
              <SHORT-NAME>EcuM_CurrentMode</SHORT-NAME>
              <IS-SERVICE>true</IS-SERVICE>
              <MODE-GROUP>
                <SHORT-NAME>currentMode</SHORT-NAME>
                <TYPE-TREF DEST="MODE-DECLARATION-GROUP">/AUTOSAR_EcuM/PortInterfaces/EcuM_Mode</TYPE-TREF>
              </MODE-GROUP>
            </MODE-SWITCH-INTERFACE>
            <DATA-TYPE-MAPPING-SET>
              <SHORT-NAME>EcuMCurrentModeMap</SHORT-NAME>
              <MODE-REQUEST-TYPE-MAPS>
                <MODE-REQUEST-TYPE-MAP>
                  <IMPLEMENTATION-DATA-TYPE-REF DEST="IMPLEMENTATION-DATA-TYPE">/AUTOSAR_Platform/ImplementationDataTypes/uint8</IMPLEMENTATION-DATA-TYPE-REF>
                  <MODE-GROUP-REF DEST="MODE-DECLARATION-GROUP">/AUTOSAR_EcuM/PortInterfaces/EcuM_Mode</MODE-GROUP-REF>
                </MODE-REQUEST-TYPE-MAP>
              </MODE-REQUEST-TYPE-MAPS>
            </DATA-TYPE-MAPPING-SET>
<!-- !LINKSTO EB.EcuM.EcuM2749,1 -->
            <MODE-DECLARATION-GROUP>
              <SHORT-NAME>EcuM_Mode</SHORT-NAME>
              <INITIAL-MODE-REF DEST="MODE-DECLARATION">/AUTOSAR_EcuM/PortInterfaces/EcuM_Mode/STARTUP</INITIAL-MODE-REF>
              <MODE-DECLARATIONS>
                <MODE-DECLARATION>
                  <SHORT-NAME>STARTUP</SHORT-NAME>
                </MODE-DECLARATION>
                <MODE-DECLARATION>
                  <SHORT-NAME>RUN</SHORT-NAME>
                </MODE-DECLARATION>
                <MODE-DECLARATION>
                  <SHORT-NAME>POST_RUN</SHORT-NAME>
                </MODE-DECLARATION>
                <MODE-DECLARATION>
                  <SHORT-NAME>SLEEP</SHORT-NAME>
                </MODE-DECLARATION>
                <MODE-DECLARATION>
                  <SHORT-NAME>WAKE_SLEEP</SHORT-NAME>
                </MODE-DECLARATION>
                <MODE-DECLARATION>
                  <SHORT-NAME>SHUTDOWN</SHORT-NAME>
                </MODE-DECLARATION>
              </MODE-DECLARATIONS>
            </MODE-DECLARATION-GROUP>
[!ENDIF!][!//
            <CLIENT-SERVER-INTERFACE>
              <SHORT-NAME>EcuM_ShutdownTarget</SHORT-NAME>
              <IS-SERVICE>true</IS-SERVICE>
              <OPERATIONS>

                <CLIENT-SERVER-OPERATION>
                  <SHORT-NAME>SelectShutdownTarget</SHORT-NAME>
                  <ARGUMENTS>
                    <ARGUMENT-DATA-PROTOTYPE>
                      <SHORT-NAME>target</SHORT-NAME>
                      <TYPE-TREF DEST="IMPLEMENTATION-DATA-TYPE">/AUTOSAR_EcuM/Datatypes/EcuM_StateType</TYPE-TREF>
                      <DIRECTION>IN</DIRECTION>
                    </ARGUMENT-DATA-PROTOTYPE>
                    <ARGUMENT-DATA-PROTOTYPE>
                      <SHORT-NAME>mode</SHORT-NAME>
                      <TYPE-TREF DEST="IMPLEMENTATION-DATA-TYPE">/AUTOSAR_Platform/ImplementationDataTypes/uint8</TYPE-TREF>
                      <DIRECTION>IN</DIRECTION>
                    </ARGUMENT-DATA-PROTOTYPE>
                  </ARGUMENTS>
                  <POSSIBLE-ERROR-REFS>
                    <POSSIBLE-ERROR-REF DEST="APPLICATION-ERROR">/AUTOSAR_EcuM/PortInterfaces/EcuM_ShutdownTarget/E_NOT_OK</POSSIBLE-ERROR-REF>
                  </POSSIBLE-ERROR-REFS>
                </CLIENT-SERVER-OPERATION>

                <CLIENT-SERVER-OPERATION>
                  <SHORT-NAME>GetShutdownTarget</SHORT-NAME>
                  <ARGUMENTS>
                    <ARGUMENT-DATA-PROTOTYPE>
                      <SHORT-NAME>target</SHORT-NAME>
                      <TYPE-TREF DEST="IMPLEMENTATION-DATA-TYPE">/AUTOSAR_EcuM/Datatypes/EcuM_StateType</TYPE-TREF>
                      <DIRECTION>OUT</DIRECTION>
                    </ARGUMENT-DATA-PROTOTYPE>
                    <ARGUMENT-DATA-PROTOTYPE>
                      <SHORT-NAME>mode</SHORT-NAME>
                      <TYPE-TREF DEST="IMPLEMENTATION-DATA-TYPE">/AUTOSAR_Platform/ImplementationDataTypes/uint8</TYPE-TREF>
                      <DIRECTION>OUT</DIRECTION>
                    </ARGUMENT-DATA-PROTOTYPE>
                  </ARGUMENTS>
                  <POSSIBLE-ERROR-REFS>
                    <POSSIBLE-ERROR-REF DEST="APPLICATION-ERROR">/AUTOSAR_EcuM/PortInterfaces/EcuM_ShutdownTarget/E_NOT_OK</POSSIBLE-ERROR-REF>
                  </POSSIBLE-ERROR-REFS>
                </CLIENT-SERVER-OPERATION>

                <CLIENT-SERVER-OPERATION>
                  <SHORT-NAME>GetLastShutdownTarget</SHORT-NAME>
                  <ARGUMENTS>
                    <ARGUMENT-DATA-PROTOTYPE>
                      <SHORT-NAME>target</SHORT-NAME>
                      <TYPE-TREF DEST="IMPLEMENTATION-DATA-TYPE">/AUTOSAR_EcuM/Datatypes/EcuM_StateType</TYPE-TREF>
                      <DIRECTION>OUT</DIRECTION>
                    </ARGUMENT-DATA-PROTOTYPE>
                    <ARGUMENT-DATA-PROTOTYPE>
                      <SHORT-NAME>mode</SHORT-NAME>
                      <TYPE-TREF DEST="IMPLEMENTATION-DATA-TYPE">/AUTOSAR_Platform/ImplementationDataTypes/uint8</TYPE-TREF>
                      <DIRECTION>OUT</DIRECTION>
                    </ARGUMENT-DATA-PROTOTYPE>
                  </ARGUMENTS>
                  <POSSIBLE-ERROR-REFS>
                    <POSSIBLE-ERROR-REF DEST="APPLICATION-ERROR">/AUTOSAR_EcuM/PortInterfaces/EcuM_ShutdownTarget/E_NOT_OK</POSSIBLE-ERROR-REF>
                  </POSSIBLE-ERROR-REFS>
                </CLIENT-SERVER-OPERATION>
              </OPERATIONS>
              <POSSIBLE-ERRORS>
                <APPLICATION-ERROR>
                  <SHORT-NAME>E_NOT_OK</SHORT-NAME>
                  <ERROR-CODE>1</ERROR-CODE>
                </APPLICATION-ERROR>
              </POSSIBLE-ERRORS>
            </CLIENT-SERVER-INTERFACE>

            <CLIENT-SERVER-INTERFACE>
              <SHORT-NAME>EcuM_BootTarget</SHORT-NAME>
              <IS-SERVICE>true</IS-SERVICE>
              <OPERATIONS>
                <CLIENT-SERVER-OPERATION>
                  <SHORT-NAME>SelectBootTarget</SHORT-NAME>
                  <ARGUMENTS>
                    <ARGUMENT-DATA-PROTOTYPE>
                      <SHORT-NAME>target</SHORT-NAME>
                      <TYPE-TREF DEST="IMPLEMENTATION-DATA-TYPE">/AUTOSAR_EcuM/Datatypes/EcuM_BootTargetType</TYPE-TREF>
                      <DIRECTION>IN</DIRECTION>
                    </ARGUMENT-DATA-PROTOTYPE>
                  </ARGUMENTS>
                  <POSSIBLE-ERROR-REFS>
                    <POSSIBLE-ERROR-REF DEST="APPLICATION-ERROR">/AUTOSAR_EcuM/PortInterfaces/EcuM_BootTarget/E_NOT_OK</POSSIBLE-ERROR-REF>
                  </POSSIBLE-ERROR-REFS>
                </CLIENT-SERVER-OPERATION>
                <CLIENT-SERVER-OPERATION>
                  <SHORT-NAME>GetBootTarget</SHORT-NAME>
                  <ARGUMENTS>
                    <ARGUMENT-DATA-PROTOTYPE>
                      <SHORT-NAME>target</SHORT-NAME>
                      <TYPE-TREF DEST="IMPLEMENTATION-DATA-TYPE">/AUTOSAR_EcuM/Datatypes/EcuM_BootTargetType</TYPE-TREF>
                      <DIRECTION>OUT</DIRECTION>
                    </ARGUMENT-DATA-PROTOTYPE>
                  </ARGUMENTS>
                  <POSSIBLE-ERROR-REFS>
                    <POSSIBLE-ERROR-REF DEST="APPLICATION-ERROR">/AUTOSAR_EcuM/PortInterfaces/EcuM_BootTarget/E_NOT_OK</POSSIBLE-ERROR-REF>
                  </POSSIBLE-ERROR-REFS>
                </CLIENT-SERVER-OPERATION>
              </OPERATIONS>
              <POSSIBLE-ERRORS>
                <APPLICATION-ERROR>
                  <SHORT-NAME>E_NOT_OK</SHORT-NAME>
                  <ERROR-CODE>1</ERROR-CODE>
                </APPLICATION-ERROR>
              </POSSIBLE-ERRORS>
            </CLIENT-SERVER-INTERFACE>
          </ELEMENTS>
        </AR-PACKAGE>
[!ENDIF!][!//
[!IF "EcuMGeneral/EcuMServiceAPI/EcuMDefaultASRServiceAPI = 'AUTOSAR_40'"!][!//
        <AR-PACKAGE>
          <SHORT-NAME>CompuMethods</SHORT-NAME>
          <ELEMENTS>

            <COMPU-METHOD>
              <SHORT-NAME>SHUTDOWNCAUSE</SHORT-NAME>
              <CATEGORY>TEXTTABLE</CATEGORY>
              <COMPU-INTERNAL-TO-PHYS>
                <COMPU-SCALES>
                  <COMPU-SCALE>
                    <LOWER-LIMIT INTERVAL-TYPE="CLOSED">0</LOWER-LIMIT>
                    <UPPER-LIMIT INTERVAL-TYPE="CLOSED">0</UPPER-LIMIT>
                    <COMPU-CONST>
                      <VT>ECUM_CAUSE_UNKNOWN</VT>
                    </COMPU-CONST>
                  </COMPU-SCALE>
                  <COMPU-SCALE>
                    <LOWER-LIMIT INTERVAL-TYPE="CLOSED">1</LOWER-LIMIT>
                    <UPPER-LIMIT INTERVAL-TYPE="CLOSED">1</UPPER-LIMIT>
                    <COMPU-CONST>
                      <VT>ECUM_CAUSE_ECU_STATE</VT>
                    </COMPU-CONST>
                  </COMPU-SCALE>
                  <COMPU-SCALE>
                    <LOWER-LIMIT INTERVAL-TYPE="CLOSED">2</LOWER-LIMIT>
                    <UPPER-LIMIT INTERVAL-TYPE="CLOSED">2</UPPER-LIMIT>
                    <COMPU-CONST>
                      <VT>ECUM_CAUSE_WDGM</VT>
                    </COMPU-CONST>
                  </COMPU-SCALE>
                  <COMPU-SCALE>
                    <LOWER-LIMIT INTERVAL-TYPE="CLOSED">3</LOWER-LIMIT>
                    <UPPER-LIMIT INTERVAL-TYPE="CLOSED">3</UPPER-LIMIT>
                    <COMPU-CONST>
                      <VT>ECUM_CAUSE_DCM</VT>
                    </COMPU-CONST>
                  </COMPU-SCALE>
                </COMPU-SCALES>
              </COMPU-INTERNAL-TO-PHYS>
            </COMPU-METHOD>

            <COMPU-METHOD>
              <SHORT-NAME>BOOTTARGET</SHORT-NAME>
              <CATEGORY>TEXTTABLE</CATEGORY>
              <COMPU-INTERNAL-TO-PHYS>
                <COMPU-SCALES>
                  <COMPU-SCALE>
                    <LOWER-LIMIT INTERVAL-TYPE="CLOSED">0</LOWER-LIMIT>
                    <UPPER-LIMIT INTERVAL-TYPE="CLOSED">0</UPPER-LIMIT>
                    <COMPU-CONST>
                      <VT>ECUM_BOOT_TARGET_APP</VT>
                    </COMPU-CONST>
                  </COMPU-SCALE>
                  <COMPU-SCALE>
                    <LOWER-LIMIT INTERVAL-TYPE="CLOSED">1</LOWER-LIMIT>
                    <UPPER-LIMIT INTERVAL-TYPE="CLOSED">1</UPPER-LIMIT>
                    <COMPU-CONST>
                      <VT>ECUM_BOOT_TARGET_OEM_BOOTLOADER</VT>
                    </COMPU-CONST>
                  </COMPU-SCALE>
                  <COMPU-SCALE>
                    <LOWER-LIMIT INTERVAL-TYPE="CLOSED">2</LOWER-LIMIT>
                    <UPPER-LIMIT INTERVAL-TYPE="CLOSED">2</UPPER-LIMIT>
                    <COMPU-CONST>
                      <!-- This deviates from the SWS which
                           mentions
                           ECUM_BOOT_TARGET_SYSTEM_SUPPLIER_BOOTLOADER.
                           http://www.autosar.org/bugzilla/show_bug.cgi?id=48892 -->
                      <VT>ECUM_BOOT_TARGET_SYS_BOOTLOADER</VT>
                    </COMPU-CONST>
                  </COMPU-SCALE>
                </COMPU-SCALES>
              </COMPU-INTERNAL-TO-PHYS>
                </COMPU-METHOD>

[!IF "node:exists(EcuMConfiguration/eb-list::*[1]/EcuMFixedConfiguration)"!][!//
                <COMPU-METHOD>
                  <SHORT-NAME>USERTYPE</SHORT-NAME>
                  <CATEGORY>TEXTTABLE</CATEGORY>
                  <COMPU-INTERNAL-TO-PHYS>
                    <COMPU-SCALES>
[!LOOP "EcuMConfiguration/eb-list::*[1]/EcuMFixedConfiguration/EcuMFixedUserConfig/eb-list::*"!][!//
                      <COMPU-SCALE>
                        <LOWER-LIMIT INTERVAL-TYPE="CLOSED">[!"node:value(EcuMFixedUser)"!]</LOWER-LIMIT>
                        <UPPER-LIMIT INTERVAL-TYPE="CLOSED">[!"node:value(EcuMFixedUser)"!]</UPPER-LIMIT>
                        <COMPU-CONST>
                          <VT>[!"as:name(.)"!]</VT>
                        </COMPU-CONST>
                      </COMPU-SCALE>
[!ENDLOOP!][!//
                    </COMPU-SCALES>
                  </COMPU-INTERNAL-TO-PHYS>
            </COMPU-METHOD>
[!ENDIF!][!//
          </ELEMENTS>
        </AR-PACKAGE>

            <!-- The data types 'EcuM_ModeType' and 'EcuM_TimeType' are not provided since
                 the definition is not available in AUTOSAR R4.0r2 document "Specification
                 of ECU State Manager" section 7.10.2.
                 http://www.autosar.org/bugzilla/show_bug.cgi?id=49743 -->
        <AR-PACKAGE>
          <SHORT-NAME>ImplementationDataTypes</SHORT-NAME>
          <ELEMENTS>
            <!-- The definition of the data type 'EcuM_ShutdownCauseType' is not specified in
                 AUTOSAR R4.0r2 document "Specification of ECU State Manager" section 7.10.2.
                 But it is mapped to uint8 in reference with the argument description of the
                 API EcuM_SelectShutdownCause().
                 http://www.autosar.org/bugzilla/show_bug.cgi?id=49743 -->
            <IMPLEMENTATION-DATA-TYPE>
              <SHORT-NAME>EcuM_ShutdownCauseType</SHORT-NAME>
              <CATEGORY>TYPE_REFERENCE</CATEGORY>
              <SW-DATA-DEF-PROPS>
                <SW-DATA-DEF-PROPS-VARIANTS>
                  <SW-DATA-DEF-PROPS-CONDITIONAL>
                    <COMPU-METHOD-REF DEST="COMPU-METHOD">/AUTOSAR_EcuM/CompuMethods/SHUTDOWNCAUSE</COMPU-METHOD-REF>
                    <IMPLEMENTATION-DATA-TYPE-REF DEST="IMPLEMENTATION-DATA-TYPE"
                      >/AUTOSAR_Platform/ImplementationDataTypes/uint8</IMPLEMENTATION-DATA-TYPE-REF>
                  </SW-DATA-DEF-PROPS-CONDITIONAL>
                </SW-DATA-DEF-PROPS-VARIANTS>
              </SW-DATA-DEF-PROPS>
            </IMPLEMENTATION-DATA-TYPE>

            <IMPLEMENTATION-DATA-TYPE>
              <SHORT-NAME>EcuM_BootTargetType</SHORT-NAME>
              <CATEGORY>TYPE_REFERENCE</CATEGORY>
              <SW-DATA-DEF-PROPS>
                <SW-DATA-DEF-PROPS-VARIANTS>
                  <SW-DATA-DEF-PROPS-CONDITIONAL>
                    <COMPU-METHOD-REF DEST="COMPU-METHOD">/AUTOSAR_EcuM/CompuMethods/BOOTTARGET</COMPU-METHOD-REF>
                    <IMPLEMENTATION-DATA-TYPE-REF DEST="IMPLEMENTATION-DATA-TYPE"
                          >/AUTOSAR_Platform/ImplementationDataTypes/uint8</IMPLEMENTATION-DATA-TYPE-REF>
                  </SW-DATA-DEF-PROPS-CONDITIONAL>
                </SW-DATA-DEF-PROPS-VARIANTS>
              </SW-DATA-DEF-PROPS>
            </IMPLEMENTATION-DATA-TYPE>
[!IF "node:exists(EcuMConfiguration/eb-list::*[1]/EcuMFixedConfiguration)"!][!//
            <IMPLEMENTATION-DATA-TYPE>
              <SHORT-NAME>EcuM_UserType</SHORT-NAME>
              <CATEGORY>TYPE_REFERENCE</CATEGORY>
              <SW-DATA-DEF-PROPS>
                <SW-DATA-DEF-PROPS-VARIANTS>
                  <SW-DATA-DEF-PROPS-CONDITIONAL>
                    <COMPU-METHOD-REF DEST="COMPU-METHOD">/AUTOSAR_EcuM/CompuMethods/USERTYPE</COMPU-METHOD-REF>
                    <IMPLEMENTATION-DATA-TYPE-REF DEST="IMPLEMENTATION-DATA-TYPE"
                      >/AUTOSAR_Platform/ImplementationDataTypes/uint8</IMPLEMENTATION-DATA-TYPE-REF>
                  </SW-DATA-DEF-PROPS-CONDITIONAL>
                </SW-DATA-DEF-PROPS-VARIANTS>
              </SW-DATA-DEF-PROPS>
            </IMPLEMENTATION-DATA-TYPE>
[!ENDIF!][!//
          </ELEMENTS>
        </AR-PACKAGE>

        <AR-PACKAGE>
          <SHORT-NAME>PortInterfaces</SHORT-NAME>
          <ELEMENTS>
<!-- !LINKSTO EB.EcuM.EcuM2762,1 -->
[!IF "node:exists(EcuMConfiguration/eb-list::*[1]/EcuMFixedConfiguration)"!][!//
            <!-- !LINKSTO EcuM.ASR42.SWS_EcuM_04094,1 -->
            <CLIENT-SERVER-INTERFACE>
              <SHORT-NAME>EcuM_StateRequest</SHORT-NAME>
              <IS-SERVICE>true</IS-SERVICE>
              <OPERATIONS>
                <CLIENT-SERVER-OPERATION>
                  <SHORT-NAME>RequestRUN</SHORT-NAME>
                  <POSSIBLE-ERROR-REFS>
                    <POSSIBLE-ERROR-REF DEST="APPLICATION-ERROR">/AUTOSAR_EcuM/PortInterfaces/EcuM_StateRequest/E_NOT_OK</POSSIBLE-ERROR-REF>
                  </POSSIBLE-ERROR-REFS>
                </CLIENT-SERVER-OPERATION>
                <CLIENT-SERVER-OPERATION>
                  <SHORT-NAME>ReleaseRUN</SHORT-NAME>
                  <POSSIBLE-ERROR-REFS>
                    <POSSIBLE-ERROR-REF DEST="APPLICATION-ERROR">/AUTOSAR_EcuM/PortInterfaces/EcuM_StateRequest/E_NOT_OK</POSSIBLE-ERROR-REF>
                  </POSSIBLE-ERROR-REFS>
                </CLIENT-SERVER-OPERATION>
                <CLIENT-SERVER-OPERATION>
                  <SHORT-NAME>RequestPOSTRUN</SHORT-NAME>
                  <POSSIBLE-ERROR-REFS>
                    <POSSIBLE-ERROR-REF DEST="APPLICATION-ERROR">/AUTOSAR_EcuM/PortInterfaces/EcuM_StateRequest/E_NOT_OK</POSSIBLE-ERROR-REF>
                  </POSSIBLE-ERROR-REFS>
                </CLIENT-SERVER-OPERATION>
                <CLIENT-SERVER-OPERATION>
                  <SHORT-NAME>ReleasePOSTRUN</SHORT-NAME>
                  <POSSIBLE-ERROR-REFS>
                    <POSSIBLE-ERROR-REF DEST="APPLICATION-ERROR">/AUTOSAR_EcuM/PortInterfaces/EcuM_StateRequest/E_NOT_OK</POSSIBLE-ERROR-REF>
                  </POSSIBLE-ERROR-REFS>
                </CLIENT-SERVER-OPERATION>
              </OPERATIONS>
              <POSSIBLE-ERRORS>
                <APPLICATION-ERROR>
                  <SHORT-NAME>E_NOT_OK</SHORT-NAME>
                  <ERROR-CODE>1</ERROR-CODE>
                </APPLICATION-ERROR>
              </POSSIBLE-ERRORS>
            </CLIENT-SERVER-INTERFACE>
            <MODE-SWITCH-INTERFACE>
              <SHORT-NAME>EcuM_CurrentMode</SHORT-NAME>
              <IS-SERVICE>true</IS-SERVICE>
              <MODE-GROUP>
                <SHORT-NAME>currentMode</SHORT-NAME>
                <TYPE-TREF DEST="MODE-DECLARATION-GROUP">/AUTOSAR_EcuM/PortInterfaces/EcuM_Mode</TYPE-TREF>
              </MODE-GROUP>
            </MODE-SWITCH-INTERFACE>
            <DATA-TYPE-MAPPING-SET>
              <SHORT-NAME>EcuMCurrentModeMap</SHORT-NAME>
              <MODE-REQUEST-TYPE-MAPS>
                <MODE-REQUEST-TYPE-MAP>
                  <IMPLEMENTATION-DATA-TYPE-REF DEST="IMPLEMENTATION-DATA-TYPE">/AUTOSAR_Platform/ImplementationDataTypes/uint8</IMPLEMENTATION-DATA-TYPE-REF>
                  <MODE-GROUP-REF DEST="MODE-DECLARATION-GROUP">/AUTOSAR_EcuM/PortInterfaces/EcuM_Mode</MODE-GROUP-REF>
                </MODE-REQUEST-TYPE-MAP>
              </MODE-REQUEST-TYPE-MAPS>
            </DATA-TYPE-MAPPING-SET>
<!-- !LINKSTO EB.EcuM.EcuM2749,1 -->
            <MODE-DECLARATION-GROUP>
              <SHORT-NAME>EcuM_Mode</SHORT-NAME>
              <INITIAL-MODE-REF DEST="MODE-DECLARATION">/AUTOSAR_EcuM/PortInterfaces/EcuM_Mode/STARTUP</INITIAL-MODE-REF>
              <MODE-DECLARATIONS>
                <MODE-DECLARATION>
                  <SHORT-NAME>STARTUP</SHORT-NAME>
                </MODE-DECLARATION>
                <MODE-DECLARATION>
                  <SHORT-NAME>RUN</SHORT-NAME>
                </MODE-DECLARATION>
                <MODE-DECLARATION>
                  <SHORT-NAME>POST_RUN</SHORT-NAME>
                </MODE-DECLARATION>
                <MODE-DECLARATION>
                  <SHORT-NAME>SLEEP</SHORT-NAME>
                </MODE-DECLARATION>
                <MODE-DECLARATION>
                  <SHORT-NAME>WAKE_SLEEP</SHORT-NAME>
                </MODE-DECLARATION>
                <MODE-DECLARATION>
                  <SHORT-NAME>SHUTDOWN</SHORT-NAME>
                </MODE-DECLARATION>
              </MODE-DECLARATIONS>
            </MODE-DECLARATION-GROUP>
[!ENDIF!][!//
            <!-- !LINKSTO EcuM.ASR42.SWS_EcuM_04094,1 -->
            <CLIENT-SERVER-INTERFACE>
              <SHORT-NAME>EcuM_ShutdownTarget</SHORT-NAME>
              <IS-SERVICE>true</IS-SERVICE>
              <OPERATIONS>

                <!-- !LINKSTO EcuM.EB_Ref.SWS_EcuM_03011_5,1 -->
                <CLIENT-SERVER-OPERATION>
                  <SHORT-NAME>SelectShutdownTarget</SHORT-NAME>
                  <ARGUMENTS>
                    <ARGUMENT-DATA-PROTOTYPE>
                      <SHORT-NAME>target</SHORT-NAME>
                      <TYPE-TREF DEST="IMPLEMENTATION-DATA-TYPE">/AUTOSAR_EcuM/ImplementationDataTypes/EcuM_StateType</TYPE-TREF>
                      <DIRECTION>IN</DIRECTION>
                    </ARGUMENT-DATA-PROTOTYPE>
                    <ARGUMENT-DATA-PROTOTYPE>
                      <SHORT-NAME>mode</SHORT-NAME>
                      <TYPE-TREF DEST="IMPLEMENTATION-DATA-TYPE">/AUTOSAR_Platform/ImplementationDataTypes/uint8</TYPE-TREF>
                      <DIRECTION>IN</DIRECTION>
                    </ARGUMENT-DATA-PROTOTYPE>
                  </ARGUMENTS>
                  <POSSIBLE-ERROR-REFS>
                    <POSSIBLE-ERROR-REF DEST="APPLICATION-ERROR">/AUTOSAR_EcuM/PortInterfaces/EcuM_ShutdownTarget/E_NOT_OK</POSSIBLE-ERROR-REF>
                  </POSSIBLE-ERROR-REFS>
                </CLIENT-SERVER-OPERATION>

                <!-- !LINKSTO EcuM.EB_Ref.SWS_EcuM_03011_3,1 -->
                <CLIENT-SERVER-OPERATION>
                  <SHORT-NAME>GetShutdownTarget</SHORT-NAME>
                  <ARGUMENTS>
                    <ARGUMENT-DATA-PROTOTYPE>
                      <SHORT-NAME>target</SHORT-NAME>
                      <TYPE-TREF DEST="IMPLEMENTATION-DATA-TYPE">/AUTOSAR_EcuM/ImplementationDataTypes/EcuM_StateType</TYPE-TREF>
                      <DIRECTION>OUT</DIRECTION>
                    </ARGUMENT-DATA-PROTOTYPE>
                    <ARGUMENT-DATA-PROTOTYPE>
                      <SHORT-NAME>mode</SHORT-NAME>
                      <TYPE-TREF DEST="IMPLEMENTATION-DATA-TYPE">/AUTOSAR_Platform/ImplementationDataTypes/uint8</TYPE-TREF>
                      <DIRECTION>OUT</DIRECTION>
                    </ARGUMENT-DATA-PROTOTYPE>
                  </ARGUMENTS>
                  <POSSIBLE-ERROR-REFS>
                    <POSSIBLE-ERROR-REF DEST="APPLICATION-ERROR">/AUTOSAR_EcuM/PortInterfaces/EcuM_ShutdownTarget/E_NOT_OK</POSSIBLE-ERROR-REF>
                  </POSSIBLE-ERROR-REFS>
                </CLIENT-SERVER-OPERATION>

                <!-- !LINKSTO EcuM.EB_Ref.SWS_EcuM_03011_1,1 -->
                <CLIENT-SERVER-OPERATION>
                  <SHORT-NAME>GetLastShutdownTarget</SHORT-NAME>
                  <ARGUMENTS>
                    <ARGUMENT-DATA-PROTOTYPE>
                      <SHORT-NAME>target</SHORT-NAME>
                      <TYPE-TREF DEST="IMPLEMENTATION-DATA-TYPE">/AUTOSAR_EcuM/ImplementationDataTypes/EcuM_StateType</TYPE-TREF>
                      <DIRECTION>OUT</DIRECTION>
                    </ARGUMENT-DATA-PROTOTYPE>
                    <ARGUMENT-DATA-PROTOTYPE>
                      <SHORT-NAME>mode</SHORT-NAME>
                      <TYPE-TREF DEST="IMPLEMENTATION-DATA-TYPE">/AUTOSAR_Platform/ImplementationDataTypes/uint8</TYPE-TREF>
                      <DIRECTION>OUT</DIRECTION>
                    </ARGUMENT-DATA-PROTOTYPE>
                  </ARGUMENTS>
                  <POSSIBLE-ERROR-REFS>
                    <POSSIBLE-ERROR-REF DEST="APPLICATION-ERROR">/AUTOSAR_EcuM/PortInterfaces/EcuM_ShutdownTarget/E_NOT_OK</POSSIBLE-ERROR-REF>
                  </POSSIBLE-ERROR-REFS>
                </CLIENT-SERVER-OPERATION>

                <!-- shutdown cause -->
                <!-- !LINKSTO EcuM.EB_Ref.SWS_EcuM_03011_4,1 -->
                <CLIENT-SERVER-OPERATION>
                  <SHORT-NAME>SelectShutdownCause</SHORT-NAME>
                  <ARGUMENTS>
                    <ARGUMENT-DATA-PROTOTYPE>
                      <SHORT-NAME>target</SHORT-NAME>
                      <TYPE-TREF DEST="IMPLEMENTATION-DATA-TYPE">/AUTOSAR_EcuM/ImplementationDataTypes/EcuM_ShutdownCauseType</TYPE-TREF>
                      <DIRECTION>IN</DIRECTION>
                    </ARGUMENT-DATA-PROTOTYPE>
                  </ARGUMENTS>
                  <POSSIBLE-ERROR-REFS>
                    <POSSIBLE-ERROR-REF DEST="APPLICATION-ERROR">/AUTOSAR_EcuM/PortInterfaces/EcuM_ShutdownTarget/E_NOT_OK</POSSIBLE-ERROR-REF>
                  </POSSIBLE-ERROR-REFS>
                </CLIENT-SERVER-OPERATION>

                <!-- !LINKSTO EcuM.EB_Ref.SWS_EcuM_03011_2,1 -->
                <CLIENT-SERVER-OPERATION>
                  <SHORT-NAME>GetShutdownCause</SHORT-NAME>
                  <ARGUMENTS>
                    <ARGUMENT-DATA-PROTOTYPE>
                      <SHORT-NAME>target</SHORT-NAME>
                      <TYPE-TREF DEST="IMPLEMENTATION-DATA-TYPE">/AUTOSAR_EcuM/ImplementationDataTypes/EcuM_ShutdownCauseType</TYPE-TREF>
                      <DIRECTION>OUT</DIRECTION>
                    </ARGUMENT-DATA-PROTOTYPE>
                  </ARGUMENTS>
                  <POSSIBLE-ERROR-REFS>
                    <POSSIBLE-ERROR-REF DEST="APPLICATION-ERROR">/AUTOSAR_EcuM/PortInterfaces/EcuM_ShutdownTarget/E_NOT_OK</POSSIBLE-ERROR-REF>
                  </POSSIBLE-ERROR-REFS>
                </CLIENT-SERVER-OPERATION>

                <CLIENT-SERVER-OPERATION>
                  <SHORT-NAME>GetMostRecentShutdown</SHORT-NAME>
                  <ARGUMENTS>
                    <ARGUMENT-DATA-PROTOTYPE>
                      <SHORT-NAME>target</SHORT-NAME>
                      <TYPE-TREF DEST="IMPLEMENTATION-DATA-TYPE">/AUTOSAR_EcuM/ImplementationDataTypes/EcuM_StateType</TYPE-TREF>
                      <DIRECTION>OUT</DIRECTION>
                    </ARGUMENT-DATA-PROTOTYPE>

                    <ARGUMENT-DATA-PROTOTYPE>
                      <SHORT-NAME>mode</SHORT-NAME>
                      <TYPE-TREF DEST="IMPLEMENTATION-DATA-TYPE">/AUTOSAR_Platform/ImplementationDataTypes/uint8</TYPE-TREF>
                      <DIRECTION>OUT</DIRECTION>
                    </ARGUMENT-DATA-PROTOTYPE>

                    <ARGUMENT-DATA-PROTOTYPE>
                      <SHORT-NAME>cause</SHORT-NAME>
                      <TYPE-TREF DEST="IMPLEMENTATION-DATA-TYPE">/AUTOSAR_EcuM/ImplementationDataTypes/EcuM_ShutdownCauseType</TYPE-TREF>
                      <DIRECTION>OUT</DIRECTION>
                    </ARGUMENT-DATA-PROTOTYPE>

                    <ARGUMENT-DATA-PROTOTYPE>
                      <SHORT-NAME>time</SHORT-NAME>
                      <TYPE-TREF DEST="IMPLEMENTATION-DATA-TYPE">/AUTOSAR_Platform/ImplementationDataTypes/uint32</TYPE-TREF>
                      <DIRECTION>OUT</DIRECTION>
                    </ARGUMENT-DATA-PROTOTYPE>
                  </ARGUMENTS>
                  <POSSIBLE-ERROR-REFS>
                    <POSSIBLE-ERROR-REF DEST="APPLICATION-ERROR">/AUTOSAR_EcuM/PortInterfaces/EcuM_ShutdownTarget/E_NOT_OK</POSSIBLE-ERROR-REF>
                  </POSSIBLE-ERROR-REFS>
                </CLIENT-SERVER-OPERATION>

                <CLIENT-SERVER-OPERATION>
                  <SHORT-NAME>GetNextRecentShutdown</SHORT-NAME>
                  <ARGUMENTS>
                    <ARGUMENT-DATA-PROTOTYPE>
                      <SHORT-NAME>target</SHORT-NAME>
                      <TYPE-TREF DEST="IMPLEMENTATION-DATA-TYPE">/AUTOSAR_EcuM/ImplementationDataTypes/EcuM_StateType</TYPE-TREF>
                      <DIRECTION>OUT</DIRECTION>
                    </ARGUMENT-DATA-PROTOTYPE>

                    <ARGUMENT-DATA-PROTOTYPE>
                      <SHORT-NAME>mode</SHORT-NAME>
                      <TYPE-TREF DEST="IMPLEMENTATION-DATA-TYPE">/AUTOSAR_Platform/ImplementationDataTypes/uint8</TYPE-TREF>
                      <DIRECTION>OUT</DIRECTION>
                    </ARGUMENT-DATA-PROTOTYPE>

                    <ARGUMENT-DATA-PROTOTYPE>
                      <SHORT-NAME>cause</SHORT-NAME>
                      <TYPE-TREF DEST="IMPLEMENTATION-DATA-TYPE">/AUTOSAR_EcuM/ImplementationDataTypes/EcuM_ShutdownCauseType</TYPE-TREF>
                      <DIRECTION>OUT</DIRECTION>
                    </ARGUMENT-DATA-PROTOTYPE>

                    <ARGUMENT-DATA-PROTOTYPE>
                      <SHORT-NAME>time</SHORT-NAME>
                      <TYPE-TREF DEST="IMPLEMENTATION-DATA-TYPE">/AUTOSAR_Platform/ImplementationDataTypes/uint32</TYPE-TREF>
                      <DIRECTION>OUT</DIRECTION>
                    </ARGUMENT-DATA-PROTOTYPE>
                  </ARGUMENTS>
                  <POSSIBLE-ERROR-REFS>
                    <POSSIBLE-ERROR-REF DEST="APPLICATION-ERROR">/AUTOSAR_EcuM/PortInterfaces/EcuM_ShutdownTarget/E_NOT_OK</POSSIBLE-ERROR-REF>
                  </POSSIBLE-ERROR-REFS>
                </CLIENT-SERVER-OPERATION>
              </OPERATIONS>
              <POSSIBLE-ERRORS>
                <APPLICATION-ERROR>
                  <SHORT-NAME>E_NOT_OK</SHORT-NAME>
                  <ERROR-CODE>1</ERROR-CODE>
                </APPLICATION-ERROR>
              </POSSIBLE-ERRORS>
            </CLIENT-SERVER-INTERFACE>

            <!-- !LINKSTO EcuM.ASR42.SWS_EcuM_04094,1 -->
            <CLIENT-SERVER-INTERFACE>
              <SHORT-NAME>EcuM_BootTarget</SHORT-NAME>
              <IS-SERVICE>true</IS-SERVICE>
              <OPERATIONS>
                <!-- !LINKSTO EcuM.EB_Ref.SWS_EcuM_03012_1,1 -->
                <CLIENT-SERVER-OPERATION>
                  <SHORT-NAME>SelectBootTarget</SHORT-NAME>
                  <ARGUMENTS>
                    <ARGUMENT-DATA-PROTOTYPE>
                      <SHORT-NAME>target</SHORT-NAME>
                      <TYPE-TREF DEST="IMPLEMENTATION-DATA-TYPE">/AUTOSAR_EcuM/ImplementationDataTypes/EcuM_BootTargetType</TYPE-TREF>
                      <DIRECTION>IN</DIRECTION>
                    </ARGUMENT-DATA-PROTOTYPE>
                  </ARGUMENTS>
                  <POSSIBLE-ERROR-REFS>
                    <POSSIBLE-ERROR-REF DEST="APPLICATION-ERROR">/AUTOSAR_EcuM/PortInterfaces/EcuM_BootTarget/E_NOT_OK</POSSIBLE-ERROR-REF>
                  </POSSIBLE-ERROR-REFS>
                </CLIENT-SERVER-OPERATION>
                <!-- !LINKSTO EcuM.EB_Ref.SWS_EcuM_03012_2,1 -->
                <CLIENT-SERVER-OPERATION>
                  <SHORT-NAME>GetBootTarget</SHORT-NAME>
                  <ARGUMENTS>
                    <ARGUMENT-DATA-PROTOTYPE>
                      <SHORT-NAME>target</SHORT-NAME>
                      <TYPE-TREF DEST="IMPLEMENTATION-DATA-TYPE">/AUTOSAR_EcuM/ImplementationDataTypes/EcuM_BootTargetType</TYPE-TREF>
                      <DIRECTION>OUT</DIRECTION>
                    </ARGUMENT-DATA-PROTOTYPE>
                  </ARGUMENTS>
                  <POSSIBLE-ERROR-REFS>
                    <POSSIBLE-ERROR-REF DEST="APPLICATION-ERROR">/AUTOSAR_EcuM/PortInterfaces/EcuM_BootTarget/E_NOT_OK</POSSIBLE-ERROR-REF>
                  </POSSIBLE-ERROR-REFS>
                </CLIENT-SERVER-OPERATION>
              </OPERATIONS>
              <POSSIBLE-ERRORS>
                <APPLICATION-ERROR>
                  <SHORT-NAME>E_NOT_OK</SHORT-NAME>
                  <ERROR-CODE>1</ERROR-CODE>
                </APPLICATION-ERROR>
              </POSSIBLE-ERRORS>
            </CLIENT-SERVER-INTERFACE>
          </ELEMENTS>
        </AR-PACKAGE>
[!ENDIF!][!//
[!IF "EcuMGeneral/EcuMServiceAPI/EcuMDefaultASRServiceAPI = 'AUTOSAR_R20_11'"!][!//
        <AR-PACKAGE>
          <SHORT-NAME>CompuMethods</SHORT-NAME>
          <ELEMENTS>

            <COMPU-METHOD>
              <SHORT-NAME>SHUTDOWNCAUSE</SHORT-NAME>
              <CATEGORY>TEXTTABLE</CATEGORY>
              <COMPU-INTERNAL-TO-PHYS>
                <COMPU-SCALES>
                  <COMPU-SCALE>
                    <LOWER-LIMIT INTERVAL-TYPE="CLOSED">0</LOWER-LIMIT>
                    <UPPER-LIMIT INTERVAL-TYPE="CLOSED">0</UPPER-LIMIT>
                    <COMPU-CONST>
                      <VT>ECUM_CAUSE_UNKNOWN</VT>
                    </COMPU-CONST>
                  </COMPU-SCALE>
                  <COMPU-SCALE>
                    <LOWER-LIMIT INTERVAL-TYPE="CLOSED">1</LOWER-LIMIT>
                    <UPPER-LIMIT INTERVAL-TYPE="CLOSED">1</UPPER-LIMIT>
                    <COMPU-CONST>
                      <VT>ECUM_CAUSE_ECU_STATE</VT>
                    </COMPU-CONST>
                  </COMPU-SCALE>
                  <COMPU-SCALE>
                    <LOWER-LIMIT INTERVAL-TYPE="CLOSED">2</LOWER-LIMIT>
                    <UPPER-LIMIT INTERVAL-TYPE="CLOSED">2</UPPER-LIMIT>
                    <COMPU-CONST>
                      <VT>ECUM_CAUSE_WDGM</VT>
                    </COMPU-CONST>
                  </COMPU-SCALE>
                  <COMPU-SCALE>
                    <LOWER-LIMIT INTERVAL-TYPE="CLOSED">3</LOWER-LIMIT>
                    <UPPER-LIMIT INTERVAL-TYPE="CLOSED">3</UPPER-LIMIT>
                    <COMPU-CONST>
                      <VT>ECUM_CAUSE_DCM</VT>
                    </COMPU-CONST>
                  </COMPU-SCALE>
                </COMPU-SCALES>
              </COMPU-INTERNAL-TO-PHYS>
            </COMPU-METHOD>

            <COMPU-METHOD>
              <SHORT-NAME>SHUTDOWNTARGET</SHORT-NAME>
              <CATEGORY>TEXTTABLE</CATEGORY>
              <COMPU-INTERNAL-TO-PHYS>
                <COMPU-SCALES>
                  <COMPU-SCALE>
                    <LOWER-LIMIT INTERVAL-TYPE="CLOSED">0</LOWER-LIMIT>
                    <UPPER-LIMIT INTERVAL-TYPE="CLOSED">0</UPPER-LIMIT>
                    <COMPU-CONST>
                      <VT>ECUM_SHUTDOWN_TARGET_SLEEP</VT>
                    </COMPU-CONST>
                  </COMPU-SCALE>
                  <COMPU-SCALE>
                    <LOWER-LIMIT INTERVAL-TYPE="CLOSED">1</LOWER-LIMIT>
                    <UPPER-LIMIT INTERVAL-TYPE="CLOSED">1</UPPER-LIMIT>
                    <COMPU-CONST>
                      <VT>ECUM_SHUTDOWN_TARGET_RESET</VT>
                    </COMPU-CONST>
                  </COMPU-SCALE>
                  <COMPU-SCALE>
                    <LOWER-LIMIT INTERVAL-TYPE="CLOSED">2</LOWER-LIMIT>
                    <UPPER-LIMIT INTERVAL-TYPE="CLOSED">2</UPPER-LIMIT>
                    <COMPU-CONST>
                      <VT>ECUM_SHUTDOWN_TARGET_OFF</VT>
                    </COMPU-CONST>
                  </COMPU-SCALE>
                </COMPU-SCALES>
              </COMPU-INTERNAL-TO-PHYS>
            </COMPU-METHOD>

            <COMPU-METHOD>
              <SHORT-NAME>SHUTDOWNMODE</SHORT-NAME>
              <CATEGORY>TEXTTABLE</CATEGORY>
              <COMPU-INTERNAL-TO-PHYS>
                <COMPU-SCALES>
[!SELECT "EcuMConfiguration/eb-list::*[1]/EcuMCommonConfiguration"!][!//
[!LOOP "util:distinct(node:order(EcuMSleepMode/eb-list::*,'node:value(EcuMSleepModeId)'))"!][!//
                  <COMPU-SCALE>
                    <LOWER-LIMIT INTERVAL-TYPE="CLOSED">[!"node:value(EcuMSleepModeId)"!]</LOWER-LIMIT>
                    <UPPER-LIMIT INTERVAL-TYPE="CLOSED">[!"node:value(EcuMSleepModeId)"!]</UPPER-LIMIT>
                    <COMPU-CONST>
                      <VT>[!"as:name(.)"!]</VT>
                    </COMPU-CONST>
                  </COMPU-SCALE>
[!ENDLOOP!]
[!ENDSELECT!]
[!SELECT "EcuMConfiguration/eb-list::*[1]/EcuMFlexConfiguration"!][!//
[!LOOP "util:distinct(node:order(EcuMResetMode/eb-list::*,'node:value(EcuMResetModeId)'))"!][!//
                  <COMPU-SCALE>
                    <LOWER-LIMIT INTERVAL-TYPE="CLOSED">[!"num:i(node:value(EcuMResetModeId) + 256)"!]</LOWER-LIMIT>
                    <UPPER-LIMIT INTERVAL-TYPE="CLOSED">[!"num:i(node:value(EcuMResetModeId) + 256)"!]</UPPER-LIMIT>
                    <COMPU-CONST>
                      <VT>[!"as:name(.)"!]</VT>
                    </COMPU-CONST>
                  </COMPU-SCALE>
[!ENDLOOP!]
[!ENDSELECT!]
                </COMPU-SCALES>
              </COMPU-INTERNAL-TO-PHYS>
            </COMPU-METHOD>

            <COMPU-METHOD>
              <SHORT-NAME>BOOTTARGET</SHORT-NAME>
              <CATEGORY>TEXTTABLE</CATEGORY>
              <COMPU-INTERNAL-TO-PHYS>
                <COMPU-SCALES>
                  <COMPU-SCALE>
                    <LOWER-LIMIT INTERVAL-TYPE="CLOSED">0</LOWER-LIMIT>
                    <UPPER-LIMIT INTERVAL-TYPE="CLOSED">0</UPPER-LIMIT>
                    <COMPU-CONST>
                      <VT>ECUM_BOOT_TARGET_APP</VT>
                    </COMPU-CONST>
                  </COMPU-SCALE>
                  <COMPU-SCALE>
                    <LOWER-LIMIT INTERVAL-TYPE="CLOSED">1</LOWER-LIMIT>
                    <UPPER-LIMIT INTERVAL-TYPE="CLOSED">1</UPPER-LIMIT>
                    <COMPU-CONST>
                      <VT>ECUM_BOOT_TARGET_OEM_BOOTLOADER</VT>
                    </COMPU-CONST>
                  </COMPU-SCALE>
                  <COMPU-SCALE>
                    <LOWER-LIMIT INTERVAL-TYPE="CLOSED">2</LOWER-LIMIT>
                    <UPPER-LIMIT INTERVAL-TYPE="CLOSED">2</UPPER-LIMIT>
                    <COMPU-CONST>
                      <!-- This deviates from the SWS which
                           mentions
                           ECUM_BOOT_TARGET_SYSTEM_SUPPLIER_BOOTLOADER.
                           http://www.autosar.org/bugzilla/show_bug.cgi?id=48892 -->
                      <VT>ECUM_BOOT_TARGET_SYS_BOOTLOADER</VT>
                    </COMPU-CONST>
                  </COMPU-SCALE>
                </COMPU-SCALES>
              </COMPU-INTERNAL-TO-PHYS>
                </COMPU-METHOD>

          </ELEMENTS>
        </AR-PACKAGE>

        <AR-PACKAGE>
          <SHORT-NAME>ImplementationDataTypes</SHORT-NAME>
          <ELEMENTS>
            <IMPLEMENTATION-DATA-TYPE>
              <SHORT-NAME>EcuM_ShutdownCauseType</SHORT-NAME>
              <CATEGORY>TYPE_REFERENCE</CATEGORY>
              <SW-DATA-DEF-PROPS>
                <SW-DATA-DEF-PROPS-VARIANTS>
                  <SW-DATA-DEF-PROPS-CONDITIONAL>
                    <COMPU-METHOD-REF DEST="COMPU-METHOD">/AUTOSAR_EcuM/CompuMethods/SHUTDOWNCAUSE</COMPU-METHOD-REF>
                    <IMPLEMENTATION-DATA-TYPE-REF DEST="IMPLEMENTATION-DATA-TYPE"
                      >/AUTOSAR_Platform/ImplementationDataTypes/uint8</IMPLEMENTATION-DATA-TYPE-REF>
                  </SW-DATA-DEF-PROPS-CONDITIONAL>
                </SW-DATA-DEF-PROPS-VARIANTS>
              </SW-DATA-DEF-PROPS>
            </IMPLEMENTATION-DATA-TYPE>

            <!-- !LINKSTO EcuM.SWS_EcuM_04136,1 -->
            <IMPLEMENTATION-DATA-TYPE>
              <SHORT-NAME>EcuM_ShutdownTargetType</SHORT-NAME>
              <CATEGORY>TYPE_REFERENCE</CATEGORY>
              <SW-DATA-DEF-PROPS>
                <SW-DATA-DEF-PROPS-VARIANTS>
                  <SW-DATA-DEF-PROPS-CONDITIONAL>
                    <COMPU-METHOD-REF DEST="COMPU-METHOD">/AUTOSAR_EcuM/CompuMethods/SHUTDOWNTARGET</COMPU-METHOD-REF>
                    <IMPLEMENTATION-DATA-TYPE-REF DEST="IMPLEMENTATION-DATA-TYPE"
                      >/AUTOSAR_Platform/ImplementationDataTypes/uint8</IMPLEMENTATION-DATA-TYPE-REF>
                  </SW-DATA-DEF-PROPS-CONDITIONAL>
                </SW-DATA-DEF-PROPS-VARIANTS>
              </SW-DATA-DEF-PROPS>
            </IMPLEMENTATION-DATA-TYPE>

            <!-- !LINKSTO EcuM.SWS_EcuM_04101,1 -->
            <IMPLEMENTATION-DATA-TYPE>
              <SHORT-NAME>EcuM_ShutdownModeType</SHORT-NAME>
              <CATEGORY>TYPE_REFERENCE</CATEGORY>
              <SW-DATA-DEF-PROPS>
                <SW-DATA-DEF-PROPS-VARIANTS>
                  <SW-DATA-DEF-PROPS-CONDITIONAL>
                    <COMPU-METHOD-REF DEST="COMPU-METHOD">/AUTOSAR_EcuM/CompuMethods/SHUTDOWNMODE</COMPU-METHOD-REF>
                    <IMPLEMENTATION-DATA-TYPE-REF DEST="IMPLEMENTATION-DATA-TYPE"
                      >/AUTOSAR_Platform/ImplementationDataTypes/uint16</IMPLEMENTATION-DATA-TYPE-REF>
                  </SW-DATA-DEF-PROPS-CONDITIONAL>
                </SW-DATA-DEF-PROPS-VARIANTS>
              </SW-DATA-DEF-PROPS>
            </IMPLEMENTATION-DATA-TYPE>

            <IMPLEMENTATION-DATA-TYPE>
              <SHORT-NAME>EcuM_BootTargetType</SHORT-NAME>
              <CATEGORY>TYPE_REFERENCE</CATEGORY>
              <SW-DATA-DEF-PROPS>
                <SW-DATA-DEF-PROPS-VARIANTS>
                  <SW-DATA-DEF-PROPS-CONDITIONAL>
                    <COMPU-METHOD-REF DEST="COMPU-METHOD">/AUTOSAR_EcuM/CompuMethods/BOOTTARGET</COMPU-METHOD-REF>
                    <IMPLEMENTATION-DATA-TYPE-REF DEST="IMPLEMENTATION-DATA-TYPE"
                          >/AUTOSAR_Platform/ImplementationDataTypes/uint8</IMPLEMENTATION-DATA-TYPE-REF>
                  </SW-DATA-DEF-PROPS-CONDITIONAL>
                </SW-DATA-DEF-PROPS-VARIANTS>
              </SW-DATA-DEF-PROPS>
            </IMPLEMENTATION-DATA-TYPE>
          </ELEMENTS>
        </AR-PACKAGE>

        <AR-PACKAGE>
          <SHORT-NAME>PortInterfaces</SHORT-NAME>
          <ELEMENTS>
            <!-- !LINKSTO EcuM.ASR42.SWS_EcuM_04094,1 -->
            <CLIENT-SERVER-INTERFACE>
              <SHORT-NAME>EcuM_ShutdownTarget</SHORT-NAME>
              <IS-SERVICE>true</IS-SERVICE>
              <OPERATIONS>

                <!-- !LINKSTO EcuM.EB_Ref.SWS_EcuM_03011_5,1 -->
                <CLIENT-SERVER-OPERATION>
                  <SHORT-NAME>SelectShutdownTarget</SHORT-NAME>
                  <ARGUMENTS>
                    <ARGUMENT-DATA-PROTOTYPE>
                      <SHORT-NAME>shutdownTarget</SHORT-NAME>
                      <TYPE-TREF DEST="IMPLEMENTATION-DATA-TYPE">/AUTOSAR_EcuM/ImplementationDataTypes/EcuM_ShutdownTargetType</TYPE-TREF>
                      <DIRECTION>IN</DIRECTION>
                    </ARGUMENT-DATA-PROTOTYPE>
                    <ARGUMENT-DATA-PROTOTYPE>
                      <SHORT-NAME>shutdownMode</SHORT-NAME>
                      <TYPE-TREF DEST="IMPLEMENTATION-DATA-TYPE">/AUTOSAR_EcuM/ImplementationDataTypes/EcuM_ShutdownModeType</TYPE-TREF>
                      <DIRECTION>IN</DIRECTION>
                    </ARGUMENT-DATA-PROTOTYPE>
                  </ARGUMENTS>
                  <POSSIBLE-ERROR-REFS>
                    <POSSIBLE-ERROR-REF DEST="APPLICATION-ERROR">/AUTOSAR_EcuM/PortInterfaces/EcuM_ShutdownTarget/E_OK</POSSIBLE-ERROR-REF>
                    <POSSIBLE-ERROR-REF DEST="APPLICATION-ERROR">/AUTOSAR_EcuM/PortInterfaces/EcuM_ShutdownTarget/E_NOT_OK</POSSIBLE-ERROR-REF>
                  </POSSIBLE-ERROR-REFS>
                </CLIENT-SERVER-OPERATION>

                <!-- !LINKSTO EcuM.EB_Ref.SWS_EcuM_03011_3,1 -->
                <CLIENT-SERVER-OPERATION>
                  <SHORT-NAME>GetShutdownTarget</SHORT-NAME>
                  <ARGUMENTS>
                    <ARGUMENT-DATA-PROTOTYPE>
                      <SHORT-NAME>shutdownTarget</SHORT-NAME>
                      <TYPE-TREF DEST="IMPLEMENTATION-DATA-TYPE">/AUTOSAR_EcuM/ImplementationDataTypes/EcuM_ShutdownTargetType</TYPE-TREF>
                      <DIRECTION>OUT</DIRECTION>
                    </ARGUMENT-DATA-PROTOTYPE>
                    <ARGUMENT-DATA-PROTOTYPE>
                      <SHORT-NAME>shutdownMode</SHORT-NAME>
                      <TYPE-TREF DEST="IMPLEMENTATION-DATA-TYPE">/AUTOSAR_EcuM/ImplementationDataTypes/EcuM_ShutdownModeType</TYPE-TREF>
                      <DIRECTION>OUT</DIRECTION>
                    </ARGUMENT-DATA-PROTOTYPE>
                  </ARGUMENTS>
                  <POSSIBLE-ERROR-REFS>
                    <POSSIBLE-ERROR-REF DEST="APPLICATION-ERROR">/AUTOSAR_EcuM/PortInterfaces/EcuM_ShutdownTarget/E_OK</POSSIBLE-ERROR-REF>
                    <POSSIBLE-ERROR-REF DEST="APPLICATION-ERROR">/AUTOSAR_EcuM/PortInterfaces/EcuM_ShutdownTarget/E_NOT_OK</POSSIBLE-ERROR-REF>
                  </POSSIBLE-ERROR-REFS>
                </CLIENT-SERVER-OPERATION>

                <!-- !LINKSTO EcuM.EB_Ref.SWS_EcuM_03011_1,1 -->
                <CLIENT-SERVER-OPERATION>
                  <SHORT-NAME>GetLastShutdownTarget</SHORT-NAME>
                  <ARGUMENTS>
                    <ARGUMENT-DATA-PROTOTYPE>
                      <SHORT-NAME>shutdownTarget</SHORT-NAME>
                      <TYPE-TREF DEST="IMPLEMENTATION-DATA-TYPE">/AUTOSAR_EcuM/ImplementationDataTypes/EcuM_ShutdownTargetType</TYPE-TREF>
                      <DIRECTION>OUT</DIRECTION>
                    </ARGUMENT-DATA-PROTOTYPE>
                    <ARGUMENT-DATA-PROTOTYPE>
                      <SHORT-NAME>shutdownMode</SHORT-NAME>
                      <TYPE-TREF DEST="IMPLEMENTATION-DATA-TYPE">/AUTOSAR_EcuM/ImplementationDataTypes/EcuM_ShutdownModeType</TYPE-TREF>
                      <DIRECTION>OUT</DIRECTION>
                    </ARGUMENT-DATA-PROTOTYPE>
                  </ARGUMENTS>
                  <POSSIBLE-ERROR-REFS>
                    <POSSIBLE-ERROR-REF DEST="APPLICATION-ERROR">/AUTOSAR_EcuM/PortInterfaces/EcuM_ShutdownTarget/E_OK</POSSIBLE-ERROR-REF>
                    <POSSIBLE-ERROR-REF DEST="APPLICATION-ERROR">/AUTOSAR_EcuM/PortInterfaces/EcuM_ShutdownTarget/E_NOT_OK</POSSIBLE-ERROR-REF>
                  </POSSIBLE-ERROR-REFS>
                </CLIENT-SERVER-OPERATION>

                <!-- shutdown cause -->
                <!-- !LINKSTO EcuM.EB_Ref.SWS_EcuM_03011_4,1 -->
                <CLIENT-SERVER-OPERATION>
                  <SHORT-NAME>SelectShutdownCause</SHORT-NAME>
                  <ARGUMENTS>
                    <ARGUMENT-DATA-PROTOTYPE>
                      <SHORT-NAME>shutdownCause</SHORT-NAME>
                      <TYPE-TREF DEST="IMPLEMENTATION-DATA-TYPE">/AUTOSAR_EcuM/ImplementationDataTypes/EcuM_ShutdownCauseType</TYPE-TREF>
                      <DIRECTION>IN</DIRECTION>
                    </ARGUMENT-DATA-PROTOTYPE>
                  </ARGUMENTS>
                  <POSSIBLE-ERROR-REFS>
                    <POSSIBLE-ERROR-REF DEST="APPLICATION-ERROR">/AUTOSAR_EcuM/PortInterfaces/EcuM_ShutdownTarget/E_OK</POSSIBLE-ERROR-REF>
                    <POSSIBLE-ERROR-REF DEST="APPLICATION-ERROR">/AUTOSAR_EcuM/PortInterfaces/EcuM_ShutdownTarget/E_NOT_OK</POSSIBLE-ERROR-REF>
                  </POSSIBLE-ERROR-REFS>
                </CLIENT-SERVER-OPERATION>

                <!-- !LINKSTO EcuM.EB_Ref.SWS_EcuM_03011_2,1 -->
                <CLIENT-SERVER-OPERATION>
                  <SHORT-NAME>GetShutdownCause</SHORT-NAME>
                  <ARGUMENTS>
                    <ARGUMENT-DATA-PROTOTYPE>
                      <SHORT-NAME>shutdownCause</SHORT-NAME>
                      <TYPE-TREF DEST="IMPLEMENTATION-DATA-TYPE">/AUTOSAR_EcuM/ImplementationDataTypes/EcuM_ShutdownCauseType</TYPE-TREF>
                      <DIRECTION>OUT</DIRECTION>
                    </ARGUMENT-DATA-PROTOTYPE>
                  </ARGUMENTS>
                  <POSSIBLE-ERROR-REFS>
                    <POSSIBLE-ERROR-REF DEST="APPLICATION-ERROR">/AUTOSAR_EcuM/PortInterfaces/EcuM_ShutdownTarget/E_OK</POSSIBLE-ERROR-REF>
                    <POSSIBLE-ERROR-REF DEST="APPLICATION-ERROR">/AUTOSAR_EcuM/PortInterfaces/EcuM_ShutdownTarget/E_NOT_OK</POSSIBLE-ERROR-REF>
                  </POSSIBLE-ERROR-REFS>
                </CLIENT-SERVER-OPERATION>

              </OPERATIONS>
              <POSSIBLE-ERRORS>
                <APPLICATION-ERROR>
                  <SHORT-NAME>E_OK</SHORT-NAME>
                  <ERROR-CODE>0</ERROR-CODE>
                </APPLICATION-ERROR>
                <APPLICATION-ERROR>
                  <SHORT-NAME>E_NOT_OK</SHORT-NAME>
                  <ERROR-CODE>1</ERROR-CODE>
                </APPLICATION-ERROR>
              </POSSIBLE-ERRORS>
            </CLIENT-SERVER-INTERFACE>

            <!-- !LINKSTO EcuM.ASR42.SWS_EcuM_04094,1 -->
            <CLIENT-SERVER-INTERFACE>
              <SHORT-NAME>EcuM_BootTarget</SHORT-NAME>
              <IS-SERVICE>true</IS-SERVICE>
              <OPERATIONS>
                <!-- !LINKSTO EcuM.EB_Ref.SWS_EcuM_03012_1,1 -->
                <CLIENT-SERVER-OPERATION>
                  <SHORT-NAME>SelectBootTarget</SHORT-NAME>
                  <ARGUMENTS>
                    <ARGUMENT-DATA-PROTOTYPE>
                      <SHORT-NAME>target</SHORT-NAME>
                      <TYPE-TREF DEST="IMPLEMENTATION-DATA-TYPE">/AUTOSAR_EcuM/ImplementationDataTypes/EcuM_BootTargetType</TYPE-TREF>
                      <DIRECTION>IN</DIRECTION>
                    </ARGUMENT-DATA-PROTOTYPE>
                  </ARGUMENTS>
                  <POSSIBLE-ERROR-REFS>
                    <POSSIBLE-ERROR-REF DEST="APPLICATION-ERROR">/AUTOSAR_EcuM/PortInterfaces/EcuM_BootTarget/E_OK</POSSIBLE-ERROR-REF>
                    <POSSIBLE-ERROR-REF DEST="APPLICATION-ERROR">/AUTOSAR_EcuM/PortInterfaces/EcuM_BootTarget/E_NOT_OK</POSSIBLE-ERROR-REF>
                  </POSSIBLE-ERROR-REFS>
                </CLIENT-SERVER-OPERATION>
                <!-- !LINKSTO EcuM.EB_Ref.SWS_EcuM_03012_2,1 -->
                <CLIENT-SERVER-OPERATION>
                  <SHORT-NAME>GetBootTarget</SHORT-NAME>
                  <ARGUMENTS>
                    <ARGUMENT-DATA-PROTOTYPE>
                      <SHORT-NAME>target</SHORT-NAME>
                      <TYPE-TREF DEST="IMPLEMENTATION-DATA-TYPE">/AUTOSAR_EcuM/ImplementationDataTypes/EcuM_BootTargetType</TYPE-TREF>
                      <DIRECTION>OUT</DIRECTION>
                    </ARGUMENT-DATA-PROTOTYPE>
                  </ARGUMENTS>
                  <POSSIBLE-ERROR-REFS>
                    <POSSIBLE-ERROR-REF DEST="APPLICATION-ERROR">/AUTOSAR_EcuM/PortInterfaces/EcuM_BootTarget/E_OK</POSSIBLE-ERROR-REF>
                    <POSSIBLE-ERROR-REF DEST="APPLICATION-ERROR">/AUTOSAR_EcuM/PortInterfaces/EcuM_BootTarget/E_NOT_OK</POSSIBLE-ERROR-REF>
                  </POSSIBLE-ERROR-REFS>
                </CLIENT-SERVER-OPERATION>
              </OPERATIONS>
              <POSSIBLE-ERRORS>
                <APPLICATION-ERROR>
                  <SHORT-NAME>E_OK</SHORT-NAME>
                  <ERROR-CODE>0</ERROR-CODE>
                </APPLICATION-ERROR>
                <APPLICATION-ERROR>
                  <SHORT-NAME>E_NOT_OK</SHORT-NAME>
                  <ERROR-CODE>1</ERROR-CODE>
                </APPLICATION-ERROR>
              </POSSIBLE-ERRORS>
            </CLIENT-SERVER-INTERFACE>
          </ELEMENTS>
        </AR-PACKAGE>
[!ENDIF!][!//
      </AR-PACKAGES>
    </AR-PACKAGE>
  </AR-PACKAGES>
</AUTOSAR>
