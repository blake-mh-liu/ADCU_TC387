<?xml version="1.0" encoding="UTF-8"?>
<AUTOSAR xmlns="http://autosar.org/3.2.2"
  xmlns:xsi="http://www.w3.org/2001/XMLSchema-instance"
  xsi:schemaLocation="http://autosar.org/3.2.2">
[!/* do not generate this file if RTE is not used */!][!//
[!SKIPFILE "(node:existsAndFalse(EcuMGeneral/EcuMRteUsage)) or not(node:exists(EcuMGeneral/EcuMServiceAPI))"!][!//
[!IF "node:exists(EcuMGeneral/EcuMServiceAPI) and  EcuMGeneral/EcuMServiceAPI/EcuMDefaultASRServiceAPI = 'AUTOSAR_32'"!][!//
[!VAR "swComponentTypePackageName" = "'ComponentTypes'"!][!//
[!VAR "swcImplementationPackageName" = "'Implementations'"!][!//
[!VAR "swcImplementationDataTypesPackageName" = "'Datatypes'"!][!//
[!ELSE!][!//
[!VAR "swComponentTypePackageName" = "'SwComponentTypes'"!][!//
[!VAR "swcImplementationPackageName" = "'SwcImplementations'"!][!//
[!VAR "swcImplementationDataTypesPackageName" = "'ImplementationDataTypes'"!][!//
[!ENDIF!][!//
  <TOP-LEVEL-PACKAGES>
    <AR-PACKAGE>
      <SHORT-NAME>AUTOSAR_EcuM</SHORT-NAME>
      <ELEMENTS/>
      <SUB-PACKAGES>
        <AR-PACKAGE>
          <SHORT-NAME>[!"$swComponentTypePackageName"!]</SHORT-NAME>
          <ELEMENTS>
            <SERVICE-COMPONENT-TYPE>
              <SHORT-NAME>EcuM</SHORT-NAME>
              <PORTS>
[!IF "node:exists(EcuMGeneral/EcuMServiceAPI) and (node:existsAndTrue(EcuMGeneral/EcuMServiceAPI/EcuMEnableASR32ServiceAPI))"!][!//
<!-- Provide AUTOSAR 3.2 service -->
[!VAR "EcuMStateCtr"="0"!][!//
[!LOOP "EcuMConfiguration/eb-list::*[1]/EcuMFixedConfiguration/EcuMFixedUserConfig/eb-list::*"!][!//
                <P-PORT-PROTOTYPE>
                  <SHORT-NAME>SR_ASR32_[!"num:i($EcuMStateCtr)"!]</SHORT-NAME>
                  <PROVIDED-INTERFACE-TREF DEST="CLIENT-SERVER-INTERFACE">/AUTOSAR_EcuM/ASR32/PortInterfaces/EcuM_ASR32_StateRequest</PROVIDED-INTERFACE-TREF>
                </P-PORT-PROTOTYPE>
[!VAR "EcuMStateCtr"="$EcuMStateCtr + 1.0"!]
[!ENDLOOP!][!//
                <P-PORT-PROTOTYPE>
                  <SHORT-NAME>shutdownTarget_ASR32</SHORT-NAME>
                  <!-- We do not specify the queue length here and
                       let the Rte decide on the optimal queue
                       length depending on the number of connected
                       clients. -->
                  <PROVIDED-INTERFACE-TREF DEST="CLIENT-SERVER-INTERFACE">/AUTOSAR_EcuM/ASR32/PortInterfaces/EcuM_ASR32_ShutdownTarget</PROVIDED-INTERFACE-TREF>
                </P-PORT-PROTOTYPE>
                <P-PORT-PROTOTYPE>
                  <SHORT-NAME>bootTarget_ASR32</SHORT-NAME>
                  <PROVIDED-INTERFACE-TREF DEST="CLIENT-SERVER-INTERFACE">/AUTOSAR_EcuM/ASR32/PortInterfaces/EcuM_ASR32_BootTarget</PROVIDED-INTERFACE-TREF>
                </P-PORT-PROTOTYPE>
[!IF "node:exists(EcuMConfiguration/eb-list::*[1]/EcuMFixedConfiguration)"!][!//
                <P-PORT-PROTOTYPE>
                  <SHORT-NAME>currentMode_ASR32</SHORT-NAME>
                  <PROVIDED-COM-SPECS>
                    <MODE-SWITCH-COM-SPEC>
                      <MODE-GROUP-REF DEST="MODE-DECLARATION-GROUP-PROTOTYPE">/AUTOSAR_EcuM/ASR32/PortInterfaces/EcuM_ASR32_CurrentMode/currentMode</MODE-GROUP-REF>
                      <QUEUE-LENGTH>6</QUEUE-LENGTH>
                    </MODE-SWITCH-COM-SPEC>
                  </PROVIDED-COM-SPECS>
                  <PROVIDED-INTERFACE-TREF DEST="SENDER-RECEIVER-INTERFACE">/AUTOSAR_EcuM/ASR32/PortInterfaces/EcuM_ASR32_CurrentMode</PROVIDED-INTERFACE-TREF>
                </P-PORT-PROTOTYPE>
[!ENDIF!][!//
[!ENDIF!][!//
[!IF "node:exists(EcuMGeneral/EcuMServiceAPI) and (node:existsAndTrue(EcuMGeneral/EcuMServiceAPI/EcuMEnableASR40ServiceAPI))"!][!//
<!-- Provide AUTOSAR 4.0 service -->
[!VAR "EcuMStateCtr"="0"!][!//
[!LOOP "EcuMConfiguration/eb-list::*[1]/EcuMFixedConfiguration/EcuMFixedUserConfig/eb-list::*"!][!//
                <P-PORT-PROTOTYPE>
                  <SHORT-NAME>SR_ASR40_[!"num:i($EcuMStateCtr)"!]</SHORT-NAME>
                  <PROVIDED-INTERFACE-TREF DEST="CLIENT-SERVER-INTERFACE">/AUTOSAR_EcuM/ASR40/PortInterfaces/EcuM_ASR40_StateRequest</PROVIDED-INTERFACE-TREF>
                </P-PORT-PROTOTYPE>
[!VAR "EcuMStateCtr"="$EcuMStateCtr + 1.0"!]
[!ENDLOOP!][!//
                <P-PORT-PROTOTYPE>
                  <SHORT-NAME>shutdownTarget_ASR40</SHORT-NAME>
                  <!-- We do not specify the queue length here and
                       let the Rte decide on the optimal queue
                       length depending on the number of connected
                       clients. -->
                  <PROVIDED-INTERFACE-TREF DEST="CLIENT-SERVER-INTERFACE">/AUTOSAR_EcuM/ASR40/PortInterfaces/EcuM_ASR40_ShutdownTarget</PROVIDED-INTERFACE-TREF>
                </P-PORT-PROTOTYPE>
                <P-PORT-PROTOTYPE>
                  <SHORT-NAME>bootTarget_ASR40</SHORT-NAME>
                  <PROVIDED-INTERFACE-TREF DEST="CLIENT-SERVER-INTERFACE">/AUTOSAR_EcuM/ASR40/PortInterfaces/EcuM_ASR40_BootTarget</PROVIDED-INTERFACE-TREF>
                </P-PORT-PROTOTYPE>
[!IF "node:exists(EcuMConfiguration/eb-list::*[1]/EcuMFixedConfiguration)"!][!//
                <P-PORT-PROTOTYPE>
                  <SHORT-NAME>currentMode_ASR40</SHORT-NAME>
                  <PROVIDED-COM-SPECS>
                    <MODE-SWITCH-COM-SPEC>
                      <MODE-GROUP-REF DEST="MODE-DECLARATION-GROUP-PROTOTYPE">/AUTOSAR_EcuM/ASR40/PortInterfaces/EcuM_ASR40_CurrentMode/currentMode</MODE-GROUP-REF>
                      <QUEUE-LENGTH>6</QUEUE-LENGTH>
                    </MODE-SWITCH-COM-SPEC>
                  </PROVIDED-COM-SPECS>
                  <PROVIDED-INTERFACE-TREF DEST="SENDER-RECEIVER-INTERFACE">/AUTOSAR_EcuM/ASR40/PortInterfaces/EcuM_ASR40_CurrentMode</PROVIDED-INTERFACE-TREF>
                </P-PORT-PROTOTYPE>
[!ENDIF!][!//
[!ENDIF!][!//
[!IF "node:exists(EcuMGeneral/EcuMServiceAPI) and EcuMGeneral/EcuMServiceAPI/EcuMDefaultASRServiceAPI != 'NONE'"!][!//
<!-- Provide the default service -->
[!VAR "EcuMStateCtr"="0"!][!//
[!LOOP "EcuMConfiguration/eb-list::*[1]/EcuMFixedConfiguration/EcuMFixedUserConfig/eb-list::*"!][!//
                <P-PORT-PROTOTYPE>
                  <SHORT-NAME>SR[!"num:i($EcuMStateCtr)"!]</SHORT-NAME>
                  <PROVIDED-INTERFACE-TREF DEST="CLIENT-SERVER-INTERFACE">/AUTOSAR_EcuM/PortInterfaces/EcuM_StateRequest</PROVIDED-INTERFACE-TREF>
                </P-PORT-PROTOTYPE>
[!VAR "EcuMStateCtr"="$EcuMStateCtr + 1.0"!]
[!ENDLOOP!][!//
                <P-PORT-PROTOTYPE>
                  <SHORT-NAME>shutdownTarget</SHORT-NAME>
                  <!-- We do not specify the queue length here and
                       let the Rte decide on the optimal queue
                       length depending on the number of connected
                       clients. -->
                  <PROVIDED-INTERFACE-TREF DEST="CLIENT-SERVER-INTERFACE">/AUTOSAR_EcuM/PortInterfaces/EcuM_ShutdownTarget</PROVIDED-INTERFACE-TREF>
                </P-PORT-PROTOTYPE>
                <P-PORT-PROTOTYPE>
                  <SHORT-NAME>bootTarget</SHORT-NAME>
                  <PROVIDED-INTERFACE-TREF DEST="CLIENT-SERVER-INTERFACE">/AUTOSAR_EcuM/PortInterfaces/EcuM_BootTarget</PROVIDED-INTERFACE-TREF>
                </P-PORT-PROTOTYPE>
[!IF "node:exists(EcuMConfiguration/eb-list::*[1]/EcuMFixedConfiguration)"!][!//
                <P-PORT-PROTOTYPE>
                  <SHORT-NAME>currentMode</SHORT-NAME>
                  <PROVIDED-COM-SPECS>
                    <MODE-SWITCH-COM-SPEC>
                      <MODE-GROUP-REF DEST="MODE-DECLARATION-GROUP-PROTOTYPE">/AUTOSAR_EcuM/PortInterfaces/EcuM_CurrentMode/currentMode</MODE-GROUP-REF>
                      <QUEUE-LENGTH>6</QUEUE-LENGTH>
                    </MODE-SWITCH-COM-SPEC>
                  </PROVIDED-COM-SPECS>
                  <PROVIDED-INTERFACE-TREF DEST="SENDER-RECEIVER-INTERFACE">/AUTOSAR_EcuM/PortInterfaces/EcuM_CurrentMode</PROVIDED-INTERFACE-TREF>
                </P-PORT-PROTOTYPE>
[!ENDIF!][!//
[!ENDIF!][!//
              </PORTS>
            </SERVICE-COMPONENT-TYPE>
          </ELEMENTS>
        </AR-PACKAGE>
        <AR-PACKAGE>
          <SHORT-NAME>InternalBehaviors</SHORT-NAME>
          <ELEMENTS>
            <INTERNAL-BEHAVIOR>
              <SHORT-NAME>EcuMIntBeh</SHORT-NAME>
              <COMPONENT-REF DEST="SERVICE-COMPONENT-TYPE">/AUTOSAR_EcuM/[!"$swComponentTypePackageName"!]/EcuM</COMPONENT-REF>
              <EVENTS>
[!IF "node:exists(EcuMGeneral/EcuMServiceAPI) and (node:existsAndTrue(EcuMGeneral/EcuMServiceAPI/EcuMEnableASR32ServiceAPI))"!][!//
<!-- Provide AUTOSAR 3.2 service -->
                <OPERATION-INVOKED-EVENT>
                  <SHORT-NAME>EV_ASR32_SelShutdownTarget</SHORT-NAME>
                  <START-ON-EVENT-REF DEST="RUNNABLE-ENTITY">/AUTOSAR_EcuM/InternalBehaviors/EcuMIntBeh/RE_ASR32_SelectShutdownTarget</START-ON-EVENT-REF>
                  <OPERATION-IREF>
                    <P-PORT-PROTOTYPE-REF DEST="P-PORT-PROTOTYPE">/AUTOSAR_EcuM/[!"$swComponentTypePackageName"!]/EcuM/shutdownTarget_ASR32</P-PORT-PROTOTYPE-REF>
                    <OPERATION-PROTOTYPE-REF DEST="OPERATION-PROTOTYPE">/AUTOSAR_EcuM/ASR32/PortInterfaces/EcuM_ASR32_ShutdownTarget/SelectShutdownTarget</OPERATION-PROTOTYPE-REF>
                  </OPERATION-IREF>
                </OPERATION-INVOKED-EVENT>
                <OPERATION-INVOKED-EVENT>
                  <SHORT-NAME>EV_ASR32_GetShutdownTarget</SHORT-NAME>
                  <START-ON-EVENT-REF DEST="RUNNABLE-ENTITY">/AUTOSAR_EcuM/InternalBehaviors/EcuMIntBeh/RE_ASR32_GetShutdownTarget</START-ON-EVENT-REF>
                  <OPERATION-IREF>
                    <P-PORT-PROTOTYPE-REF DEST="P-PORT-PROTOTYPE">/AUTOSAR_EcuM/[!"$swComponentTypePackageName"!]/EcuM/shutdownTarget_ASR32</P-PORT-PROTOTYPE-REF>
                    <OPERATION-PROTOTYPE-REF DEST="OPERATION-PROTOTYPE">/AUTOSAR_EcuM/ASR32/PortInterfaces/EcuM_ASR32_ShutdownTarget/GetShutdownTarget</OPERATION-PROTOTYPE-REF>
                  </OPERATION-IREF>
                </OPERATION-INVOKED-EVENT>
                <OPERATION-INVOKED-EVENT>
                  <SHORT-NAME>EV_ASR32_GetLastShutdownTarget</SHORT-NAME>
                  <START-ON-EVENT-REF DEST="RUNNABLE-ENTITY">/AUTOSAR_EcuM/InternalBehaviors/EcuMIntBeh/RE_ASR32_GetLastShutdownTarget</START-ON-EVENT-REF>
                  <OPERATION-IREF>
                    <P-PORT-PROTOTYPE-REF DEST="P-PORT-PROTOTYPE">/AUTOSAR_EcuM/[!"$swComponentTypePackageName"!]/EcuM/shutdownTarget_ASR32</P-PORT-PROTOTYPE-REF>
                    <OPERATION-PROTOTYPE-REF DEST="OPERATION-PROTOTYPE">/AUTOSAR_EcuM/ASR32/PortInterfaces/EcuM_ASR32_ShutdownTarget/GetLastShutdownTarget</OPERATION-PROTOTYPE-REF>
                  </OPERATION-IREF>
                </OPERATION-INVOKED-EVENT>

                <OPERATION-INVOKED-EVENT>
                  <SHORT-NAME>EV_ASR32_SelBootTarget</SHORT-NAME>
                  <START-ON-EVENT-REF DEST="RUNNABLE-ENTITY">/AUTOSAR_EcuM/InternalBehaviors/EcuMIntBeh/RE_ASR32_SelectBootTarget</START-ON-EVENT-REF>
                  <OPERATION-IREF>
                    <P-PORT-PROTOTYPE-REF DEST="P-PORT-PROTOTYPE">/AUTOSAR_EcuM/[!"$swComponentTypePackageName"!]/EcuM/bootTarget_ASR32</P-PORT-PROTOTYPE-REF>
                    <OPERATION-PROTOTYPE-REF DEST="OPERATION-PROTOTYPE">/AUTOSAR_EcuM/ASR32/PortInterfaces/EcuM_ASR32_BootTarget/SelectBootTarget</OPERATION-PROTOTYPE-REF>
                  </OPERATION-IREF>
                </OPERATION-INVOKED-EVENT>

                <OPERATION-INVOKED-EVENT>
                  <SHORT-NAME>EV_ASR32_GetBootTarget</SHORT-NAME>
                  <START-ON-EVENT-REF DEST="RUNNABLE-ENTITY">/AUTOSAR_EcuM/InternalBehaviors/EcuMIntBeh/RE_ASR32_GetBootTarget</START-ON-EVENT-REF>
                  <OPERATION-IREF>
                    <P-PORT-PROTOTYPE-REF DEST="P-PORT-PROTOTYPE">/AUTOSAR_EcuM/[!"$swComponentTypePackageName"!]/EcuM/bootTarget_ASR32</P-PORT-PROTOTYPE-REF>
                    <OPERATION-PROTOTYPE-REF DEST="OPERATION-PROTOTYPE">/AUTOSAR_EcuM/ASR32/PortInterfaces/EcuM_ASR32_BootTarget/GetBootTarget</OPERATION-PROTOTYPE-REF>
                  </OPERATION-IREF>
                </OPERATION-INVOKED-EVENT>

[!VAR "EcuMStateCtr"="0"!][!//
[!LOOP "EcuMConfiguration/eb-list::*[1]/EcuMFixedConfiguration/EcuMFixedUserConfig/eb-list::*"!][!//
                <OPERATION-INVOKED-EVENT>
                  <SHORT-NAME>EV_ASR32_SR[!"num:i($EcuMStateCtr)"!]_RequestRUN</SHORT-NAME>
                  <START-ON-EVENT-REF DEST="RUNNABLE-ENTITY">/AUTOSAR_EcuM/InternalBehaviors/EcuMIntBeh/RE_ASR32_RequestRUN</START-ON-EVENT-REF>
                  <OPERATION-IREF>
                    <P-PORT-PROTOTYPE-REF DEST="P-PORT-PROTOTYPE">/AUTOSAR_EcuM/[!"$swComponentTypePackageName"!]/EcuM/SR_ASR32_[!"num:i($EcuMStateCtr)"!]</P-PORT-PROTOTYPE-REF>
                    <OPERATION-PROTOTYPE-REF DEST="OPERATION-PROTOTYPE">/AUTOSAR_EcuM/ASR32/PortInterfaces/EcuM_ASR32_StateRequest/RequestRUN</OPERATION-PROTOTYPE-REF>
                  </OPERATION-IREF>
                </OPERATION-INVOKED-EVENT>
                <OPERATION-INVOKED-EVENT>
                  <SHORT-NAME>EV_ASR32_SR[!"num:i($EcuMStateCtr)"!]_ReleaseRUN</SHORT-NAME>
                  <START-ON-EVENT-REF DEST="RUNNABLE-ENTITY">/AUTOSAR_EcuM/InternalBehaviors/EcuMIntBeh/RE_ASR32_ReleaseRUN</START-ON-EVENT-REF>
                  <OPERATION-IREF>
                    <P-PORT-PROTOTYPE-REF DEST="P-PORT-PROTOTYPE">/AUTOSAR_EcuM/[!"$swComponentTypePackageName"!]/EcuM/SR_ASR32_[!"num:i($EcuMStateCtr)"!]</P-PORT-PROTOTYPE-REF>
                    <OPERATION-PROTOTYPE-REF DEST="OPERATION-PROTOTYPE">/AUTOSAR_EcuM/ASR32/PortInterfaces/EcuM_ASR32_StateRequest/ReleaseRUN</OPERATION-PROTOTYPE-REF>
                  </OPERATION-IREF>
                </OPERATION-INVOKED-EVENT>
                <OPERATION-INVOKED-EVENT>
                  <SHORT-NAME>EV_ASR32_SR[!"num:i($EcuMStateCtr)"!]_RequestPOSTRUN</SHORT-NAME>
                  <START-ON-EVENT-REF DEST="RUNNABLE-ENTITY">/AUTOSAR_EcuM/InternalBehaviors/EcuMIntBeh/RE_ASR32_RequestPOSTRUN</START-ON-EVENT-REF>
                  <OPERATION-IREF>
                    <P-PORT-PROTOTYPE-REF DEST="P-PORT-PROTOTYPE">/AUTOSAR_EcuM/[!"$swComponentTypePackageName"!]/EcuM/SR_ASR32_[!"num:i($EcuMStateCtr)"!]</P-PORT-PROTOTYPE-REF>
                    <OPERATION-PROTOTYPE-REF DEST="OPERATION-PROTOTYPE">/AUTOSAR_EcuM/ASR32/PortInterfaces/EcuM_ASR32_StateRequest/RequestPOSTRUN</OPERATION-PROTOTYPE-REF>
                  </OPERATION-IREF>
                </OPERATION-INVOKED-EVENT>
                <OPERATION-INVOKED-EVENT>
                  <SHORT-NAME>EV_ASR32_SR[!"num:i($EcuMStateCtr)"!]_ReleasePOSTRUN</SHORT-NAME>
                  <START-ON-EVENT-REF DEST="RUNNABLE-ENTITY">/AUTOSAR_EcuM/InternalBehaviors/EcuMIntBeh/RE_ASR32_ReleasePOSTRUN</START-ON-EVENT-REF>
                  <OPERATION-IREF>
                    <P-PORT-PROTOTYPE-REF DEST="P-PORT-PROTOTYPE">/AUTOSAR_EcuM/[!"$swComponentTypePackageName"!]/EcuM/SR_ASR32_[!"num:i($EcuMStateCtr)"!]</P-PORT-PROTOTYPE-REF>
                    <OPERATION-PROTOTYPE-REF DEST="OPERATION-PROTOTYPE">/AUTOSAR_EcuM/ASR32/PortInterfaces/EcuM_ASR32_StateRequest/ReleasePOSTRUN</OPERATION-PROTOTYPE-REF>
                  </OPERATION-IREF>
                </OPERATION-INVOKED-EVENT>
[!VAR "EcuMStateCtr"="$EcuMStateCtr + 1.0"!]
[!ENDLOOP!][!//
[!ENDIF!][!//
[!IF "node:exists(EcuMGeneral/EcuMServiceAPI) and (node:existsAndTrue(EcuMGeneral/EcuMServiceAPI/EcuMEnableASR40ServiceAPI))"!][!//
<!-- Provide AUTOSAR 4.0 service -->
                <OPERATION-INVOKED-EVENT>
                  <SHORT-NAME>EV_ASR40_SelShutdownTarget</SHORT-NAME>
                  <START-ON-EVENT-REF DEST="RUNNABLE-ENTITY">/AUTOSAR_EcuM/InternalBehaviors/EcuMIntBeh/RE_ASR40_SelectShutdownTarget</START-ON-EVENT-REF>
                  <OPERATION-IREF>
                    <P-PORT-PROTOTYPE-REF DEST="P-PORT-PROTOTYPE">/AUTOSAR_EcuM/[!"$swComponentTypePackageName"!]/EcuM/shutdownTarget_ASR40</P-PORT-PROTOTYPE-REF>
                    <OPERATION-PROTOTYPE-REF DEST="OPERATION-PROTOTYPE">/AUTOSAR_EcuM/ASR40/PortInterfaces/EcuM_ASR40_ShutdownTarget/SelectShutdownTarget</OPERATION-PROTOTYPE-REF>
                  </OPERATION-IREF>
                </OPERATION-INVOKED-EVENT>
                <OPERATION-INVOKED-EVENT>
                  <SHORT-NAME>EV_ASR40_GetShutdownTarget</SHORT-NAME>
                  <START-ON-EVENT-REF DEST="RUNNABLE-ENTITY">/AUTOSAR_EcuM/InternalBehaviors/EcuMIntBeh/RE_ASR40_GetShutdownTarget</START-ON-EVENT-REF>
                  <OPERATION-IREF>
                    <P-PORT-PROTOTYPE-REF DEST="P-PORT-PROTOTYPE">/AUTOSAR_EcuM/[!"$swComponentTypePackageName"!]/EcuM/shutdownTarget_ASR40</P-PORT-PROTOTYPE-REF>
                    <OPERATION-PROTOTYPE-REF DEST="OPERATION-PROTOTYPE">/AUTOSAR_EcuM/ASR40/PortInterfaces/EcuM_ASR40_ShutdownTarget/GetShutdownTarget</OPERATION-PROTOTYPE-REF>
                  </OPERATION-IREF>
                </OPERATION-INVOKED-EVENT>
                <OPERATION-INVOKED-EVENT>
                  <SHORT-NAME>EV_ASR40_GetLastShutdownTarget</SHORT-NAME>
                  <START-ON-EVENT-REF DEST="RUNNABLE-ENTITY">/AUTOSAR_EcuM/InternalBehaviors/EcuMIntBeh/RE_ASR40_GetLastShutdownTarget</START-ON-EVENT-REF>
                  <OPERATION-IREF>
                    <P-PORT-PROTOTYPE-REF DEST="P-PORT-PROTOTYPE">/AUTOSAR_EcuM/[!"$swComponentTypePackageName"!]/EcuM/shutdownTarget_ASR40</P-PORT-PROTOTYPE-REF>
                    <OPERATION-PROTOTYPE-REF DEST="OPERATION-PROTOTYPE">/AUTOSAR_EcuM/ASR40/PortInterfaces/EcuM_ASR40_ShutdownTarget/GetLastShutdownTarget</OPERATION-PROTOTYPE-REF>
                  </OPERATION-IREF>
                </OPERATION-INVOKED-EVENT>

                <OPERATION-INVOKED-EVENT>
                  <SHORT-NAME>EV_ASR40_GetMostRecentShutdown</SHORT-NAME>
                  <START-ON-EVENT-REF DEST="RUNNABLE-ENTITY">/AUTOSAR_EcuM/InternalBehaviors/EcuMIntBeh/RE_ASR40_GetMostRecentShutdown</START-ON-EVENT-REF>
                  <OPERATION-IREF>
                    <P-PORT-PROTOTYPE-REF DEST="P-PORT-PROTOTYPE">/AUTOSAR_EcuM/[!"$swComponentTypePackageName"!]/EcuM/shutdownTarget_ASR40</P-PORT-PROTOTYPE-REF>
                    <OPERATION-PROTOTYPE-REF DEST="OPERATION-PROTOTYPE">/AUTOSAR_EcuM/ASR40/PortInterfaces/EcuM_ASR40_ShutdownTarget/GetMostRecentShutdown</OPERATION-PROTOTYPE-REF>
                  </OPERATION-IREF>
                </OPERATION-INVOKED-EVENT>

                <OPERATION-INVOKED-EVENT>
                  <SHORT-NAME>EV_ASR40_GetNextRecentShutdown</SHORT-NAME>
                  <START-ON-EVENT-REF DEST="RUNNABLE-ENTITY">/AUTOSAR_EcuM/InternalBehaviors/EcuMIntBeh/RE_ASR40_GetNextRecentShutdown</START-ON-EVENT-REF>
                  <OPERATION-IREF>
                    <P-PORT-PROTOTYPE-REF DEST="P-PORT-PROTOTYPE">/AUTOSAR_EcuM/[!"$swComponentTypePackageName"!]/EcuM/shutdownTarget_ASR40</P-PORT-PROTOTYPE-REF>
                    <OPERATION-PROTOTYPE-REF DEST="OPERATION-PROTOTYPE">/AUTOSAR_EcuM/ASR40/PortInterfaces/EcuM_ASR40_ShutdownTarget/GetNextRecentShutdown</OPERATION-PROTOTYPE-REF>
                  </OPERATION-IREF>
                </OPERATION-INVOKED-EVENT>

                <OPERATION-INVOKED-EVENT>
                  <SHORT-NAME>EV_ASR40_SelectShutdownCause</SHORT-NAME>
                  <START-ON-EVENT-REF DEST="RUNNABLE-ENTITY">/AUTOSAR_EcuM/InternalBehaviors/EcuMIntBeh/RE_ASR40_SelectShutdownCause</START-ON-EVENT-REF>
                  <OPERATION-IREF>
                    <P-PORT-PROTOTYPE-REF DEST="P-PORT-PROTOTYPE">/AUTOSAR_EcuM/[!"$swComponentTypePackageName"!]/EcuM/shutdownTarget_ASR40</P-PORT-PROTOTYPE-REF>
                    <OPERATION-PROTOTYPE-REF DEST="OPERATION-PROTOTYPE">/AUTOSAR_EcuM/ASR40/PortInterfaces/EcuM_ASR40_ShutdownTarget/SelectShutdownCause</OPERATION-PROTOTYPE-REF>
                  </OPERATION-IREF>
                </OPERATION-INVOKED-EVENT>

                <OPERATION-INVOKED-EVENT>
                  <SHORT-NAME>EV_ASR40_GetShutdownCause</SHORT-NAME>
                  <START-ON-EVENT-REF DEST="RUNNABLE-ENTITY">/AUTOSAR_EcuM/InternalBehaviors/EcuMIntBeh/RE_ASR40_GetShutdownCause</START-ON-EVENT-REF>
                  <OPERATION-IREF>
                    <P-PORT-PROTOTYPE-REF DEST="P-PORT-PROTOTYPE">/AUTOSAR_EcuM/[!"$swComponentTypePackageName"!]/EcuM/shutdownTarget_ASR40</P-PORT-PROTOTYPE-REF>
                    <OPERATION-PROTOTYPE-REF DEST="OPERATION-PROTOTYPE">/AUTOSAR_EcuM/ASR40/PortInterfaces/EcuM_ASR40_ShutdownTarget/GetShutdownCause</OPERATION-PROTOTYPE-REF>
                  </OPERATION-IREF>
                </OPERATION-INVOKED-EVENT>

                <OPERATION-INVOKED-EVENT>
                  <SHORT-NAME>EV_ASR40_SelBootTarget</SHORT-NAME>
                  <START-ON-EVENT-REF DEST="RUNNABLE-ENTITY">/AUTOSAR_EcuM/InternalBehaviors/EcuMIntBeh/RE_ASR40_SelectBootTarget</START-ON-EVENT-REF>
                  <OPERATION-IREF>
                    <P-PORT-PROTOTYPE-REF DEST="P-PORT-PROTOTYPE">/AUTOSAR_EcuM/[!"$swComponentTypePackageName"!]/EcuM/bootTarget_ASR40</P-PORT-PROTOTYPE-REF>
                    <OPERATION-PROTOTYPE-REF DEST="OPERATION-PROTOTYPE">/AUTOSAR_EcuM/ASR40/PortInterfaces/EcuM_ASR40_BootTarget/SelectBootTarget</OPERATION-PROTOTYPE-REF>
                  </OPERATION-IREF>
                </OPERATION-INVOKED-EVENT>

                <OPERATION-INVOKED-EVENT>
                  <SHORT-NAME>EV_ASR40_GetBootTarget</SHORT-NAME>
                  <START-ON-EVENT-REF DEST="RUNNABLE-ENTITY">/AUTOSAR_EcuM/InternalBehaviors/EcuMIntBeh/RE_ASR40_GetBootTarget</START-ON-EVENT-REF>
                  <OPERATION-IREF>
                    <P-PORT-PROTOTYPE-REF DEST="P-PORT-PROTOTYPE">/AUTOSAR_EcuM/[!"$swComponentTypePackageName"!]/EcuM/bootTarget_ASR40</P-PORT-PROTOTYPE-REF>
                    <OPERATION-PROTOTYPE-REF DEST="OPERATION-PROTOTYPE">/AUTOSAR_EcuM/ASR40/PortInterfaces/EcuM_ASR40_BootTarget/GetBootTarget</OPERATION-PROTOTYPE-REF>
                  </OPERATION-IREF>
                </OPERATION-INVOKED-EVENT>

[!VAR "EcuMStateCtr"="0"!][!//
[!LOOP "EcuMConfiguration/eb-list::*[1]/EcuMFixedConfiguration/EcuMFixedUserConfig/eb-list::*"!][!//
                <OPERATION-INVOKED-EVENT>
                  <SHORT-NAME>EV_ASR40_SR[!"num:i($EcuMStateCtr)"!]_RequestRUN</SHORT-NAME>
                  <START-ON-EVENT-REF DEST="RUNNABLE-ENTITY">/AUTOSAR_EcuM/InternalBehaviors/EcuMIntBeh/RE_ASR40_RequestRUN</START-ON-EVENT-REF>
                  <OPERATION-IREF>
                    <P-PORT-PROTOTYPE-REF DEST="P-PORT-PROTOTYPE">/AUTOSAR_EcuM/[!"$swComponentTypePackageName"!]/EcuM/SR_ASR40_[!"num:i($EcuMStateCtr)"!]</P-PORT-PROTOTYPE-REF>
                    <OPERATION-PROTOTYPE-REF DEST="OPERATION-PROTOTYPE">/AUTOSAR_EcuM/ASR40/PortInterfaces/EcuM_ASR40_StateRequest/RequestRUN</OPERATION-PROTOTYPE-REF>
                  </OPERATION-IREF>
                </OPERATION-INVOKED-EVENT>
                <OPERATION-INVOKED-EVENT>
                  <SHORT-NAME>EV_ASR40_SR[!"num:i($EcuMStateCtr)"!]_ReleaseRUN</SHORT-NAME>
                  <START-ON-EVENT-REF DEST="RUNNABLE-ENTITY">/AUTOSAR_EcuM/InternalBehaviors/EcuMIntBeh/RE_ASR40_ReleaseRUN</START-ON-EVENT-REF>
                  <OPERATION-IREF>
                    <P-PORT-PROTOTYPE-REF DEST="P-PORT-PROTOTYPE">/AUTOSAR_EcuM/[!"$swComponentTypePackageName"!]/EcuM/SR_ASR40_[!"num:i($EcuMStateCtr)"!]</P-PORT-PROTOTYPE-REF>
                    <OPERATION-PROTOTYPE-REF DEST="OPERATION-PROTOTYPE">/AUTOSAR_EcuM/ASR40/PortInterfaces/EcuM_ASR40_StateRequest/ReleaseRUN</OPERATION-PROTOTYPE-REF>
                  </OPERATION-IREF>
                </OPERATION-INVOKED-EVENT>
                <OPERATION-INVOKED-EVENT>
                  <SHORT-NAME>EV_ASR40_SR[!"num:i($EcuMStateCtr)"!]_RequestPOSTRUN</SHORT-NAME>
                  <START-ON-EVENT-REF DEST="RUNNABLE-ENTITY">/AUTOSAR_EcuM/InternalBehaviors/EcuMIntBeh/RE_ASR40_RequestPOSTRUN</START-ON-EVENT-REF>
                  <OPERATION-IREF>
                    <P-PORT-PROTOTYPE-REF DEST="P-PORT-PROTOTYPE">/AUTOSAR_EcuM/[!"$swComponentTypePackageName"!]/EcuM/SR_ASR40_[!"num:i($EcuMStateCtr)"!]</P-PORT-PROTOTYPE-REF>
                    <OPERATION-PROTOTYPE-REF DEST="OPERATION-PROTOTYPE">/AUTOSAR_EcuM/ASR40/PortInterfaces/EcuM_ASR40_StateRequest/RequestPOSTRUN</OPERATION-PROTOTYPE-REF>
                  </OPERATION-IREF>
                </OPERATION-INVOKED-EVENT>
                <OPERATION-INVOKED-EVENT>
                  <SHORT-NAME>EV_ASR40_SR[!"num:i($EcuMStateCtr)"!]_ReleasePOSTRUN</SHORT-NAME>
                  <START-ON-EVENT-REF DEST="RUNNABLE-ENTITY">/AUTOSAR_EcuM/InternalBehaviors/EcuMIntBeh/RE_ASR40_ReleasePOSTRUN</START-ON-EVENT-REF>
                  <OPERATION-IREF>
                    <P-PORT-PROTOTYPE-REF DEST="P-PORT-PROTOTYPE">/AUTOSAR_EcuM/[!"$swComponentTypePackageName"!]/EcuM/SR_ASR40_[!"num:i($EcuMStateCtr)"!]</P-PORT-PROTOTYPE-REF>
                    <OPERATION-PROTOTYPE-REF DEST="OPERATION-PROTOTYPE">/AUTOSAR_EcuM/ASR40/PortInterfaces/EcuM_ASR40_StateRequest/ReleasePOSTRUN</OPERATION-PROTOTYPE-REF>
                  </OPERATION-IREF>
                </OPERATION-INVOKED-EVENT>
[!VAR "EcuMStateCtr"="$EcuMStateCtr + 1.0"!]
[!ENDLOOP!][!//
[!ENDIF!][!//
[!IF "node:exists(EcuMGeneral/EcuMServiceAPI) and EcuMGeneral/EcuMServiceAPI/EcuMDefaultASRServiceAPI != 'NONE'"!][!//
<!-- Provide the default service -->
                <OPERATION-INVOKED-EVENT>
                  <SHORT-NAME>EV_SelShutdownTarget</SHORT-NAME>
                  <START-ON-EVENT-REF DEST="RUNNABLE-ENTITY">/AUTOSAR_EcuM/InternalBehaviors/EcuMIntBeh/RE_SelectShutdownTarget</START-ON-EVENT-REF>
                  <OPERATION-IREF>
                    <P-PORT-PROTOTYPE-REF DEST="P-PORT-PROTOTYPE">/AUTOSAR_EcuM/[!"$swComponentTypePackageName"!]/EcuM/shutdownTarget</P-PORT-PROTOTYPE-REF>
                    <OPERATION-PROTOTYPE-REF DEST="OPERATION-PROTOTYPE">/AUTOSAR_EcuM/PortInterfaces/EcuM_ShutdownTarget/SelectShutdownTarget</OPERATION-PROTOTYPE-REF>
                  </OPERATION-IREF>
                </OPERATION-INVOKED-EVENT>
                <OPERATION-INVOKED-EVENT>
                  <SHORT-NAME>EV_GetShutdownTarget</SHORT-NAME>
                  <START-ON-EVENT-REF DEST="RUNNABLE-ENTITY">/AUTOSAR_EcuM/InternalBehaviors/EcuMIntBeh/RE_GetShutdownTarget</START-ON-EVENT-REF>
                  <OPERATION-IREF>
                    <P-PORT-PROTOTYPE-REF DEST="P-PORT-PROTOTYPE">/AUTOSAR_EcuM/[!"$swComponentTypePackageName"!]/EcuM/shutdownTarget</P-PORT-PROTOTYPE-REF>
                    <OPERATION-PROTOTYPE-REF DEST="OPERATION-PROTOTYPE">/AUTOSAR_EcuM/PortInterfaces/EcuM_ShutdownTarget/GetShutdownTarget</OPERATION-PROTOTYPE-REF>
                  </OPERATION-IREF>
                </OPERATION-INVOKED-EVENT>
                <OPERATION-INVOKED-EVENT>
                  <SHORT-NAME>EV_GetLastShutdownTarget</SHORT-NAME>
                  <START-ON-EVENT-REF DEST="RUNNABLE-ENTITY">/AUTOSAR_EcuM/InternalBehaviors/EcuMIntBeh/RE_GetLastShutdownTarget</START-ON-EVENT-REF>
                  <OPERATION-IREF>
                    <P-PORT-PROTOTYPE-REF DEST="P-PORT-PROTOTYPE">/AUTOSAR_EcuM/[!"$swComponentTypePackageName"!]/EcuM/shutdownTarget</P-PORT-PROTOTYPE-REF>
                    <OPERATION-PROTOTYPE-REF DEST="OPERATION-PROTOTYPE">/AUTOSAR_EcuM/PortInterfaces/EcuM_ShutdownTarget/GetLastShutdownTarget</OPERATION-PROTOTYPE-REF>
                  </OPERATION-IREF>
                </OPERATION-INVOKED-EVENT>
[!IF "EcuMGeneral/EcuMServiceAPI/EcuMDefaultASRServiceAPI = 'AUTOSAR_40'"!][!//
                <OPERATION-INVOKED-EVENT>
                  <SHORT-NAME>EV_GetMostRecentShutdown</SHORT-NAME>
                  <START-ON-EVENT-REF DEST="RUNNABLE-ENTITY">/AUTOSAR_EcuM/InternalBehaviors/EcuMIntBeh/RE_GetMostRecentShutdown</START-ON-EVENT-REF>
                  <OPERATION-IREF>
                    <P-PORT-PROTOTYPE-REF DEST="P-PORT-PROTOTYPE">/AUTOSAR_EcuM/[!"$swComponentTypePackageName"!]/EcuM/shutdownTarget</P-PORT-PROTOTYPE-REF>
                    <OPERATION-PROTOTYPE-REF DEST="OPERATION-PROTOTYPE">/AUTOSAR_EcuM/PortInterfaces/EcuM_ShutdownTarget/GetMostRecentShutdown</OPERATION-PROTOTYPE-REF>
                  </OPERATION-IREF>
                </OPERATION-INVOKED-EVENT>

                <OPERATION-INVOKED-EVENT>
                  <SHORT-NAME>EV_GetNextRecentShutdown</SHORT-NAME>
                  <START-ON-EVENT-REF DEST="RUNNABLE-ENTITY">/AUTOSAR_EcuM/InternalBehaviors/EcuMIntBeh/RE_GetNextRecentShutdown</START-ON-EVENT-REF>
                  <OPERATION-IREF>
                    <P-PORT-PROTOTYPE-REF DEST="P-PORT-PROTOTYPE">/AUTOSAR_EcuM/[!"$swComponentTypePackageName"!]/EcuM/shutdownTarget</P-PORT-PROTOTYPE-REF>
                    <OPERATION-PROTOTYPE-REF DEST="OPERATION-PROTOTYPE">/AUTOSAR_EcuM/PortInterfaces/EcuM_ShutdownTarget/GetNextRecentShutdown</OPERATION-PROTOTYPE-REF>
                  </OPERATION-IREF>
                </OPERATION-INVOKED-EVENT>

                <OPERATION-INVOKED-EVENT>
                  <SHORT-NAME>EV_SelectShutdownCause</SHORT-NAME>
                  <START-ON-EVENT-REF DEST="RUNNABLE-ENTITY">/AUTOSAR_EcuM/InternalBehaviors/EcuMIntBeh/RE_SelectShutdownCause</START-ON-EVENT-REF>
                  <OPERATION-IREF>
                    <P-PORT-PROTOTYPE-REF DEST="P-PORT-PROTOTYPE">/AUTOSAR_EcuM/[!"$swComponentTypePackageName"!]/EcuM/shutdownTarget</P-PORT-PROTOTYPE-REF>
                    <OPERATION-PROTOTYPE-REF DEST="OPERATION-PROTOTYPE">/AUTOSAR_EcuM/PortInterfaces/EcuM_ShutdownTarget/SelectShutdownCause</OPERATION-PROTOTYPE-REF>
                  </OPERATION-IREF>
                </OPERATION-INVOKED-EVENT>

                <OPERATION-INVOKED-EVENT>
                  <SHORT-NAME>EV_GetShutdownCause</SHORT-NAME>
                  <START-ON-EVENT-REF DEST="RUNNABLE-ENTITY">/AUTOSAR_EcuM/InternalBehaviors/EcuMIntBeh/RE_GetShutdownCause</START-ON-EVENT-REF>
                  <OPERATION-IREF>
                    <P-PORT-PROTOTYPE-REF DEST="P-PORT-PROTOTYPE">/AUTOSAR_EcuM/[!"$swComponentTypePackageName"!]/EcuM/shutdownTarget</P-PORT-PROTOTYPE-REF>
                    <OPERATION-PROTOTYPE-REF DEST="OPERATION-PROTOTYPE">/AUTOSAR_EcuM/PortInterfaces/EcuM_ShutdownTarget/GetShutdownCause</OPERATION-PROTOTYPE-REF>
                  </OPERATION-IREF>
                </OPERATION-INVOKED-EVENT>
[!ENDIF!][!//
                <OPERATION-INVOKED-EVENT>
                  <SHORT-NAME>EV_SelBootTarget</SHORT-NAME>
                  <START-ON-EVENT-REF DEST="RUNNABLE-ENTITY">/AUTOSAR_EcuM/InternalBehaviors/EcuMIntBeh/RE_SelectBootTarget</START-ON-EVENT-REF>
                  <OPERATION-IREF>
                    <P-PORT-PROTOTYPE-REF DEST="P-PORT-PROTOTYPE">/AUTOSAR_EcuM/[!"$swComponentTypePackageName"!]/EcuM/bootTarget</P-PORT-PROTOTYPE-REF>
                    <OPERATION-PROTOTYPE-REF DEST="OPERATION-PROTOTYPE">/AUTOSAR_EcuM/PortInterfaces/EcuM_BootTarget/SelectBootTarget</OPERATION-PROTOTYPE-REF>
                  </OPERATION-IREF>
                </OPERATION-INVOKED-EVENT>

                <OPERATION-INVOKED-EVENT>
                  <SHORT-NAME>EV_GetBootTarget</SHORT-NAME>
                  <START-ON-EVENT-REF DEST="RUNNABLE-ENTITY">/AUTOSAR_EcuM/InternalBehaviors/EcuMIntBeh/RE_GetBootTarget</START-ON-EVENT-REF>
                  <OPERATION-IREF>
                    <P-PORT-PROTOTYPE-REF DEST="P-PORT-PROTOTYPE">/AUTOSAR_EcuM/[!"$swComponentTypePackageName"!]/EcuM/bootTarget</P-PORT-PROTOTYPE-REF>
                    <OPERATION-PROTOTYPE-REF DEST="OPERATION-PROTOTYPE">/AUTOSAR_EcuM/PortInterfaces/EcuM_BootTarget/GetBootTarget</OPERATION-PROTOTYPE-REF>
                  </OPERATION-IREF>
                </OPERATION-INVOKED-EVENT>
[!VAR "EcuMStateCtr"="0"!]
[!LOOP "EcuMConfiguration/eb-list::*[1]/EcuMFixedConfiguration/EcuMFixedUserConfig/eb-list::*"!][!//
                <OPERATION-INVOKED-EVENT>
                  <SHORT-NAME>EV_SR[!"num:i($EcuMStateCtr)"!]_RequestRUN</SHORT-NAME>
                  <START-ON-EVENT-REF DEST="RUNNABLE-ENTITY">/AUTOSAR_EcuM/InternalBehaviors/EcuMIntBeh/RE_RequestRUN</START-ON-EVENT-REF>
                  <OPERATION-IREF>
                    <P-PORT-PROTOTYPE-REF DEST="P-PORT-PROTOTYPE">/AUTOSAR_EcuM/[!"$swComponentTypePackageName"!]/EcuM/SR[!"num:i($EcuMStateCtr)"!]</P-PORT-PROTOTYPE-REF>
                    <OPERATION-PROTOTYPE-REF DEST="OPERATION-PROTOTYPE">/AUTOSAR_EcuM/PortInterfaces/EcuM_StateRequest/RequestRUN</OPERATION-PROTOTYPE-REF>
                  </OPERATION-IREF>
                </OPERATION-INVOKED-EVENT>
                <OPERATION-INVOKED-EVENT>
                  <SHORT-NAME>EV_SR[!"num:i($EcuMStateCtr)"!]_ReleaseRUN</SHORT-NAME>
                  <START-ON-EVENT-REF DEST="RUNNABLE-ENTITY">/AUTOSAR_EcuM/InternalBehaviors/EcuMIntBeh/RE_ReleaseRUN</START-ON-EVENT-REF>
                  <OPERATION-IREF>
                    <P-PORT-PROTOTYPE-REF DEST="P-PORT-PROTOTYPE">/AUTOSAR_EcuM/[!"$swComponentTypePackageName"!]/EcuM/SR[!"num:i($EcuMStateCtr)"!]</P-PORT-PROTOTYPE-REF>
                    <OPERATION-PROTOTYPE-REF DEST="OPERATION-PROTOTYPE">/AUTOSAR_EcuM/PortInterfaces/EcuM_StateRequest/ReleaseRUN</OPERATION-PROTOTYPE-REF>
                  </OPERATION-IREF>
                </OPERATION-INVOKED-EVENT>
                <OPERATION-INVOKED-EVENT>
                  <SHORT-NAME>EV_SR[!"num:i($EcuMStateCtr)"!]_RequestPOSTRUN</SHORT-NAME>
                  <START-ON-EVENT-REF DEST="RUNNABLE-ENTITY">/AUTOSAR_EcuM/InternalBehaviors/EcuMIntBeh/RE_RequestPOSTRUN</START-ON-EVENT-REF>
                  <OPERATION-IREF>
                    <P-PORT-PROTOTYPE-REF DEST="P-PORT-PROTOTYPE">/AUTOSAR_EcuM/[!"$swComponentTypePackageName"!]/EcuM/SR[!"num:i($EcuMStateCtr)"!]</P-PORT-PROTOTYPE-REF>
                    <OPERATION-PROTOTYPE-REF DEST="OPERATION-PROTOTYPE">/AUTOSAR_EcuM/PortInterfaces/EcuM_StateRequest/RequestPOSTRUN</OPERATION-PROTOTYPE-REF>
                  </OPERATION-IREF>
                </OPERATION-INVOKED-EVENT>
                <OPERATION-INVOKED-EVENT>
                  <SHORT-NAME>EV_SR[!"num:i($EcuMStateCtr)"!]_ReleasePOSTRUN</SHORT-NAME>
                  <START-ON-EVENT-REF DEST="RUNNABLE-ENTITY">/AUTOSAR_EcuM/InternalBehaviors/EcuMIntBeh/RE_ReleasePOSTRUN</START-ON-EVENT-REF>
                  <OPERATION-IREF>
                    <P-PORT-PROTOTYPE-REF DEST="P-PORT-PROTOTYPE">/AUTOSAR_EcuM/[!"$swComponentTypePackageName"!]/EcuM/SR[!"num:i($EcuMStateCtr)"!]</P-PORT-PROTOTYPE-REF>
                    <OPERATION-PROTOTYPE-REF DEST="OPERATION-PROTOTYPE">/AUTOSAR_EcuM/PortInterfaces/EcuM_StateRequest/ReleasePOSTRUN</OPERATION-PROTOTYPE-REF>
                  </OPERATION-IREF>
                </OPERATION-INVOKED-EVENT>
[!VAR "EcuMStateCtr"="$EcuMStateCtr + 1.0"!]
[!ENDLOOP!][!//
[!ENDIF!][!//
              </EVENTS>
[!IF "node:exists(EcuMConfiguration/eb-list::*[1]/EcuMFixedConfiguration)"!][!//              
              <PORT-API-OPTIONS>
[!IF "node:exists(EcuMGeneral/EcuMServiceAPI) and (node:existsAndTrue(EcuMGeneral/EcuMServiceAPI/EcuMEnableASR32ServiceAPI))"!][!//
                <!-- Provide AUTOSAR 3.2 service -->
[!VAR "EcuMStateCtr"="0"!][!//
[!LOOP "EcuMConfiguration/eb-list::*[1]/EcuMFixedConfiguration/EcuMFixedUserConfig/eb-list::*"!][!//
                <PORT-API-OPTION>
                  <ENABLE-TAKE-ADDRESS>false</ENABLE-TAKE-ADDRESS>
                  <INDIRECT-API>false</INDIRECT-API>
                  <PORT-ARG-VALUES>
                    <INTEGER-LITERAL>
                      <SHORT-NAME>PORTARG_SR_ASR32_[!"num:i($EcuMStateCtr)"!]</SHORT-NAME>
                      <TYPE-TREF DEST="INTEGER-TYPE">/AUTOSAR_EcuM/ASR32/Datatypes/EcuM_ASR32_UserType</TYPE-TREF>
                      <VALUE>[!"num:i($EcuMStateCtr)"!]</VALUE>
                    </INTEGER-LITERAL>
                  </PORT-ARG-VALUES>
                  <PORT-REF DEST="P-PORT-PROTOTYPE">/AUTOSAR_EcuM/[!"$swComponentTypePackageName"!]/EcuM/SR_ASR32_[!"num:i($EcuMStateCtr)"!]</PORT-REF>
                </PORT-API-OPTION>
[!VAR "EcuMStateCtr"="$EcuMStateCtr + 1.0"!]
[!ENDLOOP!][!//
[!ENDIF!][!//
[!IF "node:exists(EcuMGeneral/EcuMServiceAPI) and (node:existsAndTrue(EcuMGeneral/EcuMServiceAPI/EcuMEnableASR40ServiceAPI))"!][!//
                <!-- Provide AUTOSAR 4.0 service -->
[!VAR "EcuMStateCtr"="0"!][!//
[!LOOP "EcuMConfiguration/eb-list::*[1]/EcuMFixedConfiguration/EcuMFixedUserConfig/eb-list::*"!][!//
                <PORT-API-OPTION>
                  <ENABLE-TAKE-ADDRESS>false</ENABLE-TAKE-ADDRESS>
                  <INDIRECT-API>false</INDIRECT-API>
                  <PORT-ARG-VALUES>
                    <INTEGER-LITERAL>
                      <SHORT-NAME>PORTARG_SR_ASR40_[!"num:i($EcuMStateCtr)"!]</SHORT-NAME>
                      <TYPE-TREF DEST="INTEGER-TYPE">/AUTOSAR_EcuM/ASR40/Datatypes/EcuM_ASR40_UserType</TYPE-TREF>
                      <VALUE>[!"num:i($EcuMStateCtr)"!]</VALUE>
                    </INTEGER-LITERAL>
                  </PORT-ARG-VALUES>
                  <PORT-REF DEST="P-PORT-PROTOTYPE">/AUTOSAR_EcuM/[!"$swComponentTypePackageName"!]/EcuM/SR_ASR40_[!"num:i($EcuMStateCtr)"!]</PORT-REF>
                </PORT-API-OPTION>
[!VAR "EcuMStateCtr"="$EcuMStateCtr + 1.0"!]
[!ENDLOOP!][!//
[!ENDIF!][!//
[!IF "node:exists(EcuMGeneral/EcuMServiceAPI) and EcuMGeneral/EcuMServiceAPI/EcuMDefaultASRServiceAPI != 'NONE'"!][!//
                <!-- Provide the default service -->
[!VAR "EcuMStateCtr"="0"!][!//
[!LOOP "EcuMConfiguration/eb-list::*[1]/EcuMFixedConfiguration/EcuMFixedUserConfig/eb-list::*"!][!//
                <PORT-API-OPTION>
                  <ENABLE-TAKE-ADDRESS>false</ENABLE-TAKE-ADDRESS>
                  <INDIRECT-API>false</INDIRECT-API>
                  <PORT-ARG-VALUES>
                    <INTEGER-LITERAL>
                      <SHORT-NAME>PORTARG_SR[!"num:i($EcuMStateCtr)"!]</SHORT-NAME>
                      <TYPE-TREF DEST="INTEGER-TYPE">/AUTOSAR_EcuM/[!"$swcImplementationDataTypesPackageName"!]/EcuM_UserType</TYPE-TREF>
                      <VALUE>[!"num:i($EcuMStateCtr)"!]</VALUE>
                    </INTEGER-LITERAL>
                  </PORT-ARG-VALUES>
                  <PORT-REF DEST="P-PORT-PROTOTYPE">/AUTOSAR_EcuM/[!"$swComponentTypePackageName"!]/EcuM/SR[!"num:i($EcuMStateCtr)"!]</PORT-REF>
                </PORT-API-OPTION>
[!VAR "EcuMStateCtr"="$EcuMStateCtr + 1.0"!]
[!ENDLOOP!][!//
[!ENDIF!][!//
              </PORT-API-OPTIONS>            
[!ENDIF!][!//
              <RUNNABLES>
[!IF "node:exists(EcuMGeneral/EcuMServiceAPI) and (node:existsAndTrue(EcuMGeneral/EcuMServiceAPI/EcuMEnableASR32ServiceAPI))"!][!//
<!-- Provide AUTOSAR 3.2 service -->
[!IF "node:exists(EcuMConfiguration/eb-list::*[1]/EcuMFixedConfiguration)"!][!//
                <RUNNABLE-ENTITY>
                  <SHORT-NAME>RE_ASR32_RequestRUN</SHORT-NAME>
                  <ARGUMENTS>
                    <RUNNABLE-ENTITY-ARGUMENT>
                      <SYMBOL>user</SYMBOL>
                    </RUNNABLE-ENTITY-ARGUMENT>
                  </ARGUMENTS>
                  <CAN-BE-INVOKED-CONCURRENTLY>true</CAN-BE-INVOKED-CONCURRENTLY>
                  <MINIMUM-START-INTERVAL>0</MINIMUM-START-INTERVAL>
                  <SYMBOL>EcuM_ASR32_Rte_RequestRUN</SYMBOL>
                </RUNNABLE-ENTITY>
                <RUNNABLE-ENTITY>
                  <SHORT-NAME>RE_ASR32_ReleaseRUN</SHORT-NAME>
                  <ARGUMENTS>
                    <RUNNABLE-ENTITY-ARGUMENT>
                      <SYMBOL>user</SYMBOL>
                    </RUNNABLE-ENTITY-ARGUMENT>
                  </ARGUMENTS>
                  <CAN-BE-INVOKED-CONCURRENTLY>true</CAN-BE-INVOKED-CONCURRENTLY>
                  <MINIMUM-START-INTERVAL>0</MINIMUM-START-INTERVAL>
                  <SYMBOL>EcuM_ASR32_Rte_ReleaseRUN</SYMBOL>
                </RUNNABLE-ENTITY>
                <RUNNABLE-ENTITY>
                  <SHORT-NAME>RE_ASR32_RequestPOSTRUN</SHORT-NAME>
                  <ARGUMENTS>
                    <RUNNABLE-ENTITY-ARGUMENT>
                      <SYMBOL>user</SYMBOL>
                    </RUNNABLE-ENTITY-ARGUMENT>
                  </ARGUMENTS>
                  <CAN-BE-INVOKED-CONCURRENTLY>true</CAN-BE-INVOKED-CONCURRENTLY>
                  <MINIMUM-START-INTERVAL>0</MINIMUM-START-INTERVAL>
                  <SYMBOL>EcuM_ASR32_Rte_RequestPOST_RUN</SYMBOL>
                </RUNNABLE-ENTITY>
                <RUNNABLE-ENTITY>
                  <SHORT-NAME>RE_ASR32_ReleasePOSTRUN</SHORT-NAME>
                  <ARGUMENTS>
                    <RUNNABLE-ENTITY-ARGUMENT>
                      <SYMBOL>user</SYMBOL>
                    </RUNNABLE-ENTITY-ARGUMENT>
                  </ARGUMENTS>
                  <CAN-BE-INVOKED-CONCURRENTLY>true</CAN-BE-INVOKED-CONCURRENTLY>
                  <MINIMUM-START-INTERVAL>0</MINIMUM-START-INTERVAL>
                  <SYMBOL>EcuM_ASR32_Rte_ReleasePOST_RUN</SYMBOL>
                </RUNNABLE-ENTITY>
[!ENDIF!][!//
                <RUNNABLE-ENTITY>
                  <SHORT-NAME>RE_ASR32_SelectShutdownTarget</SHORT-NAME>
                  <CAN-BE-INVOKED-CONCURRENTLY>true</CAN-BE-INVOKED-CONCURRENTLY>
                  <MINIMUM-START-INTERVAL>0</MINIMUM-START-INTERVAL>
                  <SYMBOL>EcuM_ASR32_Rte_SelectShutdownTarget</SYMBOL>
                </RUNNABLE-ENTITY>
                <RUNNABLE-ENTITY>
                  <SHORT-NAME>RE_ASR32_GetShutdownTarget</SHORT-NAME>
                  <CAN-BE-INVOKED-CONCURRENTLY>true</CAN-BE-INVOKED-CONCURRENTLY>
                  <MINIMUM-START-INTERVAL>0</MINIMUM-START-INTERVAL>
                  <SYMBOL>EcuM_ASR32_Rte_GetShutdownTarget</SYMBOL>
                </RUNNABLE-ENTITY>
                <RUNNABLE-ENTITY>
                  <SHORT-NAME>RE_ASR32_GetLastShutdownTarget</SHORT-NAME>
                  <CAN-BE-INVOKED-CONCURRENTLY>true</CAN-BE-INVOKED-CONCURRENTLY>
                  <MINIMUM-START-INTERVAL>0</MINIMUM-START-INTERVAL>
                  <SYMBOL>EcuM_ASR32_Rte_GetLastShutdownTarget</SYMBOL>
                </RUNNABLE-ENTITY>

                <RUNNABLE-ENTITY>
                  <SHORT-NAME>RE_ASR32_SelectBootTarget</SHORT-NAME>
                  <CAN-BE-INVOKED-CONCURRENTLY>true</CAN-BE-INVOKED-CONCURRENTLY>
                  <MINIMUM-START-INTERVAL>0</MINIMUM-START-INTERVAL>
                  <SYMBOL>EcuM_ASR32_Rte_SelectBootTarget</SYMBOL>
                </RUNNABLE-ENTITY>
                <RUNNABLE-ENTITY>
                  <SHORT-NAME>RE_ASR32_GetBootTarget</SHORT-NAME>
                  <CAN-BE-INVOKED-CONCURRENTLY>true</CAN-BE-INVOKED-CONCURRENTLY>
                  <MINIMUM-START-INTERVAL>0</MINIMUM-START-INTERVAL>
                  <SYMBOL>EcuM_ASR32_Rte_GetBootTarget</SYMBOL>
                </RUNNABLE-ENTITY>
[!ENDIF!][!//
[!IF "node:exists(EcuMGeneral/EcuMServiceAPI) and (node:existsAndTrue(EcuMGeneral/EcuMServiceAPI/EcuMEnableASR40ServiceAPI))"!][!//
<!-- Provide AUTOSAR 4.0 service -->
[!IF "node:exists(EcuMConfiguration/eb-list::*[1]/EcuMFixedConfiguration)"!][!//
                <RUNNABLE-ENTITY>
                  <SHORT-NAME>RE_ASR40_RequestRUN</SHORT-NAME>
                  <ARGUMENTS>
                    <RUNNABLE-ENTITY-ARGUMENT>
                      <SYMBOL>user</SYMBOL>
                    </RUNNABLE-ENTITY-ARGUMENT>
                  </ARGUMENTS>
                  <CAN-BE-INVOKED-CONCURRENTLY>true</CAN-BE-INVOKED-CONCURRENTLY>
                  <MINIMUM-START-INTERVAL>0</MINIMUM-START-INTERVAL>
                  <SYMBOL>EcuM_ASR40_Rte_RequestRUN</SYMBOL>
                </RUNNABLE-ENTITY>
                <RUNNABLE-ENTITY>
                  <SHORT-NAME>RE_ASR40_ReleaseRUN</SHORT-NAME>
                  <ARGUMENTS>
                    <RUNNABLE-ENTITY-ARGUMENT>
                      <SYMBOL>user</SYMBOL>
                    </RUNNABLE-ENTITY-ARGUMENT>
                  </ARGUMENTS>
                  <CAN-BE-INVOKED-CONCURRENTLY>true</CAN-BE-INVOKED-CONCURRENTLY>
                  <MINIMUM-START-INTERVAL>0</MINIMUM-START-INTERVAL>
                  <SYMBOL>EcuM_ASR40_Rte_ReleaseRUN</SYMBOL>
                </RUNNABLE-ENTITY>
                <RUNNABLE-ENTITY>
                  <SHORT-NAME>RE_ASR40_RequestPOSTRUN</SHORT-NAME>
                  <ARGUMENTS>
                    <RUNNABLE-ENTITY-ARGUMENT>
                      <SYMBOL>user</SYMBOL>
                    </RUNNABLE-ENTITY-ARGUMENT>
                  </ARGUMENTS>
                  <CAN-BE-INVOKED-CONCURRENTLY>true</CAN-BE-INVOKED-CONCURRENTLY>
                  <MINIMUM-START-INTERVAL>0</MINIMUM-START-INTERVAL>
                  <SYMBOL>EcuM_ASR40_Rte_RequestPOST_RUN</SYMBOL>
                </RUNNABLE-ENTITY>
                <RUNNABLE-ENTITY>
                  <SHORT-NAME>RE_ASR40_ReleasePOSTRUN</SHORT-NAME>
                  <ARGUMENTS>
                    <RUNNABLE-ENTITY-ARGUMENT>
                      <SYMBOL>user</SYMBOL>
                    </RUNNABLE-ENTITY-ARGUMENT>
                  </ARGUMENTS>
                  <CAN-BE-INVOKED-CONCURRENTLY>true</CAN-BE-INVOKED-CONCURRENTLY>
                  <MINIMUM-START-INTERVAL>0</MINIMUM-START-INTERVAL>
                  <SYMBOL>EcuM_ASR40_Rte_ReleasePOST_RUN</SYMBOL>
                </RUNNABLE-ENTITY>
[!ENDIF!][!//
                <RUNNABLE-ENTITY>
                  <SHORT-NAME>RE_ASR40_SelectShutdownTarget</SHORT-NAME>
                  <CAN-BE-INVOKED-CONCURRENTLY>true</CAN-BE-INVOKED-CONCURRENTLY>
                  <MINIMUM-START-INTERVAL>0</MINIMUM-START-INTERVAL>
                  <SYMBOL>EcuM_ASR40_Rte_SelectShutdownTarget</SYMBOL>
                </RUNNABLE-ENTITY>
                <RUNNABLE-ENTITY>
                  <SHORT-NAME>RE_ASR40_GetShutdownTarget</SHORT-NAME>
                  <CAN-BE-INVOKED-CONCURRENTLY>true</CAN-BE-INVOKED-CONCURRENTLY>
                  <MINIMUM-START-INTERVAL>0</MINIMUM-START-INTERVAL>
                  <SYMBOL>EcuM_ASR40_Rte_GetShutdownTarget</SYMBOL>
                </RUNNABLE-ENTITY>
                <RUNNABLE-ENTITY>
                  <SHORT-NAME>RE_ASR40_GetLastShutdownTarget</SHORT-NAME>
                  <CAN-BE-INVOKED-CONCURRENTLY>true</CAN-BE-INVOKED-CONCURRENTLY>
                  <MINIMUM-START-INTERVAL>0</MINIMUM-START-INTERVAL>
                  <SYMBOL>EcuM_ASR40_Rte_GetLastShutdownTarget</SYMBOL>
                </RUNNABLE-ENTITY>

                <RUNNABLE-ENTITY>
                  <SHORT-NAME>RE_ASR40_GetMostRecentShutdown</SHORT-NAME>
                  <CAN-BE-INVOKED-CONCURRENTLY>true</CAN-BE-INVOKED-CONCURRENTLY>
                  <MINIMUM-START-INTERVAL>0</MINIMUM-START-INTERVAL>
                  <SYMBOL>EcuM_ASR40_Rte_GetMostRecentShutdown</SYMBOL>
                </RUNNABLE-ENTITY>
                <RUNNABLE-ENTITY>
                  <SHORT-NAME>RE_ASR40_GetNextRecentShutdown</SHORT-NAME>
                  <CAN-BE-INVOKED-CONCURRENTLY>true</CAN-BE-INVOKED-CONCURRENTLY>
                  <MINIMUM-START-INTERVAL>0</MINIMUM-START-INTERVAL>
                  <SYMBOL>EcuM_ASR40_Rte_GetNextRecentShutdown</SYMBOL>
                </RUNNABLE-ENTITY>
                <RUNNABLE-ENTITY>
                  <SHORT-NAME>RE_ASR40_SelectShutdownCause</SHORT-NAME>
                  <CAN-BE-INVOKED-CONCURRENTLY>true</CAN-BE-INVOKED-CONCURRENTLY>
                  <MINIMUM-START-INTERVAL>0</MINIMUM-START-INTERVAL>
                  <SYMBOL>EcuM_ASR40_Rte_SelectShutdownCause</SYMBOL>
                </RUNNABLE-ENTITY>
                <RUNNABLE-ENTITY>
                  <SHORT-NAME>RE_ASR40_GetShutdownCause</SHORT-NAME>
                  <CAN-BE-INVOKED-CONCURRENTLY>true</CAN-BE-INVOKED-CONCURRENTLY>
                  <MINIMUM-START-INTERVAL>0</MINIMUM-START-INTERVAL>
                  <SYMBOL>EcuM_ASR40_Rte_GetShutdownCause</SYMBOL>
                </RUNNABLE-ENTITY>

                <RUNNABLE-ENTITY>
                  <SHORT-NAME>RE_ASR40_SelectBootTarget</SHORT-NAME>
                  <CAN-BE-INVOKED-CONCURRENTLY>true</CAN-BE-INVOKED-CONCURRENTLY>
                  <MINIMUM-START-INTERVAL>0</MINIMUM-START-INTERVAL>
                  <SYMBOL>EcuM_ASR40_Rte_SelectBootTarget</SYMBOL>
                </RUNNABLE-ENTITY>
                <RUNNABLE-ENTITY>
                  <SHORT-NAME>RE_ASR40_GetBootTarget</SHORT-NAME>
                  <CAN-BE-INVOKED-CONCURRENTLY>true</CAN-BE-INVOKED-CONCURRENTLY>
                  <MINIMUM-START-INTERVAL>0</MINIMUM-START-INTERVAL>
                  <SYMBOL>EcuM_ASR40_Rte_GetBootTarget</SYMBOL>
                </RUNNABLE-ENTITY>
[!ENDIF!][!//
[!IF "node:exists(EcuMGeneral/EcuMServiceAPI) and EcuMGeneral/EcuMServiceAPI/EcuMDefaultASRServiceAPI != 'NONE'"!][!//
<!-- Provide the default service -->
[!IF "node:exists(EcuMConfiguration/eb-list::*[1]/EcuMFixedConfiguration)"!][!//
                <RUNNABLE-ENTITY>
                  <SHORT-NAME>RE_RequestRUN</SHORT-NAME>
                  <ARGUMENTS>
                    <RUNNABLE-ENTITY-ARGUMENT>
                      <SYMBOL>user</SYMBOL>
                    </RUNNABLE-ENTITY-ARGUMENT>
                  </ARGUMENTS>
                  <CAN-BE-INVOKED-CONCURRENTLY>true</CAN-BE-INVOKED-CONCURRENTLY>
                  <MINIMUM-START-INTERVAL>0</MINIMUM-START-INTERVAL>
                  <SYMBOL>EcuM_Rte_RequestRUN</SYMBOL>
                </RUNNABLE-ENTITY>
                <RUNNABLE-ENTITY>
                  <SHORT-NAME>RE_ReleaseRUN</SHORT-NAME>
                  <ARGUMENTS>
                    <RUNNABLE-ENTITY-ARGUMENT>
                      <SYMBOL>user</SYMBOL>
                    </RUNNABLE-ENTITY-ARGUMENT>
                  </ARGUMENTS>
                  <CAN-BE-INVOKED-CONCURRENTLY>true</CAN-BE-INVOKED-CONCURRENTLY>
                  <MINIMUM-START-INTERVAL>0</MINIMUM-START-INTERVAL>
                  <SYMBOL>EcuM_Rte_ReleaseRUN</SYMBOL>
                </RUNNABLE-ENTITY>
                <RUNNABLE-ENTITY>
                  <SHORT-NAME>RE_RequestPOSTRUN</SHORT-NAME>
                  <ARGUMENTS>
                    <RUNNABLE-ENTITY-ARGUMENT>
                      <SYMBOL>user</SYMBOL>
                    </RUNNABLE-ENTITY-ARGUMENT>
                  </ARGUMENTS>
                  <CAN-BE-INVOKED-CONCURRENTLY>true</CAN-BE-INVOKED-CONCURRENTLY>
                  <MINIMUM-START-INTERVAL>0</MINIMUM-START-INTERVAL>
                  <SYMBOL>EcuM_Rte_RequestPOST_RUN</SYMBOL>
                </RUNNABLE-ENTITY>
                <RUNNABLE-ENTITY>
                  <SHORT-NAME>RE_ReleasePOSTRUN</SHORT-NAME>
                  <ARGUMENTS>
                    <RUNNABLE-ENTITY-ARGUMENT>
                      <SYMBOL>user</SYMBOL>
                    </RUNNABLE-ENTITY-ARGUMENT>
                  </ARGUMENTS>
                  <CAN-BE-INVOKED-CONCURRENTLY>true</CAN-BE-INVOKED-CONCURRENTLY>
                  <MINIMUM-START-INTERVAL>0</MINIMUM-START-INTERVAL>
                  <SYMBOL>EcuM_Rte_ReleasePOST_RUN</SYMBOL>
                </RUNNABLE-ENTITY>
[!ENDIF!][!//
                <RUNNABLE-ENTITY>
                  <SHORT-NAME>RE_SelectShutdownTarget</SHORT-NAME>
                  <CAN-BE-INVOKED-CONCURRENTLY>true</CAN-BE-INVOKED-CONCURRENTLY>
                  <MINIMUM-START-INTERVAL>0</MINIMUM-START-INTERVAL>
                  <SYMBOL>EcuM_Rte_SelectShutdownTarget</SYMBOL>
                </RUNNABLE-ENTITY>
                <RUNNABLE-ENTITY>
                  <SHORT-NAME>RE_GetShutdownTarget</SHORT-NAME>
                  <CAN-BE-INVOKED-CONCURRENTLY>true</CAN-BE-INVOKED-CONCURRENTLY>
                  <MINIMUM-START-INTERVAL>0</MINIMUM-START-INTERVAL>
                  <SYMBOL>EcuM_Rte_GetShutdownTarget</SYMBOL>
                </RUNNABLE-ENTITY>
                <RUNNABLE-ENTITY>
                  <SHORT-NAME>RE_GetLastShutdownTarget</SHORT-NAME>
                  <CAN-BE-INVOKED-CONCURRENTLY>true</CAN-BE-INVOKED-CONCURRENTLY>
                  <MINIMUM-START-INTERVAL>0</MINIMUM-START-INTERVAL>
                  <SYMBOL>EcuM_Rte_GetLastShutdownTarget</SYMBOL>
                </RUNNABLE-ENTITY>
[!IF "EcuMGeneral/EcuMServiceAPI/EcuMDefaultASRServiceAPI = 'AUTOSAR_40'"!][!//
                <RUNNABLE-ENTITY>
                  <SHORT-NAME>RE_GetMostRecentShutdown</SHORT-NAME>
                  <CAN-BE-INVOKED-CONCURRENTLY>true</CAN-BE-INVOKED-CONCURRENTLY>
                  <MINIMUM-START-INTERVAL>0</MINIMUM-START-INTERVAL>
                  <SYMBOL>EcuM_Rte_GetMostRecentShutdown</SYMBOL>
                </RUNNABLE-ENTITY>
                <RUNNABLE-ENTITY>
                  <SHORT-NAME>RE_GetNextRecentShutdown</SHORT-NAME>
                  <CAN-BE-INVOKED-CONCURRENTLY>true</CAN-BE-INVOKED-CONCURRENTLY>
                  <MINIMUM-START-INTERVAL>0</MINIMUM-START-INTERVAL>
                  <SYMBOL>EcuM_Rte_GetNextRecentShutdown</SYMBOL>
                </RUNNABLE-ENTITY>
                <RUNNABLE-ENTITY>
                  <SHORT-NAME>RE_SelectShutdownCause</SHORT-NAME>
                  <CAN-BE-INVOKED-CONCURRENTLY>true</CAN-BE-INVOKED-CONCURRENTLY>
                  <MINIMUM-START-INTERVAL>0</MINIMUM-START-INTERVAL>
                  <SYMBOL>EcuM_Rte_SelectShutdownCause</SYMBOL>
                </RUNNABLE-ENTITY>
                <RUNNABLE-ENTITY>
                  <SHORT-NAME>RE_GetShutdownCause</SHORT-NAME>
                  <CAN-BE-INVOKED-CONCURRENTLY>true</CAN-BE-INVOKED-CONCURRENTLY>
                  <MINIMUM-START-INTERVAL>0</MINIMUM-START-INTERVAL>
                  <SYMBOL>EcuM_Rte_GetShutdownCause</SYMBOL>
                </RUNNABLE-ENTITY>
[!ENDIF!][!//
                <RUNNABLE-ENTITY>
                  <SHORT-NAME>RE_SelectBootTarget</SHORT-NAME>
                  <CAN-BE-INVOKED-CONCURRENTLY>true</CAN-BE-INVOKED-CONCURRENTLY>
                  <MINIMUM-START-INTERVAL>0</MINIMUM-START-INTERVAL>
                  <SYMBOL>EcuM_Rte_SelectBootTarget</SYMBOL>
                </RUNNABLE-ENTITY>
                <RUNNABLE-ENTITY>
                  <SHORT-NAME>RE_GetBootTarget</SHORT-NAME>
                  <CAN-BE-INVOKED-CONCURRENTLY>true</CAN-BE-INVOKED-CONCURRENTLY>
                  <MINIMUM-START-INTERVAL>0</MINIMUM-START-INTERVAL>
                  <SYMBOL>EcuM_Rte_GetBootTarget</SYMBOL>
                </RUNNABLE-ENTITY>
[!ENDIF!][!//
                <RUNNABLE-ENTITY>
                  <SHORT-NAME>RE_Main</SHORT-NAME>
                  <CAN-BE-INVOKED-CONCURRENTLY>false</CAN-BE-INVOKED-CONCURRENTLY>
                  <MINIMUM-START-INTERVAL>0</MINIMUM-START-INTERVAL>
[!IF "node:exists(EcuMConfiguration/eb-list::*[1]/EcuMFixedConfiguration)"!][!//
                      <MODE-SWITCH-POINTS>
[!IF "node:exists(EcuMGeneral/EcuMServiceAPI) and (node:existsAndTrue(EcuMGeneral/EcuMServiceAPI/EcuMEnableASR32ServiceAPI))"!][!//
<!-- Provide AUTOSAR 3.2 service -->
                         <MODE-SWITCH-POINT>
                            <SHORT-NAME>msp_ASR32</SHORT-NAME>
                            <MODE-GROUP-IREF>
                               <P-PORT-PROTOTYPE-REF DEST="P-PORT-PROTOTYPE">/AUTOSAR_EcuM/[!"$swComponentTypePackageName"!]/EcuM/currentMode_ASR32</P-PORT-PROTOTYPE-REF>
                               <MODE-DECLARATION-GROUP-PROTOTYPE-REF DEST="MODE-DECLARATION-GROUP-PROTOTYPE">/AUTOSAR_EcuM/ASR32/PortInterfaces/EcuM_ASR32_CurrentMode/currentMode</MODE-DECLARATION-GROUP-PROTOTYPE-REF>
                            </MODE-GROUP-IREF>
                         </MODE-SWITCH-POINT>
[!ENDIF!][!//
[!IF "node:exists(EcuMGeneral/EcuMServiceAPI) and (node:existsAndTrue(EcuMGeneral/EcuMServiceAPI/EcuMEnableASR40ServiceAPI))"!][!//
<!-- Provide AUTOSAR 4.0 service -->
                         <MODE-SWITCH-POINT>
                            <SHORT-NAME>msp_ASR40</SHORT-NAME>
                            <MODE-GROUP-IREF>
                               <P-PORT-PROTOTYPE-REF DEST="P-PORT-PROTOTYPE">/AUTOSAR_EcuM/[!"$swComponentTypePackageName"!]/EcuM/currentMode_ASR40</P-PORT-PROTOTYPE-REF>
                               <MODE-DECLARATION-GROUP-PROTOTYPE-REF DEST="MODE-DECLARATION-GROUP-PROTOTYPE">/AUTOSAR_EcuM/ASR40/PortInterfaces/EcuM_ASR40_CurrentMode/currentMode</MODE-DECLARATION-GROUP-PROTOTYPE-REF>
                            </MODE-GROUP-IREF>
                         </MODE-SWITCH-POINT>
[!ENDIF!][!//
[!IF "node:exists(EcuMGeneral/EcuMServiceAPI) and EcuMGeneral/EcuMServiceAPI/EcuMDefaultASRServiceAPI != 'NONE'"!][!//
<!-- Provide the default service -->
                         <MODE-SWITCH-POINT>
                            <SHORT-NAME>msp</SHORT-NAME>
                            <MODE-GROUP-IREF>
                               <P-PORT-PROTOTYPE-REF DEST="P-PORT-PROTOTYPE">/AUTOSAR_EcuM/[!"$swComponentTypePackageName"!]/EcuM/currentMode</P-PORT-PROTOTYPE-REF>
                               <MODE-DECLARATION-GROUP-PROTOTYPE-REF DEST="MODE-DECLARATION-GROUP-PROTOTYPE">/AUTOSAR_EcuM/PortInterfaces/EcuM_CurrentMode/currentMode</MODE-DECLARATION-GROUP-PROTOTYPE-REF>
                            </MODE-GROUP-IREF>
                         </MODE-SWITCH-POINT>
[!ENDIF!][!//
                      </MODE-SWITCH-POINTS>
[!ENDIF!][!//
                  <SYMBOL>EcuM_MainFunction</SYMBOL>
                </RUNNABLE-ENTITY>
              </RUNNABLES>
              <SUPPORTS-MULTIPLE-INSTANTIATION>false</SUPPORTS-MULTIPLE-INSTANTIATION>
            </INTERNAL-BEHAVIOR>
          </ELEMENTS>
        </AR-PACKAGE>
      </SUB-PACKAGES>
    </AR-PACKAGE>

    <AR-PACKAGE>
      <SHORT-NAME>EB_EcuM</SHORT-NAME>
      <SUB-PACKAGES>
        <AR-PACKAGE>
          <SHORT-NAME>[!"$swcImplementationPackageName"!]</SHORT-NAME>
          <ELEMENTS>

          <!-- description of implementation -->

            <SWC-IMPLEMENTATION>
              <SHORT-NAME>EcuMImpl</SHORT-NAME>
              <CODE-DESCRIPTORS>
                <CODE>
                  <SHORT-NAME>Code</SHORT-NAME>
                  <TYPE>SRC</TYPE>
                </CODE>
              </CODE-DESCRIPTORS>
              <PROGRAMMING-LANGUAGE>C</PROGRAMMING-LANGUAGE>
              <RESOURCE-CONSUMPTION>
                <SHORT-NAME>Resources</SHORT-NAME>
                <OBJECT-FILE-SECTIONS>
                  <MEMORY-SECTION>
                    <SHORT-NAME>CODE</SHORT-NAME>
                    <ALIGNMENT>1</ALIGNMENT>
                    <SECTION-NAME>CODE</SECTION-NAME>
                    <SECTION-TYPE>CODE</SECTION-TYPE>
                    <SIZE>0</SIZE>
                    <SW-ADDR-METHOD-REFS>
                      <SW-ADDR-METHOD-REF DEST="SW-ADDR-METHOD">/AUTOSAR_MemMap/SwAddrMethods/CODE</SW-ADDR-METHOD-REF>
                    </SW-ADDR-METHOD-REFS>
                  </MEMORY-SECTION>
                </OBJECT-FILE-SECTIONS>
              </RESOURCE-CONSUMPTION>
              <SW-MAJOR-VERSION>5</SW-MAJOR-VERSION>
              <SW-MINOR-VERSION>15</SW-MINOR-VERSION>
              <SW-PATCH-VERSION>15</SW-PATCH-VERSION>
              <VENDOR-ID>1</VENDOR-ID>
              <BEHAVIOR-REF DEST="INTERNAL-BEHAVIOR">/AUTOSAR_EcuM/InternalBehaviors/EcuMIntBeh</BEHAVIOR-REF>
            </SWC-IMPLEMENTATION>
          </ELEMENTS>
        </AR-PACKAGE>
      </SUB-PACKAGES>
    </AR-PACKAGE>
  </TOP-LEVEL-PACKAGES>
</AUTOSAR>
