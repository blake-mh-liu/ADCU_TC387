<?xml version="1.0" encoding="UTF-8"?>
<AUTOSAR xmlns="http://autosar.org/3.2.2"
  xmlns:xsi="http://www.w3.org/2001/XMLSchema-instance"
  xsi:schemaLocation="http://autosar.org/3.2.2">
[!/* do not generate this file if RTE is not used */!][!//
[!SKIPFILE "(node:existsAndFalse(EcuMGeneral/EcuMRteUsage))  or not(node:exists(EcuMGeneral/EcuMServiceAPI))"!][!//
  <TOP-LEVEL-PACKAGES>
    <AR-PACKAGE>
      <SHORT-NAME>AUTOSAR_EcuM</SHORT-NAME>
      <SUB-PACKAGES>
[!IF "node:exists(EcuMGeneral/EcuMServiceAPI) and (node:existsAndTrue(EcuMGeneral/EcuMServiceAPI/EcuMEnableASR32ServiceAPI))"!][!//
        <!-- Provide AUTOSAR 3.2 service interface -->
        <AR-PACKAGE> <!-- ASR32 -->
          <SHORT-NAME>ASR32</SHORT-NAME>
          <SUB-PACKAGES>
            <AR-PACKAGE>
              <SHORT-NAME>CompuMethods</SHORT-NAME>
              <ELEMENTS>
                <COMPU-METHOD>
                  <SHORT-NAME>ASR32_STATES</SHORT-NAME>
                  <CATEGORY>TEXTTABLE</CATEGORY>
                  <COMPU-INTERNAL-TO-PHYS>
                    <COMPU-SCALES>
                      <COMPU-SCALE>
                        <LOWER-LIMIT INTERVAL-TYPE="CLOSED">16</LOWER-LIMIT>
                        <UPPER-LIMIT INTERVAL-TYPE="CLOSED">16</UPPER-LIMIT>
                        <COMPU-CONST>
                          <VT>ECUM_STATE_STARTUP</VT>
                        </COMPU-CONST>
                      </COMPU-SCALE>
                      <COMPU-SCALE>
                        <LOWER-LIMIT INTERVAL-TYPE="CLOSED">17</LOWER-LIMIT>
                        <UPPER-LIMIT INTERVAL-TYPE="CLOSED">17</UPPER-LIMIT>
                        <COMPU-CONST>
                          <VT>ECUM_STATE_STARTUP_ONE</VT>
                        </COMPU-CONST>
                      </COMPU-SCALE>
                      <COMPU-SCALE>
                        <LOWER-LIMIT INTERVAL-TYPE="CLOSED">18</LOWER-LIMIT>
                        <UPPER-LIMIT INTERVAL-TYPE="CLOSED">18</UPPER-LIMIT>
                        <COMPU-CONST>
                          <VT>ECUM_STATE_STARTUP_TWO</VT>
                        </COMPU-CONST>
                      </COMPU-SCALE>
                      <COMPU-SCALE>
                        <LOWER-LIMIT INTERVAL-TYPE="CLOSED">32</LOWER-LIMIT>
                        <UPPER-LIMIT INTERVAL-TYPE="CLOSED">32</UPPER-LIMIT>
                        <COMPU-CONST>
                          <VT>ECUM_STATE_WAKEUP</VT>
                        </COMPU-CONST>
                      </COMPU-SCALE>
                      <COMPU-SCALE>
                        <LOWER-LIMIT INTERVAL-TYPE="CLOSED">33</LOWER-LIMIT>
                        <UPPER-LIMIT INTERVAL-TYPE="CLOSED">33</UPPER-LIMIT>
                        <COMPU-CONST>
                          <VT>ECUM_STATE_WAKEUP_ONE</VT>
                        </COMPU-CONST>
                      </COMPU-SCALE>
                      <COMPU-SCALE>
                        <LOWER-LIMIT INTERVAL-TYPE="CLOSED">34</LOWER-LIMIT>
                        <UPPER-LIMIT INTERVAL-TYPE="CLOSED">34</UPPER-LIMIT>
                        <COMPU-CONST>
                          <VT>ECUM_STATE_WAKEUP_VALIDATION</VT>
                        </COMPU-CONST>
                      </COMPU-SCALE>
                      <COMPU-SCALE>
                        <LOWER-LIMIT INTERVAL-TYPE="CLOSED">35</LOWER-LIMIT>
                        <UPPER-LIMIT INTERVAL-TYPE="CLOSED">35</UPPER-LIMIT>
                        <COMPU-CONST>
                          <VT>ECUM_STATE_WAKEUP_REACTION</VT>
                        </COMPU-CONST>
                      </COMPU-SCALE>
                      <COMPU-SCALE>
                        <LOWER-LIMIT INTERVAL-TYPE="CLOSED">36</LOWER-LIMIT>
                        <UPPER-LIMIT INTERVAL-TYPE="CLOSED">36</UPPER-LIMIT>
                        <COMPU-CONST>
                          <VT>ECUM_STATE_WAKEUP_TWO</VT>
                        </COMPU-CONST>
                      </COMPU-SCALE>
                      <COMPU-SCALE>
                        <LOWER-LIMIT INTERVAL-TYPE="CLOSED">37</LOWER-LIMIT>
                        <UPPER-LIMIT INTERVAL-TYPE="CLOSED">37</UPPER-LIMIT>
                        <COMPU-CONST>
                          <VT>ECUM_STATE_WAKEUP_WAKESLEEP</VT>
                        </COMPU-CONST>
                      </COMPU-SCALE>
                      <COMPU-SCALE>
                        <LOWER-LIMIT INTERVAL-TYPE="CLOSED">38</LOWER-LIMIT>
                        <UPPER-LIMIT INTERVAL-TYPE="CLOSED">38</UPPER-LIMIT>
                        <COMPU-CONST>
                          <VT>ECUM_STATE_WAKEUP_TTII</VT>
                        </COMPU-CONST>
                      </COMPU-SCALE>
                      <COMPU-SCALE>
                        <LOWER-LIMIT INTERVAL-TYPE="CLOSED">48</LOWER-LIMIT>
                        <UPPER-LIMIT INTERVAL-TYPE="CLOSED">48</UPPER-LIMIT>
                        <COMPU-CONST>
                          <VT>ECUM_STATE_RUN</VT>
                        </COMPU-CONST>
                      </COMPU-SCALE>
                      <COMPU-SCALE>
                        <LOWER-LIMIT INTERVAL-TYPE="CLOSED">50</LOWER-LIMIT>
                        <UPPER-LIMIT INTERVAL-TYPE="CLOSED">50</UPPER-LIMIT>
                        <COMPU-CONST>
                          <VT>ECUM_STATE_APP_RUN</VT>
                        </COMPU-CONST>
                      </COMPU-SCALE>
                      <COMPU-SCALE>
                        <LOWER-LIMIT INTERVAL-TYPE="CLOSED">51</LOWER-LIMIT>
                        <UPPER-LIMIT INTERVAL-TYPE="CLOSED">51</UPPER-LIMIT>
                        <COMPU-CONST>
                          <VT>ECUM_STATE_APP_POST_RUN</VT>
                        </COMPU-CONST>
                      </COMPU-SCALE>
                      <COMPU-SCALE>
                        <LOWER-LIMIT INTERVAL-TYPE="CLOSED">64</LOWER-LIMIT>
                        <UPPER-LIMIT INTERVAL-TYPE="CLOSED">64</UPPER-LIMIT>
                        <COMPU-CONST>
                          <VT>ECUM_STATE_SHUTDOWN</VT>
                        </COMPU-CONST>
                      </COMPU-SCALE>
                      <COMPU-SCALE>
                        <LOWER-LIMIT INTERVAL-TYPE="CLOSED">68</LOWER-LIMIT>
                        <UPPER-LIMIT INTERVAL-TYPE="CLOSED">68</UPPER-LIMIT>
                        <COMPU-CONST>
                          <VT>ECUM_STATE_PREP_SHUTDOWN</VT>
                        </COMPU-CONST>
                      </COMPU-SCALE>
                      <COMPU-SCALE>
                        <LOWER-LIMIT INTERVAL-TYPE="CLOSED">73</LOWER-LIMIT>
                        <UPPER-LIMIT INTERVAL-TYPE="CLOSED">73</UPPER-LIMIT>
                        <COMPU-CONST>
                          <VT>ECUM_STATE_GO_SLEEP</VT>
                        </COMPU-CONST>
                      </COMPU-SCALE>
                      <COMPU-SCALE>
                        <LOWER-LIMIT INTERVAL-TYPE="CLOSED">77</LOWER-LIMIT>
                        <UPPER-LIMIT INTERVAL-TYPE="CLOSED">77</UPPER-LIMIT>
                        <COMPU-CONST>
                          <VT>ECUM_STATE_GO_OFF_ONE</VT>
                        </COMPU-CONST>
                      </COMPU-SCALE>
                      <COMPU-SCALE>
                        <LOWER-LIMIT INTERVAL-TYPE="CLOSED">78</LOWER-LIMIT>
                        <UPPER-LIMIT INTERVAL-TYPE="CLOSED">78</UPPER-LIMIT>
                        <COMPU-CONST>
                          <VT>ECUM_STATE_GO_OFF_TWO</VT>
                        </COMPU-CONST>
                      </COMPU-SCALE>
                      <COMPU-SCALE>
                        <LOWER-LIMIT INTERVAL-TYPE="CLOSED">80</LOWER-LIMIT>
                        <UPPER-LIMIT INTERVAL-TYPE="CLOSED">80</UPPER-LIMIT>
                        <COMPU-CONST>
                          <VT>ECUM_STATE_SLEEP</VT>
                        </COMPU-CONST>
                      </COMPU-SCALE>
                      <COMPU-SCALE>
                        <LOWER-LIMIT INTERVAL-TYPE="CLOSED">128</LOWER-LIMIT>
                        <UPPER-LIMIT INTERVAL-TYPE="CLOSED">128</UPPER-LIMIT>
                        <COMPU-CONST>
                          <VT>ECUM_STATE_OFF</VT>
                        </COMPU-CONST>
                      </COMPU-SCALE>
                      <COMPU-SCALE>
                        <LOWER-LIMIT INTERVAL-TYPE="CLOSED">144</LOWER-LIMIT>
                        <UPPER-LIMIT INTERVAL-TYPE="CLOSED">144</UPPER-LIMIT>
                        <COMPU-CONST>
                          <VT>ECUM_STATE_RESET</VT>
                        </COMPU-CONST>
                      </COMPU-SCALE>
                    </COMPU-SCALES>
                  </COMPU-INTERNAL-TO-PHYS>
                </COMPU-METHOD>

                <COMPU-METHOD>
                  <SHORT-NAME>ASR32_BOOTTARGET</SHORT-NAME>
                  <CATEGORY>TEXTTABLE</CATEGORY>
                  <COMPU-INTERNAL-TO-PHYS>
                    <COMPU-SCALES>
                      <COMPU-SCALE>
                        <LOWER-LIMIT INTERVAL-TYPE="CLOSED">0</LOWER-LIMIT>
                        <UPPER-LIMIT INTERVAL-TYPE="CLOSED">0</UPPER-LIMIT>
                        <COMPU-CONST>
                          <VT>ECUM_BOOT_TARGET_APP</VT>
                        </COMPU-CONST>
                      </COMPU-SCALE>
                      <COMPU-SCALE>
                        <LOWER-LIMIT INTERVAL-TYPE="CLOSED">1</LOWER-LIMIT>
                        <UPPER-LIMIT INTERVAL-TYPE="CLOSED">1</UPPER-LIMIT>
                        <COMPU-CONST>
                          <VT>ECUM_BOOT_TARGET_BOOTLOADER</VT>
                        </COMPU-CONST>
                      </COMPU-SCALE>
                    </COMPU-SCALES>
                  </COMPU-INTERNAL-TO-PHYS>
                </COMPU-METHOD>
[!IF "node:exists(EcuMConfiguration/eb-list::*[1]/EcuMFixedConfiguration)"!][!//
                    <COMPU-METHOD>
                      <SHORT-NAME>ASR32_USERTYPE</SHORT-NAME>
                      <CATEGORY>TEXTTABLE</CATEGORY>
                      <COMPU-INTERNAL-TO-PHYS>
                        <COMPU-SCALES>
[!LOOP "EcuMConfiguration/eb-list::*[1]/EcuMFixedConfiguration/EcuMFixedUserConfig/eb-list::*"!][!//
                          <COMPU-SCALE>
                            <LOWER-LIMIT INTERVAL-TYPE="CLOSED">[!"node:value(EcuMFixedUser)"!]</LOWER-LIMIT>
                            <UPPER-LIMIT INTERVAL-TYPE="CLOSED">[!"node:value(EcuMFixedUser)"!]</UPPER-LIMIT>
                            <COMPU-CONST>
                              <VT>[!"as:name(.)"!]</VT>
                            </COMPU-CONST>
                          </COMPU-SCALE>
[!ENDLOOP!][!//
                        </COMPU-SCALES>
                      </COMPU-INTERNAL-TO-PHYS>
                </COMPU-METHOD>
[!ENDIF!][!//
              </ELEMENTS>
            </AR-PACKAGE>
            <AR-PACKAGE>
              <SHORT-NAME>Datatypes</SHORT-NAME>
              <ELEMENTS>
                <INTEGER-TYPE>
                  <SHORT-NAME>EcuM_ASR32_StateType</SHORT-NAME>
                  <CATEGORY>TYPE_REFERENCE</CATEGORY>
                  <SW-DATA-DEF-PROPS>
                    <BASE-TYPE-REF DEST="SW-BASE-TYPE">/AUTOSAR_PlatformTypes/BaseTypes/uint8</BASE-TYPE-REF>
                    <COMPU-METHOD-REF DEST="COMPU-METHOD">/AUTOSAR_EcuM/ASR32/CompuMethods/ASR32_STATES</COMPU-METHOD-REF>
                  </SW-DATA-DEF-PROPS>
                  <LOWER-LIMIT INTERVAL-TYPE="CLOSED">16</LOWER-LIMIT>
                  <UPPER-LIMIT INTERVAL-TYPE="CLOSED">144</UPPER-LIMIT>
                </INTEGER-TYPE>

                <INTEGER-TYPE>
                  <SHORT-NAME>EcuM_ASR32_BootTargetType</SHORT-NAME>
                  <CATEGORY>TYPE_REFERENCE</CATEGORY>
                  <SW-DATA-DEF-PROPS>
                    <BASE-TYPE-REF DEST="SW-BASE-TYPE">/AUTOSAR_PlatformTypes/BaseTypes/uint8</BASE-TYPE-REF>
                    <COMPU-METHOD-REF DEST="COMPU-METHOD">/AUTOSAR_EcuM/ASR32/CompuMethods/ASR32_BOOTTARGET</COMPU-METHOD-REF>
                  </SW-DATA-DEF-PROPS>
                  <LOWER-LIMIT INTERVAL-TYPE="CLOSED">0</LOWER-LIMIT>
                  <UPPER-LIMIT INTERVAL-TYPE="CLOSED">1</UPPER-LIMIT>
                </INTEGER-TYPE>
[!IF "node:exists(EcuMConfiguration/eb-list::*[1]/EcuMFixedConfiguration)"!][!//
                <INTEGER-TYPE>
                  <SHORT-NAME>EcuM_ASR32_UserType</SHORT-NAME>
                  <CATEGORY>TYPE_REFERENCE</CATEGORY>
                  <SW-DATA-DEF-PROPS>
                    <BASE-TYPE-REF DEST="SW-BASE-TYPE">/AUTOSAR_PlatformTypes/BaseTypes/uint8</BASE-TYPE-REF>
                    <COMPU-METHOD-REF DEST="COMPU-METHOD">/AUTOSAR_EcuM/ASR32/CompuMethods/ASR32_USERTYPE</COMPU-METHOD-REF>
                  </SW-DATA-DEF-PROPS>
                  <LOWER-LIMIT INTERVAL-TYPE="CLOSED">0</LOWER-LIMIT>
                  <UPPER-LIMIT INTERVAL-TYPE="CLOSED">255</UPPER-LIMIT>
                </INTEGER-TYPE>
[!ENDIF!][!//
              </ELEMENTS>
            </AR-PACKAGE>
            <AR-PACKAGE>
              <SHORT-NAME>ModeDeclarationGroups</SHORT-NAME>
              <ELEMENTS>
[!IF "node:exists(EcuMConfiguration/eb-list::*[1]/EcuMFixedConfiguration)"!][!//
                <MODE-DECLARATION-GROUP>
                  <SHORT-NAME>EcuM_ASR32_Mode</SHORT-NAME>
                  <INITIAL-MODE-REF DEST="MODE-DECLARATION">/AUTOSAR_EcuM/ASR32/ModeDeclarationGroups/EcuM_ASR32_Mode/STARTUP</INITIAL-MODE-REF>
                  <MODE-DECLARATIONS>
                    <MODE-DECLARATION>
                      <SHORT-NAME>STARTUP</SHORT-NAME>
                    </MODE-DECLARATION>
                    <MODE-DECLARATION>
                      <SHORT-NAME>RUN</SHORT-NAME>
                    </MODE-DECLARATION>
                    <MODE-DECLARATION>
                      <SHORT-NAME>POST_RUN</SHORT-NAME>
                    </MODE-DECLARATION>
                    <MODE-DECLARATION>
                      <SHORT-NAME>SLEEP</SHORT-NAME>
                    </MODE-DECLARATION>
                    <MODE-DECLARATION>
                      <SHORT-NAME>WAKE_SLEEP</SHORT-NAME>
                    </MODE-DECLARATION>
                    <MODE-DECLARATION>
                      <SHORT-NAME>SHUTDOWN</SHORT-NAME>
                    </MODE-DECLARATION>
                  </MODE-DECLARATIONS>
                </MODE-DECLARATION-GROUP>
[!ENDIF!][!//
              </ELEMENTS>
            </AR-PACKAGE>
            <AR-PACKAGE>
              <SHORT-NAME>PortInterfaces</SHORT-NAME>
              <ELEMENTS>
[!IF "node:exists(EcuMConfiguration/eb-list::*[1]/EcuMFixedConfiguration)"!][!//
                <CLIENT-SERVER-INTERFACE>
                  <SHORT-NAME>EcuM_ASR32_StateRequest</SHORT-NAME>
                  <IS-SERVICE>true</IS-SERVICE>
                  <OPERATIONS>
                    <OPERATION-PROTOTYPE>
                      <SHORT-NAME>RequestRUN</SHORT-NAME>
                      <POSSIBLE-ERROR-REFS>
                        <POSSIBLE-ERROR-REF DEST="APPLICATION-ERROR">/AUTOSAR_EcuM/ASR32/PortInterfaces/EcuM_ASR32_StateRequest/E_NOT_OK</POSSIBLE-ERROR-REF>
                      </POSSIBLE-ERROR-REFS>
                    </OPERATION-PROTOTYPE>
                    <OPERATION-PROTOTYPE>
                      <SHORT-NAME>ReleaseRUN</SHORT-NAME>
                      <POSSIBLE-ERROR-REFS>
                        <POSSIBLE-ERROR-REF DEST="APPLICATION-ERROR">/AUTOSAR_EcuM/ASR32/PortInterfaces/EcuM_ASR32_StateRequest/E_NOT_OK</POSSIBLE-ERROR-REF>
                      </POSSIBLE-ERROR-REFS>
                    </OPERATION-PROTOTYPE>
                    <OPERATION-PROTOTYPE>
                      <SHORT-NAME>RequestPOSTRUN</SHORT-NAME>
                      <POSSIBLE-ERROR-REFS>
                        <POSSIBLE-ERROR-REF DEST="APPLICATION-ERROR">/AUTOSAR_EcuM/ASR32/PortInterfaces/EcuM_ASR32_StateRequest/E_NOT_OK</POSSIBLE-ERROR-REF>
                      </POSSIBLE-ERROR-REFS>
                    </OPERATION-PROTOTYPE>
                    <OPERATION-PROTOTYPE>
                      <SHORT-NAME>ReleasePOSTRUN</SHORT-NAME>
                      <POSSIBLE-ERROR-REFS>
                        <POSSIBLE-ERROR-REF DEST="APPLICATION-ERROR">/AUTOSAR_EcuM/ASR32/PortInterfaces/EcuM_ASR32_StateRequest/E_NOT_OK</POSSIBLE-ERROR-REF>
                      </POSSIBLE-ERROR-REFS>
                    </OPERATION-PROTOTYPE>
                  </OPERATIONS>
                  <POSSIBLE-ERRORS>
                    <APPLICATION-ERROR>
                      <SHORT-NAME>E_NOT_OK</SHORT-NAME>
                      <ERROR-CODE>1</ERROR-CODE>
                    </APPLICATION-ERROR>
                  </POSSIBLE-ERRORS>
                </CLIENT-SERVER-INTERFACE>

                <SENDER-RECEIVER-INTERFACE>
                  <SHORT-NAME>EcuM_ASR32_CurrentMode</SHORT-NAME>
                  <IS-SERVICE>true</IS-SERVICE>
                  <DATA-ELEMENTS />
                  <MODE-GROUPS>
                    <MODE-DECLARATION-GROUP-PROTOTYPE>
                      <SHORT-NAME>currentMode</SHORT-NAME>
                      <TYPE-TREF DEST="MODE-DECLARATION-GROUP">/AUTOSAR_EcuM/ASR32/ModeDeclarationGroups/EcuM_ASR32_Mode</TYPE-TREF>
                    </MODE-DECLARATION-GROUP-PROTOTYPE>
                  </MODE-GROUPS>
                </SENDER-RECEIVER-INTERFACE>
[!ENDIF!][!//
                <CLIENT-SERVER-INTERFACE>
                  <SHORT-NAME>EcuM_ASR32_ShutdownTarget</SHORT-NAME>
                  <IS-SERVICE>true</IS-SERVICE>
                  <OPERATIONS>

                    <OPERATION-PROTOTYPE>
                      <SHORT-NAME>SelectShutdownTarget</SHORT-NAME>
                      <ARGUMENTS>
                        <ARGUMENT-PROTOTYPE>
                          <SHORT-NAME>target</SHORT-NAME>
                          <TYPE-TREF DEST="INTEGER-TYPE">/AUTOSAR_EcuM/ASR32/Datatypes/EcuM_ASR32_StateType</TYPE-TREF>
                          <DIRECTION>IN</DIRECTION>
                        </ARGUMENT-PROTOTYPE>
                        <ARGUMENT-PROTOTYPE>
                          <SHORT-NAME>mode</SHORT-NAME>
                          <TYPE-TREF DEST="INTEGER-TYPE">/AUTOSAR_PlatformTypes/Datatypes/uint8</TYPE-TREF>
                          <DIRECTION>IN</DIRECTION>
                        </ARGUMENT-PROTOTYPE>
                      </ARGUMENTS>
                      <POSSIBLE-ERROR-REFS>
                        <POSSIBLE-ERROR-REF DEST="APPLICATION-ERROR">/AUTOSAR_EcuM/ASR32/PortInterfaces/EcuM_ASR32_ShutdownTarget/E_NOT_OK</POSSIBLE-ERROR-REF>
                      </POSSIBLE-ERROR-REFS>
                    </OPERATION-PROTOTYPE>

                    <OPERATION-PROTOTYPE>
                      <SHORT-NAME>GetShutdownTarget</SHORT-NAME>
                      <ARGUMENTS>
                        <ARGUMENT-PROTOTYPE>
                          <SHORT-NAME>target</SHORT-NAME>
                          <TYPE-TREF DEST="INTEGER-TYPE">/AUTOSAR_EcuM/ASR32/Datatypes/EcuM_ASR32_StateType</TYPE-TREF>
                          <DIRECTION>OUT</DIRECTION>
                        </ARGUMENT-PROTOTYPE>
                        <ARGUMENT-PROTOTYPE>
                          <SHORT-NAME>mode</SHORT-NAME>
                          <TYPE-TREF DEST="INTEGER-TYPE">/AUTOSAR_PlatformTypes/Datatypes/uint8</TYPE-TREF>
                          <DIRECTION>OUT</DIRECTION>
                        </ARGUMENT-PROTOTYPE>
                      </ARGUMENTS>
                      <POSSIBLE-ERROR-REFS>
                        <POSSIBLE-ERROR-REF DEST="APPLICATION-ERROR">/AUTOSAR_EcuM/ASR32/PortInterfaces/EcuM_ASR32_ShutdownTarget/E_NOT_OK</POSSIBLE-ERROR-REF>
                      </POSSIBLE-ERROR-REFS>
                    </OPERATION-PROTOTYPE>

                    <OPERATION-PROTOTYPE>
                      <SHORT-NAME>GetLastShutdownTarget</SHORT-NAME>
                      <ARGUMENTS>
                        <ARGUMENT-PROTOTYPE>
                          <SHORT-NAME>target</SHORT-NAME>
                          <TYPE-TREF DEST="INTEGER-TYPE">/AUTOSAR_EcuM/ASR32/Datatypes/EcuM_ASR32_StateType</TYPE-TREF>
                          <DIRECTION>OUT</DIRECTION>
                        </ARGUMENT-PROTOTYPE>
                        <ARGUMENT-PROTOTYPE>
                          <SHORT-NAME>mode</SHORT-NAME>
                          <TYPE-TREF DEST="INTEGER-TYPE">/AUTOSAR_PlatformTypes/Datatypes/uint8</TYPE-TREF>
                          <DIRECTION>OUT</DIRECTION>
                        </ARGUMENT-PROTOTYPE>
                      </ARGUMENTS>
                      <POSSIBLE-ERROR-REFS>
                        <POSSIBLE-ERROR-REF DEST="APPLICATION-ERROR">/AUTOSAR_EcuM/ASR32/PortInterfaces/EcuM_ASR32_ShutdownTarget/E_NOT_OK</POSSIBLE-ERROR-REF>
                      </POSSIBLE-ERROR-REFS>
                    </OPERATION-PROTOTYPE>

                  </OPERATIONS>
                  <POSSIBLE-ERRORS>
                    <APPLICATION-ERROR>
                      <SHORT-NAME>E_NOT_OK</SHORT-NAME>
                      <ERROR-CODE>1</ERROR-CODE>
                    </APPLICATION-ERROR>
                  </POSSIBLE-ERRORS>
                </CLIENT-SERVER-INTERFACE>

                <CLIENT-SERVER-INTERFACE>
                  <SHORT-NAME>EcuM_ASR32_BootTarget</SHORT-NAME>
                  <IS-SERVICE>true</IS-SERVICE>
                  <OPERATIONS>
                    <OPERATION-PROTOTYPE>
                      <SHORT-NAME>SelectBootTarget</SHORT-NAME>
                      <ARGUMENTS>
                        <ARGUMENT-PROTOTYPE>
                          <SHORT-NAME>target</SHORT-NAME>
                          <TYPE-TREF DEST="INTEGER-TYPE">/AUTOSAR_EcuM/ASR32/Datatypes/EcuM_ASR32_BootTargetType</TYPE-TREF>
                          <DIRECTION>IN</DIRECTION>
                        </ARGUMENT-PROTOTYPE>
                      </ARGUMENTS>
                      <POSSIBLE-ERROR-REFS>
                        <POSSIBLE-ERROR-REF DEST="APPLICATION-ERROR">/AUTOSAR_EcuM/ASR32/PortInterfaces/EcuM_ASR32_BootTarget/E_NOT_OK</POSSIBLE-ERROR-REF>
                      </POSSIBLE-ERROR-REFS>
                    </OPERATION-PROTOTYPE>
                    <OPERATION-PROTOTYPE>
                      <SHORT-NAME>GetBootTarget</SHORT-NAME>
                      <ARGUMENTS>
                        <ARGUMENT-PROTOTYPE>
                          <SHORT-NAME>target</SHORT-NAME>
                          <TYPE-TREF DEST="INTEGER-TYPE">/AUTOSAR_EcuM/ASR32/Datatypes/EcuM_ASR32_BootTargetType</TYPE-TREF>
                          <DIRECTION>OUT</DIRECTION>
                        </ARGUMENT-PROTOTYPE>
                      </ARGUMENTS>
                      <POSSIBLE-ERROR-REFS>
                        <POSSIBLE-ERROR-REF DEST="APPLICATION-ERROR">/AUTOSAR_EcuM/ASR32/PortInterfaces/EcuM_ASR32_BootTarget/E_NOT_OK</POSSIBLE-ERROR-REF>
                      </POSSIBLE-ERROR-REFS>
                    </OPERATION-PROTOTYPE>
                  </OPERATIONS>
                  <POSSIBLE-ERRORS>
                    <APPLICATION-ERROR>
                      <SHORT-NAME>E_NOT_OK</SHORT-NAME>
                      <ERROR-CODE>1</ERROR-CODE>
                    </APPLICATION-ERROR>
                  </POSSIBLE-ERRORS>
                </CLIENT-SERVER-INTERFACE>
              </ELEMENTS>
            </AR-PACKAGE>
          </SUB-PACKAGES>
        </AR-PACKAGE>
[!ENDIF!][!//
[!IF "node:exists(EcuMGeneral/EcuMServiceAPI) and (node:existsAndTrue(EcuMGeneral/EcuMServiceAPI/EcuMEnableASR40ServiceAPI))"!][!//
        <!-- Provide AUTOSAR 4.0 service interface -->
        <AR-PACKAGE> <!-- ASR40 -->
          <SHORT-NAME>ASR40</SHORT-NAME>
          <SUB-PACKAGES>
            <AR-PACKAGE>
              <SHORT-NAME>CompuMethods</SHORT-NAME>
              <ELEMENTS>
                <COMPU-METHOD>
                  <SHORT-NAME>ASR40_STATES</SHORT-NAME>
                  <CATEGORY>TEXTTABLE</CATEGORY>
                  <COMPU-INTERNAL-TO-PHYS>
                    <COMPU-SCALES>
                      <COMPU-SCALE>
                        <LOWER-LIMIT INTERVAL-TYPE="CLOSED">16</LOWER-LIMIT>
                        <UPPER-LIMIT INTERVAL-TYPE="CLOSED">16</UPPER-LIMIT>
                        <COMPU-CONST>
                          <VT>ECUM_STATE_STARTUP</VT>
                        </COMPU-CONST>
                      </COMPU-SCALE>
                      <COMPU-SCALE>
                        <LOWER-LIMIT INTERVAL-TYPE="CLOSED">17</LOWER-LIMIT>
                        <UPPER-LIMIT INTERVAL-TYPE="CLOSED">17</UPPER-LIMIT>
                        <COMPU-CONST>
                          <VT>ECUM_STATE_STARTUP_ONE</VT>
                        </COMPU-CONST>
                      </COMPU-SCALE>
                      <COMPU-SCALE>
                        <LOWER-LIMIT INTERVAL-TYPE="CLOSED">18</LOWER-LIMIT>
                        <UPPER-LIMIT INTERVAL-TYPE="CLOSED">18</UPPER-LIMIT>
                        <COMPU-CONST>
                          <VT>ECUM_STATE_STARTUP_TWO</VT>
                        </COMPU-CONST>
                      </COMPU-SCALE>
                      <COMPU-SCALE>
                        <LOWER-LIMIT INTERVAL-TYPE="CLOSED">32</LOWER-LIMIT>
                        <UPPER-LIMIT INTERVAL-TYPE="CLOSED">32</UPPER-LIMIT>
                        <COMPU-CONST>
                          <VT>ECUM_STATE_WAKEUP</VT>
                        </COMPU-CONST>
                      </COMPU-SCALE>
                      <COMPU-SCALE>
                        <LOWER-LIMIT INTERVAL-TYPE="CLOSED">33</LOWER-LIMIT>
                        <UPPER-LIMIT INTERVAL-TYPE="CLOSED">33</UPPER-LIMIT>
                        <COMPU-CONST>
                          <VT>ECUM_STATE_WAKEUP_ONE</VT>
                        </COMPU-CONST>
                      </COMPU-SCALE>
                      <COMPU-SCALE>
                        <LOWER-LIMIT INTERVAL-TYPE="CLOSED">34</LOWER-LIMIT>
                        <UPPER-LIMIT INTERVAL-TYPE="CLOSED">34</UPPER-LIMIT>
                        <COMPU-CONST>
                          <VT>ECUM_STATE_WAKEUP_VALIDATION</VT>
                        </COMPU-CONST>
                      </COMPU-SCALE>
                      <COMPU-SCALE>
                        <LOWER-LIMIT INTERVAL-TYPE="CLOSED">35</LOWER-LIMIT>
                        <UPPER-LIMIT INTERVAL-TYPE="CLOSED">35</UPPER-LIMIT>
                        <COMPU-CONST>
                          <VT>ECUM_STATE_WAKEUP_REACTION</VT>
                        </COMPU-CONST>
                      </COMPU-SCALE>
                      <COMPU-SCALE>
                        <LOWER-LIMIT INTERVAL-TYPE="CLOSED">36</LOWER-LIMIT>
                        <UPPER-LIMIT INTERVAL-TYPE="CLOSED">36</UPPER-LIMIT>
                        <COMPU-CONST>
                          <VT>ECUM_STATE_WAKEUP_TWO</VT>
                        </COMPU-CONST>
                      </COMPU-SCALE>
                      <COMPU-SCALE>
                        <LOWER-LIMIT INTERVAL-TYPE="CLOSED">37</LOWER-LIMIT>
                        <UPPER-LIMIT INTERVAL-TYPE="CLOSED">37</UPPER-LIMIT>
                        <COMPU-CONST>
                          <VT>ECUM_STATE_WAKEUP_WAKESLEEP</VT>
                        </COMPU-CONST>
                      </COMPU-SCALE>
                      <COMPU-SCALE>
                        <LOWER-LIMIT INTERVAL-TYPE="CLOSED">38</LOWER-LIMIT>
                        <UPPER-LIMIT INTERVAL-TYPE="CLOSED">38</UPPER-LIMIT>
                        <COMPU-CONST>
                          <VT>ECUM_STATE_WAKEUP_TTII</VT>
                        </COMPU-CONST>
                      </COMPU-SCALE>
                      <COMPU-SCALE>
                        <LOWER-LIMIT INTERVAL-TYPE="CLOSED">48</LOWER-LIMIT>
                        <UPPER-LIMIT INTERVAL-TYPE="CLOSED">48</UPPER-LIMIT>
                        <COMPU-CONST>
                          <VT>ECUM_STATE_RUN</VT>
                        </COMPU-CONST>
                      </COMPU-SCALE>
                      <COMPU-SCALE>
                        <LOWER-LIMIT INTERVAL-TYPE="CLOSED">50</LOWER-LIMIT>
                        <UPPER-LIMIT INTERVAL-TYPE="CLOSED">50</UPPER-LIMIT>
                        <COMPU-CONST>
                          <VT>ECUM_STATE_APP_RUN</VT>
                        </COMPU-CONST>
                      </COMPU-SCALE>
                      <COMPU-SCALE>
                        <LOWER-LIMIT INTERVAL-TYPE="CLOSED">51</LOWER-LIMIT>
                        <UPPER-LIMIT INTERVAL-TYPE="CLOSED">51</UPPER-LIMIT>
                        <COMPU-CONST>
                          <VT>ECUM_STATE_APP_POST_RUN</VT>
                        </COMPU-CONST>
                      </COMPU-SCALE>
                      <COMPU-SCALE>
                        <LOWER-LIMIT INTERVAL-TYPE="CLOSED">64</LOWER-LIMIT>
                        <UPPER-LIMIT INTERVAL-TYPE="CLOSED">64</UPPER-LIMIT>
                        <COMPU-CONST>
                          <VT>ECUM_STATE_SHUTDOWN</VT>
                        </COMPU-CONST>
                      </COMPU-SCALE>
                      <COMPU-SCALE>
                        <LOWER-LIMIT INTERVAL-TYPE="CLOSED">68</LOWER-LIMIT>
                        <UPPER-LIMIT INTERVAL-TYPE="CLOSED">68</UPPER-LIMIT>
                        <COMPU-CONST>
                          <VT>ECUM_STATE_PREP_SHUTDOWN</VT>
                        </COMPU-CONST>
                      </COMPU-SCALE>
                      <COMPU-SCALE>
                        <LOWER-LIMIT INTERVAL-TYPE="CLOSED">73</LOWER-LIMIT>
                        <UPPER-LIMIT INTERVAL-TYPE="CLOSED">73</UPPER-LIMIT>
                        <COMPU-CONST>
                          <VT>ECUM_STATE_GO_SLEEP</VT>
                        </COMPU-CONST>
                      </COMPU-SCALE>
                      <COMPU-SCALE>
                        <LOWER-LIMIT INTERVAL-TYPE="CLOSED">77</LOWER-LIMIT>
                        <UPPER-LIMIT INTERVAL-TYPE="CLOSED">77</UPPER-LIMIT>
                        <COMPU-CONST>
                          <VT>ECUM_STATE_GO_OFF_ONE</VT>
                        </COMPU-CONST>
                      </COMPU-SCALE>
                      <COMPU-SCALE>
                        <LOWER-LIMIT INTERVAL-TYPE="CLOSED">78</LOWER-LIMIT>
                        <UPPER-LIMIT INTERVAL-TYPE="CLOSED">78</UPPER-LIMIT>
                        <COMPU-CONST>
                          <VT>ECUM_STATE_GO_OFF_TWO</VT>
                        </COMPU-CONST>
                      </COMPU-SCALE>
                      <COMPU-SCALE>
                        <LOWER-LIMIT INTERVAL-TYPE="CLOSED">80</LOWER-LIMIT>
                        <UPPER-LIMIT INTERVAL-TYPE="CLOSED">80</UPPER-LIMIT>
                        <COMPU-CONST>
                          <VT>ECUM_STATE_SLEEP</VT>
                        </COMPU-CONST>
                      </COMPU-SCALE>
                      <COMPU-SCALE>
                        <LOWER-LIMIT INTERVAL-TYPE="CLOSED">128</LOWER-LIMIT>
                        <UPPER-LIMIT INTERVAL-TYPE="CLOSED">128</UPPER-LIMIT>
                        <COMPU-CONST>
                          <VT>ECUM_STATE_OFF</VT>
                        </COMPU-CONST>
                      </COMPU-SCALE>
                      <COMPU-SCALE>
                        <LOWER-LIMIT INTERVAL-TYPE="CLOSED">144</LOWER-LIMIT>
                        <UPPER-LIMIT INTERVAL-TYPE="CLOSED">144</UPPER-LIMIT>
                        <COMPU-CONST>
                          <VT>ECUM_STATE_RESET</VT>
                        </COMPU-CONST>
                      </COMPU-SCALE>
                    </COMPU-SCALES>
                  </COMPU-INTERNAL-TO-PHYS>
                </COMPU-METHOD>
                <COMPU-METHOD>
                  <SHORT-NAME>ASR40_SHUTDOWNCAUSE</SHORT-NAME>
                  <CATEGORY>TEXTTABLE</CATEGORY>
                  <COMPU-INTERNAL-TO-PHYS>
                    <COMPU-SCALES>
                      <COMPU-SCALE>
                        <LOWER-LIMIT INTERVAL-TYPE="CLOSED">0</LOWER-LIMIT>
                        <UPPER-LIMIT INTERVAL-TYPE="CLOSED">0</UPPER-LIMIT>
                        <COMPU-CONST>
                          <VT>ECUM_CAUSE_UNKNOWN</VT>
                        </COMPU-CONST>
                      </COMPU-SCALE>
                      <COMPU-SCALE>
                        <LOWER-LIMIT INTERVAL-TYPE="CLOSED">1</LOWER-LIMIT>
                        <UPPER-LIMIT INTERVAL-TYPE="CLOSED">1</UPPER-LIMIT>
                        <COMPU-CONST>
                          <VT>ECUM_CAUSE_ECU_STATE</VT>
                        </COMPU-CONST>
                      </COMPU-SCALE>
                      <COMPU-SCALE>
                        <LOWER-LIMIT INTERVAL-TYPE="CLOSED">2</LOWER-LIMIT>
                        <UPPER-LIMIT INTERVAL-TYPE="CLOSED">2</UPPER-LIMIT>
                        <COMPU-CONST>
                          <VT>ECUM_CAUSE_WDGM</VT>
                        </COMPU-CONST>
                      </COMPU-SCALE>
                      <COMPU-SCALE>
                        <LOWER-LIMIT INTERVAL-TYPE="CLOSED">3</LOWER-LIMIT>
                        <UPPER-LIMIT INTERVAL-TYPE="CLOSED">3</UPPER-LIMIT>
                        <COMPU-CONST>
                          <VT>ECUM_CAUSE_DCM</VT>
                        </COMPU-CONST>
                      </COMPU-SCALE>
                    </COMPU-SCALES>
                  </COMPU-INTERNAL-TO-PHYS>
                </COMPU-METHOD>
                <COMPU-METHOD>
                  <SHORT-NAME>ASR40_BOOTTARGET</SHORT-NAME>
                  <CATEGORY>TEXTTABLE</CATEGORY>
                  <COMPU-INTERNAL-TO-PHYS>
                    <COMPU-SCALES>
                      <COMPU-SCALE>
                        <LOWER-LIMIT INTERVAL-TYPE="CLOSED">0</LOWER-LIMIT>
                        <UPPER-LIMIT INTERVAL-TYPE="CLOSED">0</UPPER-LIMIT>
                        <COMPU-CONST>
                          <VT>ECUM_BOOT_TARGET_APP</VT>
                        </COMPU-CONST>
                      </COMPU-SCALE>
                      <COMPU-SCALE>
                        <LOWER-LIMIT INTERVAL-TYPE="CLOSED">1</LOWER-LIMIT>
                        <UPPER-LIMIT INTERVAL-TYPE="CLOSED">1</UPPER-LIMIT>
                        <COMPU-CONST>
                          <VT>ECUM_BOOT_TARGET_OEM_BOOTLOADER</VT>
                        </COMPU-CONST>
                      </COMPU-SCALE>
                      <COMPU-SCALE>
                        <LOWER-LIMIT INTERVAL-TYPE="CLOSED">2</LOWER-LIMIT>
                        <UPPER-LIMIT INTERVAL-TYPE="CLOSED">2</UPPER-LIMIT>
                        <COMPU-CONST>
                          <!-- This deviates from the SWS which
                               mentions
                               ECUM_BOOT_TARGET_SYSTEM_SUPPLIER_BOOTLOADER.
                               http://www.autosar.org/bugzilla/show_bug.cgi?id=48892 -->
                          <VT>ECUM_BOOT_TARGET_SYS_BOOTLOADER</VT>
                        </COMPU-CONST>
                      </COMPU-SCALE>
                    </COMPU-SCALES>
                  </COMPU-INTERNAL-TO-PHYS>
                </COMPU-METHOD>
[!IF "node:exists(EcuMConfiguration/eb-list::*[1]/EcuMFixedConfiguration)"!][!//
                <COMPU-METHOD>
                  <SHORT-NAME>ASR40_USERTYPE</SHORT-NAME>
                  <CATEGORY>TEXTTABLE</CATEGORY>
                  <COMPU-INTERNAL-TO-PHYS>
                    <COMPU-SCALES>
[!LOOP "EcuMConfiguration/eb-list::*[1]/EcuMFixedConfiguration/EcuMFixedUserConfig/eb-list::*"!][!//
                      <COMPU-SCALE>
                        <LOWER-LIMIT INTERVAL-TYPE="CLOSED">[!"node:value(EcuMFixedUser)"!]</LOWER-LIMIT>
                        <UPPER-LIMIT INTERVAL-TYPE="CLOSED">[!"node:value(EcuMFixedUser)"!]</UPPER-LIMIT>
                        <COMPU-CONST>
                          <VT>[!"as:name(.)"!]</VT>
                        </COMPU-CONST>
                      </COMPU-SCALE>
[!ENDLOOP!][!//
                    </COMPU-SCALES>
                  </COMPU-INTERNAL-TO-PHYS>
                </COMPU-METHOD>
[!ENDIF!][!//
              </ELEMENTS>
            </AR-PACKAGE>
            <AR-PACKAGE>
              <SHORT-NAME>Datatypes</SHORT-NAME>
              <!--
                 We do not use AUTOSAR 4.0.3 package name here for the sake of consistency, since for
                 the ServiceComponentType we _HAVE_ to use the AUTSOAR 3.2.1 package name unless 4.0.3
                 has been selected as default (i.e., we _CANNOT_ replicate the ServiceComponentType for
                 each activated version (e.g., one for 3.2.2 and one for 4.0.3)
               -->
              <ELEMENTS>
                <INTEGER-TYPE>
                  <SHORT-NAME>EcuM_ASR40_StateType</SHORT-NAME>
                  <CATEGORY>TYPE_REFERENCE</CATEGORY>
                  <SW-DATA-DEF-PROPS>
                    <BASE-TYPE-REF DEST="SW-BASE-TYPE">/AUTOSAR_PlatformTypes/BaseTypes/uint8</BASE-TYPE-REF>
                    <COMPU-METHOD-REF DEST="COMPU-METHOD">/AUTOSAR_EcuM/ASR40/CompuMethods/ASR40_STATES</COMPU-METHOD-REF>
                  </SW-DATA-DEF-PROPS>
                  <LOWER-LIMIT INTERVAL-TYPE="CLOSED">16</LOWER-LIMIT>
                  <UPPER-LIMIT INTERVAL-TYPE="CLOSED">144</UPPER-LIMIT>
                </INTEGER-TYPE>

                <!-- The definition of the data type 'EcuM_ShutdownCauseType' is not specified in
                     AUTOSAR R4.0r2 document "Specification of ECU State Manager" section 7.10.2.
                     But it is mapped to uint8 in reference with the argument description of the
                     API EcuM_SelectShutdownCause().
                     http://www.autosar.org/bugzilla/show_bug.cgi?id=49743 -->
                <INTEGER-TYPE>
                  <SHORT-NAME>EcuM_ASR40_ShutdownCauseType</SHORT-NAME>
                  <CATEGORY>TYPE_REFERENCE</CATEGORY>
                  <SW-DATA-DEF-PROPS>
                    <BASE-TYPE-REF DEST="SW-BASE-TYPE">/AUTOSAR_PlatformTypes/BaseTypes/uint8</BASE-TYPE-REF>
                    <COMPU-METHOD-REF DEST="COMPU-METHOD">/AUTOSAR_EcuM/ASR40/CompuMethods/ASR40_SHUTDOWNCAUSE</COMPU-METHOD-REF>
                  </SW-DATA-DEF-PROPS>
                  <LOWER-LIMIT INTERVAL-TYPE="CLOSED">0</LOWER-LIMIT>
                  <UPPER-LIMIT INTERVAL-TYPE="CLOSED">255</UPPER-LIMIT>
                </INTEGER-TYPE>

                <INTEGER-TYPE>
                  <SHORT-NAME>EcuM_ASR40_BootTargetType</SHORT-NAME>
                  <CATEGORY>TYPE_REFERENCE</CATEGORY>
                  <SW-DATA-DEF-PROPS>
                    <BASE-TYPE-REF DEST="SW-BASE-TYPE">/AUTOSAR_PlatformTypes/BaseTypes/uint8</BASE-TYPE-REF>
                    <COMPU-METHOD-REF DEST="COMPU-METHOD">/AUTOSAR_EcuM/ASR40/CompuMethods/ASR40_BOOTTARGET</COMPU-METHOD-REF>
                  </SW-DATA-DEF-PROPS>
                  <LOWER-LIMIT INTERVAL-TYPE="CLOSED">0</LOWER-LIMIT>
                  <UPPER-LIMIT INTERVAL-TYPE="CLOSED">2</UPPER-LIMIT>
                </INTEGER-TYPE>
[!IF "node:exists(EcuMConfiguration/eb-list::*[1]/EcuMFixedConfiguration)"!][!//
                <INTEGER-TYPE>
                  <SHORT-NAME>EcuM_ASR40_UserType</SHORT-NAME>
                  <CATEGORY>TYPE_REFERENCE</CATEGORY>
                  <SW-DATA-DEF-PROPS>
                    <BASE-TYPE-REF DEST="SW-BASE-TYPE">/AUTOSAR_PlatformTypes/BaseTypes/uint8</BASE-TYPE-REF>
                    <COMPU-METHOD-REF DEST="COMPU-METHOD">/AUTOSAR_EcuM/ASR40/CompuMethods/ASR40_USERTYPE</COMPU-METHOD-REF>
                  </SW-DATA-DEF-PROPS>
                  <LOWER-LIMIT INTERVAL-TYPE="CLOSED">0</LOWER-LIMIT>
                  <UPPER-LIMIT INTERVAL-TYPE="CLOSED">255</UPPER-LIMIT>
                </INTEGER-TYPE>
[!ENDIF!][!//
              </ELEMENTS>
            </AR-PACKAGE>
            <AR-PACKAGE>
              <SHORT-NAME>ModeDeclarationGroups</SHORT-NAME>
              <ELEMENTS>
[!IF "node:exists(EcuMConfiguration/eb-list::*[1]/EcuMFixedConfiguration)"!][!//
                <MODE-DECLARATION-GROUP>
                  <SHORT-NAME>EcuM_ASR40_Mode</SHORT-NAME>
                  <INITIAL-MODE-REF DEST="MODE-DECLARATION">/AUTOSAR_EcuM/ASR40/ModeDeclarationGroups/EcuM_ASR40_Mode/STARTUP</INITIAL-MODE-REF>
                  <MODE-DECLARATIONS>
                    <MODE-DECLARATION>
                      <SHORT-NAME>STARTUP</SHORT-NAME>
                    </MODE-DECLARATION>
                    <MODE-DECLARATION>
                      <SHORT-NAME>RUN</SHORT-NAME>
                    </MODE-DECLARATION>
                    <MODE-DECLARATION>
                      <SHORT-NAME>POST_RUN</SHORT-NAME>
                    </MODE-DECLARATION>
                    <MODE-DECLARATION>
                      <SHORT-NAME>SLEEP</SHORT-NAME>
                    </MODE-DECLARATION>
                    <MODE-DECLARATION>
                      <SHORT-NAME>WAKE_SLEEP</SHORT-NAME>
                    </MODE-DECLARATION>
                    <MODE-DECLARATION>
                      <SHORT-NAME>SHUTDOWN</SHORT-NAME>
                    </MODE-DECLARATION>
                  </MODE-DECLARATIONS>
                </MODE-DECLARATION-GROUP>
[!ENDIF!][!//
              </ELEMENTS>
            </AR-PACKAGE>
            <AR-PACKAGE>
              <SHORT-NAME>PortInterfaces</SHORT-NAME>
              <ELEMENTS>
[!IF "node:exists(EcuMConfiguration/eb-list::*[1]/EcuMFixedConfiguration)"!][!//
                <CLIENT-SERVER-INTERFACE>
                  <SHORT-NAME>EcuM_ASR40_StateRequest</SHORT-NAME>
                  <IS-SERVICE>true</IS-SERVICE>
                  <OPERATIONS>
                    <OPERATION-PROTOTYPE>
                      <SHORT-NAME>RequestRUN</SHORT-NAME>
                      <POSSIBLE-ERROR-REFS>
                        <POSSIBLE-ERROR-REF DEST="APPLICATION-ERROR">/AUTOSAR_EcuM/ASR40/PortInterfaces/EcuM_ASR40_StateRequest/E_NOT_OK</POSSIBLE-ERROR-REF>
                      </POSSIBLE-ERROR-REFS>
                    </OPERATION-PROTOTYPE>
                    <OPERATION-PROTOTYPE>
                      <SHORT-NAME>ReleaseRUN</SHORT-NAME>
                      <POSSIBLE-ERROR-REFS>
                        <POSSIBLE-ERROR-REF DEST="APPLICATION-ERROR">/AUTOSAR_EcuM/ASR40/PortInterfaces/EcuM_ASR40_StateRequest/E_NOT_OK</POSSIBLE-ERROR-REF>
                      </POSSIBLE-ERROR-REFS>
                    </OPERATION-PROTOTYPE>
                    <OPERATION-PROTOTYPE>
                      <SHORT-NAME>RequestPOSTRUN</SHORT-NAME>
                      <POSSIBLE-ERROR-REFS>
                        <POSSIBLE-ERROR-REF DEST="APPLICATION-ERROR">/AUTOSAR_EcuM/ASR40/PortInterfaces/EcuM_ASR40_StateRequest/E_NOT_OK</POSSIBLE-ERROR-REF>
                      </POSSIBLE-ERROR-REFS>
                    </OPERATION-PROTOTYPE>
                    <OPERATION-PROTOTYPE>
                      <SHORT-NAME>ReleasePOSTRUN</SHORT-NAME>
                      <POSSIBLE-ERROR-REFS>
                        <POSSIBLE-ERROR-REF DEST="APPLICATION-ERROR">/AUTOSAR_EcuM/ASR40/PortInterfaces/EcuM_ASR40_StateRequest/E_NOT_OK</POSSIBLE-ERROR-REF>
                      </POSSIBLE-ERROR-REFS>
                    </OPERATION-PROTOTYPE>
                  </OPERATIONS>
                  <POSSIBLE-ERRORS>
                    <APPLICATION-ERROR>
                      <SHORT-NAME>E_NOT_OK</SHORT-NAME>
                      <ERROR-CODE>1</ERROR-CODE>
                    </APPLICATION-ERROR>
                  </POSSIBLE-ERRORS>
                </CLIENT-SERVER-INTERFACE>

                <SENDER-RECEIVER-INTERFACE>
                  <SHORT-NAME>EcuM_ASR40_CurrentMode</SHORT-NAME>
                  <IS-SERVICE>true</IS-SERVICE>
                  <DATA-ELEMENTS />
                  <MODE-GROUPS>
                    <MODE-DECLARATION-GROUP-PROTOTYPE>
                      <SHORT-NAME>currentMode</SHORT-NAME>
                      <TYPE-TREF DEST="MODE-DECLARATION-GROUP">/AUTOSAR_EcuM/ASR40/ModeDeclarationGroups/EcuM_ASR40_Mode</TYPE-TREF>
                    </MODE-DECLARATION-GROUP-PROTOTYPE>
                  </MODE-GROUPS>
                </SENDER-RECEIVER-INTERFACE>
[!ENDIF!][!//
                <CLIENT-SERVER-INTERFACE>
                  <SHORT-NAME>EcuM_ASR40_ShutdownTarget</SHORT-NAME>
                  <IS-SERVICE>true</IS-SERVICE>
                  <OPERATIONS>

                    <OPERATION-PROTOTYPE>
                      <SHORT-NAME>SelectShutdownTarget</SHORT-NAME>
                      <ARGUMENTS>
                        <ARGUMENT-PROTOTYPE>
                          <SHORT-NAME>target</SHORT-NAME>
                          <TYPE-TREF DEST="INTEGER-TYPE">/AUTOSAR_EcuM/ASR40/Datatypes/EcuM_ASR40_StateType</TYPE-TREF>
                          <DIRECTION>IN</DIRECTION>
                        </ARGUMENT-PROTOTYPE>
                        <ARGUMENT-PROTOTYPE>
                          <SHORT-NAME>mode</SHORT-NAME>
                          <TYPE-TREF DEST="INTEGER-TYPE">/AUTOSAR_PlatformTypes/Datatypes/uint8</TYPE-TREF>
                          <DIRECTION>IN</DIRECTION>
                        </ARGUMENT-PROTOTYPE>
                      </ARGUMENTS>
                      <POSSIBLE-ERROR-REFS>
                        <POSSIBLE-ERROR-REF DEST="APPLICATION-ERROR">/AUTOSAR_EcuM/ASR40/PortInterfaces/EcuM_ASR40_ShutdownTarget/E_NOT_OK</POSSIBLE-ERROR-REF>
                      </POSSIBLE-ERROR-REFS>
                    </OPERATION-PROTOTYPE>

                    <OPERATION-PROTOTYPE>
                      <SHORT-NAME>GetShutdownTarget</SHORT-NAME>
                      <ARGUMENTS>
                        <ARGUMENT-PROTOTYPE>
                          <SHORT-NAME>target</SHORT-NAME>
                          <TYPE-TREF DEST="INTEGER-TYPE">/AUTOSAR_EcuM/ASR40/Datatypes/EcuM_ASR40_StateType</TYPE-TREF>
                          <DIRECTION>OUT</DIRECTION>
                        </ARGUMENT-PROTOTYPE>
                        <ARGUMENT-PROTOTYPE>
                          <SHORT-NAME>mode</SHORT-NAME>
                          <TYPE-TREF DEST="INTEGER-TYPE">/AUTOSAR_PlatformTypes/Datatypes/uint8</TYPE-TREF>
                          <DIRECTION>OUT</DIRECTION>
                        </ARGUMENT-PROTOTYPE>
                      </ARGUMENTS>
                      <POSSIBLE-ERROR-REFS>
                        <POSSIBLE-ERROR-REF DEST="APPLICATION-ERROR">/AUTOSAR_EcuM/ASR40/PortInterfaces/EcuM_ASR40_ShutdownTarget/E_NOT_OK</POSSIBLE-ERROR-REF>
                      </POSSIBLE-ERROR-REFS>
                    </OPERATION-PROTOTYPE>

                    <OPERATION-PROTOTYPE>
                      <SHORT-NAME>GetLastShutdownTarget</SHORT-NAME>
                      <ARGUMENTS>
                        <ARGUMENT-PROTOTYPE>
                          <SHORT-NAME>target</SHORT-NAME>
                          <TYPE-TREF DEST="INTEGER-TYPE">/AUTOSAR_EcuM/ASR40/Datatypes/EcuM_ASR40_StateType</TYPE-TREF>
                          <DIRECTION>OUT</DIRECTION>
                        </ARGUMENT-PROTOTYPE>
                        <ARGUMENT-PROTOTYPE>
                          <SHORT-NAME>mode</SHORT-NAME>
                          <TYPE-TREF DEST="INTEGER-TYPE">/AUTOSAR_PlatformTypes/Datatypes/uint8</TYPE-TREF>
                          <DIRECTION>OUT</DIRECTION>
                        </ARGUMENT-PROTOTYPE>
                      </ARGUMENTS>
                      <POSSIBLE-ERROR-REFS>
                        <POSSIBLE-ERROR-REF DEST="APPLICATION-ERROR">/AUTOSAR_EcuM/ASR40/PortInterfaces/EcuM_ASR40_ShutdownTarget/E_NOT_OK</POSSIBLE-ERROR-REF>
                      </POSSIBLE-ERROR-REFS>
                    </OPERATION-PROTOTYPE>

                    <!-- shutdown cause -->
                    <OPERATION-PROTOTYPE>
                      <SHORT-NAME>SelectShutdownCause</SHORT-NAME>
                      <ARGUMENTS>
                        <ARGUMENT-PROTOTYPE>
                          <SHORT-NAME>target</SHORT-NAME>
                          <TYPE-TREF DEST="INTEGER-TYPE">/AUTOSAR_EcuM/ASR40/Datatypes/EcuM_ASR40_ShutdownCauseType</TYPE-TREF>
                          <DIRECTION>IN</DIRECTION>
                        </ARGUMENT-PROTOTYPE>
                      </ARGUMENTS>
                      <POSSIBLE-ERROR-REFS>
                        <POSSIBLE-ERROR-REF DEST="APPLICATION-ERROR">/AUTOSAR_EcuM/ASR40/PortInterfaces/EcuM_ASR40_ShutdownTarget/E_NOT_OK</POSSIBLE-ERROR-REF>
                      </POSSIBLE-ERROR-REFS>
                    </OPERATION-PROTOTYPE>

                    <OPERATION-PROTOTYPE>
                      <SHORT-NAME>GetShutdownCause</SHORT-NAME>
                      <ARGUMENTS>
                        <ARGUMENT-PROTOTYPE>
                          <SHORT-NAME>target</SHORT-NAME>
                          <TYPE-TREF DEST="INTEGER-TYPE">/AUTOSAR_EcuM/ASR40/Datatypes/EcuM_ASR40_ShutdownCauseType</TYPE-TREF>
                          <DIRECTION>OUT</DIRECTION>
                        </ARGUMENT-PROTOTYPE>
                      </ARGUMENTS>
                      <POSSIBLE-ERROR-REFS>
                        <POSSIBLE-ERROR-REF DEST="APPLICATION-ERROR">/AUTOSAR_EcuM/ASR40/PortInterfaces/EcuM_ASR40_ShutdownTarget/E_NOT_OK</POSSIBLE-ERROR-REF>
                      </POSSIBLE-ERROR-REFS>
                    </OPERATION-PROTOTYPE>

                    <OPERATION-PROTOTYPE>
                      <SHORT-NAME>GetMostRecentShutdown</SHORT-NAME>
                      <ARGUMENTS>
                        <ARGUMENT-PROTOTYPE>
                          <SHORT-NAME>target</SHORT-NAME>
                          <TYPE-TREF DEST="INTEGER-TYPE">/AUTOSAR_EcuM/ASR40/Datatypes/EcuM_ASR40_StateType</TYPE-TREF>
                          <DIRECTION>OUT</DIRECTION>
                        </ARGUMENT-PROTOTYPE>

                        <ARGUMENT-PROTOTYPE>
                          <SHORT-NAME>mode</SHORT-NAME>
                          <TYPE-TREF DEST="INTEGER-TYPE">/AUTOSAR_PlatformTypes/Datatypes/uint8</TYPE-TREF>
                          <DIRECTION>OUT</DIRECTION>
                        </ARGUMENT-PROTOTYPE>

                        <ARGUMENT-PROTOTYPE>
                          <SHORT-NAME>cause</SHORT-NAME>
                          <TYPE-TREF DEST="INTEGER-TYPE">/AUTOSAR_EcuM/ASR40/Datatypes/EcuM_ASR40_ShutdownCauseType</TYPE-TREF>
                          <DIRECTION>OUT</DIRECTION>
                        </ARGUMENT-PROTOTYPE>

                        <ARGUMENT-PROTOTYPE>
                          <SHORT-NAME>time</SHORT-NAME>
                          <TYPE-TREF DEST="INTEGER-TYPE">/AUTOSAR_PlatformTypes/Datatypes/uint32</TYPE-TREF>
                          <DIRECTION>OUT</DIRECTION>
                        </ARGUMENT-PROTOTYPE>
                      </ARGUMENTS>
                      <POSSIBLE-ERROR-REFS>
                        <POSSIBLE-ERROR-REF DEST="APPLICATION-ERROR">/AUTOSAR_EcuM/ASR40/PortInterfaces/EcuM_ASR40_ShutdownTarget/E_NOT_OK</POSSIBLE-ERROR-REF>
                      </POSSIBLE-ERROR-REFS>
                    </OPERATION-PROTOTYPE>

                    <OPERATION-PROTOTYPE>
                      <SHORT-NAME>GetNextRecentShutdown</SHORT-NAME>
                      <ARGUMENTS>
                        <ARGUMENT-PROTOTYPE>
                          <SHORT-NAME>target</SHORT-NAME>
                          <TYPE-TREF DEST="INTEGER-TYPE">/AUTOSAR_EcuM/ASR40/Datatypes/EcuM_ASR40_StateType</TYPE-TREF>
                          <DIRECTION>OUT</DIRECTION>
                        </ARGUMENT-PROTOTYPE>

                        <ARGUMENT-PROTOTYPE>
                          <SHORT-NAME>mode</SHORT-NAME>
                          <TYPE-TREF DEST="INTEGER-TYPE">/AUTOSAR_PlatformTypes/Datatypes/uint8</TYPE-TREF>
                          <DIRECTION>OUT</DIRECTION>
                        </ARGUMENT-PROTOTYPE>

                        <ARGUMENT-PROTOTYPE>
                          <SHORT-NAME>cause</SHORT-NAME>
                          <TYPE-TREF DEST="INTEGER-TYPE">/AUTOSAR_EcuM/ASR40/Datatypes/EcuM_ASR40_ShutdownCauseType</TYPE-TREF>
                          <DIRECTION>OUT</DIRECTION>
                        </ARGUMENT-PROTOTYPE>

                        <ARGUMENT-PROTOTYPE>
                          <SHORT-NAME>time</SHORT-NAME>
                          <TYPE-TREF DEST="INTEGER-TYPE">/AUTOSAR_PlatformTypes/Datatypes/uint32</TYPE-TREF>
                          <DIRECTION>OUT</DIRECTION>
                        </ARGUMENT-PROTOTYPE>
                      </ARGUMENTS>
                      <POSSIBLE-ERROR-REFS>
                        <POSSIBLE-ERROR-REF DEST="APPLICATION-ERROR">/AUTOSAR_EcuM/ASR40/PortInterfaces/EcuM_ASR40_ShutdownTarget/E_NOT_OK</POSSIBLE-ERROR-REF>
                      </POSSIBLE-ERROR-REFS>
                    </OPERATION-PROTOTYPE>

                  </OPERATIONS>
                  <POSSIBLE-ERRORS>
                    <APPLICATION-ERROR>
                      <SHORT-NAME>E_NOT_OK</SHORT-NAME>
                      <ERROR-CODE>1</ERROR-CODE>
                    </APPLICATION-ERROR>
                  </POSSIBLE-ERRORS>
                </CLIENT-SERVER-INTERFACE>

                <CLIENT-SERVER-INTERFACE>
                  <SHORT-NAME>EcuM_ASR40_BootTarget</SHORT-NAME>
                  <IS-SERVICE>true</IS-SERVICE>
                  <OPERATIONS>
                    <OPERATION-PROTOTYPE>
                      <SHORT-NAME>SelectBootTarget</SHORT-NAME>
                      <ARGUMENTS>
                        <ARGUMENT-PROTOTYPE>
                          <SHORT-NAME>target</SHORT-NAME>
                          <TYPE-TREF DEST="INTEGER-TYPE">/AUTOSAR_EcuM/ASR40/Datatypes/EcuM_ASR40_BootTargetType</TYPE-TREF>
                          <DIRECTION>IN</DIRECTION>
                        </ARGUMENT-PROTOTYPE>
                      </ARGUMENTS>
                      <POSSIBLE-ERROR-REFS>
                        <POSSIBLE-ERROR-REF DEST="APPLICATION-ERROR">/AUTOSAR_EcuM/ASR40/PortInterfaces/EcuM_ASR40_BootTarget/E_NOT_OK</POSSIBLE-ERROR-REF>
                      </POSSIBLE-ERROR-REFS>
                    </OPERATION-PROTOTYPE>
                    <OPERATION-PROTOTYPE>
                      <SHORT-NAME>GetBootTarget</SHORT-NAME>
                      <ARGUMENTS>
                        <ARGUMENT-PROTOTYPE>
                          <SHORT-NAME>target</SHORT-NAME>
                          <TYPE-TREF DEST="INTEGER-TYPE">/AUTOSAR_EcuM/ASR40/Datatypes/EcuM_ASR40_BootTargetType</TYPE-TREF>
                          <DIRECTION>OUT</DIRECTION>
                        </ARGUMENT-PROTOTYPE>
                      </ARGUMENTS>
                      <POSSIBLE-ERROR-REFS>
                        <POSSIBLE-ERROR-REF DEST="APPLICATION-ERROR">/AUTOSAR_EcuM/ASR40/PortInterfaces/EcuM_ASR40_BootTarget/E_NOT_OK</POSSIBLE-ERROR-REF>
                      </POSSIBLE-ERROR-REFS>
                    </OPERATION-PROTOTYPE>
                  </OPERATIONS>
                  <POSSIBLE-ERRORS>
                    <APPLICATION-ERROR>
                      <SHORT-NAME>E_NOT_OK</SHORT-NAME>
                      <ERROR-CODE>1</ERROR-CODE>
                    </APPLICATION-ERROR>
                  </POSSIBLE-ERRORS>
                </CLIENT-SERVER-INTERFACE>
              </ELEMENTS>
            </AR-PACKAGE>
          </SUB-PACKAGES>
        </AR-PACKAGE>
[!ENDIF!][!//
[!IF "node:exists(EcuMGeneral/EcuMServiceAPI) and EcuMGeneral/EcuMServiceAPI/EcuMDefaultASRServiceAPI = 'AUTOSAR_32'"!][!//
        <!-- Provide default service interface as AUTOSAR 3.2 -->
        <AR-PACKAGE>
          <SHORT-NAME>CompuMethods</SHORT-NAME>
          <ELEMENTS>
            <COMPU-METHOD>
              <SHORT-NAME>STATES</SHORT-NAME>
              <CATEGORY>TEXTTABLE</CATEGORY>
              <COMPU-INTERNAL-TO-PHYS>
                <COMPU-SCALES>
                  <COMPU-SCALE>
                    <LOWER-LIMIT INTERVAL-TYPE="CLOSED">16</LOWER-LIMIT>
                    <UPPER-LIMIT INTERVAL-TYPE="CLOSED">16</UPPER-LIMIT>
                    <COMPU-CONST>
                      <VT>ECUM_STATE_STARTUP</VT>
                    </COMPU-CONST>
                  </COMPU-SCALE>
                  <COMPU-SCALE>
                    <LOWER-LIMIT INTERVAL-TYPE="CLOSED">17</LOWER-LIMIT>
                    <UPPER-LIMIT INTERVAL-TYPE="CLOSED">17</UPPER-LIMIT>
                    <COMPU-CONST>
                      <VT>ECUM_STATE_STARTUP_ONE</VT>
                    </COMPU-CONST>
                  </COMPU-SCALE>
                  <COMPU-SCALE>
                    <LOWER-LIMIT INTERVAL-TYPE="CLOSED">18</LOWER-LIMIT>
                    <UPPER-LIMIT INTERVAL-TYPE="CLOSED">18</UPPER-LIMIT>
                    <COMPU-CONST>
                      <VT>ECUM_STATE_STARTUP_TWO</VT>
                    </COMPU-CONST>
                  </COMPU-SCALE>
                  <COMPU-SCALE>
                    <LOWER-LIMIT INTERVAL-TYPE="CLOSED">32</LOWER-LIMIT>
                    <UPPER-LIMIT INTERVAL-TYPE="CLOSED">32</UPPER-LIMIT>
                    <COMPU-CONST>
                      <VT>ECUM_STATE_WAKEUP</VT>
                    </COMPU-CONST>
                  </COMPU-SCALE>
                  <COMPU-SCALE>
                    <LOWER-LIMIT INTERVAL-TYPE="CLOSED">33</LOWER-LIMIT>
                    <UPPER-LIMIT INTERVAL-TYPE="CLOSED">33</UPPER-LIMIT>
                    <COMPU-CONST>
                      <VT>ECUM_STATE_WAKEUP_ONE</VT>
                    </COMPU-CONST>
                  </COMPU-SCALE>
                  <COMPU-SCALE>
                    <LOWER-LIMIT INTERVAL-TYPE="CLOSED">34</LOWER-LIMIT>
                    <UPPER-LIMIT INTERVAL-TYPE="CLOSED">34</UPPER-LIMIT>
                    <COMPU-CONST>
                      <VT>ECUM_STATE_WAKEUP_VALIDATION</VT>
                    </COMPU-CONST>
                  </COMPU-SCALE>
                  <COMPU-SCALE>
                    <LOWER-LIMIT INTERVAL-TYPE="CLOSED">35</LOWER-LIMIT>
                    <UPPER-LIMIT INTERVAL-TYPE="CLOSED">35</UPPER-LIMIT>
                    <COMPU-CONST>
                      <VT>ECUM_STATE_WAKEUP_REACTION</VT>
                    </COMPU-CONST>
                  </COMPU-SCALE>
                  <COMPU-SCALE>
                    <LOWER-LIMIT INTERVAL-TYPE="CLOSED">36</LOWER-LIMIT>
                    <UPPER-LIMIT INTERVAL-TYPE="CLOSED">36</UPPER-LIMIT>
                    <COMPU-CONST>
                      <VT>ECUM_STATE_WAKEUP_TWO</VT>
                    </COMPU-CONST>
                  </COMPU-SCALE>
                  <COMPU-SCALE>
                    <LOWER-LIMIT INTERVAL-TYPE="CLOSED">37</LOWER-LIMIT>
                    <UPPER-LIMIT INTERVAL-TYPE="CLOSED">37</UPPER-LIMIT>
                    <COMPU-CONST>
                      <VT>ECUM_STATE_WAKEUP_WAKESLEEP</VT>
                    </COMPU-CONST>
                  </COMPU-SCALE>
                  <COMPU-SCALE>
                    <LOWER-LIMIT INTERVAL-TYPE="CLOSED">38</LOWER-LIMIT>
                    <UPPER-LIMIT INTERVAL-TYPE="CLOSED">38</UPPER-LIMIT>
                    <COMPU-CONST>
                      <VT>ECUM_STATE_WAKEUP_TTII</VT>
                    </COMPU-CONST>
                  </COMPU-SCALE>
                  <COMPU-SCALE>
                    <LOWER-LIMIT INTERVAL-TYPE="CLOSED">48</LOWER-LIMIT>
                    <UPPER-LIMIT INTERVAL-TYPE="CLOSED">48</UPPER-LIMIT>
                    <COMPU-CONST>
                      <VT>ECUM_STATE_RUN</VT>
                    </COMPU-CONST>
                  </COMPU-SCALE>
                  <COMPU-SCALE>
                    <LOWER-LIMIT INTERVAL-TYPE="CLOSED">50</LOWER-LIMIT>
                    <UPPER-LIMIT INTERVAL-TYPE="CLOSED">50</UPPER-LIMIT>
                    <COMPU-CONST>
                      <VT>ECUM_STATE_APP_RUN</VT>
                    </COMPU-CONST>
                  </COMPU-SCALE>
                  <COMPU-SCALE>
                    <LOWER-LIMIT INTERVAL-TYPE="CLOSED">51</LOWER-LIMIT>
                    <UPPER-LIMIT INTERVAL-TYPE="CLOSED">51</UPPER-LIMIT>
                    <COMPU-CONST>
                      <VT>ECUM_STATE_APP_POST_RUN</VT>
                    </COMPU-CONST>
                  </COMPU-SCALE>
                  <COMPU-SCALE>
                    <LOWER-LIMIT INTERVAL-TYPE="CLOSED">64</LOWER-LIMIT>
                    <UPPER-LIMIT INTERVAL-TYPE="CLOSED">64</UPPER-LIMIT>
                    <COMPU-CONST>
                      <VT>ECUM_STATE_SHUTDOWN</VT>
                    </COMPU-CONST>
                  </COMPU-SCALE>
                  <COMPU-SCALE>
                    <LOWER-LIMIT INTERVAL-TYPE="CLOSED">68</LOWER-LIMIT>
                    <UPPER-LIMIT INTERVAL-TYPE="CLOSED">68</UPPER-LIMIT>
                    <COMPU-CONST>
                      <VT>ECUM_STATE_PREP_SHUTDOWN</VT>
                    </COMPU-CONST>
                  </COMPU-SCALE>
                  <COMPU-SCALE>
                    <LOWER-LIMIT INTERVAL-TYPE="CLOSED">73</LOWER-LIMIT>
                    <UPPER-LIMIT INTERVAL-TYPE="CLOSED">73</UPPER-LIMIT>
                    <COMPU-CONST>
                      <VT>ECUM_STATE_GO_SLEEP</VT>
                    </COMPU-CONST>
                  </COMPU-SCALE>
                  <COMPU-SCALE>
                    <LOWER-LIMIT INTERVAL-TYPE="CLOSED">77</LOWER-LIMIT>
                    <UPPER-LIMIT INTERVAL-TYPE="CLOSED">77</UPPER-LIMIT>
                    <COMPU-CONST>
                      <VT>ECUM_STATE_GO_OFF_ONE</VT>
                    </COMPU-CONST>
                  </COMPU-SCALE>
                  <COMPU-SCALE>
                    <LOWER-LIMIT INTERVAL-TYPE="CLOSED">78</LOWER-LIMIT>
                    <UPPER-LIMIT INTERVAL-TYPE="CLOSED">78</UPPER-LIMIT>
                    <COMPU-CONST>
                      <VT>ECUM_STATE_GO_OFF_TWO</VT>
                    </COMPU-CONST>
                  </COMPU-SCALE>
                  <COMPU-SCALE>
                    <LOWER-LIMIT INTERVAL-TYPE="CLOSED">80</LOWER-LIMIT>
                    <UPPER-LIMIT INTERVAL-TYPE="CLOSED">80</UPPER-LIMIT>
                    <COMPU-CONST>
                      <VT>ECUM_STATE_SLEEP</VT>
                    </COMPU-CONST>
                  </COMPU-SCALE>
                  <COMPU-SCALE>
                    <LOWER-LIMIT INTERVAL-TYPE="CLOSED">128</LOWER-LIMIT>
                    <UPPER-LIMIT INTERVAL-TYPE="CLOSED">128</UPPER-LIMIT>
                    <COMPU-CONST>
                      <VT>ECUM_STATE_OFF</VT>
                    </COMPU-CONST>
                  </COMPU-SCALE>
                  <COMPU-SCALE>
                    <LOWER-LIMIT INTERVAL-TYPE="CLOSED">144</LOWER-LIMIT>
                    <UPPER-LIMIT INTERVAL-TYPE="CLOSED">144</UPPER-LIMIT>
                    <COMPU-CONST>
                      <VT>ECUM_STATE_RESET</VT>
                    </COMPU-CONST>
                  </COMPU-SCALE>
                </COMPU-SCALES>
              </COMPU-INTERNAL-TO-PHYS>
            </COMPU-METHOD>

            <COMPU-METHOD>
              <SHORT-NAME>BOOTTARGET</SHORT-NAME>
              <CATEGORY>TEXTTABLE</CATEGORY>
              <COMPU-INTERNAL-TO-PHYS>
                <COMPU-SCALES>
                  <COMPU-SCALE>
                    <LOWER-LIMIT INTERVAL-TYPE="CLOSED">0</LOWER-LIMIT>
                    <UPPER-LIMIT INTERVAL-TYPE="CLOSED">0</UPPER-LIMIT>
                    <COMPU-CONST>
                      <VT>ECUM_BOOT_TARGET_APP</VT>
                    </COMPU-CONST>
                  </COMPU-SCALE>
                  <COMPU-SCALE>
                    <LOWER-LIMIT INTERVAL-TYPE="CLOSED">1</LOWER-LIMIT>
                    <UPPER-LIMIT INTERVAL-TYPE="CLOSED">1</UPPER-LIMIT>
                    <COMPU-CONST>
                      <VT>ECUM_BOOT_TARGET_BOOTLOADER</VT>
                    </COMPU-CONST>
                  </COMPU-SCALE>
                </COMPU-SCALES>
              </COMPU-INTERNAL-TO-PHYS>
            </COMPU-METHOD>
[!IF "node:exists(EcuMConfiguration/eb-list::*[1]/EcuMFixedConfiguration)"!][!//
            <COMPU-METHOD>
              <SHORT-NAME>USERTYPE</SHORT-NAME>
              <CATEGORY>TEXTTABLE</CATEGORY>
              <COMPU-INTERNAL-TO-PHYS>
                <COMPU-SCALES>
[!LOOP "EcuMConfiguration/eb-list::*[1]/EcuMFixedConfiguration/EcuMFixedUserConfig/eb-list::*"!][!//
                  <COMPU-SCALE>
                    <LOWER-LIMIT INTERVAL-TYPE="CLOSED">[!"node:value(EcuMFixedUser)"!]</LOWER-LIMIT>
                    <UPPER-LIMIT INTERVAL-TYPE="CLOSED">[!"node:value(EcuMFixedUser)"!]</UPPER-LIMIT>
                    <COMPU-CONST>
                      <VT>[!"as:name(.)"!]</VT>
                    </COMPU-CONST>
                  </COMPU-SCALE>
[!ENDLOOP!][!//
                </COMPU-SCALES>
              </COMPU-INTERNAL-TO-PHYS>
            </COMPU-METHOD>
[!ENDIF!][!//
          </ELEMENTS>
        </AR-PACKAGE>
        <AR-PACKAGE>
          <SHORT-NAME>Datatypes</SHORT-NAME>
          <ELEMENTS>
            <INTEGER-TYPE>
              <SHORT-NAME>EcuM_StateType</SHORT-NAME>
              <CATEGORY>TYPE_REFERENCE</CATEGORY>
              <SW-DATA-DEF-PROPS>
                <BASE-TYPE-REF DEST="SW-BASE-TYPE">/AUTOSAR_PlatformTypes/BaseTypes/uint8</BASE-TYPE-REF>
                <COMPU-METHOD-REF DEST="COMPU-METHOD">/AUTOSAR_EcuM/CompuMethods/STATES</COMPU-METHOD-REF>
              </SW-DATA-DEF-PROPS>
              <LOWER-LIMIT INTERVAL-TYPE="CLOSED">16</LOWER-LIMIT>
              <UPPER-LIMIT INTERVAL-TYPE="CLOSED">144</UPPER-LIMIT>
            </INTEGER-TYPE>

            <INTEGER-TYPE>
              <SHORT-NAME>EcuM_BootTargetType</SHORT-NAME>
              <CATEGORY>TYPE_REFERENCE</CATEGORY>
              <SW-DATA-DEF-PROPS>
                <BASE-TYPE-REF DEST="SW-BASE-TYPE">/AUTOSAR_PlatformTypes/BaseTypes/uint8</BASE-TYPE-REF>
                <COMPU-METHOD-REF DEST="COMPU-METHOD">/AUTOSAR_EcuM/CompuMethods/BOOTTARGET</COMPU-METHOD-REF>
              </SW-DATA-DEF-PROPS>
              <LOWER-LIMIT INTERVAL-TYPE="CLOSED">0</LOWER-LIMIT>
              <UPPER-LIMIT INTERVAL-TYPE="CLOSED">1</UPPER-LIMIT>
            </INTEGER-TYPE>
[!IF "node:exists(EcuMConfiguration/eb-list::*[1]/EcuMFixedConfiguration)"!][!//
            <INTEGER-TYPE>
              <SHORT-NAME>EcuM_UserType</SHORT-NAME>
              <CATEGORY>TYPE_REFERENCE</CATEGORY>
              <SW-DATA-DEF-PROPS>
                <BASE-TYPE-REF DEST="SW-BASE-TYPE">/AUTOSAR_PlatformTypes/BaseTypes/uint8</BASE-TYPE-REF>
                <COMPU-METHOD-REF DEST="COMPU-METHOD">/AUTOSAR_EcuM/CompuMethods/USERTYPE</COMPU-METHOD-REF>
              </SW-DATA-DEF-PROPS>
              <LOWER-LIMIT INTERVAL-TYPE="CLOSED">0</LOWER-LIMIT>
              <UPPER-LIMIT INTERVAL-TYPE="CLOSED">255</UPPER-LIMIT>
            </INTEGER-TYPE>
[!ENDIF!][!//
          </ELEMENTS>
        </AR-PACKAGE>
        <AR-PACKAGE>
          <SHORT-NAME>ModeDeclarationGroups</SHORT-NAME>
          <ELEMENTS>
[!IF "node:exists(EcuMConfiguration/eb-list::*[1]/EcuMFixedConfiguration)"!][!//
            <MODE-DECLARATION-GROUP>
              <SHORT-NAME>EcuM_Mode</SHORT-NAME>
              <INITIAL-MODE-REF DEST="MODE-DECLARATION">/AUTOSAR_EcuM/ModeDeclarationGroups/EcuM_Mode/STARTUP</INITIAL-MODE-REF>
              <MODE-DECLARATIONS>
                <MODE-DECLARATION>
                  <SHORT-NAME>STARTUP</SHORT-NAME>
                </MODE-DECLARATION>
                <MODE-DECLARATION>
                  <SHORT-NAME>RUN</SHORT-NAME>
                </MODE-DECLARATION>
                <MODE-DECLARATION>
                  <SHORT-NAME>POST_RUN</SHORT-NAME>
                </MODE-DECLARATION>
                <MODE-DECLARATION>
                  <SHORT-NAME>SLEEP</SHORT-NAME>
                </MODE-DECLARATION>
                <MODE-DECLARATION>
                  <SHORT-NAME>WAKE_SLEEP</SHORT-NAME>
                </MODE-DECLARATION>
                <MODE-DECLARATION>
                  <SHORT-NAME>SHUTDOWN</SHORT-NAME>
                </MODE-DECLARATION>
              </MODE-DECLARATIONS>
            </MODE-DECLARATION-GROUP>
[!ENDIF!][!//
          </ELEMENTS>
        </AR-PACKAGE>
        <AR-PACKAGE>
          <SHORT-NAME>PortInterfaces</SHORT-NAME>
          <ELEMENTS>
[!IF "node:exists(EcuMConfiguration/eb-list::*[1]/EcuMFixedConfiguration)"!][!//
            <CLIENT-SERVER-INTERFACE>
              <SHORT-NAME>EcuM_StateRequest</SHORT-NAME>
              <IS-SERVICE>true</IS-SERVICE>
              <OPERATIONS>
                <OPERATION-PROTOTYPE>
                  <SHORT-NAME>RequestRUN</SHORT-NAME>
                  <POSSIBLE-ERROR-REFS>
                    <POSSIBLE-ERROR-REF DEST="APPLICATION-ERROR">/AUTOSAR_EcuM/PortInterfaces/EcuM_StateRequest/E_NOT_OK</POSSIBLE-ERROR-REF>
                  </POSSIBLE-ERROR-REFS>
                </OPERATION-PROTOTYPE>
                <OPERATION-PROTOTYPE>
                  <SHORT-NAME>ReleaseRUN</SHORT-NAME>
                  <POSSIBLE-ERROR-REFS>
                    <POSSIBLE-ERROR-REF DEST="APPLICATION-ERROR">/AUTOSAR_EcuM/PortInterfaces/EcuM_StateRequest/E_NOT_OK</POSSIBLE-ERROR-REF>
                  </POSSIBLE-ERROR-REFS>
                </OPERATION-PROTOTYPE>
                <OPERATION-PROTOTYPE>
                  <SHORT-NAME>RequestPOSTRUN</SHORT-NAME>
                  <POSSIBLE-ERROR-REFS>
                    <POSSIBLE-ERROR-REF DEST="APPLICATION-ERROR">/AUTOSAR_EcuM/PortInterfaces/EcuM_StateRequest/E_NOT_OK</POSSIBLE-ERROR-REF>
                  </POSSIBLE-ERROR-REFS>
                </OPERATION-PROTOTYPE>
                <OPERATION-PROTOTYPE>
                  <SHORT-NAME>ReleasePOSTRUN</SHORT-NAME>
                  <POSSIBLE-ERROR-REFS>
                    <POSSIBLE-ERROR-REF DEST="APPLICATION-ERROR">/AUTOSAR_EcuM/PortInterfaces/EcuM_StateRequest/E_NOT_OK</POSSIBLE-ERROR-REF>
                  </POSSIBLE-ERROR-REFS>
                </OPERATION-PROTOTYPE>
              </OPERATIONS>
              <POSSIBLE-ERRORS>
                <APPLICATION-ERROR>
                  <SHORT-NAME>E_NOT_OK</SHORT-NAME>
                  <ERROR-CODE>1</ERROR-CODE>
                </APPLICATION-ERROR>
              </POSSIBLE-ERRORS>
            </CLIENT-SERVER-INTERFACE>

            <SENDER-RECEIVER-INTERFACE>
              <SHORT-NAME>EcuM_CurrentMode</SHORT-NAME>
              <IS-SERVICE>true</IS-SERVICE>
              <DATA-ELEMENTS />
              <MODE-GROUPS>
                <MODE-DECLARATION-GROUP-PROTOTYPE>
                  <SHORT-NAME>currentMode</SHORT-NAME>
                  <TYPE-TREF DEST="MODE-DECLARATION-GROUP">/AUTOSAR_EcuM/ModeDeclarationGroups/EcuM_Mode</TYPE-TREF>
                </MODE-DECLARATION-GROUP-PROTOTYPE>
              </MODE-GROUPS>
            </SENDER-RECEIVER-INTERFACE>
[!ENDIF!][!//
            <CLIENT-SERVER-INTERFACE>
              <SHORT-NAME>EcuM_ShutdownTarget</SHORT-NAME>
              <IS-SERVICE>true</IS-SERVICE>
              <OPERATIONS>

                <OPERATION-PROTOTYPE>
                  <SHORT-NAME>SelectShutdownTarget</SHORT-NAME>
                  <ARGUMENTS>
                    <ARGUMENT-PROTOTYPE>
                      <SHORT-NAME>target</SHORT-NAME>
                      <TYPE-TREF DEST="INTEGER-TYPE">/AUTOSAR_EcuM/Datatypes/EcuM_StateType</TYPE-TREF>
                      <DIRECTION>IN</DIRECTION>
                    </ARGUMENT-PROTOTYPE>
                    <ARGUMENT-PROTOTYPE>
                      <SHORT-NAME>mode</SHORT-NAME>
                      <TYPE-TREF DEST="INTEGER-TYPE">/AUTOSAR_PlatformTypes/Datatypes/uint8</TYPE-TREF>
                      <DIRECTION>IN</DIRECTION>
                    </ARGUMENT-PROTOTYPE>
                  </ARGUMENTS>
                  <POSSIBLE-ERROR-REFS>
                    <POSSIBLE-ERROR-REF DEST="APPLICATION-ERROR">/AUTOSAR_EcuM/PortInterfaces/EcuM_ShutdownTarget/E_NOT_OK</POSSIBLE-ERROR-REF>
                  </POSSIBLE-ERROR-REFS>
                </OPERATION-PROTOTYPE>

                <OPERATION-PROTOTYPE>
                  <SHORT-NAME>GetShutdownTarget</SHORT-NAME>
                  <ARGUMENTS>
                    <ARGUMENT-PROTOTYPE>
                      <SHORT-NAME>target</SHORT-NAME>
                      <TYPE-TREF DEST="INTEGER-TYPE">/AUTOSAR_EcuM/Datatypes/EcuM_StateType</TYPE-TREF>
                      <DIRECTION>OUT</DIRECTION>
                    </ARGUMENT-PROTOTYPE>
                    <ARGUMENT-PROTOTYPE>
                      <SHORT-NAME>mode</SHORT-NAME>
                      <TYPE-TREF DEST="INTEGER-TYPE">/AUTOSAR_PlatformTypes/Datatypes/uint8</TYPE-TREF>
                      <DIRECTION>OUT</DIRECTION>
                    </ARGUMENT-PROTOTYPE>
                  </ARGUMENTS>
                  <POSSIBLE-ERROR-REFS>
                    <POSSIBLE-ERROR-REF DEST="APPLICATION-ERROR">/AUTOSAR_EcuM/PortInterfaces/EcuM_ShutdownTarget/E_NOT_OK</POSSIBLE-ERROR-REF>
                  </POSSIBLE-ERROR-REFS>
                </OPERATION-PROTOTYPE>

                <OPERATION-PROTOTYPE>
                  <SHORT-NAME>GetLastShutdownTarget</SHORT-NAME>
                  <ARGUMENTS>
                    <ARGUMENT-PROTOTYPE>
                      <SHORT-NAME>target</SHORT-NAME>
                      <TYPE-TREF DEST="INTEGER-TYPE">/AUTOSAR_EcuM/Datatypes/EcuM_StateType</TYPE-TREF>
                      <DIRECTION>OUT</DIRECTION>
                    </ARGUMENT-PROTOTYPE>
                    <ARGUMENT-PROTOTYPE>
                      <SHORT-NAME>mode</SHORT-NAME>
                      <TYPE-TREF DEST="INTEGER-TYPE">/AUTOSAR_PlatformTypes/Datatypes/uint8</TYPE-TREF>
                      <DIRECTION>OUT</DIRECTION>
                    </ARGUMENT-PROTOTYPE>
                  </ARGUMENTS>
                  <POSSIBLE-ERROR-REFS>
                    <POSSIBLE-ERROR-REF DEST="APPLICATION-ERROR">/AUTOSAR_EcuM/PortInterfaces/EcuM_ShutdownTarget/E_NOT_OK</POSSIBLE-ERROR-REF>
                  </POSSIBLE-ERROR-REFS>
                </OPERATION-PROTOTYPE>

              </OPERATIONS>
              <POSSIBLE-ERRORS>
                <APPLICATION-ERROR>
                  <SHORT-NAME>E_NOT_OK</SHORT-NAME>
                  <ERROR-CODE>1</ERROR-CODE>
                </APPLICATION-ERROR>
              </POSSIBLE-ERRORS>
            </CLIENT-SERVER-INTERFACE>

            <CLIENT-SERVER-INTERFACE>
              <SHORT-NAME>EcuM_BootTarget</SHORT-NAME>
              <IS-SERVICE>true</IS-SERVICE>
              <OPERATIONS>
                <OPERATION-PROTOTYPE>
                  <SHORT-NAME>SelectBootTarget</SHORT-NAME>
                  <ARGUMENTS>
                    <ARGUMENT-PROTOTYPE>
                      <SHORT-NAME>target</SHORT-NAME>
                      <TYPE-TREF DEST="INTEGER-TYPE">/AUTOSAR_EcuM/Datatypes/EcuM_BootTargetType</TYPE-TREF>
                      <DIRECTION>IN</DIRECTION>
                    </ARGUMENT-PROTOTYPE>
                  </ARGUMENTS>
                  <POSSIBLE-ERROR-REFS>
                    <POSSIBLE-ERROR-REF DEST="APPLICATION-ERROR">/AUTOSAR_EcuM/PortInterfaces/EcuM_BootTarget/E_NOT_OK</POSSIBLE-ERROR-REF>
                  </POSSIBLE-ERROR-REFS>
                </OPERATION-PROTOTYPE>
                <OPERATION-PROTOTYPE>
                  <SHORT-NAME>GetBootTarget</SHORT-NAME>
                  <ARGUMENTS>
                    <ARGUMENT-PROTOTYPE>
                      <SHORT-NAME>target</SHORT-NAME>
                      <TYPE-TREF DEST="INTEGER-TYPE">/AUTOSAR_EcuM/Datatypes/EcuM_BootTargetType</TYPE-TREF>
                      <DIRECTION>OUT</DIRECTION>
                    </ARGUMENT-PROTOTYPE>
                  </ARGUMENTS>
                  <POSSIBLE-ERROR-REFS>
                    <POSSIBLE-ERROR-REF DEST="APPLICATION-ERROR">/AUTOSAR_EcuM/PortInterfaces/EcuM_BootTarget/E_NOT_OK</POSSIBLE-ERROR-REF>
                  </POSSIBLE-ERROR-REFS>
                </OPERATION-PROTOTYPE>
              </OPERATIONS>
              <POSSIBLE-ERRORS>
                <APPLICATION-ERROR>
                  <SHORT-NAME>E_NOT_OK</SHORT-NAME>
                  <ERROR-CODE>1</ERROR-CODE>
                </APPLICATION-ERROR>
              </POSSIBLE-ERRORS>
            </CLIENT-SERVER-INTERFACE>
          </ELEMENTS>
        </AR-PACKAGE>
[!ENDIF!][!//
[!IF "node:exists(EcuMGeneral/EcuMServiceAPI) and EcuMGeneral/EcuMServiceAPI/EcuMDefaultASRServiceAPI = 'AUTOSAR_40'"!][!//
<!-- Provide default service interface as AUTOSAR 4.0 -->
        <AR-PACKAGE>
          <SHORT-NAME>CompuMethods</SHORT-NAME>
          <ELEMENTS>
            <COMPU-METHOD>
              <SHORT-NAME>STATES</SHORT-NAME>
              <CATEGORY>TEXTTABLE</CATEGORY>
              <COMPU-INTERNAL-TO-PHYS>
                <COMPU-SCALES>
                  <COMPU-SCALE>
                    <LOWER-LIMIT INTERVAL-TYPE="CLOSED">16</LOWER-LIMIT>
                    <UPPER-LIMIT INTERVAL-TYPE="CLOSED">16</UPPER-LIMIT>
                    <COMPU-CONST>
                      <VT>ECUM_STATE_STARTUP</VT>
                    </COMPU-CONST>
                  </COMPU-SCALE>
                  <COMPU-SCALE>
                    <LOWER-LIMIT INTERVAL-TYPE="CLOSED">17</LOWER-LIMIT>
                    <UPPER-LIMIT INTERVAL-TYPE="CLOSED">17</UPPER-LIMIT>
                    <COMPU-CONST>
                      <VT>ECUM_STATE_STARTUP_ONE</VT>
                    </COMPU-CONST>
                  </COMPU-SCALE>
                  <COMPU-SCALE>
                    <LOWER-LIMIT INTERVAL-TYPE="CLOSED">18</LOWER-LIMIT>
                    <UPPER-LIMIT INTERVAL-TYPE="CLOSED">18</UPPER-LIMIT>
                    <COMPU-CONST>
                      <VT>ECUM_STATE_STARTUP_TWO</VT>
                    </COMPU-CONST>
                  </COMPU-SCALE>
                  <COMPU-SCALE>
                    <LOWER-LIMIT INTERVAL-TYPE="CLOSED">32</LOWER-LIMIT>
                    <UPPER-LIMIT INTERVAL-TYPE="CLOSED">32</UPPER-LIMIT>
                    <COMPU-CONST>
                      <VT>ECUM_STATE_WAKEUP</VT>
                    </COMPU-CONST>
                  </COMPU-SCALE>
                  <COMPU-SCALE>
                    <LOWER-LIMIT INTERVAL-TYPE="CLOSED">33</LOWER-LIMIT>
                    <UPPER-LIMIT INTERVAL-TYPE="CLOSED">33</UPPER-LIMIT>
                    <COMPU-CONST>
                      <VT>ECUM_STATE_WAKEUP_ONE</VT>
                    </COMPU-CONST>
                  </COMPU-SCALE>
                  <COMPU-SCALE>
                    <LOWER-LIMIT INTERVAL-TYPE="CLOSED">34</LOWER-LIMIT>
                    <UPPER-LIMIT INTERVAL-TYPE="CLOSED">34</UPPER-LIMIT>
                    <COMPU-CONST>
                      <VT>ECUM_STATE_WAKEUP_VALIDATION</VT>
                    </COMPU-CONST>
                  </COMPU-SCALE>
                  <COMPU-SCALE>
                    <LOWER-LIMIT INTERVAL-TYPE="CLOSED">35</LOWER-LIMIT>
                    <UPPER-LIMIT INTERVAL-TYPE="CLOSED">35</UPPER-LIMIT>
                    <COMPU-CONST>
                      <VT>ECUM_STATE_WAKEUP_REACTION</VT>
                    </COMPU-CONST>
                  </COMPU-SCALE>
                  <COMPU-SCALE>
                    <LOWER-LIMIT INTERVAL-TYPE="CLOSED">36</LOWER-LIMIT>
                    <UPPER-LIMIT INTERVAL-TYPE="CLOSED">36</UPPER-LIMIT>
                    <COMPU-CONST>
                      <VT>ECUM_STATE_WAKEUP_TWO</VT>
                    </COMPU-CONST>
                  </COMPU-SCALE>
                  <COMPU-SCALE>
                    <LOWER-LIMIT INTERVAL-TYPE="CLOSED">37</LOWER-LIMIT>
                    <UPPER-LIMIT INTERVAL-TYPE="CLOSED">37</UPPER-LIMIT>
                    <COMPU-CONST>
                      <VT>ECUM_STATE_WAKEUP_WAKESLEEP</VT>
                    </COMPU-CONST>
                  </COMPU-SCALE>
                  <COMPU-SCALE>
                    <LOWER-LIMIT INTERVAL-TYPE="CLOSED">38</LOWER-LIMIT>
                    <UPPER-LIMIT INTERVAL-TYPE="CLOSED">38</UPPER-LIMIT>
                    <COMPU-CONST>
                      <VT>ECUM_STATE_WAKEUP_TTII</VT>
                    </COMPU-CONST>
                  </COMPU-SCALE>
                  <COMPU-SCALE>
                    <LOWER-LIMIT INTERVAL-TYPE="CLOSED">48</LOWER-LIMIT>
                    <UPPER-LIMIT INTERVAL-TYPE="CLOSED">48</UPPER-LIMIT>
                    <COMPU-CONST>
                      <VT>ECUM_STATE_RUN</VT>
                    </COMPU-CONST>
                  </COMPU-SCALE>
                  <COMPU-SCALE>
                    <LOWER-LIMIT INTERVAL-TYPE="CLOSED">50</LOWER-LIMIT>
                    <UPPER-LIMIT INTERVAL-TYPE="CLOSED">50</UPPER-LIMIT>
                    <COMPU-CONST>
                      <VT>ECUM_STATE_APP_RUN</VT>
                    </COMPU-CONST>
                  </COMPU-SCALE>
                  <COMPU-SCALE>
                    <LOWER-LIMIT INTERVAL-TYPE="CLOSED">51</LOWER-LIMIT>
                    <UPPER-LIMIT INTERVAL-TYPE="CLOSED">51</UPPER-LIMIT>
                    <COMPU-CONST>
                      <VT>ECUM_STATE_APP_POST_RUN</VT>
                    </COMPU-CONST>
                  </COMPU-SCALE>
                  <COMPU-SCALE>
                    <LOWER-LIMIT INTERVAL-TYPE="CLOSED">64</LOWER-LIMIT>
                    <UPPER-LIMIT INTERVAL-TYPE="CLOSED">64</UPPER-LIMIT>
                    <COMPU-CONST>
                      <VT>ECUM_STATE_SHUTDOWN</VT>
                    </COMPU-CONST>
                  </COMPU-SCALE>
                  <COMPU-SCALE>
                    <LOWER-LIMIT INTERVAL-TYPE="CLOSED">68</LOWER-LIMIT>
                    <UPPER-LIMIT INTERVAL-TYPE="CLOSED">68</UPPER-LIMIT>
                    <COMPU-CONST>
                      <VT>ECUM_STATE_PREP_SHUTDOWN</VT>
                    </COMPU-CONST>
                  </COMPU-SCALE>
                  <COMPU-SCALE>
                    <LOWER-LIMIT INTERVAL-TYPE="CLOSED">73</LOWER-LIMIT>
                    <UPPER-LIMIT INTERVAL-TYPE="CLOSED">73</UPPER-LIMIT>
                    <COMPU-CONST>
                      <VT>ECUM_STATE_GO_SLEEP</VT>
                    </COMPU-CONST>
                  </COMPU-SCALE>
                  <COMPU-SCALE>
                    <LOWER-LIMIT INTERVAL-TYPE="CLOSED">77</LOWER-LIMIT>
                    <UPPER-LIMIT INTERVAL-TYPE="CLOSED">77</UPPER-LIMIT>
                    <COMPU-CONST>
                      <VT>ECUM_STATE_GO_OFF_ONE</VT>
                    </COMPU-CONST>
                  </COMPU-SCALE>
                  <COMPU-SCALE>
                    <LOWER-LIMIT INTERVAL-TYPE="CLOSED">78</LOWER-LIMIT>
                    <UPPER-LIMIT INTERVAL-TYPE="CLOSED">78</UPPER-LIMIT>
                    <COMPU-CONST>
                      <VT>ECUM_STATE_GO_OFF_TWO</VT>
                    </COMPU-CONST>
                  </COMPU-SCALE>
                  <COMPU-SCALE>
                    <LOWER-LIMIT INTERVAL-TYPE="CLOSED">80</LOWER-LIMIT>
                    <UPPER-LIMIT INTERVAL-TYPE="CLOSED">80</UPPER-LIMIT>
                    <COMPU-CONST>
                      <VT>ECUM_STATE_SLEEP</VT>
                    </COMPU-CONST>
                  </COMPU-SCALE>
                  <COMPU-SCALE>
                    <LOWER-LIMIT INTERVAL-TYPE="CLOSED">128</LOWER-LIMIT>
                    <UPPER-LIMIT INTERVAL-TYPE="CLOSED">128</UPPER-LIMIT>
                    <COMPU-CONST>
                      <VT>ECUM_STATE_OFF</VT>
                    </COMPU-CONST>
                  </COMPU-SCALE>
                  <COMPU-SCALE>
                    <LOWER-LIMIT INTERVAL-TYPE="CLOSED">144</LOWER-LIMIT>
                    <UPPER-LIMIT INTERVAL-TYPE="CLOSED">144</UPPER-LIMIT>
                    <COMPU-CONST>
                      <VT>ECUM_STATE_RESET</VT>
                    </COMPU-CONST>
                  </COMPU-SCALE>
                </COMPU-SCALES>
              </COMPU-INTERNAL-TO-PHYS>
            </COMPU-METHOD>
            <COMPU-METHOD>
              <SHORT-NAME>SHUTDOWNCAUSE</SHORT-NAME>
              <CATEGORY>TEXTTABLE</CATEGORY>
              <COMPU-INTERNAL-TO-PHYS>
                <COMPU-SCALES>
                  <COMPU-SCALE>
                    <LOWER-LIMIT INTERVAL-TYPE="CLOSED">0</LOWER-LIMIT>
                    <UPPER-LIMIT INTERVAL-TYPE="CLOSED">0</UPPER-LIMIT>
                    <COMPU-CONST>
                      <VT>ECUM_CAUSE_UNKNOWN</VT>
                    </COMPU-CONST>
                  </COMPU-SCALE>
                  <COMPU-SCALE>
                    <LOWER-LIMIT INTERVAL-TYPE="CLOSED">1</LOWER-LIMIT>
                    <UPPER-LIMIT INTERVAL-TYPE="CLOSED">1</UPPER-LIMIT>
                    <COMPU-CONST>
                      <VT>ECUM_CAUSE_ECU_STATE</VT>
                    </COMPU-CONST>
                  </COMPU-SCALE>
                  <COMPU-SCALE>
                    <LOWER-LIMIT INTERVAL-TYPE="CLOSED">2</LOWER-LIMIT>
                    <UPPER-LIMIT INTERVAL-TYPE="CLOSED">2</UPPER-LIMIT>
                    <COMPU-CONST>
                      <VT>ECUM_CAUSE_WDGM</VT>
                    </COMPU-CONST>
                  </COMPU-SCALE>
                  <COMPU-SCALE>
                    <LOWER-LIMIT INTERVAL-TYPE="CLOSED">3</LOWER-LIMIT>
                    <UPPER-LIMIT INTERVAL-TYPE="CLOSED">3</UPPER-LIMIT>
                    <COMPU-CONST>
                      <VT>ECUM_CAUSE_DCM</VT>
                    </COMPU-CONST>
                  </COMPU-SCALE>
                </COMPU-SCALES>
              </COMPU-INTERNAL-TO-PHYS>
            </COMPU-METHOD>
            <COMPU-METHOD>
              <SHORT-NAME>BOOTTARGET</SHORT-NAME>
              <CATEGORY>TEXTTABLE</CATEGORY>
              <COMPU-INTERNAL-TO-PHYS>
                <COMPU-SCALES>
                  <COMPU-SCALE>
                    <LOWER-LIMIT INTERVAL-TYPE="CLOSED">0</LOWER-LIMIT>
                    <UPPER-LIMIT INTERVAL-TYPE="CLOSED">0</UPPER-LIMIT>
                    <COMPU-CONST>
                      <VT>ECUM_BOOT_TARGET_APP</VT>
                    </COMPU-CONST>
                  </COMPU-SCALE>
                  <COMPU-SCALE>
                    <LOWER-LIMIT INTERVAL-TYPE="CLOSED">1</LOWER-LIMIT>
                    <UPPER-LIMIT INTERVAL-TYPE="CLOSED">1</UPPER-LIMIT>
                    <COMPU-CONST>
                      <VT>ECUM_BOOT_TARGET_OEM_BOOTLOADER</VT>
                    </COMPU-CONST>
                  </COMPU-SCALE>
                  <COMPU-SCALE>
                    <LOWER-LIMIT INTERVAL-TYPE="CLOSED">2</LOWER-LIMIT>
                    <UPPER-LIMIT INTERVAL-TYPE="CLOSED">2</UPPER-LIMIT>
                    <COMPU-CONST>
                      <!-- This deviates from the SWS which
                           mentions
                           ECUM_BOOT_TARGET_SYSTEM_SUPPLIER_BOOTLOADER.
                           http://www.autosar.org/bugzilla/show_bug.cgi?id=48892 -->
                      <VT>ECUM_BOOT_TARGET_SYS_BOOTLOADER</VT>
                    </COMPU-CONST>
                  </COMPU-SCALE>
                </COMPU-SCALES>
              </COMPU-INTERNAL-TO-PHYS>
            </COMPU-METHOD>
[!IF "node:exists(EcuMConfiguration/eb-list::*[1]/EcuMFixedConfiguration)"!][!//
            <COMPU-METHOD>
              <SHORT-NAME>USERTYPE</SHORT-NAME>
              <CATEGORY>TEXTTABLE</CATEGORY>
              <COMPU-INTERNAL-TO-PHYS>
                <COMPU-SCALES>
[!LOOP "EcuMConfiguration/eb-list::*[1]/EcuMFixedConfiguration/EcuMFixedUserConfig/eb-list::*"!][!//
                  <COMPU-SCALE>
                    <LOWER-LIMIT INTERVAL-TYPE="CLOSED">[!"node:value(EcuMFixedUser)"!]</LOWER-LIMIT>
                    <UPPER-LIMIT INTERVAL-TYPE="CLOSED">[!"node:value(EcuMFixedUser)"!]</UPPER-LIMIT>
                    <COMPU-CONST>
                      <VT>[!"as:name(.)"!]</VT>
                    </COMPU-CONST>
                  </COMPU-SCALE>
[!ENDLOOP!][!//
                </COMPU-SCALES>
              </COMPU-INTERNAL-TO-PHYS>
            </COMPU-METHOD>
[!ENDIF!][!//
          </ELEMENTS>
        </AR-PACKAGE>
        <AR-PACKAGE>
          <SHORT-NAME>ImplementationDataTypes</SHORT-NAME>
          <!--
            We use AUTOSAR 4.0.3 package name here since the AUTOSAR 4.0.3 SWC will look in this package
          -->
          <ELEMENTS>
            <INTEGER-TYPE>
              <SHORT-NAME>EcuM_StateType</SHORT-NAME>
              <CATEGORY>TYPE_REFERENCE</CATEGORY>
              <SW-DATA-DEF-PROPS>
                <BASE-TYPE-REF DEST="SW-BASE-TYPE">/AUTOSAR_PlatformTypes/BaseTypes/uint8</BASE-TYPE-REF>
                <COMPU-METHOD-REF DEST="COMPU-METHOD">/AUTOSAR_EcuM/CompuMethods/STATES</COMPU-METHOD-REF>
              </SW-DATA-DEF-PROPS>
              <LOWER-LIMIT INTERVAL-TYPE="CLOSED">16</LOWER-LIMIT>
              <UPPER-LIMIT INTERVAL-TYPE="CLOSED">144</UPPER-LIMIT>
            </INTEGER-TYPE>

            <!-- The definition of the data type 'EcuM_ShutdownCauseType' is not specified in
                 AUTOSAR R4.0r2 document "Specification of ECU State Manager" section 7.10.2.
                 But it is mapped to uint8 in reference with the argument description of the
                 API EcuM_SelectShutdownCause().
                 http://www.autosar.org/bugzilla/show_bug.cgi?id=49743 -->
            <INTEGER-TYPE>
              <SHORT-NAME>EcuM_ShutdownCauseType</SHORT-NAME>
              <CATEGORY>TYPE_REFERENCE</CATEGORY>
              <SW-DATA-DEF-PROPS>
                <BASE-TYPE-REF DEST="SW-BASE-TYPE">/AUTOSAR_PlatformTypes/BaseTypes/uint8</BASE-TYPE-REF>
                <COMPU-METHOD-REF DEST="COMPU-METHOD">/AUTOSAR_EcuM/CompuMethods/SHUTDOWNCAUSE</COMPU-METHOD-REF>
              </SW-DATA-DEF-PROPS>
              <LOWER-LIMIT INTERVAL-TYPE="CLOSED">0</LOWER-LIMIT>
              <UPPER-LIMIT INTERVAL-TYPE="CLOSED">255</UPPER-LIMIT>
            </INTEGER-TYPE>

            <INTEGER-TYPE>
              <SHORT-NAME>EcuM_BootTargetType</SHORT-NAME>
              <CATEGORY>TYPE_REFERENCE</CATEGORY>
              <SW-DATA-DEF-PROPS>
                <BASE-TYPE-REF DEST="SW-BASE-TYPE">/AUTOSAR_PlatformTypes/BaseTypes/uint8</BASE-TYPE-REF>
                <COMPU-METHOD-REF DEST="COMPU-METHOD">/AUTOSAR_EcuM/CompuMethods/BOOTTARGET</COMPU-METHOD-REF>
              </SW-DATA-DEF-PROPS>
              <LOWER-LIMIT INTERVAL-TYPE="CLOSED">0</LOWER-LIMIT>
              <UPPER-LIMIT INTERVAL-TYPE="CLOSED">2</UPPER-LIMIT>
            </INTEGER-TYPE>
[!IF "node:exists(EcuMConfiguration/eb-list::*[1]/EcuMFixedConfiguration)"!][!//
            <INTEGER-TYPE>
              <SHORT-NAME>EcuM_UserType</SHORT-NAME>
              <CATEGORY>TYPE_REFERENCE</CATEGORY>
              <SW-DATA-DEF-PROPS>
                <BASE-TYPE-REF DEST="SW-BASE-TYPE">/AUTOSAR_PlatformTypes/BaseTypes/uint8</BASE-TYPE-REF>
                <COMPU-METHOD-REF DEST="COMPU-METHOD">/AUTOSAR_EcuM/CompuMethods/USERTYPE</COMPU-METHOD-REF>
              </SW-DATA-DEF-PROPS>
              <LOWER-LIMIT INTERVAL-TYPE="CLOSED">0</LOWER-LIMIT>
              <UPPER-LIMIT INTERVAL-TYPE="CLOSED">255</UPPER-LIMIT>
            </INTEGER-TYPE>
[!ENDIF!][!//
          </ELEMENTS>
        </AR-PACKAGE>
        <AR-PACKAGE>
          <SHORT-NAME>ModeDeclarationGroups</SHORT-NAME>
          <ELEMENTS>
[!IF "node:exists(EcuMConfiguration/eb-list::*[1]/EcuMFixedConfiguration)"!][!//
            <MODE-DECLARATION-GROUP>
              <SHORT-NAME>EcuM_Mode</SHORT-NAME>
              <INITIAL-MODE-REF DEST="MODE-DECLARATION">/AUTOSAR_EcuM/ModeDeclarationGroups/EcuM_Mode/STARTUP</INITIAL-MODE-REF>
              <MODE-DECLARATIONS>
                <MODE-DECLARATION>
                  <SHORT-NAME>STARTUP</SHORT-NAME>
                </MODE-DECLARATION>
                <MODE-DECLARATION>
                  <SHORT-NAME>RUN</SHORT-NAME>
                </MODE-DECLARATION>
                <MODE-DECLARATION>
                  <SHORT-NAME>POST_RUN</SHORT-NAME>
                </MODE-DECLARATION>
                <MODE-DECLARATION>
                  <SHORT-NAME>SLEEP</SHORT-NAME>
                </MODE-DECLARATION>
                <MODE-DECLARATION>
                  <SHORT-NAME>WAKE_SLEEP</SHORT-NAME>
                </MODE-DECLARATION>
                <MODE-DECLARATION>
                  <SHORT-NAME>SHUTDOWN</SHORT-NAME>
                </MODE-DECLARATION>
              </MODE-DECLARATIONS>
            </MODE-DECLARATION-GROUP>
[!ENDIF!][!//
          </ELEMENTS>
        </AR-PACKAGE>
        <AR-PACKAGE>
          <SHORT-NAME>PortInterfaces</SHORT-NAME>
          <ELEMENTS>
[!IF "node:exists(EcuMConfiguration/eb-list::*[1]/EcuMFixedConfiguration)"!][!//
            <CLIENT-SERVER-INTERFACE>
              <SHORT-NAME>EcuM_StateRequest</SHORT-NAME>
              <IS-SERVICE>true</IS-SERVICE>
              <OPERATIONS>
                <OPERATION-PROTOTYPE>
                  <SHORT-NAME>RequestRUN</SHORT-NAME>
                  <POSSIBLE-ERROR-REFS>
                    <POSSIBLE-ERROR-REF DEST="APPLICATION-ERROR">/AUTOSAR_EcuM/PortInterfaces/EcuM_StateRequest/E_NOT_OK</POSSIBLE-ERROR-REF>
                  </POSSIBLE-ERROR-REFS>
                </OPERATION-PROTOTYPE>
                <OPERATION-PROTOTYPE>
                  <SHORT-NAME>ReleaseRUN</SHORT-NAME>
                  <POSSIBLE-ERROR-REFS>
                    <POSSIBLE-ERROR-REF DEST="APPLICATION-ERROR">/AUTOSAR_EcuM/PortInterfaces/EcuM_StateRequest/E_NOT_OK</POSSIBLE-ERROR-REF>
                  </POSSIBLE-ERROR-REFS>
                </OPERATION-PROTOTYPE>
                <OPERATION-PROTOTYPE>
                  <SHORT-NAME>RequestPOSTRUN</SHORT-NAME>
                  <POSSIBLE-ERROR-REFS>
                    <POSSIBLE-ERROR-REF DEST="APPLICATION-ERROR">/AUTOSAR_EcuM/PortInterfaces/EcuM_StateRequest/E_NOT_OK</POSSIBLE-ERROR-REF>
                  </POSSIBLE-ERROR-REFS>
                </OPERATION-PROTOTYPE>
                <OPERATION-PROTOTYPE>
                  <SHORT-NAME>ReleasePOSTRUN</SHORT-NAME>
                  <POSSIBLE-ERROR-REFS>
                    <POSSIBLE-ERROR-REF DEST="APPLICATION-ERROR">/AUTOSAR_EcuM/PortInterfaces/EcuM_StateRequest/E_NOT_OK</POSSIBLE-ERROR-REF>
                  </POSSIBLE-ERROR-REFS>
                </OPERATION-PROTOTYPE>
              </OPERATIONS>
              <POSSIBLE-ERRORS>
                <APPLICATION-ERROR>
                  <SHORT-NAME>E_NOT_OK</SHORT-NAME>
                  <ERROR-CODE>1</ERROR-CODE>
                </APPLICATION-ERROR>
              </POSSIBLE-ERRORS>
            </CLIENT-SERVER-INTERFACE>

            <SENDER-RECEIVER-INTERFACE>
              <SHORT-NAME>EcuM_CurrentMode</SHORT-NAME>
              <IS-SERVICE>true</IS-SERVICE>
              <DATA-ELEMENTS />
              <MODE-GROUPS>
                <MODE-DECLARATION-GROUP-PROTOTYPE>
                  <SHORT-NAME>currentMode</SHORT-NAME>
                  <TYPE-TREF DEST="MODE-DECLARATION-GROUP">/AUTOSAR_EcuM/ModeDeclarationGroups/EcuM_Mode</TYPE-TREF>
                </MODE-DECLARATION-GROUP-PROTOTYPE>
              </MODE-GROUPS>
            </SENDER-RECEIVER-INTERFACE>
[!ENDIF!][!//
            <CLIENT-SERVER-INTERFACE>
              <SHORT-NAME>EcuM_ShutdownTarget</SHORT-NAME>
              <IS-SERVICE>true</IS-SERVICE>
              <OPERATIONS>

                <OPERATION-PROTOTYPE>
                  <SHORT-NAME>SelectShutdownTarget</SHORT-NAME>
                  <ARGUMENTS>
                    <ARGUMENT-PROTOTYPE>
                      <SHORT-NAME>target</SHORT-NAME>
                      <TYPE-TREF DEST="INTEGER-TYPE">/AUTOSAR_EcuM/ImplementationDataTypes/EcuM_StateType</TYPE-TREF>
                      <DIRECTION>IN</DIRECTION>
                    </ARGUMENT-PROTOTYPE>
                    <ARGUMENT-PROTOTYPE>
                      <SHORT-NAME>mode</SHORT-NAME>
                      <TYPE-TREF DEST="INTEGER-TYPE">/AUTOSAR_PlatformTypes/Datatypes/uint8</TYPE-TREF>
                      <DIRECTION>IN</DIRECTION>
                    </ARGUMENT-PROTOTYPE>
                  </ARGUMENTS>
                  <POSSIBLE-ERROR-REFS>
                    <POSSIBLE-ERROR-REF DEST="APPLICATION-ERROR">/AUTOSAR_EcuM/PortInterfaces/EcuM_ShutdownTarget/E_NOT_OK</POSSIBLE-ERROR-REF>
                  </POSSIBLE-ERROR-REFS>
                </OPERATION-PROTOTYPE>

                <OPERATION-PROTOTYPE>
                  <SHORT-NAME>GetShutdownTarget</SHORT-NAME>
                  <ARGUMENTS>
                    <ARGUMENT-PROTOTYPE>
                      <SHORT-NAME>target</SHORT-NAME>
                      <TYPE-TREF DEST="INTEGER-TYPE">/AUTOSAR_EcuM/ImplementationDataTypes/EcuM_StateType</TYPE-TREF>
                      <DIRECTION>OUT</DIRECTION>
                    </ARGUMENT-PROTOTYPE>
                    <ARGUMENT-PROTOTYPE>
                      <SHORT-NAME>mode</SHORT-NAME>
                      <TYPE-TREF DEST="INTEGER-TYPE">/AUTOSAR_PlatformTypes/Datatypes/uint8</TYPE-TREF>
                      <DIRECTION>OUT</DIRECTION>
                    </ARGUMENT-PROTOTYPE>
                  </ARGUMENTS>
                  <POSSIBLE-ERROR-REFS>
                    <POSSIBLE-ERROR-REF DEST="APPLICATION-ERROR">/AUTOSAR_EcuM/PortInterfaces/EcuM_ShutdownTarget/E_NOT_OK</POSSIBLE-ERROR-REF>
                  </POSSIBLE-ERROR-REFS>
                </OPERATION-PROTOTYPE>

                <OPERATION-PROTOTYPE>
                  <SHORT-NAME>GetLastShutdownTarget</SHORT-NAME>
                  <ARGUMENTS>
                    <ARGUMENT-PROTOTYPE>
                      <SHORT-NAME>target</SHORT-NAME>
                      <TYPE-TREF DEST="INTEGER-TYPE">/AUTOSAR_EcuM/ImplementationDataTypes/EcuM_StateType</TYPE-TREF>
                      <DIRECTION>OUT</DIRECTION>
                    </ARGUMENT-PROTOTYPE>
                    <ARGUMENT-PROTOTYPE>
                      <SHORT-NAME>mode</SHORT-NAME>
                      <TYPE-TREF DEST="INTEGER-TYPE">/AUTOSAR_PlatformTypes/Datatypes/uint8</TYPE-TREF>
                      <DIRECTION>OUT</DIRECTION>
                    </ARGUMENT-PROTOTYPE>
                  </ARGUMENTS>
                  <POSSIBLE-ERROR-REFS>
                    <POSSIBLE-ERROR-REF DEST="APPLICATION-ERROR">/AUTOSAR_EcuM/PortInterfaces/EcuM_ShutdownTarget/E_NOT_OK</POSSIBLE-ERROR-REF>
                  </POSSIBLE-ERROR-REFS>
                </OPERATION-PROTOTYPE>

                <!-- shutdown cause -->
                <OPERATION-PROTOTYPE>
                  <SHORT-NAME>SelectShutdownCause</SHORT-NAME>
                  <ARGUMENTS>
                    <ARGUMENT-PROTOTYPE>
                      <SHORT-NAME>target</SHORT-NAME>
                      <TYPE-TREF DEST="INTEGER-TYPE">/AUTOSAR_EcuM/ImplementationDataTypes/EcuM_ShutdownCauseType</TYPE-TREF>
                      <DIRECTION>IN</DIRECTION>
                    </ARGUMENT-PROTOTYPE>
                  </ARGUMENTS>
                  <POSSIBLE-ERROR-REFS>
                    <POSSIBLE-ERROR-REF DEST="APPLICATION-ERROR">/AUTOSAR_EcuM/PortInterfaces/EcuM_ShutdownTarget/E_NOT_OK</POSSIBLE-ERROR-REF>
                  </POSSIBLE-ERROR-REFS>
                </OPERATION-PROTOTYPE>

                <OPERATION-PROTOTYPE>
                  <SHORT-NAME>GetShutdownCause</SHORT-NAME>
                  <ARGUMENTS>
                    <ARGUMENT-PROTOTYPE>
                      <SHORT-NAME>target</SHORT-NAME>
                      <TYPE-TREF DEST="INTEGER-TYPE">/AUTOSAR_EcuM/ImplementationDataTypes/EcuM_ShutdownCauseType</TYPE-TREF>
                      <DIRECTION>OUT</DIRECTION>
                    </ARGUMENT-PROTOTYPE>
                  </ARGUMENTS>
                  <POSSIBLE-ERROR-REFS>
                    <POSSIBLE-ERROR-REF DEST="APPLICATION-ERROR">/AUTOSAR_EcuM/PortInterfaces/EcuM_ShutdownTarget/E_NOT_OK</POSSIBLE-ERROR-REF>
                  </POSSIBLE-ERROR-REFS>
                </OPERATION-PROTOTYPE>

                <OPERATION-PROTOTYPE>
                  <SHORT-NAME>GetMostRecentShutdown</SHORT-NAME>
                  <ARGUMENTS>
                    <ARGUMENT-PROTOTYPE>
                      <SHORT-NAME>target</SHORT-NAME>
                      <TYPE-TREF DEST="INTEGER-TYPE">/AUTOSAR_EcuM/ImplementationDataTypes/EcuM_StateType</TYPE-TREF>
                      <DIRECTION>OUT</DIRECTION>
                    </ARGUMENT-PROTOTYPE>

                    <ARGUMENT-PROTOTYPE>
                      <SHORT-NAME>mode</SHORT-NAME>
                      <TYPE-TREF DEST="INTEGER-TYPE">/AUTOSAR_PlatformTypes/Datatypes/uint8</TYPE-TREF>
                      <DIRECTION>OUT</DIRECTION>
                    </ARGUMENT-PROTOTYPE>

                    <ARGUMENT-PROTOTYPE>
                      <SHORT-NAME>cause</SHORT-NAME>
                      <TYPE-TREF DEST="INTEGER-TYPE">/AUTOSAR_EcuM/ImplementationDataTypes/EcuM_ShutdownCauseType</TYPE-TREF>
                      <DIRECTION>OUT</DIRECTION>
                    </ARGUMENT-PROTOTYPE>

                    <ARGUMENT-PROTOTYPE>
                      <SHORT-NAME>time</SHORT-NAME>
                      <TYPE-TREF DEST="INTEGER-TYPE">/AUTOSAR_PlatformTypes/Datatypes/uint32</TYPE-TREF>
                      <DIRECTION>OUT</DIRECTION>
                    </ARGUMENT-PROTOTYPE>
                  </ARGUMENTS>
                  <POSSIBLE-ERROR-REFS>
                    <POSSIBLE-ERROR-REF DEST="APPLICATION-ERROR">/AUTOSAR_EcuM/PortInterfaces/EcuM_ShutdownTarget/E_NOT_OK</POSSIBLE-ERROR-REF>
                  </POSSIBLE-ERROR-REFS>
                </OPERATION-PROTOTYPE>

                <OPERATION-PROTOTYPE>
                  <SHORT-NAME>GetNextRecentShutdown</SHORT-NAME>
                  <ARGUMENTS>
                    <ARGUMENT-PROTOTYPE>
                      <SHORT-NAME>target</SHORT-NAME>
                      <TYPE-TREF DEST="INTEGER-TYPE">/AUTOSAR_EcuM/ImplementationDataTypes/EcuM_StateType</TYPE-TREF>
                      <DIRECTION>OUT</DIRECTION>
                    </ARGUMENT-PROTOTYPE>

                    <ARGUMENT-PROTOTYPE>
                      <SHORT-NAME>mode</SHORT-NAME>
                      <TYPE-TREF DEST="INTEGER-TYPE">/AUTOSAR_PlatformTypes/Datatypes/uint8</TYPE-TREF>
                      <DIRECTION>OUT</DIRECTION>
                    </ARGUMENT-PROTOTYPE>

                    <ARGUMENT-PROTOTYPE>
                      <SHORT-NAME>cause</SHORT-NAME>
                      <TYPE-TREF DEST="INTEGER-TYPE">/AUTOSAR_EcuM/ImplementationDataTypes/EcuM_ShutdownCauseType</TYPE-TREF>
                      <DIRECTION>OUT</DIRECTION>
                    </ARGUMENT-PROTOTYPE>

                    <ARGUMENT-PROTOTYPE>
                      <SHORT-NAME>time</SHORT-NAME>
                      <TYPE-TREF DEST="INTEGER-TYPE">/AUTOSAR_PlatformTypes/Datatypes/uint32</TYPE-TREF>
                      <DIRECTION>OUT</DIRECTION>
                    </ARGUMENT-PROTOTYPE>
                  </ARGUMENTS>
                  <POSSIBLE-ERROR-REFS>
                    <POSSIBLE-ERROR-REF DEST="APPLICATION-ERROR">/AUTOSAR_EcuM/PortInterfaces/EcuM_ShutdownTarget/E_NOT_OK</POSSIBLE-ERROR-REF>
                  </POSSIBLE-ERROR-REFS>
                </OPERATION-PROTOTYPE>

              </OPERATIONS>
              <POSSIBLE-ERRORS>
                <APPLICATION-ERROR>
                  <SHORT-NAME>E_NOT_OK</SHORT-NAME>
                  <ERROR-CODE>1</ERROR-CODE>
                </APPLICATION-ERROR>
              </POSSIBLE-ERRORS>
            </CLIENT-SERVER-INTERFACE>

            <CLIENT-SERVER-INTERFACE>
              <SHORT-NAME>EcuM_BootTarget</SHORT-NAME>
              <IS-SERVICE>true</IS-SERVICE>
              <OPERATIONS>
                <OPERATION-PROTOTYPE>
                  <SHORT-NAME>SelectBootTarget</SHORT-NAME>
                  <ARGUMENTS>
                    <ARGUMENT-PROTOTYPE>
                      <SHORT-NAME>target</SHORT-NAME>
                      <TYPE-TREF DEST="INTEGER-TYPE">/AUTOSAR_EcuM/ImplementationDataTypes/EcuM_BootTargetType</TYPE-TREF>
                      <DIRECTION>IN</DIRECTION>
                    </ARGUMENT-PROTOTYPE>
                  </ARGUMENTS>
                  <POSSIBLE-ERROR-REFS>
                    <POSSIBLE-ERROR-REF DEST="APPLICATION-ERROR">/AUTOSAR_EcuM/PortInterfaces/EcuM_BootTarget/E_NOT_OK</POSSIBLE-ERROR-REF>
                  </POSSIBLE-ERROR-REFS>
                </OPERATION-PROTOTYPE>
                <OPERATION-PROTOTYPE>
                  <SHORT-NAME>GetBootTarget</SHORT-NAME>
                  <ARGUMENTS>
                    <ARGUMENT-PROTOTYPE>
                      <SHORT-NAME>target</SHORT-NAME>
                      <TYPE-TREF DEST="INTEGER-TYPE">/AUTOSAR_EcuM/ImplementationDataTypes/EcuM_BootTargetType</TYPE-TREF>
                      <DIRECTION>OUT</DIRECTION>
                    </ARGUMENT-PROTOTYPE>
                  </ARGUMENTS>
                  <POSSIBLE-ERROR-REFS>
                    <POSSIBLE-ERROR-REF DEST="APPLICATION-ERROR">/AUTOSAR_EcuM/PortInterfaces/EcuM_BootTarget/E_NOT_OK</POSSIBLE-ERROR-REF>
                  </POSSIBLE-ERROR-REFS>
                </OPERATION-PROTOTYPE>
              </OPERATIONS>
              <POSSIBLE-ERRORS>
                <APPLICATION-ERROR>
                  <SHORT-NAME>E_NOT_OK</SHORT-NAME>
                  <ERROR-CODE>1</ERROR-CODE>
                </APPLICATION-ERROR>
              </POSSIBLE-ERRORS>
            </CLIENT-SERVER-INTERFACE>
          </ELEMENTS>
        </AR-PACKAGE>

[!ENDIF!][!//
      </SUB-PACKAGES>
    </AR-PACKAGE>
  </TOP-LEVEL-PACKAGES>
</AUTOSAR>
