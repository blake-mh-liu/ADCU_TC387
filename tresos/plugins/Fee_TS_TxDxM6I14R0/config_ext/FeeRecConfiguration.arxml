AUTOSAR XML (schema 00046)
package /TS_TxDxM6I14R0
  module config FeeRecConfiguration: definition=Fee
    FeeBlockConfiguration_0 (FeeBlockConfiguration): FeeBlockNumber=16, FeeImmediateData=1, FeeBlockSize=4
    FeeBlockConfiguration_1 (FeeBlockConfiguration): FeeBlockNumber=17, FeeImmediateData=1, FeeBlockSize=4
