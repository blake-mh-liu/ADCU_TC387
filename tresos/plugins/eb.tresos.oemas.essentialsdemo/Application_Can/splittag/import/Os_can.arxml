AUTOSAR XML (schema 4-3-0)
package /Os
  module config Os
    OsApp_Qm (OsApplication): OsAppIsrRef=CANSR0_ISR, OsAppIsrRef=CANSR4_ISR, OsAppIsrRef=CANSR8_ISR
    3 x OsIsr, all with OsIsrCategory=CATEGORY_2, OsStacksize=512, OsTricoreIrqLevel=8:
      CANSR0_ISR: OsTricoreVector=CANINT0
      CANSR4_ISR: OsTricoreVector=CANINT4
      CANSR8_ISR: OsTricoreVector=CANINT8
