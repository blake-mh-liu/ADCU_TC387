AUTOSAR XML (schema 4-3-0)
package /NvM
  module config NvM
    6 x NvMBlockDescriptor:
      NvMBlock_ConfigID: NvMBlockJobPriority=1, NvMSelectBlockForReadAll=0, NvMSelectBlockForWriteAll=0
        NvMTargetBlockReference
          NvMTargetBlockReference (NvMFeeRef)
      PersistentCounterValue: NvMBlockJobPriority=64, NvMNvBlockLength=1, NvMProvideRteServicePort=1, NvMRomBlockNum=1, NvMSelectBlockForReadAll=1, NvMSelectBlockForWriteAll=1, NvMRamBlockDataAddress=&Demo_CyclicCounter_Ram_Block, NvMRomBlockDataAddress=&Demo_CyclicCounter_Rom_Block
        NvMTargetBlockReference
          NvMTargetBlockReference (NvMFeeRef)
      NVM_BLOCK_DEM_PRIMARY: NvMBlockCrcType=NVM_CRC32, NvMBlockJobPriority=1, NvMBlockManagementType=NVM_BLOCK_DATASET, NvMBlockUseCrc=1, NvMExtraBlockChecks=1, NvMNvBlockNum=2, NvMRamBlockDataAddress=&Dem_NvGateEntryPrimaryData, NvMRomBlockNum=0, NvMSelectBlockForReadAll=0, NvMSelectBlockForWriteAll=0, NvMSingleBlockCallback=Dem_NvMGateEntryPrimaryBlockCallback
        NvMTargetBlockReference
          NvMTargetBlockReference (NvMFeeRef)
      NVM_BLOCK_DEM_DEFAULT: NvMBlockCrcType=NVM_CRC32, NvMBlockJobPriority=64, NvMBlockUseCrc=1, NvMBlockUseSyncMechanism=1, NvMExtraBlockChecks=1, NvMRamBlockDataAddress=&Dem_NvData, NvMReadRamBlockFromNvCallback=Dem_NvMReadCopyEventStatusBlock, NvMSelectBlockForReadAll=1, NvMSelectBlockForWriteAll=1, NvMSingleBlockCallback=Dem_NvMEventStatusBlockCallback, NvMWriteRamBlockToNvCallback=Dem_NvMWriteCopyEventStatusBlock
        NvMTargetBlockReference
          NvMTargetBlockReference (NvMFeeRef)
      NVM_BLOCK_DCM_ROE: NvMBlockJobPriority=1, NvMExtraBlockChecks=1, NvMNvBlockLength=16, NvMRamBlockDataAddress=&Dcm_Dsl_RoeServices_Persistent_Data, NvMSelectBlockForReadAll=1, NvMSelectBlockForWriteAll=1
        NvMTargetBlockReference
          NvMTargetBlockReference (NvMFeeRef)
      NVM_BLOCK_DCM_NvM_Dummy: NvMBlockJobPriority=1, NvMNvBlockLength=17, NvMRomBlockDataAddress=&DidF190_DefaultData, NvMRomBlockNum=1
        NvMTargetBlockReference
          NvMTargetBlockReference (NvMFeeRef)
    NvMCommon: NvMBswMMultiBlockJobStatusInformation=0, NvMRteUsage=1, NvMSizeImmediateJobQueue=1, NvMUserHeader=Eb_Intgr_NvM_Include.h
