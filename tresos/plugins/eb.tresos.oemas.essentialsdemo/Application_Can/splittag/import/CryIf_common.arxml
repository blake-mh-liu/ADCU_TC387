AUTOSAR XML (schema 4-3-0)
package /CryIf
  module config CryIf
    CryIfGeneral: CryIfDevErrorDetect=1
    CryIfEbGeneral
      CryIfEbMisc: CryIfEbAutosarApiVersion=CRYIF_API_VERSION_EB
    CryIfChannel_Crypto (CryIfChannel): CryIfDriverObjectRef=CryptoDriverObject_Software
    CryIfKey_Pdu_SecuredOut_T (CryIfKey): CryIfKeyId=0, CryIfKeyRef=CryptoKey_Pdu_SecuredOut_T
    CryIfKey_Pdu_SecuredIn_R (CryIfKey): CryIfKeyId=1, CryIfKeyRef=CryptoKey_Pdu_SecuredIn_R
