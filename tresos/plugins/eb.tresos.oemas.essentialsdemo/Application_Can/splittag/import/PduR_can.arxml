AUTOSAR XML (schema 4-3-0)
package /PduR
  module config PduR
    4 x PduRBswModules:
      CanNm: PduRCommunicationInterface=1, PduRLowerModule=1, PduRTriggertransmit=1, PduRTxConfirmation=1
      CanTp: PduRChangeParameterRequestApi=0
      IpduM: PduRBswModuleIsEnabled=0
      SecOC: PduRCommunicationInterface=1, PduRLowerModule=1, PduRTxConfirmation=1, PduRUpperModule=1
    PduRRoutingTables
      PduRRoutingTable
        Pdu_SecuredOut_277T (PduRRoutingPath)
          Pdu_SecuredOut_277T_S (PduRSrcPdu): PduRSourcePduHandleId=0
        Pdu_SecuredPayloadIn_261R (PduRRoutingPath)
          Pdu_SecuredPayloadIn_261R_S (PduRSrcPdu): PduRSourcePduHandleId=0
