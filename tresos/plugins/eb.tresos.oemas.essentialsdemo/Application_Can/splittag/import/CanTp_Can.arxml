AUTOSAR XML (schema 4-3-0)
package /CanTp
  module config CanTp
    CanTpGeneral: CanTpCancelReceiveApi=1, CanTpCancelTransmitApi=1, CanTpFlexibleDataRateSupport=1, CanTpMaxRxNSdus=20
