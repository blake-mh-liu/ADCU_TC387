AUTOSAR XML (schema 4-3-0)
package /ComM
  module config ComM
    ComMGeneral:
      ComMPncPrepareSleepTimer = 0.64
      ComMPncReleaseChannel = COMM_NO_INTERNAL_AND_EXTERNAL_REQUESTS
      ComMPncSupport = 1
      ComMRteUsage = 1
      ComMSynchronousWakeUp = 0
