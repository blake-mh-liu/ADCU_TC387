AUTOSAR XML (schema 4-3-0)
package /Dcm
  module config Dcm
    DcmConfigSet
      DcmDsd
        DcmDsdServiceTable
          3 x DcmDsdService, all with DcmDsdSidTabSessionLevelRef=Default, DcmDsdSidTabSessionLevelRef=Extended:
            DiagnosticReadDTCInformation
            DiagnosticResponseOnEvent: DcmDsdSidTabServiceId=134
              3 x DcmDsdSubService, all with DcmDsdSubServiceSessionLevelRef=Default, DcmDsdSubServiceSessionLevelRef=Extended:
                DcmDsdSubService_0x4: DcmDsdSubServiceId=4
                DcmDsdSubService_0x40: DcmDsdSubServiceId=64
                DcmDsdSubService_0x45: DcmDsdSubServiceId=69
            DiagnosticTesterPresent: DcmDsdSidTabServiceId=62
              DcmDsdSubService_0 (DcmDsdSubService): DcmDsdSubServiceSessionLevelRef=Default, DcmDsdSubServiceSessionLevelRef=Extended
      DcmDsl
        DcmDslServiceRequestManufacturerNotification_0 (DcmDslServiceRequestManufacturerNotification)
        DcmDslServiceRequestSupplierNotification_0 (DcmDslServiceRequestSupplierNotification)
        3 x DcmDslBuffer, all with DcmDslBufferSize=1024:
          DcmDslBuffer
          DcmDslBufferFunc
          DcmDslBufferTx
        DcmDslDiagResp: DcmDslDiagRespMaxNumRespPend=2
        DcmDslProtocol
          DcmDsdServiceTable (DcmDslProtocolRow): DcmDemClientRef=CLIENT_0, DcmDslProtocolTxBufferID=DcmDslBufferTx
      DcmDsp: DcmDspPowerDownTime=255, DcmDspSessionControlTiming=1
        DcmDspComControl
          DcmDspComControlAllChannel_0 (DcmDspComControlAllChannel)
        NvM_Dummy (DcmDspData): DcmDspDataUsePort=USE_BLOCK_ID, DcmDspDataBlockIdRef=NVM_BLOCK_DCM_NvM_Dummy
        Session (DcmDspData): DcmDspDataConditionCheckReadFncUsed=0, DcmDspDataReadFnc=Dcm_Internalf186Readout, DcmDspDataUsePort=USE_DATA_SYNCH_FNC
        DcmDspRoe: DcmDspRoeInterMessageTime=1.0, DcmDspRoeBlockIdRef=NVM_BLOCK_DCM_ROE
          DcmDspRoeEvent: DcmDspRoeEventId=0, DcmDspRoeInitialEventStatus=DCM_ROE_STOPPED
            DcmDspRoeEventProperties
              DcmDspRoeEventProperties (DcmDspRoeOnChangeOfDataIdentifier): DcmDspRoeDidRef=DcmDspDid_ActiveDiagnosticInformation
          DcmDspRoeEventWindowTime: DcmDspRoeEventWindowTime=DCM_ROE_EVENT_WINDOW_INFINITE, DcmDspRoeStorageState=1
        DcmDspSecurity
          Level_1 (DcmDspSecurityRow): DcmDspSecurityUsePort=USE_SECURITY_ASYNCH_CLIENT_SERVER
          Level_3 (DcmDspSecurityRow): DcmDspSecurityUsePort=USE_SECURITY_ASYNCH_CLIENT_SERVER
      DcmGeneral: DcmModeDeclarationSupport=1, DcmNRCPolicyISOVersion=ISO14229_2013
        DcmServiceAPI: DcmDefaultASRServiceAPI=AUTOSAR_42
