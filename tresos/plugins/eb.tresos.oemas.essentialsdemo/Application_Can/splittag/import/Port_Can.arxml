AUTOSAR XML (schema 4-3-0)
package /Port
  module config Port: implementation-config-variant=VARIANT-POST-BUILD-SELECTABLE
    PortConfigSet_0 (PortConfigSet)
      3 x PortContainer:
        PortContainer_2
          PortPin_0 (PortPin): PortPinMode=PORT_PIN_MODE_ALL, PortPinModeChangeable=1
          PortPin_4 (PortPin): PortPinMode=PORT_PIN_MODE_ALL, PortPinModeChangeable=1
        PortContainer_9
          PortPin_6 (PortPin): PortPinDirection=PORT_PIN_OUT, PortPinInitialMode=PORT_PIN_MODE_ALT5, PortPinModeChangeable=1
        PortContainer_14
          PortPin_6 (PortPin): PortPinDirection=PORT_PIN_OUT, PortPinModeChangeable=1
