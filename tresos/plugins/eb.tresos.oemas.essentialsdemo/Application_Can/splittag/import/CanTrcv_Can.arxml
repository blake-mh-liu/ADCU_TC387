AUTOSAR XML (schema 4-3-0)
package /CanTrcv
  module config CanTrcv: implementation-config-variant=VARIANT-PRE-COMPILE
    CanTrcvConfigSet_0 (CanTrcvConfigSet)
      CanTrcvChannel_0 (CanTrcvChannel): CanTrcvChannelId=0, CanTrcvMaxBaudrate=500, CanTrcvWakeupByBusUsed=1, CanTrcvWakeupSourceRef=ECUM_WKSOURCE_CAN
    CanTrcvGeneral: CanTrcvDevErrorDetect=1, CanTrcvWakeUpSupport=CANTRCV_WAKEUP_BY_POLLING
