AUTOSAR XML (schema 4-3-0)
package /EcuM
  module config EcuM: implementation-config-variant=VARIANT-POST-BUILD
    EcuM_Config_0 (EcuMConfiguration)
      EcuMCommonConfiguration
        EcuMSleepMode_0 (EcuMSleepMode): EcuMSleepModeMcuModeRef=McuModeSettingConf_0
      EcuMFlexConfiguration: EcuMFlexModuleConfigurationRef=McuModuleConfiguration_0, EcuMNormalMcuModeRef=McuModeSettingConf_0
