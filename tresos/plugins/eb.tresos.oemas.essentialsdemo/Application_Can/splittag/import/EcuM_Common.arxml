AUTOSAR XML (schema 4-3-0)
package /EcuM
  module config EcuM
    EcuM_Config_0 (EcuMConfiguration)
      EcuMCommonConfiguration: EcuMDefaultAppMode=OSDEFAULTAPPMODE
        EcuMDriverInitListOne
          4 x EcuMDriverInitItem, all with EcuMModuleService=Init:
            Eb_Intgr_McuArchClockInit: EcuMEnableVendorApiInfix=0, EcuMModuleHeaderFile=Eb_Intgr_McuArchClockInit, EcuMModuleID=Eb_Intgr_McuArchClockInit
            Mcu_Init: EcuMEnableVendorApiInfix=0, EcuMModuleHeaderFile=Mcu, EcuMModuleID=Mcu, EcuMModuleInitConfigStr=BASE_MCU_CONFIG_PTR
            PbcfgM_Init: EcuMEnableVendorApiInfix=0, EcuMModuleHeaderFile=PbcfgM, EcuMModuleID=PbcfgM, EcuMModuleInitConfigStr=BASE_PBCFGM_CONFIG_PTR
            Wdg_Init: EcuMModuleID=Wdg, EcuMModuleInitConfigStr=NULL_PTR
        EcuMSleepMode_0 (EcuMSleepMode):
          EcuMWakeupSourceMask = ECUM_WKSOURCE_EXTERNAL_WDG
          EcuMWakeupSourceMask = ECUM_WKSOURCE_INTERNAL_RESET
          EcuMWakeupSourceMask = ECUM_WKSOURCE_INTERNAL_WDG
          EcuMWakeupSourceMask = ECUM_WKSOURCE_POWER
          EcuMWakeupSourceMask = ECUM_WKSOURCE_RESET
        5 x EcuMWakeupSource:
          ECUM_WKSOURCE_POWER: EcuMWakeupSourceId=0, EcuMResetReasonRef=MCU_POWER_ON_RESET
          ECUM_WKSOURCE_RESET: EcuMWakeupSourceId=1, EcuMResetReasonRef=MCU_RESET_UNDEFINED
          ECUM_WKSOURCE_INTERNAL_RESET: EcuMWakeupSourceId=2, EcuMResetReasonRef=MCU_RESET_UNDEFINED
          ECUM_WKSOURCE_INTERNAL_WDG: EcuMWakeupSourceId=3
          ECUM_WKSOURCE_EXTERNAL_WDG: EcuMWakeupSourceId=4, EcuMResetReasonRef=MCU_RESET_UNDEFINED
      EcuMFlexConfiguration: EcuMNormalMcuModeRef=McuModeSettingConf_0
        3 x EcuMFlexUserConfig:
          EcuMFlexUser_BswM
          EcuMFlexUser_SchM
          EcuMFlexUser_ComM
        3 x EcuMResetMode:
          ECUM_RESET_MCU
          ECUM_RESET_WDG
          ECUM_RESET_IO
        4 x EcuMShutdownCause:
          ECUM_CAUSE_UNKNOWN
          ECUM_CAUSE_ECU_STATE
          ECUM_CAUSE_WDGM
          ECUM_CAUSE_DCM
        3 x EcuMShutdownTarget:
          ECUM_STATE_SLEEP: EcuMShutdownTargetId=80
          ECUM_STATE_OFF: EcuMShutdownTargetId=128
          ECUM_STATE_RESET: EcuMShutdownTargetId=144
    EcuMGeneral: EcuMIncludeDem=1
