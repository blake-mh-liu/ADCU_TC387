AUTOSAR XML (schema 4-3-0)
package /Dem
  module config Dem
    DemGeneral: DemSuppressionSupport=DEM_DTC_SUPPRESSION
