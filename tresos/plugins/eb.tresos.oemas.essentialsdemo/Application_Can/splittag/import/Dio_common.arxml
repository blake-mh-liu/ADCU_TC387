AUTOSAR XML (schema 4-3-0)
package /Dio
  module config Dio
    DioConfig_0 (DioConfig)
      DIO_PORT_D (DioPort): DioPortId=33
        MY_LED_CYCLIC (DioChannel): DioChannelId=6
