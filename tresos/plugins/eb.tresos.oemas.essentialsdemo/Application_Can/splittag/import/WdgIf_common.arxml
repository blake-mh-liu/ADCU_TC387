AUTOSAR XML (schema 4-3-0)
package /WdgIf
  module config WdgIf
    WdgIfDevice_0 (WdgIfDevice): WdgIfDriverRef=WdgGeneral
    WdgIfGeneral: WdgIfDriverAPIInfixEnable=0
