AUTOSAR XML (schema 4-3-0)
package /Csm
  module config Csm
    CsmEbGeneral
      CsmEbMisc: CsmEbAutosarApiVersion=CSM_API_VERSION_EB
    CsmJobs
      CsmJob_Pdu_SecuredOut_T (CsmJob): CsmJobId=0, CsmJobKeyRef=CsmConf_CsmKey_Pdu_SecuredOut_T, CsmJobPrimitiveRef=CsmPrim_MacGen_SecOC, CsmJobQueueRef=CsmQueue_Crypto
      CsmJob_Pdu_SecuredIn_R (CsmJob): CsmJobId=1, CsmJobKeyRef=CsmConf_CsmKey_Pdu_SecuredIn_R, CsmJobPrimitiveRef=CsmPrim_MacVer_SecOC, CsmJobQueueRef=CsmQueue_Crypto
    CsmKeys
      CsmConf_CsmKey_Pdu_SecuredOut_T (CsmKey): CsmKeyId=0, CsmKeyRef=CryIfKey_Pdu_SecuredOut_T
      CsmConf_CsmKey_Pdu_SecuredIn_R (CsmKey): CsmKeyId=1, CsmKeyRef=CryIfKey_Pdu_SecuredIn_R
    CsmPrim_MacGen_SecOC (CsmPrimitives)
      CsmMacGenerate
        CsmMacGenerateConfig:
          CsmMacGenerateAlgorithmKeyLength = 16
          CsmMacGenerateAlgorithmMode = CRYPTO_ALGOMODE_CMAC
          CsmMacGenerateDataMaxLength = 16
          CsmMacGenerateProcessing = CSM_SYNCHRONOUS
          CsmMacGenerateResultLength = 3
    CsmPrim_MacVer_SecOC (CsmPrimitives)
      CsmMacVerify
        CsmMacVerifyConfig:
          CsmMacVerifyAlgorithmKeyLength = 16
          CsmMacVerifyAlgorithmMode = CRYPTO_ALGOMODE_CMAC
          CsmMacVerifyCompareLength = 24
          CsmMacVerifyDataMaxLength = 16
          CsmMacVerifyProcessing = CSM_SYNCHRONOUS
    CsmQueues
      CsmQueue_Crypto (CsmQueue): CsmQueueSize=11, CsmChannelRef=CryIfChannel_Crypto
