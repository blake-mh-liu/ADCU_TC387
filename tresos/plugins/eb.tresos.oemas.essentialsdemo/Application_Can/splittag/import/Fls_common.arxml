AUTOSAR XML (schema 4-3-0)
package /Fls
  module config Fls: implementation-config-variant=VARIANT-POST-BUILD-LOADABLE
    FlsConfigSet_0 (FlsConfigSet): FlsJobEndNotification=Fee_JobEndNotification, FlsJobErrorNotification=Fee_JobErrorNotification
      FlsSectorList
        FlsSector_0 (FlsSector)
    FlsGeneral: FlsDevErrorDetect=0, FlsPBFixedAddress=1
    FlsIfxSpecificConfig: FlsUseEraseSuspend=1
