AUTOSAR XML (schema 4-3-0)
package /Mcu
  module config Mcu
    McuModuleConfiguration_0 (McuModuleConfiguration)
      GtmConfiguration_0 (GtmConfiguration)
        GtmGeneral: GtmSleepMode=GTM_SLEEP_DISABLE
      McuClockSettingConfig_0 (McuClockSettingConfig)
        McuClockReferencePoint:
          McuK2DivSteps = 4
          McuASCLINFDivider = 4
          McuASCLINSDivider = 4
          McuBAUD1Divider = 4
          McuBAUD2Divider = 5
          McuBBBDivider = 2
          McuCANDivider = 10
          McuCPU{0..2}Divider = 0
          McuClockASCLINFFrequency = 6.25E7
          McuClockASCLINSFrequency = 6.25E7
          McuClockBAUD1Frequency = 6.25E7
          McuClockBAUD2Frequency = 5.0E7
          McuClockBBBFrequency = 1.25E8
          McuClockCANFrequency = 2.5E7
          McuClockCPU{0..2}Frequency = 2.5E8
          McuClockErayPll2Frequency = 9.6E7
          McuClockErayPllFrequency = 1.6E8
          McuClockFSI2Frequency = 2.5E8
          McuClockFSIFrequency = 8.3333333E7
          McuClockGTMFrequency = 6.25E7
          McuClockMAXFrequency = 2.5E8
          McuClockReferencePoint2Frequency = 1.0E8
          McuClockReferencePointFrequency = 2.5E8
          McuClockSPBFrequency = 6.25E7
          McuClockSRIFrequency = 2.5E8
          McuClockSTMFrequency = 5.0E7
          McuETHDivider = 2
          McuErayDivider = 2
          McuErayPllK2Divider = 2
          McuErayPllNDivider = 23
          McuFSI2Divider = 1
          McuFSIDivider = 3
          McuGTMDivider = 4
          McuPllK2Divider = 1
          McuPllK3Divider = 4
          McuPllNDivider = 24
          McuPllPDivider = 0
          McuSPBDivider = 4
          McuSTMDivider = 5
