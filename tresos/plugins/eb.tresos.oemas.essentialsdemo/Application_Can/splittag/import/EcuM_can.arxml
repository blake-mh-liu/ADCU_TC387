AUTOSAR XML (schema 4-3-0)
package /EcuM
  module config EcuM
    EcuM_Config_0 (EcuMConfiguration)
      EcuMCommonConfiguration
        EcuMSleepMode_0 (EcuMSleepMode): EcuMSleepModeSuspend=1, EcuMWakeupSourceMask=ECUM_WKSOURCE_CAN
        ECUM_WKSOURCE_INTERNAL_WDG (EcuMWakeupSource): EcuMResetReasonRef=MCU_RESET_UNDEFINED
        ECUM_WKSOURCE_CAN (EcuMWakeupSource): EcuMWakeupSourceId=5, EcuMComMChannelRef=CanNetwork
