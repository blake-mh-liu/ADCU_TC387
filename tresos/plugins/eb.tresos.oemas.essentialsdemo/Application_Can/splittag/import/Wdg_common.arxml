AUTOSAR XML (schema 4-3-0)
package /Wdg
  module config Wdg: implementation-config-variant=VARIANT-POST-BUILD
    WdgGeneral: WdgRunArea=RAM
    WdgSettingsConfig_0 (WdgSettingsConfig): WdgDefaultMode=WDGIF_SLOW_MODE
