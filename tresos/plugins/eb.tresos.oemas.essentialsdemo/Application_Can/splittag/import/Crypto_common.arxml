AUTOSAR XML (schema 4-3-0)
package /Crypto
  module config Crypto
    CryptoGeneral: CryptoDevErrorDetect=1
    CryptoDriverObjects
      CryptoDriverObject_Software (CryptoDriverObject): CryptoPrimitiveRef=CryptoPrimitive_AES_CMAC_Mac_Generate, CryptoPrimitiveRef=CryptoPrimitive_AES_CMAC_Mac_Verify
    CryptoKeyElements
      CryptoKeyElement_SecOC_Key (CryptoKeyElement): CryptoKeyElementId=1, CryptoKeyElementSize=16, CryptoKeyElementReadAccess=CRYPTO_RA_ALLOWED, CryptoKeyElementWriteAccess=CRYPTO_WA_ALLOWED
      CryptoKeyElement_Key_Checksum (CryptoKeyElement): CryptoKeyElementId=2, CryptoKeyElementSize=4, CryptoKeyElementReadAccess=CRYPTO_RA_ALLOWED, CryptoKeyElementWriteAccess=CRYPTO_WA_ALLOWED
    CryptoKeyTypes
      CryptoKeyType_SecOC (CryptoKeyType): CryptoKeyElementRef=CryptoKeyElement_SecOC_Key, CryptoKeyElementRef=CryptoKeyElement_Key_Checksum
    CryptoKeys
      CryptoKey_Pdu_SecuredOut_T (CryptoKey): CryptoKeyId=0, CryptoKeyTypeRef=CryptoKeyType_SecOC
      CryptoKey_Pdu_SecuredIn_R (CryptoKey): CryptoKeyId=1, CryptoKeyTypeRef=CryptoKeyType_SecOC
