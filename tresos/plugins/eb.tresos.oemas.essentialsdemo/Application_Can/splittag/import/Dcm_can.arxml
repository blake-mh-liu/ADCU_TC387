AUTOSAR XML (schema 4-3-0)
package /Dcm
  module config Dcm
    DcmConfigSet
      DcmDsl
        DcmDslProtocol
          DcmDsdServiceTable (DcmDslProtocolRow)
            4 x DcmDslConnection:
              CAN_DiagnosticConnection_Main
                CAN_DiagnosticConnection_Main (DcmDslMainConnection)
                  Dcm_Pdu_USDT_CAN_Rx_Func (DcmDslProtocolRx): DcmDslProtocolRxPduId=2, DcmDslProtocolRxBufferID=DcmDslBufferFunc
                  Dcm_Pdu_USDT_CAN_Rx_Phys (DcmDslProtocolRx): DcmDslProtocolRxPduId=3, DcmDslProtocolRxBufferID=DcmDslBuffer
                  Dcm_Pdu_USDT_CAN_Tx (DcmDslProtocolTx): DcmDslTxConfirmationPduId=1
              CAN_FD_DiagnosticConnection_Main
                CAN_FD_DiagnosticConnection_Main (DcmDslMainConnection)
                  Dcm_Pdu_USDT_CAN_FD_Rx_Func (DcmDslProtocolRx): DcmDslProtocolRxPduId=0, DcmDslProtocolRxBufferID=DcmDslBufferFunc
                  Dcm_Pdu_USDT_CAN_FD_Rx_Phys (DcmDslProtocolRx): DcmDslProtocolRxPduId=1, DcmDslProtocolRxBufferID=DcmDslBuffer
                  Dcm_Pdu_USDT_CAN_FD_Tx (DcmDslProtocolTx): DcmDslTxConfirmationPduId=0
              DcmDslConnection_0
                DcmDslConnection_0 (DcmDslResponseOnEvent)
              DiagnosticConnection_PeriodicTransmission
                DiagnosticConnection_PeriodicTransmission (DcmDslPeriodicTransmission)
                  Dcm_Pdu_UUDT_CAN_FD_Tx_417133291T (DcmDslPeriodicConnection): DcmDslPeriodicTxConfirmationPduId=3
                  Dcm_Pdu_UUDT_CAN_Tx_417133035T (DcmDslPeriodicConnection): DcmDslPeriodicTxConfirmationPduId=2
      DcmDsp
        DcmDspComControl
          DcmDspComControlAllChannel_0 (DcmDspComControlAllChannel): DcmDspAllComMChannelRef=CanNetwork
        DIAGNOSTIC_CHECK_PRECOND (DcmDspRoutine):
          DcmDspRoutineIdentifier = 515
          DcmDspRoutineUsePort = 0
          DcmDspStartRoutineFnc = PROG_ReqCheckProgPreCondition
          DcmDspRoutineInfoRef = DcmDspRoutineInfo_515
        DcmDspRoutineInfo_515 (DcmDspRoutineInfo)
          DcmDspRoutineAuthorization: DcmDspRoutineSessionRef=Extended
