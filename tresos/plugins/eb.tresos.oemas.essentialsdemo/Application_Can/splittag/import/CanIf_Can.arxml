AUTOSAR XML (schema 4-3-0)
package /CanIf
  module config CanIf
    CanIfDispatchCfg: CanIfDispatchUserCheckTrcvWakeFlagIndicationUL=CAN_SM, CanIfDispatchUserClearTrcvWufFlagIndicationUL=CAN_SM
    CanIfInitCfg
      9 x CanIfRxPduCfg:
        ISIP_E2EProt_DataIn_280R
        N_Pdu_USDT_CAN_FD_Rx_Func_Tp_417070834R
        N_Pdu_USDT_CAN_FD_Rx_Phys_Tp_417000434R
        N_Pdu_USDT_CAN_Rx_Func_Tp_417070833R
        N_Pdu_USDT_CAN_Rx_Phys_Tp_417000433R
        Nm_Pdu_CanIn_592R
        Pdu_CounterIn_256R
        Pdu_CounterIn_CAN_FD_257R
        Pdu_SecuredIn_261R
      11 x CanIfTxPduCfg:
        Dcm_Pdu_UUDT_CAN_FD_Tx_417133291T
        Dcm_Pdu_UUDT_CAN_Tx_417133035T
        ISIP_E2EProt_DataOut_284T
        N_Pdu_USDT_CAN_FD_Tx_Tp_417002219T
        N_Pdu_USDT_CAN_FD_Tx_Tp_D_417002219T
        N_Pdu_USDT_CAN_Tx_Tp_417001963T
        N_Pdu_USDT_CAN_Tx_Tp_D_417001963T
        Nm_Pdu_CanOut_593T
        Pdu_CounterOut_272T
        Pdu_CounterOut_CAN_FD_273T
        Pdu_SecuredOut_277T
    CanIfPrivateCfg: CanIfPrivateDlcCheck=0
    CanIfPublicCfg: CanIfPublicCtrlWakeupSupport=0, CanIfPublicPnSupport=1, CanIfSingleCanTrcvAPIInfixEnable=0
    CanIfTrcvDrvCfg_0 (CanIfTrcvDrvCfg)
      CanIfTrcvCfg_0 (CanIfTrcvCfg): CanIfTrcvWakeupSupport=1, CanIfTrcvCanTrcvRef=CanTrcvChannel_0, CanIfTrcvWakeupSourceInRef=ECUM_WKSOURCE_CAN
    PDUR (CanIfUpperLayerConfig): CanIfRxPduUserRxIndicationName=PduR_CanIfRxIndication, CanIfTxPduUserTxConfirmationName=PduR_CanIfTxConfirmation
    CAN_NM (CanIfUpperLayerConfig): CanIfRxPduUserRxIndicationName=CanNm_RxIndication, CanIfTxPduUserTxConfirmationName=CanNm_TxConfirmation
    CAN_TP (CanIfUpperLayerConfig): CanIfRxPduUserRxIndicationName=CanTp_RxIndication, CanIfTxPduUserTxConfirmationName=CanTp_TxConfirmation
