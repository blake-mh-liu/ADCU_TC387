AUTOSAR XML (schema 4-3-0)
package /CanNm
  module config CanNm
    CanNmGeneral: CanNmPnSupported=1
    CanNmGlobalConfig: CanNmActiveWakeupBitEnabled=1, CanNmPnResetTime=1.28
      CanNmCluster (CanNmChannelConfig): CanNmMsgTimeoutTime=0.32, CanNmPnHandleMultipleNetworkRequests=1
