AUTOSAR XML (schema 4-3-0)
package /MemMap
  module config MemMap: implementation-config-variant=VARIANT-PRE-COMPILE
    MemMapAS40Compatibility: MemMapAS40Compatibility=1
    MemMapHeaderFiles: MemMapHeaderFiles=Platforms_MemMap_MCAL.h, MemMapHeaderFiles=Platforms_MemMap_Stubs.h
