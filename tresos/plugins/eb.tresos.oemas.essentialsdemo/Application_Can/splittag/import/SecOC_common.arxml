AUTOSAR XML (schema 4-3-0)
package /SecOC
  module config SecOC
    SecOCGeneral: SecOCASR403=1, SecOCQueryFreshnessValue=RTE, SecOCRteUsage=1
