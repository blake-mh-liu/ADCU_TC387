AUTOSAR XML (schema 4-3-0)
package /Port
  module config Port: implementation-config-variant=VARIANT-POST-BUILD-SELECTABLE
    PortConfigSet_0 (PortConfigSet)
      17 x PortContainer:
        PortContainer_0
          13 x PortPin, all with PortPinMode=PORT_PIN_MODE_ALL:
            PortPin_{0..12}
        PortContainer_1
          5 x PortPin, all with PortPinMode=PORT_PIN_MODE_ALL:
            PortPin_{0..4}
        PortContainer_2
          12 x PortPin:
            PortPin_0
            PortPin_{1..3}: PortPinMode=PORT_PIN_MODE_ALL
            PortPin_4
            PortPin_{5..11}: PortPinMode=PORT_PIN_MODE_ALL
        PortContainer_3
          9 x PortPin, all with PortPinMode=PORT_PIN_MODE_ALL:
            PortPin_{0..8}
        PortContainer_4
          16 x PortPin, all with PortPinMode=PORT_PIN_MODE_ALL:
            PortPin_{0..15}
        PortContainer_5
          PortPin_0 (PortPin): PortPinMode=PORT_PIN_MODE_ALL
          PortPin_1 (PortPin): PortPinMode=PORT_PIN_MODE_ALL
        PortContainer_6
          PortLVDSM_0 (PortLVDSM)
          PortLVDSM_1 (PortLVDSM)
          4 x PortPin, all with PortPinMode=PORT_PIN_MODE_ALL:
            PortPin_{0..3}
        PortContainer_7
          11 x PortPin, all with PortPinMode=PORT_PIN_MODE_ALL:
            PortPin_{0..10}
        PortContainer_8
          9 x PortPin, all with PortPinMode=PORT_PIN_MODE_ALL:
            PortPin_{0..8}
        PortContainer_9
          13 x PortPin, all with PortPinMode=PORT_PIN_MODE_ALL:
            PortPin_{0..12}
        PortContainer_10
          3 x PortLVDSH:
            PortLVDSH_{0..2}
          8 x PortPin, all with PortPinMode=PORT_PIN_MODE_ALL:
            PortPin_{0..7}
        PortContainer_11
          PortLVDSM_0 (PortLVDSM)
          PortLVDSM_1 (PortLVDSM)
          12 x PortPin, all with PortPinMode=PORT_PIN_MODE_ALL:
            PortPin_{0..11}
        PortContainer_12
          8 x PortPin, all with PortPinMode=PORT_PIN_MODE_ALL:
            PortPin_{0..7}
        PortContainer_13
          7 x PortPin, all with PortPinMode=PORT_PIN_MODE_ALL:
            PortPin_{0..6}
        PortContainer_14
          16 x PortPin, all with PortPinMode=PORT_PIN_MODE_ALL:
            PortPin_{0..15}
        PortContainer_15
          5 x PortPin, all with PortPinMode=PORT_PIN_MODE_ALL:
            PortPin_{0..4}
        PortContainer_16
          10 x PortPin, all with PortPinMode=PORT_PIN_MODE_ALL:
            PortPin_{0..9}
    PortGeneral: PortSetPinModeApi=1
