AUTOSAR XML (schema 4-3-0)
package /ServiceApplTemplate
  module config ServiceApplTemplate
    ServiceApplTemplateGeneral
      3 x ServiceSwComponentTemplate:
        ServiceSwComponentDcm: ServiceSwcPrototype=Dcm_Prototype
        ServiceSwComponentDem: ServiceSwcPrototype=Dem_Prototype
        ServiceSwComponentSecOC: ServiceSwcPrototype=SecOC_Prototype
