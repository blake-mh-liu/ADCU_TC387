AUTOSAR XML (schema 4-3-0)
package /WdgM
  module config WdgM
    WdgM_Config (WdgMConfigSet): WdgMInitialMode=WDGM_STARTUP, WdgMSleepMode=WDGM_OFF
      4 x WdgMMode:
        WDGM_STARTUP: WdgMExpiredSupervisionCycleTol=1
          WDGM_SE_TASK_Com (WdgMAliveSupervision): WdgMMaxMargin=255, WdgMSupervisionReferenceCycle=10, WdgMAliveSupervisionCheckpointRef=WdgMCheckpoint_TASK_Com
          WdgMLocalStatusParams_0 (WdgMLocalStatusParams): WdgMFailedAliveSupervisionRefCycleTol=0, WdgMLocalStatusSupervisedEntityRef=WdgMGeneral/WDGM_SE_TASK_Com
          WdgMTrigger_0 (WdgMTrigger): WdgMTriggerConditionValue=2000, WdgMWatchdogMode=WDGIF_SLOW_MODE, WdgMTriggerWatchdogRef=WdgMWatchdog_0
        WDGM_NORMAL_OPERATION: WdgMExpiredSupervisionCycleTol=1
          WDGM_SE_TASK_Com (WdgMAliveSupervision): WdgMMaxMargin=255, WdgMSupervisionReferenceCycle=10, WdgMAliveSupervisionCheckpointRef=WdgMCheckpoint_TASK_Com
          WdgMExternalLogicalSupervision_0 (WdgMExternalLogicalSupervision):
            WdgMExternalCheckpointFinalRef = WdgMCheckpoint_1_SWC_IoHwAbs_SetDiscreteValue
            WdgMExternalCheckpointInitialRef = WdgMCheckpoint_0_SWC_CyclicCounter_Cyclic
            WdgMExternalTransition_0 (WdgMExternalTransition):
              WdgMExternalTransitionDestRef = WdgMCheckpoint_1_SWC_IoHwAbs_SetDiscreteValue
              WdgMExternalTransitionSourceRef = WdgMCheckpoint_0_SWC_CyclicCounter_Cyclic
          WdgMLocalStatusParams_0 (WdgMLocalStatusParams): WdgMFailedAliveSupervisionRefCycleTol=1, WdgMLocalStatusSupervisedEntityRef=WdgMGeneral/WDGM_SE_TASK_Com
          WdgMTrigger_0 (WdgMTrigger): WdgMTriggerConditionValue=1, WdgMWatchdogMode=WDGIF_SLOW_MODE, WdgMTriggerWatchdogRef=WdgMWatchdog_0
        WDGM_SHUTDOWN: WdgMExpiredSupervisionCycleTol=1
          WDGM_SE_TASK_Com (WdgMAliveSupervision): WdgMMaxMargin=255, WdgMSupervisionReferenceCycle=10, WdgMAliveSupervisionCheckpointRef=WdgMCheckpoint_TASK_Com
          WdgMLocalStatusParams_0 (WdgMLocalStatusParams): WdgMFailedAliveSupervisionRefCycleTol=1, WdgMLocalStatusSupervisedEntityRef=WdgMGeneral/WDGM_SE_TASK_Com
          WdgMTrigger_0 (WdgMTrigger): WdgMTriggerConditionValue=1, WdgMWatchdogMode=WDGIF_SLOW_MODE, WdgMTriggerWatchdogRef=WdgMWatchdog_0
        WDGM_OFF: WdgMExpiredSupervisionCycleTol=0
          WdgMTrigger_0 (WdgMTrigger): WdgMTriggerConditionValue=1, WdgMWatchdogMode=WDGIF_OFF_MODE, WdgMTriggerWatchdogRef=WdgMWatchdog_0
    WdgMGeneral: WdgMBSWCompatibilityMode=AUTOSAR_32, WdgMImmediateReset=1
      WDGM_SE_TASK_Com (WdgMSupervisedEntity): WdgMInternalCheckpointInitialRef=WdgMCheckpoint_TASK_Com, WdgMInternallCheckpointFinalRef=WdgMCheckpoint_TASK_Com
        WdgMCheckpoint_TASK_Com (WdgMCheckpoint)
      WdgMSupervisedLogical (WdgMSupervisedEntity):
        WdgMInternalCheckpointInitialRef = WdgMCheckpoint_0_SWC_CyclicCounter_Cyclic
        WdgMInternallCheckpointFinalRef = WdgMCheckpoint_1_SWC_IoHwAbs_SetDiscreteValue
        WdgMCheckpoint_0_SWC_CyclicCounter_Cyclic (WdgMCheckpoint)
        WdgMCheckpoint_1_SWC_IoHwAbs_SetDiscreteValue (WdgMCheckpoint)
      WdgMWatchdog_0 (WdgMWatchdog): WdgMWatchdogName=InternalWatchdog, WdgMWatchdogDeviceRef=WdgIfDevice_0
