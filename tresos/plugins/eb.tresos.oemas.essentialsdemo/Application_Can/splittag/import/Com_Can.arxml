AUTOSAR XML (schema 4-3-0)
package /Com
  module config Com
    ComConfig
      4 x ComIPduGroup:
        RXPDUS_GLOBAL
        TXPDUS_GLOBAL
        RGCanNetwork: ComIPduGroupGroupRef=RXPDUS_GLOBAL
        TGCanNetwork: ComIPduGroupGroupRef=TXPDUS_GLOBAL
      4 x ComSignal, all with ComSignalInitValue=0, ComTransferProperty=TRIGGERED:
        SGCounterIn_256R: ComNotification=Rte_COMCbk_SGCounterIn_256R
        SGCounterIn_CAN_FD_257R: ComNotification=Rte_COMCbk_SGCounterIn_CAN_FD_257R
        SGCounterOut_272T
        SGCounterOut_CAN_FD_273T
