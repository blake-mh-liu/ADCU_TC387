AUTOSAR XML (schema 4-3-0)
package /CanSM
  module config CanSM
    CanSMConfiguration
      CanNetwork (CanSMManagerNetwork): CanSMTransceiverId=CanIfTrcvCfg_0
    CanSMGeneral: CanSMPNSupport=1, CanSMTxTimeoutExceptionApi=1
