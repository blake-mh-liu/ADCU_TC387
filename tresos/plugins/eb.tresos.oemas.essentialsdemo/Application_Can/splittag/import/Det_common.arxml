AUTOSAR XML (schema 4-3-0)
package /Det
  module config Det
    DetGeneral: DetRteUsage=1
    SWC_0 (SoftwareComponentList)
