AUTOSAR XML (schema 4-3-0)
package /Resource
  module config Resource
    ResourceGeneral: ResourceSubDerivative=TC297TP_128F300N
