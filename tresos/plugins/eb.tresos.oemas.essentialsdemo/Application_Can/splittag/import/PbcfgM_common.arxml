AUTOSAR XML (schema 4-3-0)
package /PbcfgM
  module config PbcfgM
    PbcfgMBswModules_0 (PbcfgMBswModules): PbcfgMBswModuleRef=BswM
