AUTOSAR XML (schema 4-3-0)
package /Can
  module config Can
    CanConfigSet
      EcuTestNode (CanController): CanControllerActivation=1, CanRxInputSelection=RXDCANxB, CanCpuClockRef=McuClockReferencePoint
        CanControllerBaudrateConfig: CanControllerPropSeg=0, CanControllerSeg1=7, CanControllerSeg2=2, CanControllerSyncJumpWidth=2
        CanControllerFdBaudrateConfig: CanControllerFdBaudRate=1250, CanControllerSeg1=4, CanControllerSeg2=3, CanControllerSyncJumpWidth=2
        FilterMask_1792 (CanFilterMask): CanFilterMaskValue=1792
    CanGeneral: CanMainFunctionModePeriod=0.005
