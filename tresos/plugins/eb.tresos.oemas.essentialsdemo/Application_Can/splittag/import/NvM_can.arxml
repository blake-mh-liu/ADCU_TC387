AUTOSAR XML (schema 4-3-0)
package /NvM
  module config NvM
    NVM_BLOCK_DEM_PRIMARY (NvMBlockDescriptor): NvMNvBlockLength=18
    NVM_BLOCK_DEM_DEFAULT (NvMBlockDescriptor): NvMNvBlockLength=38
