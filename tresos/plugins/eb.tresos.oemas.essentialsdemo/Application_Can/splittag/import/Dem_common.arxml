AUTOSAR XML (schema 4-3-0)
package /Dem
  module config Dem
    DemConfigSet
      DTC_0x000001 (DemDTCClass): DemDTCSeverity=DEM_DTC_SEV_NO_SEVERITY
      DTC_0x000001_Event (DemEventParameter)
        DemEventClass: DemAgingCycleRef=DEM_AGCYCLE_DEM_OPCYC_POWER, DemEventFailureCycleRef=DEM_OPCYC_POWER
    DemGeneral:
      DemMaxNumberClearEventsPerCycle = 20
      DemCallbackMemStackMainFuncTrigger = Eb_Intgr_BswM_TriggerMemoryStack
      DemClearDTCBehavior = DEM_CLRRESP_NONVOLATILE_FINISH
      DemMaxNumberEventEntryPrimary = 2
      DemRteUsage = 1
      DEM_AGCYCLE_DEM_OPCYC_POWER (DemAgingCycle)
      CLIENT_0 (DemClient)
      DemExternalCSDataElementClass_ExtDataRec_0x01 (DemDataElementClass)
        DemExternalCSDataElementClass_ExtDataRec_0x01 (DemExternalCSDataElementClass): DemDataElementUsePort=1
      DemExternalCSDataElementClass_Session (DemDataElementClass)
        DemExternalCSDataElementClass_Session (DemExternalCSDataElementClass): DemDataElementUsePort=1
      DEM_NVM_BLOCK_ID_DEFAULT (DemNvRamBlockId): DemNvRamBlockIdRef=NVM_BLOCK_DEM_DEFAULT
      DEM_NVM_BLOCK_ID_PRIMARY (DemNvRamBlockId): DemNvRamBlockIdRef=NVM_BLOCK_DEM_PRIMARY
      DemServiceAPI: DemDefaultASRServiceAPI=AUTOSAR_42
