AUTOSAR XML (schema 4-3-0)
package /BswM
  module config BswM: implementation-config-variant=VARIANT-POST-BUILD
    BswMConfig
      BswMArbitration
        18 x BswMLogicalExpression:
          BswM_LogEx_ComMFullCom: BswMArgumentRef=BswM_ModeCond_ComMFullCom
          BswM_LogEx_ComMNoCom: BswMArgumentRef=BswM_ModeCond_ComMNoCom
          BswM_LogEx_ComMSilentCom: BswMArgumentRef=BswM_ModeCond_ComMNoCom
          BswM_LogEx_Dcm_Reset: BswMArgumentRef=BswM_ModeCond_Dcm_Reset
          BswM_LogEx_GoOffOneA: BswMArgumentRef=BswM_ModeCond_GoOffOneA
          BswM_LogEx_GoOffOneB: BswMArgumentRef=BswM_ModeCond_GoOffOneB
          BswM_LogEx_PncCanFDStart: BswMLogicalOperator=BSWM_OR, BswMArgumentRef=BswM_ModeCond_PncCanFDFullCom, BswMArgumentRef=BswM_ModeCond_PncCanFDReadySleep
          BswM_LogEx_PncCanFDStop: BswMArgumentRef=BswM_ModeCond_PncCanFDNoCom
          BswM_LogEx_PncCanStart: BswMLogicalOperator=BSWM_OR, BswMArgumentRef=BswM_ModeCond_PncCanFullCom, BswMArgumentRef=BswM_ModeCond_PncCanReadySleep
          BswM_LogEx_PncCanStop: BswMArgumentRef=BswM_ModeCond_PncCanNoCom
          BswM_LogEx_PostRun: BswMArgumentRef=BswM_ModeCond_PostRun
          BswM_LogEx_PostRunToRunTwo: BswMLogicalOperator=BSWM_AND, BswMArgumentRef=BswM_ModeCond_ComMFullCom, BswMArgumentRef=BswM_ModeCond_PostRun
          BswM_LogEx_PrpShutdown: BswMLogicalOperator=BSWM_AND, BswMArgumentRef=BswM_ModeCond_AppInactive, BswMArgumentRef=BswM_LogEx_PrpShutdown_Transition
          BswM_LogEx_PrpShutdown_Transition: BswMLogicalOperator=BSWM_OR, BswMArgumentRef=BswM_ModeCond_PostRun, BswMArgumentRef=BswM_ModeCond_PrpShutdown
          BswM_LogEx_RunTwo: BswMLogicalOperator=BSWM_AND, BswMArgumentRef=BswM_ModeCond_RunTwo, BswMArgumentRef=BswM_ModeCond_AppActive
          BswM_LogEx_RunTwoToPostRun: BswMLogicalOperator=BSWM_AND, BswMArgumentRef=BswM_ModeCond_ComMNoCom, BswMArgumentRef=BswM_ModeCond_RunTwo
          BswM_LogEx_StartupTwoA: BswMArgumentRef=BswM_ModeCond_StartupTwoA
          BswM_LogEx_StartupTwoB: BswMLogicalOperator=BSWM_AND, BswMArgumentRef=BswM_ModeCond_StartupTwoB, BswMArgumentRef=BswM_ModeCond_AppStartup
        21 x BswMModeCondition:
          BswM_ModeCond_AppActive: BswMConditionType=BSWM_EQUALS, BswMConditionMode=BswM_ModeReqPort_AppState
            BswMConditionValue
              BswMConditionValue (BswMModeDeclaration): BswMModeValueRef=EB_INTGR_APP_ACTIVE
          BswM_ModeCond_AppInactive: BswMConditionType=BSWM_EQUALS, BswMConditionMode=BswM_ModeReqPort_AppState
            BswMConditionValue
              BswMConditionValue (BswMModeDeclaration): BswMModeValueRef=EB_INTGR_APP_INACTIVE
          BswM_ModeCond_AppStartup: BswMConditionType=BSWM_EQUALS, BswMConditionMode=BswM_ModeReqPort_AppState
            BswMConditionValue
              BswMConditionValue (BswMModeDeclaration): BswMModeValueRef=EB_INTGR_APP_STARTUP
          BswM_ModeCond_ComMFullCom: BswMConditionType=BSWM_EQUALS, BswMConditionMode=BswM_ModeReqPort_ComM_CurrentMode
            BswMConditionValue
              BswMConditionValue (BswMModeDeclaration): BswMModeValueRef=COMM_FULL_COMMUNICATION
          BswM_ModeCond_ComMNoCom: BswMConditionType=BSWM_EQUALS, BswMConditionMode=BswM_ModeReqPort_ComM_CurrentMode
            BswMConditionValue
              BswMConditionValue (BswMModeDeclaration): BswMModeValueRef=COMM_NO_COMMUNICATION
          BswM_ModeCond_ComMSilentCom: BswMConditionType=BSWM_EQUALS, BswMConditionMode=BswM_ModeReqPort_ComM_CurrentMode
            BswMConditionValue
              BswMConditionValue (BswMModeDeclaration): BswMModeValueRef=COMM_SILENT_COMMUNICATION
          BswM_ModeCond_Dcm_Reset: BswMConditionType=BSWM_EQUALS, BswMConditionMode=BswM_ModeReqPort_Dcm_ResetModeRequest
            BswMConditionValue
              BswMConditionValue (BswMModeDeclaration): BswMModeValueRef=EXECUTE
          BswM_ModeCond_GoOffOneA: BswMConditionType=BSWM_EQUALS, BswMConditionMode=BswM_ModeReqPort_EcuState
            BswMConditionValue
              BswMConditionValue (BswMModeDeclaration): BswMModeValueRef=EB_INTGR_BSWM_GO_OFF_ONE_A
          BswM_ModeCond_GoOffOneB: BswMConditionType=BSWM_EQUALS, BswMConditionMode=BswM_ModeReqPort_EcuState
            BswMConditionValue
              BswMConditionValue (BswMModeDeclaration): BswMModeValueRef=EB_INTGR_BSWM_GO_OFF_ONE_B
          BswM_ModeCond_Not_PostRun: BswMConditionType=BSWM_EQUALS_NOT, BswMConditionMode=BswM_ModeReqPort_EcuState
            BswMConditionValue
              BswMConditionValue (BswMModeDeclaration): BswMModeValueRef=EB_INTGR_BSWM_POST_RUN
          BswM_ModeCond_PncCanFDFullCom: BswMConditionType=BSWM_EQUALS, BswMConditionMode=BswM_ModeReqPort_PncCanFD
            BswMConditionValue
              BswMConditionValue (BswMBswMode): BswMBswRequestedMode=PNC_FULL_COMMUNICATION
          BswM_ModeCond_PncCanFDNoCom: BswMConditionType=BSWM_EQUALS, BswMConditionMode=BswM_ModeReqPort_PncCanFD
            BswMConditionValue
              BswMConditionValue (BswMBswMode): BswMBswRequestedMode=PNC_NO_COMMUNICATION
          BswM_ModeCond_PncCanFDReadySleep: BswMConditionType=BSWM_EQUALS, BswMConditionMode=BswM_ModeReqPort_PncCanFD
            BswMConditionValue
              BswMConditionValue (BswMBswMode): BswMBswRequestedMode=PNC_READY_SLEEP
          BswM_ModeCond_PncCanFullCom: BswMConditionType=BSWM_EQUALS, BswMConditionMode=BswM_ModeReqPort_PncCan
            BswMConditionValue
              BswMConditionValue (BswMBswMode): BswMBswRequestedMode=PNC_FULL_COMMUNICATION
          BswM_ModeCond_PncCanNoCom: BswMConditionType=BSWM_EQUALS, BswMConditionMode=BswM_ModeReqPort_PncCan
            BswMConditionValue
              BswMConditionValue (BswMBswMode): BswMBswRequestedMode=PNC_NO_COMMUNICATION
          BswM_ModeCond_PncCanReadySleep: BswMConditionType=BSWM_EQUALS, BswMConditionMode=BswM_ModeReqPort_PncCan
            BswMConditionValue
              BswMConditionValue (BswMBswMode): BswMBswRequestedMode=PNC_READY_SLEEP
          BswM_ModeCond_PostRun: BswMConditionType=BSWM_EQUALS, BswMConditionMode=BswM_ModeReqPort_EcuState
            BswMConditionValue
              BswMConditionValue (BswMModeDeclaration): BswMModeValueRef=EB_INTGR_BSWM_POST_RUN
          BswM_ModeCond_PrpShutdown: BswMConditionType=BSWM_EQUALS, BswMConditionMode=BswM_ModeReqPort_EcuState
            BswMConditionValue
              BswMConditionValue (BswMModeDeclaration): BswMModeValueRef=EB_INTGR_BSWM_PRP_SHUTDOWN
          BswM_ModeCond_RunTwo: BswMConditionType=BSWM_EQUALS, BswMConditionMode=BswM_ModeReqPort_EcuState
            BswMConditionValue
              BswMConditionValue (BswMModeDeclaration): BswMModeValueRef=EB_INTGR_BSWM_RUN_TWO
          BswM_ModeCond_StartupTwoA: BswMConditionType=BSWM_EQUALS, BswMConditionMode=BswM_ModeReqPort_EcuState
            BswMConditionValue
              BswMConditionValue (BswMModeDeclaration): BswMModeValueRef=EB_INTGR_BSWM_STARTUP_TWO_A
          BswM_ModeCond_StartupTwoB: BswMConditionType=BSWM_EQUALS, BswMConditionMode=BswM_ModeReqPort_EcuState
            BswMConditionValue
              BswMConditionValue (BswMModeDeclaration): BswMModeValueRef=EB_INTGR_BSWM_STARTUP_TWO_B
        9 x BswMModeRequestPort, all with BswMRequestProcessing=BSWM_DEFERRED:
          BswM_ModeReqPort_AppState
            BswMModeRequestSource
              BswMModeRequestSource (BswMSwcModeNotification): BswMSwcModeNotificationModeDeclarationGroupPrototypeRef=AppStateMode
          BswM_ModeReqPort_ComM_CurrentMode
            BswMModeRequestSource
              BswMModeRequestSource (BswMComMIndication): BswMComMChannelRef=CanNetwork
          BswM_ModeReqPort_DcmCommunicationControl
            BswMModeInitValue
              BswMModeInitValue (BswMSwcModeInitValue): BswMSwcModeInitValueRef=DCM_ENABLE_RX_TX_NORM_NM
            BswMModeRequestSource
              BswMModeRequestSource (BswMBswModeNotification): BswMBswModeDeclarationGroupPrototypeRef=DcmCommunicationControl_CanNetwork
          BswM_ModeReqPort_DcmDiagnosticSessionControl
            BswMModeRequestSource
              BswMModeRequestSource (BswMBswModeNotification): BswMBswModeDeclarationGroupPrototypeRef=DcmDiagnosticSessionControl
          BswM_ModeReqPort_DcmResponseOnEvent
            BswMModeInitValue
              BswMModeInitValue (BswMBswModeInitValue): BswMBswModeInitValueMode=0
            BswMModeRequestSource
              BswMModeRequestSource (BswMBswModeNotification): BswMBswModeDeclarationGroupPrototypeRef=DcmResponseOnEvent_0
          BswM_ModeReqPort_Dcm_ResetModeRequest
            BswMModeRequestSource
              BswMModeRequestSource (BswMBswModeNotification): BswMBswModeDeclarationGroupPrototypeRef=DcmEcuReset
          BswM_ModeReqPort_EcuState
            BswMModeInitValue
              BswMModeInitValue (BswMBswModeInitValue): BswMBswModeInitValueMode=0
            BswMModeRequestSource
              BswMModeRequestSource (BswMGenericRequest): BswMModeRequesterId=0
          BswM_ModeReqPort_PncCan
            BswMModeRequestSource
              BswMModeRequestSource (BswMComMPncRequest): BswMComMPncRef=ComMPnc_16
          BswM_ModeReqPort_PncCanFD
            BswMModeRequestSource
              BswMModeRequestSource (BswMComMPncRequest): BswMComMPncRef=ComMPnc_17
        17 x BswMRule:
          BswMRule_PostRun: BswMRuleInitState=BSWM_FALSE, BswMRuleExpressionRef=BswM_LogEx_PostRun, BswMRuleTrueActionList=BswM_ActLst_PostRun
          BswMRule_PostRunToRunTwo: BswMNestedExecutionOnly=0, BswMRuleInitState=BSWM_FALSE, BswMRuleExpressionRef=BswM_LogEx_PostRunToRunTwo, BswMRuleTrueActionList=BswM_ActLst_PostRunToRunTwo
          BswMRule_RunTwoToPostRun: BswMNestedExecutionOnly=0, BswMRuleInitState=BSWM_FALSE, BswMRuleExpressionRef=BswM_LogEx_RunTwoToPostRun, BswMRuleTrueActionList=BswM_ActLst_RunTwoToPostRun
          BswM_Rule_ComM_FullCom: BswMNestedExecutionOnly=0, BswMRuleInitState=BSWM_FALSE, BswMRuleExpressionRef=BswM_LogEx_ComMFullCom, BswMRuleTrueActionList=BswM_ActLst_ComM_FullCom_Can
          BswM_Rule_ComM_NoCom: BswMRuleInitState=BSWM_FALSE, BswMRuleExpressionRef=BswM_LogEx_ComMNoCom, BswMRuleTrueActionList=BswM_ActLst_ComM_NoCom_Can
          BswM_Rule_ComM_SilentCom: BswMRuleInitState=BSWM_FALSE, BswMRuleExpressionRef=BswM_LogEx_ComMNoCom, BswMRuleTrueActionList=BswM_ActLst_ComM_NoCom_Can
          BswM_Rule_Dcm_Reset: BswMRuleInitState=BSWM_FALSE, BswMRuleExpressionRef=BswM_LogEx_Dcm_Reset, BswMRuleTrueActionList=BswM_ActLst_Reset
          BswM_Rule_GoOffOneA: BswMRuleInitState=BSWM_FALSE, BswMRuleExpressionRef=BswM_LogEx_GoOffOneA, BswMRuleTrueActionList=BswM_ActLst_GoOffOneA
          BswM_Rule_GoOffOneB: BswMRuleInitState=BSWM_FALSE, BswMRuleExpressionRef=BswM_LogEx_GoOffOneB, BswMRuleTrueActionList=BswM_ActLst_GoOffOneB
          BswM_Rule_PncCanFDStart: BswMRuleInitState=BSWM_FALSE, BswMRuleExpressionRef=BswM_LogEx_PncCanFDStart, BswMRuleTrueActionList=BswM_ActLst_PnCanFDEnable
          BswM_Rule_PncCanFDStop: BswMRuleInitState=BSWM_FALSE, BswMRuleExpressionRef=BswM_LogEx_PncCanFDStop, BswMRuleTrueActionList=BswM_ActLst_PnCanFDDisable
          BswM_Rule_PncCanStart: BswMRuleInitState=BSWM_FALSE, BswMRuleExpressionRef=BswM_LogEx_PncCanStart, BswMRuleTrueActionList=BswM_ActLst_PnCanEnable
          BswM_Rule_PncCanStop: BswMRuleInitState=BSWM_FALSE, BswMRuleExpressionRef=BswM_LogEx_PncCanStop, BswMRuleTrueActionList=BswM_ActLst_PnCanDisable
          BswM_Rule_PrpShutdown: BswMNestedExecutionOnly=0, BswMRuleInitState=BSWM_FALSE, BswMRuleExpressionRef=BswM_LogEx_PrpShutdown, BswMRuleTrueActionList=BswM_ActLst_PrpShutdown
          BswM_Rule_RunTwo: BswMNestedExecutionOnly=0, BswMRuleInitState=BSWM_FALSE, BswMRuleExpressionRef=BswM_LogEx_RunTwo, BswMRuleTrueActionList=BswM_ActLst_RunTwo
          BswM_Rule_StartupTwoA: BswMNestedExecutionOnly=0, BswMRuleInitState=BSWM_UNDEFINED, BswMRuleExpressionRef=BswM_LogEx_StartupTwoA, BswMRuleTrueActionList=BswM_ActLst_StartupTwoA
          BswM_Rule_StartupTwoB: BswMNestedExecutionOnly=0, BswMRuleInitState=BSWM_FALSE, BswMRuleExpressionRef=BswM_LogEx_StartupTwoB, BswMRuleTrueActionList=BswM_ActLst_StartupTwoB
      BswMDataTypeMappingSets:
        BswMDataTypeMappingSetRef = BswMModeMapping
        BswMDataTypeMappingSetRef = ModeMapping
        BswMDataTypeMappingSetRef = DataTypeMappingSet_0
        BswMDataTypeMappingSetRef = AppModeMapping
      BswMModeControl
        41 x BswMAction:
          BswM_Act_AllowCom
            BswMAvailableActions
              BswMAvailableActions (BswMComMAllowCom): BswMComAllowed=1, BswMComMAllowChannelRef=CanNetwork
          BswM_Act_DemDeinit
            BswMAvailableActions
              BswMAvailableActions (BswMUserCallout): BswMUserCalloutFunction=Dem_Shutdown()
          BswM_Act_Disable_Rx_Disable_Tx_Can
            BswMAvailableActions
              BswMAvailableActions (BswMPduGroupSwitch): BswMDisabledPduGroupRef=RGCanNetwork, BswMDisabledPduGroupRef=TGCanNetwork
          BswM_Act_Enable_Rx_Disable_Tx_Can
            BswMAvailableActions
              BswMAvailableActions (BswMPduGroupSwitch): BswMDisabledPduGroupRef=TGCanNetwork, BswMEnabledPduGroupRef=RGCanNetwork
          BswM_Act_Enable_Rx_Enable_Tx_Can
            BswMAvailableActions
              BswMAvailableActions (BswMPduGroupSwitch): BswMEnabledPduGroupRef=RGCanNetwork, BswMEnabledPduGroupRef=TGCanNetwork
          BswM_Act_GoOffOneA
            BswMAvailableActions
              BswMAvailableActions (BswMUserCallout): BswMUserCalloutFunction=Eb_Intgr_BswM_GoOffOneA()
          BswM_Act_GoOffOneB
            BswMAvailableActions
              BswMAvailableActions (BswMUserCallout): BswMUserCalloutFunction=Eb_Intgr_BswM_GoOffOneB()
          BswM_Act_HookOnGoOffOneA
            BswMAvailableActions
              BswMAvailableActions (BswMUserCallout): BswMUserCalloutFunction=Eb_Intgr_BswM_Hook_OnGoOffOneA()
          BswM_Act_HookOnGoOffOneB
            BswMAvailableActions
              BswMAvailableActions (BswMUserCallout): BswMUserCalloutFunction=Eb_Intgr_BswM_Hook_OnGoOffOneB()
          BswM_Act_HookOnPostRun
            BswMAvailableActions
              BswMAvailableActions (BswMUserCallout): BswMUserCalloutFunction=Eb_Intgr_BswM_Hook_OnPostRun()
          BswM_Act_HookOnPrpShutdown
            BswMAvailableActions
              BswMAvailableActions (BswMUserCallout): BswMUserCalloutFunction=Eb_Intgr_BswM_Hook_OnPrpShutdown()
          BswM_Act_HookOnRunTwo
            BswMAvailableActions
              BswMAvailableActions (BswMUserCallout): BswMUserCalloutFunction=Eb_Intgr_BswM_Hook_OnRunTwo()
          BswM_Act_HookOnStartupTwoA
            BswMAvailableActions
              BswMAvailableActions (BswMUserCallout): BswMUserCalloutFunction=Eb_Intgr_BswM_Hook_OnStartupTwoA()
          BswM_Act_HookOnStartupTwoB
            BswMAvailableActions
              BswMAvailableActions (BswMUserCallout): BswMUserCalloutFunction=Eb_Intgr_BswM_Hook_OnStartupTwoB()
          BswM_Act_InitDriverInitThree
            BswMAvailableActions
              BswMAvailableActions (BswMUserCallout): BswMUserCalloutFunction=Eb_Intgr_BswM_DriverInitThree()
          BswM_Act_NvMReadAll
            BswMAvailableActions
              BswMAvailableActions (BswMUserCallout): BswMUserCalloutFunction=Eb_Intgr_BswM_InitNvMReadAll()
          BswM_Act_PncCanFD_Disable
            BswMAvailableActions
              BswMAvailableActions (BswMPduGroupSwitch): BswMDisabledPduGroupRef=PN_CANFD_IN, BswMDisabledPduGroupRef=PN_CANFD_OUT
          BswM_Act_PncCanFD_Enable
            BswMAvailableActions
              BswMAvailableActions (BswMPduGroupSwitch): BswMEnabledPduGroupRef=PN_CANFD_IN, BswMEnabledPduGroupRef=PN_CANFD_OUT
          BswM_Act_PncCan_Disable
            BswMAvailableActions
              BswMAvailableActions (BswMPduGroupSwitch): BswMDisabledPduGroupRef=PN_CAN_IN, BswMDisabledPduGroupRef=PN_CAN_OUT
          BswM_Act_PncCan_Enable
            BswMAvailableActions
              BswMAvailableActions (BswMPduGroupSwitch): BswMEnabledPduGroupRef=PN_CAN_IN, BswMEnabledPduGroupRef=PN_CAN_OUT
          BswM_Act_ReqGoOffOneA
            BswMAvailableActions
              BswMAvailableActions (BswMUserCallout): BswMUserCalloutFunction=BswM_RequestMode(0, EB_INTGR_BSWM_GO_OFF_ONE_A)
          BswM_Act_ReqPostRun
            BswMAvailableActions
              BswMAvailableActions (BswMUserCallout): BswMUserCalloutFunction=BswM_RequestMode(EB_INTGR_BSWM_BSWM_SM, EB_INTGR_BSWM_POST_RUN)
          BswM_Act_ReqPrpShutDown
            BswMAvailableActions
              BswMAvailableActions (BswMUserCallout): BswMUserCalloutFunction=BswM_RequestMode(0, EB_INTGR_BSWM_PRP_SHUTDOWN)
          BswM_Act_ReqRunTwo
            BswMAvailableActions
              BswMAvailableActions (BswMUserCallout): BswMUserCalloutFunction=BswM_RequestMode(0, EB_INTGR_BSWM_RUN_TWO)
          BswM_Act_ReqStartupTwoB
            BswMAvailableActions
              BswMAvailableActions (BswMUserCallout): BswMUserCalloutFunction=BswM_RequestMode(0, EB_INTGR_BSWM_STARTUP_TWO_B)
          BswM_Act_Reset
            BswMAvailableActions
              BswMAvailableActions (BswMEcuMSelectShutdownTarget): BswMEcuMShutdownTarget=ECUM_STATE_RESET, BswMEcuMResetModeRef=ECUM_RESET_MCU
          BswM_Act_RteModeReq_AppActive
            BswMAvailableActions
              BswMAvailableActions (BswMRteModeRequest): BswMRequestedModeRef=EB_INTGR_APP_ACTIVE, BswMRteModeRequestPortRef=BswMRteModeRequestPort_AppStateMode
          BswM_Act_RteModeReq_AppInactive
            BswMAvailableActions
              BswMAvailableActions (BswMRteModeRequest): BswMRequestedModeRef=EB_INTGR_APP_INACTIVE, BswMRteModeRequestPortRef=BswMRteModeRequestPort_AppStateMode
          BswM_Act_RteModeReq_AppStartup
            BswMAvailableActions
              BswMAvailableActions (BswMRteModeRequest): BswMRequestedModeRef=EB_INTGR_APP_STARTUP, BswMRteModeRequestPortRef=BswMRteModeRequestPort_AppStateMode
          BswM_Act_RteStart
            BswMAvailableActions
              BswMAvailableActions (BswMUserCallout): BswMUserCalloutFunction=Rte_Start()
          BswM_Act_RteSwitch_GoOffOneA
            BswMAvailableActions
              BswMAvailableActions (BswMRteSwitch): BswMRteSwitchPortRef=BswM_SwitchPort_Rte, BswMSwitchedMode=EB_INTGR_BSWM_GO_OFF_ONE_A
          BswM_Act_RteSwitch_GoOffOneB
            BswMAvailableActions
              BswMAvailableActions (BswMRteSwitch): BswMRteSwitchPortRef=BswM_SwitchPort_Rte, BswMSwitchedMode=EB_INTGR_BSWM_GO_OFF_ONE_B
          BswM_Act_RteSwitch_PrpShutdown
            BswMAvailableActions
              BswMAvailableActions (BswMRteSwitch): BswMRteSwitchPortRef=BswM_SwitchPort_Rte, BswMSwitchedMode=EB_INTGR_BSWM_PRP_SHUTDOWN
          BswM_Act_RteSwitch_Run
            BswMAvailableActions
              BswMAvailableActions (BswMRteSwitch): BswMRteSwitchPortRef=BswM_SwitchPort_Rte, BswMSwitchedMode=EB_INTGR_BSWM_RUN_TWO
          BswM_Act_RteSwitch_Startup
            BswMAvailableActions
              BswMAvailableActions (BswMRteSwitch): BswMRteSwitchPortRef=BswM_SwitchPort_Rte, BswMSwitchedMode=EB_INTGR_BSWM_STARTUP_TWO_B
          BswM_Act_RunTwo
            BswMAvailableActions
              BswMAvailableActions (BswMUserCallout): BswMUserCalloutFunction=Eb_Intgr_BswM_RunTwo()
          BswM_Act_Sleep
            BswMAvailableActions
              BswMAvailableActions (BswMEcuMSelectShutdownTarget): BswMEcuMShutdownTarget=ECUM_STATE_SLEEP, BswMEcuMSleepModeRef=EcuMSleepMode_0
          BswM_Act_StartDemOpCycleState
            BswMAvailableActions
              BswMAvailableActions (BswMUserCallout): BswMUserCalloutFunction=Dem_SetOperationCycleState(DEM_OPCYC_POWER, DEM_CYCLE_STATE_START)
          BswM_Act_StartInternalPDUs
            BswMAvailableActions
              BswMAvailableActions (BswMPduGroupSwitch): BswMEnabledPduGroupRef=RXEIRAPDUS_GLOBAL, BswMEnabledPduGroupRef=RXNMPDUS_GLOBAL, BswMEnabledPduGroupRef=TXNMPDUS_GLOBAL
          BswM_Act_StopDemOpCycleState
            BswMAvailableActions
              BswMAvailableActions (BswMUserCallout): BswMUserCalloutFunction=Dem_SetOperationCycleState(DEM_OPCYC_POWER, DEM_CYCLE_STATE_END)
          BswM_Act_WdgM_Mod
            BswMAvailableActions
              BswMAvailableActions (BswMUserCallout): BswMUserCalloutFunction=WdgM_SetMode(WdgMConf_WdgMMode_WDGM_NORMAL_OPERATION)
        17 x BswMActionList, all with BswMActionListExecution=BSWM_TRIGGER:
          BswM_ActLst_ComM_FullCom_Can
            BswMActionListItem_0 (BswMActionListItem): BswMActionListItemRef=BswM_Act_Enable_Rx_Enable_Tx_Can
          BswM_ActLst_ComM_NoCom_Can
            BswMActionListItem_1 (BswMActionListItem): BswMActionListItemRef=BswM_Act_Disable_Rx_Disable_Tx_Can
          BswM_ActLst_ComM_SilentCom_Can
            BswMActionListItem_0 (BswMActionListItem): BswMActionListItemRef=BswM_Act_Enable_Rx_Disable_Tx_Can
          BswM_ActLst_GoOffOneA
            3 x BswMActionListItem:
              BswMActionListItem_0: BswMAbortOnFail=0, BswMActionListItemIndex=2, BswMActionListItemRef=BswM_Act_RteSwitch_GoOffOneA
              BswMActionListItem_1: BswMAbortOnFail=0, BswMActionListItemIndex=0, BswMActionListItemRef=BswM_Act_HookOnGoOffOneA
              BswMActionListItem_2: BswMActionListItemIndex=1, BswMActionListItemRef=BswM_Act_GoOffOneA
          BswM_ActLst_GoOffOneB
            3 x BswMActionListItem:
              BswMActionListItem_0: BswMActionListItemIndex=2, BswMActionListItemRef=BswM_Act_GoOffOneB
              BswMActionListItem_1: BswMAbortOnFail=0, BswMActionListItemIndex=0, BswMActionListItemRef=BswM_Act_RteSwitch_GoOffOneB
              BswMActionListItem_2: BswMAbortOnFail=0, BswMActionListItemIndex=1, BswMActionListItemRef=BswM_Act_HookOnGoOffOneB
          BswM_ActLst_PnCanDisable
            BswMActionListItem_0 (BswMActionListItem): BswMActionListItemRef=BswM_Act_PncCan_Disable
          BswM_ActLst_PnCanEnable
            BswMActionListItem_0 (BswMActionListItem): BswMActionListItemRef=BswM_Act_PncCan_Enable
          BswM_ActLst_PnCanFDDisable
            BswMActionListItem_0 (BswMActionListItem): BswMActionListItemRef=BswM_Act_PncCanFD_Disable
          BswM_ActLst_PnCanFDEnable
            BswMActionListItem_0 (BswMActionListItem): BswMActionListItemRef=BswM_Act_PncCanFD_Enable
          BswM_ActLst_PostRun
            BswMActionListItem_0 (BswMActionListItem): BswMActionListItemRef=BswM_Act_HookOnPostRun
            BswMActionListItem_2 (BswMActionListItem): BswMActionListItemIndex=1, BswMActionListItemRef=BswM_Act_RteModeReq_AppInactive
          BswM_ActLst_PostRunToRunTwo
            BswMActionListItem_0 (BswMActionListItem): BswMActionListItemRef=BswM_Act_RteModeReq_AppActive
            BswMActionListItem_1 (BswMActionListItem): BswMActionListItemRef=BswM_Act_ReqRunTwo
          BswM_ActLst_PrpShutdown
            5 x BswMActionListItem:
              BswMActionListItem_0: BswMAbortOnFail=0, BswMActionListItemIndex=0, BswMActionListItemRef=BswM_Act_RteSwitch_PrpShutdown
              BswMActionListItem_1: BswMAbortOnFail=0, BswMActionListItemIndex=1, BswMActionListItemRef=BswM_Act_HookOnPrpShutdown
              BswMActionListItem_2: BswMActionListItemRef=BswM_Act_StopDemOpCycleState
              BswMActionListItem_3: BswMActionListItemRef=BswM_Act_DemDeinit
              BswMActionListItem_4: BswMActionListItemRef=BswM_Act_ReqGoOffOneA
          BswM_ActLst_Reset
            3 x BswMActionListItem:
              BswMActionListItem_0: BswMActionListItemIndex=0, BswMActionListItemRef=BswM_Act_Reset
              BswMActionListItem_1: BswMActionListItemIndex=2, BswMActionListItemRef=BswM_Act_RteModeReq_AppInactive
              BswMActionListItem_2: BswMActionListItemIndex=1, BswMActionListItemRef=BswM_Act_ReqPrpShutDown
          BswM_ActLst_RunTwo
            4 x BswMActionListItem:
              BswMActionListItem_0: BswMAbortOnFail=0, BswMActionListItemIndex=0, BswMActionListItemRef=BswM_Act_HookOnRunTwo
              BswMActionListItem_1: BswMActionListItemIndex=2, BswMActionListItemRef=BswM_Act_RteSwitch_Run
              BswMActionListItem_2: BswMActionListItemIndex=1, BswMActionListItemRef=BswM_Act_RunTwo
              BswMActionListItem_3: BswMActionListItemRef=BswM_Act_WdgM_Mod
          BswM_ActLst_RunTwoToPostRun
            BswMActionListItem_0 (BswMActionListItem): BswMActionListItemRef=BswM_Act_Sleep
            BswMActionListItem_2 (BswMActionListItem): BswMActionListItemRef=BswM_Act_ReqPostRun
          BswM_ActLst_StartupTwoA
            6 x BswMActionListItem:
              BswMActionListItem_0: BswMAbortOnFail=0, BswMActionListItemIndex=0, BswMActionListItemRef=BswM_Act_HookOnStartupTwoA
              BswMActionListItem_1: BswMActionListItemIndex=1, BswMActionListItemRef=BswM_Act_NvMReadAll
              BswMActionListItem_2: BswMActionListItemIndex=2, BswMActionListItemRef=BswM_Act_RteStart
              BswMActionListItem_3: BswMActionListItemIndex=3, BswMActionListItemRef=BswM_Act_RteSwitch_Startup
              BswMActionListItem_4: BswMActionListItemIndex=4, BswMActionListItemRef=BswM_Act_ReqStartupTwoB
              BswMActionListItem_5: BswMActionListItemRef=BswM_Act_RteModeReq_AppStartup
          BswM_ActLst_StartupTwoB
            7 x BswMActionListItem:
              BswMActionListItem_0: BswMAbortOnFail=0, BswMActionListItemIndex=0, BswMActionListItemRef=BswM_Act_HookOnStartupTwoB
              BswMActionListItem_1: BswMAbortOnFail=0, BswMActionListItemIndex=1, BswMActionListItemRef=BswM_Act_InitDriverInitThree
              BswMActionListItem_2: BswMAbortOnFail=0, BswMActionListItemIndex=3, BswMActionListItemRef=BswM_Act_AllowCom
              BswMActionListItem_3: BswMActionListItemIndex=4, BswMActionListItemRef=BswM_Act_StartDemOpCycleState
              BswMActionListItem_4: BswMActionListItemIndex=5, BswMActionListItemRef=BswM_Act_RteModeReq_AppActive
              BswMActionListItem_5: BswMActionListItemIndex=6, BswMActionListItemRef=BswM_Act_ReqRunTwo
              BswMActionListItem_6: BswMActionListItemIndex=2, BswMActionListItemRef=BswM_Act_StartInternalPDUs
        BswMRteModeRequestPort_AppStateMode (BswMRteModeRequestPort): BswMRteModeRequestPortInterfaceRef=If_AppStateRequestMode
        BswM_SwitchPort_Rte (BswMSwitchPort): BswMModeSwitchQueueLength=5, BswMModeSwitchInterfaceRef=BswMMode
    BswMGeneral:
      BswMCanSMEnabled = 1
      BswMComMEnabled = 1
      BswMDcmEnabled = 1
      BswMDevErrorDetect = 1
      BswMEcuMEnabled = 1
      BswMEthSMEnabled = 0
      BswMFrSMEnabled = 0
      BswMGenericRequestEnabled = 1
      BswMLinSMEnabled = 0
      BswMLinTPEnabled = 0
      BswMMainFunctionPeriod = 0.02
      BswMRteUsage = 1
      BswMVersionInfoApi = 0
      BswMWdgMEnabled = 0
      BswMUserIncludeFiles: BswMUserIncludeFile=Eb_Intgr_BswM_UserCallouts.h, BswMUserIncludeFile=Eb_Intgr_BswM_Hooks.h
