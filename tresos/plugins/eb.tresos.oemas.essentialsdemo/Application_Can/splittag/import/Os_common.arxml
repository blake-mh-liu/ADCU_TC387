AUTOSAR XML (schema 4-3-0)
package /Os
  module config Os
    OsMicrokernel
      MkStack: MkKernStack=512
    OSDEFAULTAPPMODE (OsAppMode)
    OsApp_Qm (OsApplication):
      OsAppMkPermitShutdownAllCores = 1
      OsAppMkPermitShutdownOS = 1
      OsTrusted = 1
      OsAppCounterRef = HwCounter
      OsAppResourceRef = Rte_Res_0
      OsAppScheduleTableRef = SchM_DefaultScheduleTable
      OsAppScheduleTableRef = Rte_DefaultScheduleTable
      OsAppTaskRef = Init_Task
      OsAppTaskRef = Rte_Event_Task
      OsAppTaskRef = Rte_Time_Task
      OsAppTaskRef = SchMComTask_5ms
      OsAppTaskRef = SchMComTask_10ms
      OsAppTaskRef = SchMDiagStateTask_20ms
      OsAppTaskRef = SchMMemTask_10ms
      OsAppTaskRef = TASK_RTE_ModeSwitchEvent
      OsApplicationHooks: OsAppShutdownHook=1
    HwCounter (OsCounter):
      OsCounterMaxAllowedValue = 4294967295
      OsCounterMinCycle = 100
      OsCounterTicksPerBase = 1000
      OsCounterTricoreTimer = STM0_T0
      OsCounterType = HARDWARE
      OsSecondsPerTick = 2.0E-8
      OsTricoreIrqLevel = 4
    OsOS: OsProtection=OFF, OsStatus=EXTENDED
      OsHooks: OsProtectionHook=0
    4 x OsTask:
      Init_Task: OsStacksize=1024, OsTaskPriority=200, OsTaskSchedule=NON
        OsTaskAutostart: OsTaskAppModeRef=OSDEFAULTAPPMODE
      Rte_Event_Task: OsStacksize=1024, OsTaskPriority=41
      Rte_Time_Task: OsStacksize=1024, OsTaskPriority=42
      TASK_RTE_ModeSwitchEvent: OsStacksize=4096, OsTaskPriority=40
