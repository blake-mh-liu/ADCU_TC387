AUTOSAR XML (schema 4-3-0)
package /SecOC
  module config SecOC
    Pdu_SecuredIn_261R (SecOCRxPduProcessing): SecOCVerificationStatusPropagationMode=NONE, SecOCRxAuthServiceConfigRef=CsmJob_Pdu_SecuredIn_R
    Pdu_SecuredOut_277T (SecOCTxPduProcessing): SecOCAuthenticationBuildAttempts=1, SecOCTxAuthServiceConfigRef=CsmJob_Pdu_SecuredOut_T
