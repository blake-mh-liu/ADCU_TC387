// T32_1000001 Tue May 14 16:42:36 2013

 B::
 
 TOOLBAR ON
 STATUSBAR ON
 FramePOS 51.429,7.0833,,,Maximized
 WinPAGE.RESet
 
 WinPAGE.Create SysSet
 
 WinCLEAR
 WinPOS 0.42857 0.16667 71. 19. 0. 0. W002
 system.state
 
 WinPOS 86.286 0.0 25. 18. 0. 0. W000
 TrOnChip.view
 
 WinPAGE.Create Debug
 
 WinCLEAR
 WinPOS 116.0 13.5 84. 21. 5. 0. W007
 Var.Frame /Locals /Caller
 
 WinPOS 0.42857 0.083333 110. 52. 15. 1. W005
 WinTABS 10. 10. 25. 62.
 data.LIST 
 
 WinPOS 115.71 0.083333 84. 7. 25. 1. W004
 WinTABS 13. 0. 0. 0. 0. 0. 0.
 break.LIST
 
 WinPOS 116.0 41.417 84. 10. 0. 0. W006
 Var.Watch
 
 WinPAGE.select Debug
 
 ENDDO
