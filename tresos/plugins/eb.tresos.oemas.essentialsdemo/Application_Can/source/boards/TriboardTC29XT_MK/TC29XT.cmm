; t32.cmm - Trace32 flash programming script for TC297 on TriboardTC2X7
;
; (c) Elektrobit Automotive GmbH
;
; Example script for flash declaration and programming of Infineon
; TriCore TC29x internal flash.
;
; Supported devices: All TC29x devices.
;
; Flash:
;   4 MByte on-chip program flash      at 0x80000000--0x803fffff (cached)
;                                      or 0xa0000000--0xa03fffff (non cached)
;   2 * 288 kByte data flash EEPROM    at 0xaf000000--0xaf047fff
;                                     and 0xaf100000--0xaf147fff
;   2 * 8 kByte data flash UCB sectors at 0xaf080000--0xaf081fff
;                                     and 0xaf180000--0xaf181fff
;   2 * 8 kByte data flash HSM sectors at 0xaf082000--0xaf083fff
;                                     and 0xaf182000--0xaf183fff
;
; RAM:
;   120 kByte Data Scratch-Pad RAM (DSPR) at        0xd0000000--0xd001dfff
;    32 kByte Instruction Scratch-Pad RAM (PSPR) at 0xc0000000--0xc0007fff
;
; HINTS:
;
;   Erased flash is showing bus error caused by ECC error. ECC width is one
;   page. In the PFlash a page is an aligned group of 32 bytes and in DFlash
;   of 8 bytes.
;
;   The flash algorithm is programming PFlash in an aligned group of 32 bytes.
;   When using FLASH.Program command the download has to care about this
;   alignment.
;
;   To avoid any aligment issues FLASH.ReProgram is recommended. Unused flash
;   data of affected sectors is programmed to 0x0.
;
;   FLASH.AUTO is not working for sectors with enabled ECC and uncorrectable
;   ECC error (showing bus error).
;

entry &elffile
if "&elffile"==""
(
	&elffile="..\..\output\bin\*"
)

entry &elffileBoot
if "&elffileBoot"==""
(
	&elffileBoot="..\..\..\Bootloader_Can\output\bin\*"
)

;========================================================================
; Initialize and start debugging

SYStem.CPU TC297T
IF DAP.Available()
(
  ; switch to DAP2 mode instead of using JTAG
  SYStem.CONFIG.DEBUGPORTTYPE DAP2
)
CORE.ASSIGN 1         ; CPU0 is selected for flash programming.
SYStem.Up

; Disable Watchdog Timers on TC297

; Disable the Safety Watchdog Timer (overall system level watchdog):
PER.Set D:0xF00360F4 %Long 0x00000008 // SCU_WDTSCON1, Request to disable the WDT
; Disable the CPU Watchdog Timers:
PER.Set D:0xF0036104 %Long 0x00000008 // SCU_WDTCPU0CON1, Request to disable the WDT
PER.Set D:0xF0036110 %Long 0x00000008 // SCU_WDTCPU1CON1, Request to disable the WDT
PER.Set D:0xF003611C %Long 0x00000008 // SCU_WDTCPU2CON1, Request to disable the WDT

;========================================================================
; Flash Declaration

IF VERSION.BUILD()<38225.
(
  DIALOG.OK "Please request a TRACE32 software update to support Boot Mode Header handling (btmtc-support@lauterbach.com)"
  ENDDO
)

FLASH.RESet

; Program flash PF0
FLASH.Create  1. 0xa0000000--0xa000bfff 0x04000 TARGET Long /BootModeHeaDer 0xa0000000--0xa000001f  ; PS0, S0..S2
FLASH.Create  1. 0xa000c000--0xa0013fff 0x04000 TARGET Long /BootModeHeaDer 0xa000ffe0--0xa000ffff  ; PS0, S3..S4
FLASH.Create  1. 0xa0014000--0xa0017fff 0x04000 NOP    Long   ; PS0, S5 (Tuning Protection)
FLASH.Create  1. 0xa0018000--0xa001bfff 0x04000 NOP    Long   ; PS0, S6 (HSM)
FLASH.Create  1. 0xa001c000--0xa001ffff 0x04000 TARGET Long /BootModeHeaDer 0xa001ffe0--0xa001ffff  ; PS0, S7
FLASH.Create  1. 0xa0020000--0xa005ffff 0x08000 TARGET Long /BootModeHeaDer 0xa0020000--0xa002001f  ; PS0, S8..S15
FLASH.Create  1. 0xa0060000--0xa007ffff 0x10000 NOP    Long   ; PS0, S16..S17 (HSM)
FLASH.Create  2. 0xa0080000--0xa009ffff 0x10000 TARGET Long   ; PS1, S18..S19
FLASH.Create  2. 0xa00a0000--0xa00fffff 0x20000 TARGET Long   ; PS1, S20..S22
FLASH.Create  3. 0xa0100000--0xa017ffff 0x40000 TARGET Long   ; PS2, S23..S24
FLASH.Create  4. 0xa0180000--0xa01fffff 0x40000 TARGET Long   ; PS3, S25..S26
; Program flash PF1
FLASH.Create  5. 0xa0200000--0xa021ffff 0x04000 TARGET Long   ; PS0, S0..S7
FLASH.Create  5. 0xa0220000--0xa025ffff 0x08000 TARGET Long   ; PS0, S8..S15
FLASH.Create  5. 0xa0260000--0xa027ffff 0x10000 TARGET Long   ; PS0, S16..S17
FLASH.Create  6. 0xa0280000--0xa029ffff 0x10000 TARGET Long   ; PS1, S18..S19
FLASH.Create  6. 0xa02a0000--0xa02fffff 0x20000 TARGET Long   ; PS1, S20..S22
FLASH.Create  7. 0xa0300000--0xa037ffff 0x40000 TARGET Long   ; PS2, S23..S24
FLASH.Create  8. 0xa0380000--0xa03fffff 0x40000 TARGET Long   ; PS3, S25..S26
  ; Program flash PF2
  FLASH.Create  9. 0xA0400000--0xA041FFFF  0x4000 TARGET Long   ; PS0, S0..S7
  FLASH.Create  9. 0xA0420000--0xA045FFFF  0x8000 TARGET Long   ; PS0, S8..S15
  FLASH.Create  9. 0xA0460000--0xA047FFFF 0x10000 TARGET Long   ; PS0, S16..S17
  FLASH.Create 10. 0xA0480000--0xA049FFFF 0x10000 TARGET Long   ; PS1, S18..S19
  FLASH.Create 10. 0xA04A0000--0xA04FFFFF 0x20000 TARGET Long   ; PS1, S20..S22
  FLASH.Create 11. 0xA0500000--0xA057FFFF 0x40000 TARGET Long   ; PS2, S23..S24
  FLASH.Create 12. 0xA0580000--0xA05FFFFF 0x40000 TARGET Long   ; PS3, S25..S26
  ; Program flash PF3
  FLASH.Create 13. 0xA0600000--0xA061FFFF  0x4000 TARGET Long   ; PS0, S0..S7
  FLASH.Create 13. 0xA0620000--0xA065FFFF  0x8000 TARGET Long   ; PS0, S8..S15
  FLASH.Create 13. 0xA0660000--0xA067FFFF 0x10000 TARGET Long   ; PS0, S16..S17
  FLASH.Create 14. 0xA0680000--0xA069FFFF 0x10000 TARGET Long   ; PS1, S18..S19
  FLASH.Create 14. 0xA06A0000--0xA06FFFFF 0x20000 TARGET Long   ; PS1, S20..S22
  FLASH.Create 15. 0xA0700000--0xA077FFFF 0x40000 TARGET Long   ; PS2, S23..S24
  FLASH.Create 16. 0xA0780000--0xA07FFFFF 0x40000 TARGET Long   ; PS3, S25..S26
; Data flash DF0
  FLASH.Create 17. 0xAF000000--0xAF0BFFFF  0x2000 TARGET Long /INFO "EEPROM"          ; DF0, EEPROM0..EEPROM95
  FLASH.Create 18. 0xAF100000--0xAF1003FF   0x400 NOP    Long /INFO "UCB_PFlash"      ; DF0, UCB0
  FLASH.Create 18. 0xAF100400--0xAF1007FF   0x400 NOP    Long /INFO "UCB_DFlash"      ; DF0, UCB1
  FLASH.Create 18. 0xAF100800--0xAF100BFF   0x400 NOP    Long /INFO "UCB_HSMCOTP"     ; DF0, UCB2
  FLASH.Create 18. 0xAF100C00--0xAF100FFF   0x400 NOP    Long /INFO "UCB_OTP"         ; DF0, UCB3
  FLASH.Create 18. 0xAF101000--0xAF1013FF   0x400 NOP    Long /INFO "UCB_IFX"         ; DF0, UCB4
  FLASH.Create 18. 0xAF101400--0xAF1017FF   0x400 NOP    Long /INFO "UCB_DBG"         ; DF0, UCB5
  FLASH.Create 18. 0xAF101800--0xAF101BFF   0x400 NOP    Long /INFO "UCB_HSM"         ; DF0, UCB6
  FLASH.Create 18. 0xAF101C00--0xAF101FFF   0x400 NOP    Long /INFO "UCB_HSMCFG"      ; DF0, UCB7
  FLASH.Create 18. 0xAF102000--0xAF102FFF   0x400 NOP    Long                         ; DF0, UCB8..UCB11
  FLASH.Create 18. 0xAF103000--0xAF103FFF   0x400 NOP    Long /INFO "Erase Counter"   ; DF0, UCB12..UCB15
  ; Data flash DF1
  FLASH.Create 19. 0xAF110000--0xAF11FFFF 0x02000 NOP    Long /INFO "HSM"             ; HSM0..HSM7

FLASH.TARGET 0xc0000000 0xd0000000 0x4000 ~~/demo/tricore/flash/long/tc2.bin
FLASH.CreateALIAS 0x80000000--0x80ffffff 0xa0000000

;========================================================================
; Example for download

FLASH.Erase all

; Enable flash programming
FLASH.ReProgram ALL

; Flash the Bootloader
; load bootloader
Data.Load.elf ..\..\Bootloader_Can\output\bin\TRICORE_TC29XT_Bootloader_Can.elf /verify
;Data.LOAD.elf "&elffileBoot" /verify
; load application
Data.LOAD.elf "&elffile" /verify
; init sectors for flag`s at 0xA0110000
;data.set 0xA0110000--0xA0113FFF 0x00

; To write the Validation of the Application manually (PROGRAMM in ASCII)
;data.set 0xa01fff00 0x50
;data.set 0xa01fff01 0x52
;data.set 0xa01fff02 0x4F
;data.set 0xa01fff03 0x47
;data.set 0xa01fff04 0x52
;data.set 0xa01fff05 0x41
;data.set 0xa01fff06 0x4d
;data.set 0xa01fff07 0x4d

GOSUB CheckAllBootModeHeaders
ENTRY &progflash
IF !&progflash
(
  DIALOG.YESNO "No valid Boot Mode Header found!" \
               "Flashing now can lock your device." \
               "Do you really want to program flash?"
  ENTRY &progflash
)

IF &progflash
(
  ; Finally program flash memory
  FLASH.ReProgram off
)
ELSE
(
  ; Revert loaded data
FLASH.ReProgram ALL
FLASH.ReProgram off
)

WAIT 1.s
Print "Programming successful!"
SyStem.Mode Up

; assign all cores
Sys.Down
Core.Assign 1 2 3
Core.ShowActive
Sys.Up

; optional settings:
SYStem.Option DUALPORT ON
SETUP.VAR %HEX
SETUP.VAR %SpotLight
SETUP.IMASKASM ON
SETUP.IMASKHLL ON

;========================================================================
; Load symbols
Data.LOAD.elf "&elffile" /nocode

; open some windows
do my_windows.cmm
;Register /spotlight

ENDDO

;========================================================================
; Check if at least one valid boot mode header is available
;
CheckAllBootModeHeaders:
(
  LOCAL &bmhdValid
  GOSUB CheckBootModeHeader 0xa0000000
  ENTRY &bmhdValid
  IF &bmhdValid
    RETURN &bmhdValid
  GOSUB CheckBootModeHeader 0xa0020000
  ENTRY &bmhdValid
  IF &bmhdValid
    RETURN &bmhdValid
  GOSUB CheckBootModeHeader 0xa000ffe0
  ENTRY &bmhdValid
  IF &bmhdValid
    RETURN &bmhdValid
  GOSUB CheckBootModeHeader 0xa001ffe0
  ENTRY &bmhdValid
  RETURN &bmhdValid
)

;========================================================================
; Check if Boot Mode Header has valid contents
;
CheckBootModeHeader:
(
  LOCAL &addr &result &bmhdid
  ENTRY &addr
  &result=TRUE()

  ON.ERROR GOSUB
  (
    &result=FALSE()
    RETURN
  )

  IF !STRing.FIND("&addr",":")
    &addr="C:&addr"

  ; Check Boot Mode Header ID
  &bmhdid=Data.Word(&addr+0x6)
  IF &result
  (
    IF &bmhdid!=0xB359
      &result=FALSE()
  )

  ; Check Boot Mode Header CRC
  IF &result
  (
    Data.SUM &addr++0x17 /Long /ByteSWAP /CRC32
    IF &result
    (
      Data.Set &addr+0x18 %Long Data.SUM() /DIFF
      IF &result
      (
        &result=!FOUND()
        IF &result
        (
          Data.Set &addr+0x1c %Long ~Data.SUM() /DIFF
          IF &result
          (
            &result=!FOUND()
          )
        )
      )
    )
  )

  RETURN &result
)
