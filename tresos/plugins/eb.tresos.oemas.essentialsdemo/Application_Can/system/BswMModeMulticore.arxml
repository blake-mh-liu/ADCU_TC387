AUTOSAR XML (schema 4-0-3)
package /BswMMode/PortInterfaces
  mode switch interface BwwMMode_CrossCore: is-service=true
    mode group CurrentCrossCoreMode: type=BswMModeGroup_CrossCore
package /BswMMode/ModeDeclarationGroups
  mode declaration group BswMModeGroup_CrossCore: initial-mode=EB_INTGR_BSWM_CROSS_CORE_INITIAL
    mode EB_INTGR_BSWM_CROSS_CORE_INITIAL
    mode EB_INTGR_BSWM_CROSS_CORE_STARTUP_TWO_A
package /BswMMode/DataTypeMappingSets
  data type mapping set BswMModeMapping_CrossCore: mode-request-type-map{implementation-data-type=uint8, mode-group=BswMModeGroup_CrossCore}
