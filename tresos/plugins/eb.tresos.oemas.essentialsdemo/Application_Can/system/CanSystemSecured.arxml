AUTOSAR XML (schema 4-2-1)
package /CanSystem/PDUS
  pdu Pdu_SecuredPayloadIn: length=9, transmission-mode-condition{data-filter=data-filter-type=ALWAYS, i-signal-in-i-pdu=SecureDataIn}, transmission-mode-true-timing=event-controlled-timing={number-of-repetitions=1, repetition-period=1.0}, unused-bit-pattern=0
    signal SecuredDataIn: start 7, 8 bit, big-endian, data-type-policy=PORT-INTERFACE-DEFINITION
  pdu Pdu_SecuredPayloadOut: length=9, transmission-mode-condition{data-filter=data-filter-type=ALWAYS, i-signal-in-i-pdu=SecureDataOut}, transmission-mode-true-timing=event-controlled-timing={number-of-repetitions=1, repetition-period=1.0}, unused-bit-pattern=0
    signal SecuredDataOut: start 7, 8 bit, big-endian, data-type-policy=PORT-INTERFACE-DEFINITION
  secured i pdu Pdu_SecuredIn: length=13, payload=PT_Pdu_SecuredPayloadDataIn, secure-communication-props={auth-algorithm=CMAC/AES-128, auth-info-tx-length=24, authentication-retries=2, data-id=12345, freshness-timestamp-time-period-factor=10000, freshness-value-id=0, freshness-value-length=40, freshness-value-tx-length=8, use-freshness-timestamp=true}
  secured i pdu Pdu_SecuredOut: length=13, payload=PT_Pdu_SecuredPayloadDataOut, secure-communication-props={auth-algorithm=CMAC/AES-128, auth-info-tx-length=24, authentication-retries=2, data-id=12345, freshness-timestamp-time-period-factor=10000, freshness-value-id=1, freshness-value-length=40, freshness-value-tx-length=8, use-freshness-timestamp=true}
package /CanSystem/FRAMES
  flexray frame Pdu_SecuredDataIn: frame-length=8
    pdu to frame mapping PduToFrame_Pdu_SecuredDataIn: packing-byte-order=little-endian, pdu=Pdu_SecuredIn, start-position=0
  flexray frame Pdu_SecuredDataOut: frame-length=8
    pdu to frame mapping PduToFrame_Pdu_SecuredDataOut: packing-byte-order=little-endian, pdu=Pdu_SecuredOut, start-position=0
