AUTOSAR XML (schema 4-0-3)
package /AUTOSAR/WdgM_Appl/BswModuleDescriptions
  bsw module description WdgM_Appl: module-id=30, provided-entrys=WdgM_TriggerTaskCom
    bsw internal behavior InternalBehavior_0
      exclusive area SCHM_WDGM_APPL_EXCLUSIVE_AREA_0
      bsw schedulable entity WdgM_TriggerTaskCom: implemented-entry=WdgM_TriggerTaskCom
      bsw timing event TimingEvent_TriggerFunction: starts-on-event=WdgM_TriggerTaskCom, period=0.005
package /AUTOSAR/WdgM_Appl/BswModuleEntrys
  bsw module entry WdgM_TriggerTaskCom: service-id=30, is-reentrant=false, is-synchronous=true, call-type=SCHEDULED, execution-context=TASK, sw-service-impl-policy=STANDARD
package /EB_WdgM_TxDxM6I1R0/Implementations
  bsw implementation BswImplementation_0: programming-language=C, sw-version=1.0.0, vendor-id=1, ar-release-version=4.0.3, behavior=InternalBehavior_0, vendor-specific-module-def=WdgM_Appl
    code-descriptors:
      code Files: artifact-descriptors=[{short-label=include::WdgM_Appl.h, category=SWHDR}, {short-label=src::WdgM_Appl.c, category=SWSRC}]
    resource consumption ResourceConsumption
      memory section WDGM_APPL_CODE: prefix=WDGM, sw-addrmethod=CODE, symbol=CODE
      section name prefix WDG
