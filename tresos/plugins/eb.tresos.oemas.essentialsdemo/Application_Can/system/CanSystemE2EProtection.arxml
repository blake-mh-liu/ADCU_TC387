AUTOSAR XML (schema 4-2-2)
package /DataTransformations
  data transformation set DATATRANSFORMATION_SET
    data transformation BaseTrans_Profile_5: execute-despite-data-unavailability=true, transformer-chain=[ComBasedTransformer, E2E_Profile_5]
    transformation technology ComBasedTransformer: buffer-properties={buffer-computation=compu-rational-coeffs={compu-numerator=[0, 1], compu-denominator=1}, header-length=0, in-place=false}, protocol=COMBased, transformer-class=SERIALIZER, version=1
    transformation technology E2E_Profile_5:
      buffer-properties={header-length=0, in-place=true}
      needs-original-data=false
      protocol=E2E
      end-to-end-transformation-description{max-delta-counter=3, max-error-state-init=0, max-error-state-invalid=0, max-error-state-valid=0, min-ok-state-init=1, min-ok-state-invalid=1, min-ok-state-valid=1, offset=0, profile-name=PROFILE_05, upper-header-bits-to-shift=0, window-size=10}
      transformer-class=SAFETY
      version=1.0.0
package /CanSystem/PDUS
  pdu ISIP_E2EProt_DataIn: length=8, transmission-mode-true-timing=event-controlled-timing={number-of-repetitions=1, repetition-period=1.0}, unused-bit-pattern=0
    signal SafetyE2E_DataIn_CRC: start 0, 16 bit, little-endian, system signal SysSig_E2EProt_DataIn_CRC, data-type-policy=PORT-INTERFACE-DEFINITION
    signal SafetyE2E_DataIn_SQC_Counter: start 16, 8 bit, little-endian, system signal SysSig_E2EProt_DataIn_SQC_Counter, data-type-policy=PORT-INTERFACE-DEFINITION
    signal SafetyE2E_DataIn: start 24, 8 bit, little-endian, system signal SysSig_E2EProt_DataIn, data-type-policy=PORT-INTERFACE-DEFINITION
    mapping sigGroup_E2EProt_DataIn: i-signal-group=sigGroup_E2EProt_DataIn
  pdu ISIP_E2EProt_DataOut: length=8, transmission-mode-condition{data-filter=data-filter-type=ALWAYS, i-signal-in-i-pdu=E2EProt_DataOut}, transmission-mode-true-timing=event-controlled-timing={number-of-repetitions=1, repetition-period=1.0}, unused-bit-pattern=0
    signal SafetyE2E_DataOut_CRC: start 0, 16 bit, little-endian, system signal SysSig_E2EProt_DataOut_CRC, data-type-policy=PORT-INTERFACE-DEFINITION
    signal SafetyE2E_DataOut_SQC_Counter: start 16, 8 bit, little-endian, system signal SysSig_E2EProt_DataOut_SQC_Counter, data-type-policy=PORT-INTERFACE-DEFINITION
    signal SafetyE2E_DataOut: start 24, 8 bit, little-endian, system signal SysSig_E2EProt_DataOut, data-type-policy=PORT-INTERFACE-DEFINITION
    mapping sigGroup_E2EProt_DataOut: i-signal-group=sigGroup_E2EProt_DataOut
package /CanSystem/FRAMES
  can frame CF_E2EProt_DataIn: frame-length=8
    pdu to frame mapping CF_E2EProt_DataIn: packing-byte-order=little-endian, pdu=ISIP_E2EProt_DataIn, start-position=0
  can frame CF_E2EProt_DataOut: frame-length=8
    pdu to frame mapping CF_E2EProt_DataOut: packing-byte-order=little-endian, pdu=ISIP_E2EProt_DataOut, start-position=0
package /CanSystem/ISIGNALGROUPS
  i signal group sigGroup_E2EProt_DataIn: com-based-signal-group-transformations=BaseTrans_Profile_5, i-signal=[SafetyE2E_DataIn_CRC, SafetyE2E_DataIn, SafetyE2E_DataIn_SQC_Counter], system-signal-group=sigGroup_E2EProt_DataIn, end-to-end-transformation-i-signal-props{transformer=E2E_Profile_5, data-ids=280, data-length=32}
  i signal group sigGroup_E2EProt_DataOut: com-based-signal-group-transformations=BaseTrans_Profile_5, i-signal=[SafetyE2E_DataOut_CRC, SafetyE2E_DataOut, SafetyE2E_DataOut_SQC_Counter], system-signal-group=sigGroup_E2EProt_DataOut, end-to-end-transformation-i-signal-props{transformer=E2E_Profile_5, data-ids=284, data-length=32}
