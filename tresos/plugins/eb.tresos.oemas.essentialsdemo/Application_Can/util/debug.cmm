do ..\source\boards\TriboardTC29XT_MK\${DERIVATE}.cmm ..\output\bin\${BINARY}

