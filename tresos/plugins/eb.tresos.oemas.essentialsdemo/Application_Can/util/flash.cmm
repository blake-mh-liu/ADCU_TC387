entry &elffile
do ../source/boards/TriboardTC29XT_MK/TC29XT.cmm &elffile
go
wait 10.0
sys.down
quit

