// T32 Wed Jun 28 15:18:56 2017

 B::
 
 TOOLBAR ON
 STATUSBAR ON
 FramePOS 51.375,7.0714,,,Maximized
 WinPAGE.RESet
 
 WinPAGE.Create SysSet
 WinCLEAR
 
 WinPOS 0.375 0.14286 71. 19. 0. 0. W002
 system.state
 
 WinPOS 86.25 0.0 25. 18. 0. 0. W000
 TrOnChip.view
 
 WinPAGE.Create Debug
 WinCLEAR
 
 WinPOS 16.75 16.0 54. 22. 0. 0. W001
 Register /spotlight
 
 WinPOS 0.375 0.071429 110. 52. 15. 1. W005
 WinTABS 10. 10. 25. 62.
 data.LIST 
 
 WinPOS 142.63 27.643 84. 21. 5. 0. W007
 Var.Frame /Locals /Caller
 
 WinPOS 143.5 57.714 84. 10. 0. 0. W006
 Var.Watch
 
 
 WinPOS 142.0 0.071429 84. 22. 24. 1. W004
 WinTABS 13. 0. 0. 0. 0. 0. 0. 0.
 break.LIST
 
 WinPAGE.select Debug
 
 ENDDO
