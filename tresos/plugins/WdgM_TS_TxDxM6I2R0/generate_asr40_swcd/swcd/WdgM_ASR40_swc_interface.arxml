<?xml version="1.0" encoding="UTF-8"?>
<AUTOSAR xmlns="http://autosar.org/schema/r4.0"
  xmlns:xsi="http://www.w3.org/2001/XMLSchema-instance"
  xsi:schemaLocation="http://autosar.org/schema/r4.0 AUTOSAR_4-0-3.xsd">
[!/* do not generate this file if RTE is not used */!][!//
[!AUTOSPACING!]
[!SKIPFILE "(node:existsAndFalse(WdgMGeneral/WdgMRteUsage)) or not(node:exists(WdgMGeneral/WdgMServiceAPI))"!][!//
  <AR-PACKAGES>
    <AR-PACKAGE> <!-- AUTOSAR_WdgM -->
      <SHORT-NAME>AUTOSAR_WdgM</SHORT-NAME>
      <AR-PACKAGES>
[!IF "node:existsAndTrue(WdgMGeneral/WdgMServiceAPI/WdgMEnableASR32ServiceAPI)"!]
        <!-- Provide AUTOSAR 3.2 service interface -->
        <AR-PACKAGE> <!-- ASR32 -->
          <SHORT-NAME>ASR32</SHORT-NAME>
          <AR-PACKAGES>
            <AR-PACKAGE> <!-- ImplementationDataTypes -->
              <SHORT-NAME>ImplementationDataTypes</SHORT-NAME>
              <!--
                We do not use AUTOSAR 3.2.2 package name here for the sake of consistency, since for
                the SwServiceComponentType we _HAVE_ to use the AUTSOAR 4.0.3 package name unless 3.2.2
                has been selected as default (i.e., we _CANNOT_ replicate the SwServiceComponentType
                for each activated version (e.g., one for 3.2.2 and one for 4.0.3)
              -->
              <CATEGORY>STANDARD</CATEGORY>
              <ELEMENTS>
                <IMPLEMENTATION-DATA-TYPE>
                  <SHORT-NAME>WdgM_ASR32_SupervisedEntityIdType</SHORT-NAME>
                  <CATEGORY>TYPE_REFERENCE</CATEGORY>
                  <SW-DATA-DEF-PROPS>
                    <SW-DATA-DEF-PROPS-VARIANTS>
                      <SW-DATA-DEF-PROPS-CONDITIONAL>
                        <IMPLEMENTATION-DATA-TYPE-REF DEST="IMPLEMENTATION-DATA-TYPE">/AUTOSAR_Platform/ImplementationDataTypes/uint16</IMPLEMENTATION-DATA-TYPE-REF>
                          <!--
                            We intentionally referring to AUTSOAR 4.0.3 uint8 type here - There is no need to replicate uint16 for AUTOSAR 3.2.2
                          -->
                      </SW-DATA-DEF-PROPS-CONDITIONAL>
                    </SW-DATA-DEF-PROPS-VARIANTS>
                  </SW-DATA-DEF-PROPS>
                </IMPLEMENTATION-DATA-TYPE>
                <DATA-TYPE-MAPPING-SET>
                  <SHORT-NAME>WdgM_ASR32_DataTypeMappingSet</SHORT-NAME>
                  <MODE-REQUEST-TYPE-MAPS>
                    <MODE-REQUEST-TYPE-MAP>
                      <IMPLEMENTATION-DATA-TYPE-REF DEST="IMPLEMENTATION-DATA-TYPE">/AUTOSAR_Platform/ImplementationDataTypes/uint8</IMPLEMENTATION-DATA-TYPE-REF>
                      <MODE-GROUP-REF DEST="MODE-DECLARATION-GROUP">/AUTOSAR_WdgM/ASR32/ModeDeclarationGroups/WdgM_ASR32_Mode</MODE-GROUP-REF>
                    </MODE-REQUEST-TYPE-MAP>
                  </MODE-REQUEST-TYPE-MAPS>
                </DATA-TYPE-MAPPING-SET>
              </ELEMENTS>
            </AR-PACKAGE>
            <AR-PACKAGE> <!-- ModeDeclarationGroups -->
              <SHORT-NAME>ModeDeclarationGroups</SHORT-NAME>
              <ELEMENTS>
                <MODE-DECLARATION-GROUP>
                  <SHORT-NAME>WdgM_ASR32_Mode</SHORT-NAME>
                  <INITIAL-MODE-REF DEST="MODE-DECLARATION">/AUTOSAR_WdgM/ASR32/ModeDeclarationGroups/WdgM_ASR32_Mode/ALIVE_OK</INITIAL-MODE-REF>
                  <MODE-DECLARATIONS>
                    <MODE-DECLARATION>
                      <SHORT-NAME>ALIVE_OK</SHORT-NAME>
                    </MODE-DECLARATION>
                    <MODE-DECLARATION>
                      <SHORT-NAME>ALIVE_FAILED</SHORT-NAME>
                    </MODE-DECLARATION>
                    <MODE-DECLARATION>
                      <SHORT-NAME>ALIVE_EXPIRED</SHORT-NAME>
                    </MODE-DECLARATION>
                    <MODE-DECLARATION>
                      <SHORT-NAME>ALIVE_STOPPED</SHORT-NAME>
                    </MODE-DECLARATION>
                    <MODE-DECLARATION>
                      <SHORT-NAME>ALIVE_DEACTIVATED</SHORT-NAME>
                    </MODE-DECLARATION>
                  </MODE-DECLARATIONS>
                </MODE-DECLARATION-GROUP>
              </ELEMENTS>
            </AR-PACKAGE>
            <AR-PACKAGE> <!-- PortInterfaces -->
              <SHORT-NAME>PortInterfaces</SHORT-NAME>
              <ELEMENTS>
                <CLIENT-SERVER-INTERFACE>
                  <SHORT-NAME>WdgM_ASR32_AliveSupervision</SHORT-NAME>
                  <IS-SERVICE>true</IS-SERVICE>
                  <OPERATIONS>
                    <!-- Operation UpdateAliveCounter -->
                    <CLIENT-SERVER-OPERATION>
                      <SHORT-NAME>UpdateAliveCounter</SHORT-NAME>
                      <POSSIBLE-ERROR-REFS>
                        <POSSIBLE-ERROR-REF DEST="APPLICATION-ERROR">/AUTOSAR_WdgM/ASR32/PortInterfaces/WdgM_ASR32_AliveSupervision/E_NOT_OK</POSSIBLE-ERROR-REF>
                      </POSSIBLE-ERROR-REFS>
                    </CLIENT-SERVER-OPERATION>
    [!IF "node:exists(WdgMGeneral/WdgMServiceAPI/WdgMEnableASR32ActivateAliveSupervisionAPI)"!]
                    <!-- Operation ActivateAliveSupervision -->
                    <CLIENT-SERVER-OPERATION>
                      <SHORT-NAME>ActivateAliveSupervision</SHORT-NAME>
                      <POSSIBLE-ERROR-REFS>
                        <POSSIBLE-ERROR-REF DEST="APPLICATION-ERROR">/AUTOSAR_WdgM/ASR32/PortInterfaces/WdgM_ASR32_AliveSupervision/E_NOT_OK</POSSIBLE-ERROR-REF>
                      </POSSIBLE-ERROR-REFS>
                    </CLIENT-SERVER-OPERATION>
    [!ENDIF!]
    [!IF "node:exists(WdgMGeneral/WdgMServiceAPI/WdgMEnableASR32DeactivateAliveSupervisionAPI)"!]
                    <!-- Operation DeactivateAliveSupervision -->
                    <CLIENT-SERVER-OPERATION>
                      <SHORT-NAME>DeactivateAliveSupervision</SHORT-NAME>
                      <POSSIBLE-ERROR-REFS>
                        <POSSIBLE-ERROR-REF DEST="APPLICATION-ERROR">/AUTOSAR_WdgM/ASR32/PortInterfaces/WdgM_ASR32_AliveSupervision/E_NOT_OK</POSSIBLE-ERROR-REF>
                      </POSSIBLE-ERROR-REFS>
                    </CLIENT-SERVER-OPERATION>
    [!ENDIF!]
                  </OPERATIONS>
                  <!-- PossibleErrors -->
                  <POSSIBLE-ERRORS>
                    <APPLICATION-ERROR>
                      <SHORT-NAME>E_NOT_OK</SHORT-NAME>
                      <ERROR-CODE>1</ERROR-CODE>
                    </APPLICATION-ERROR>
                  </POSSIBLE-ERRORS>
                </CLIENT-SERVER-INTERFACE>
                <!-- Interface WdgM_GlobalMode -->
                <MODE-SWITCH-INTERFACE>
                  <SHORT-NAME>WdgM_ASR32_GlobalMode</SHORT-NAME>
                  <IS-SERVICE>true</IS-SERVICE>
                  <MODE-GROUP>
                    <SHORT-NAME>currentMode</SHORT-NAME>
                    <TYPE-TREF DEST="MODE-DECLARATION-GROUP">/AUTOSAR_WdgM/ASR32/ModeDeclarationGroups/WdgM_ASR32_Mode</TYPE-TREF>
                  </MODE-GROUP>
                </MODE-SWITCH-INTERFACE>
                <!-- Interface WdgM_IndividualMode -->
                <MODE-SWITCH-INTERFACE>
                  <SHORT-NAME>WdgM_ASR32_IndividualMode</SHORT-NAME>
                  <IS-SERVICE>true</IS-SERVICE>
                  <MODE-GROUP>
                    <SHORT-NAME>currentMode</SHORT-NAME>
                    <TYPE-TREF DEST="MODE-DECLARATION-GROUP">/AUTOSAR_WdgM/ASR32/ModeDeclarationGroups/WdgM_ASR32_Mode</TYPE-TREF>
                  </MODE-GROUP>
                </MODE-SWITCH-INTERFACE>
              </ELEMENTS>
            </AR-PACKAGE>
          </AR-PACKAGES>
        </AR-PACKAGE>
[!ENDIF!]
[!IF "node:existsAndTrue(WdgMGeneral/WdgMServiceAPI/WdgMEnableASR40ServiceAPI)"!]
        <!-- Provide AUTOSAR 4.0 service interface -->
        <AR-PACKAGE> <!-- ASR40 -->
          <SHORT-NAME>ASR40</SHORT-NAME>
          <AR-PACKAGES>
            <AR-PACKAGE> <!-- ImplementationDataTypes -->
              <SHORT-NAME>ImplementationDataTypes</SHORT-NAME>
              <CATEGORY>STANDARD</CATEGORY>
              <ELEMENTS>
                <IMPLEMENTATION-DATA-TYPE>
                  <SHORT-NAME>WdgM_ASR40_SupervisedEntityIdType</SHORT-NAME>
                  <CATEGORY>TYPE_REFERENCE</CATEGORY>
                  <SW-DATA-DEF-PROPS>
                    <SW-DATA-DEF-PROPS-VARIANTS>
                      <SW-DATA-DEF-PROPS-CONDITIONAL>
                        <IMPLEMENTATION-DATA-TYPE-REF DEST="IMPLEMENTATION-DATA-TYPE">/AUTOSAR_Platform/ImplementationDataTypes/uint16</IMPLEMENTATION-DATA-TYPE-REF>
                      </SW-DATA-DEF-PROPS-CONDITIONAL>
                    </SW-DATA-DEF-PROPS-VARIANTS>
                  </SW-DATA-DEF-PROPS>
                </IMPLEMENTATION-DATA-TYPE>
                <IMPLEMENTATION-DATA-TYPE>
                  <SHORT-NAME>WdgM_ASR40_CheckpointIdType</SHORT-NAME>
                  <CATEGORY>TYPE_REFERENCE</CATEGORY>
                  <SW-DATA-DEF-PROPS>
                    <SW-DATA-DEF-PROPS-VARIANTS>
                      <SW-DATA-DEF-PROPS-CONDITIONAL>
                        <COMPU-METHOD-REF DEST="COMPU-METHOD">/AUTOSAR_WdgM/ASR40/CompuMethods/WdgM_ASR40_CheckpointIdTypeValues</COMPU-METHOD-REF>
                        <IMPLEMENTATION-DATA-TYPE-REF DEST="IMPLEMENTATION-DATA-TYPE">/AUTOSAR_Platform/ImplementationDataTypes/uint16</IMPLEMENTATION-DATA-TYPE-REF>
                      </SW-DATA-DEF-PROPS-CONDITIONAL>
                    </SW-DATA-DEF-PROPS-VARIANTS>
                  </SW-DATA-DEF-PROPS>
                </IMPLEMENTATION-DATA-TYPE>
                <DATA-TYPE-MAPPING-SET>
                  <SHORT-NAME>WdgM_ASR40_DataTypeMappingSet</SHORT-NAME>
                  <MODE-REQUEST-TYPE-MAPS>
                    <MODE-REQUEST-TYPE-MAP>
                      <IMPLEMENTATION-DATA-TYPE-REF DEST="IMPLEMENTATION-DATA-TYPE">/AUTOSAR_Platform/ImplementationDataTypes/uint8</IMPLEMENTATION-DATA-TYPE-REF>
                      <MODE-GROUP-REF DEST="MODE-DECLARATION-GROUP">/AUTOSAR_WdgM/ASR40/ModeDeclarationGroups/WdgM_ASR40_Mode</MODE-GROUP-REF>
                    </MODE-REQUEST-TYPE-MAP>
                  </MODE-REQUEST-TYPE-MAPS>
                </DATA-TYPE-MAPPING-SET>
              </ELEMENTS>
            </AR-PACKAGE>
            <AR-PACKAGE> <!-- ModeDeclarationGroups -->
              <SHORT-NAME>ModeDeclarationGroups</SHORT-NAME>
              <ELEMENTS>
                <MODE-DECLARATION-GROUP>
                  <SHORT-NAME>WdgM_ASR40_Mode</SHORT-NAME>
                  <INITIAL-MODE-REF DEST="MODE-DECLARATION">/AUTOSAR_WdgM/ASR40/ModeDeclarationGroups/WdgM_ASR40_Mode/SUPERVISION_OK</INITIAL-MODE-REF>
                  <MODE-DECLARATIONS>
                    <MODE-DECLARATION>
                      <SHORT-NAME>SUPERVISION_OK</SHORT-NAME>
                    </MODE-DECLARATION>
                    <MODE-DECLARATION>
                      <SHORT-NAME>SUPERVISION_FAILED</SHORT-NAME>
                    </MODE-DECLARATION>
                    <MODE-DECLARATION>
                      <SHORT-NAME>SUPERVISION_EXPIRED</SHORT-NAME>
                    </MODE-DECLARATION>
                    <MODE-DECLARATION>
                      <SHORT-NAME>SUPERVISION_STOPPED</SHORT-NAME>
                    </MODE-DECLARATION>
                    <MODE-DECLARATION>
                      <SHORT-NAME>SUPERVISION_DEACTIVATED</SHORT-NAME>
                    </MODE-DECLARATION>
                  </MODE-DECLARATIONS>
                </MODE-DECLARATION-GROUP>
              </ELEMENTS>
            </AR-PACKAGE>
            <AR-PACKAGE> <!-- CompuMethods -->
              <SHORT-NAME>CompuMethods</SHORT-NAME>
              <ELEMENTS>
                <COMPU-METHOD>
                  <SHORT-NAME>WdgM_ASR40_CheckpointIdTypeValues</SHORT-NAME>
                  <CATEGORY>TEXTTABLE</CATEGORY>
                  <COMPU-INTERNAL-TO-PHYS>
                    <COMPU-SCALES>
                      [!// !LINKSTO WDGM.EB.RteCheckpointIDs,1
                      [!IF "count(WdgMGeneral/WdgMSupervisedEntity/eb-list::*) > 0"!]
                      [!LOOP "util:distinct(node:order(WdgMGeneral/WdgMSupervisedEntity/eb-list::*, 'WdgMSupervisedEntityId'))"!]
                      [!IF "count(WdgMCheckpoint/eb-list::*) > 0"!]
                      [!LOOP "util:distinct(node:order(WdgMCheckpoint/eb-list::*, 'WdgMCheckpointId'))"!]
                      <COMPU-SCALE>
                        <SYMBOL>WdgMConf_WdgMCheckpoint_[!"as:name(.)"!]</SYMBOL>
                        <LOWER-LIMIT INTERVAL-TYPE="CLOSED">[!"WdgMCheckpointId"!]</LOWER-LIMIT>
                        <UPPER-LIMIT INTERVAL-TYPE="CLOSED">[!"WdgMCheckpointId"!]</UPPER-LIMIT>
                        <COMPU-CONST>
                          <VT>WdgMConf_WdgMCheckpoint_[!"as:name(.)"!]</VT>
                        </COMPU-CONST>
                      </COMPU-SCALE>
                      [!ENDLOOP!]
                      [!ENDIF!]
                      [!ENDLOOP!]
                      [!ENDIF!]
                    </COMPU-SCALES>
                  </COMPU-INTERNAL-TO-PHYS>
                </COMPU-METHOD>
              </ELEMENTS>
            </AR-PACKAGE>
            <AR-PACKAGE> <!-- PortInterfaces -->
              <SHORT-NAME>PortInterfaces</SHORT-NAME>
              <ELEMENTS>
                <!-- Interface WdgM_AliveSupervision -->
                <CLIENT-SERVER-INTERFACE>
                  <SHORT-NAME>WdgM_ASR40_AliveSupervision</SHORT-NAME>
                  <IS-SERVICE>true</IS-SERVICE>
                  <OPERATIONS>
                    <!-- operation UpdateAliveCounter -->
                    <CLIENT-SERVER-OPERATION>
                      <SHORT-NAME>UpdateAliveCounter</SHORT-NAME>
                      <POSSIBLE-ERROR-REFS>
                        <POSSIBLE-ERROR-REF DEST="APPLICATION-ERROR">/AUTOSAR_WdgM/ASR40/PortInterfaces/WdgM_ASR40_AliveSupervision/E_NOT_OK</POSSIBLE-ERROR-REF>
                      </POSSIBLE-ERROR-REFS>
                    </CLIENT-SERVER-OPERATION>
                    <!-- operation CheckpointReached -->
                    <CLIENT-SERVER-OPERATION>
                      <SHORT-NAME>CheckpointReached</SHORT-NAME>
                      <ARGUMENTS>
                        <ARGUMENT-DATA-PROTOTYPE>
                          <SHORT-NAME>CheckpointId</SHORT-NAME>
                          <TYPE-TREF DEST="IMPLEMENTATION-DATA-TYPE">/AUTOSAR_WdgM/ASR40/ImplementationDataTypes/WdgM_ASR40_CheckpointIdType</TYPE-TREF>
                          <DIRECTION>IN</DIRECTION>
                        </ARGUMENT-DATA-PROTOTYPE>
                      </ARGUMENTS>
                      <POSSIBLE-ERROR-REFS>
                        <POSSIBLE-ERROR-REF DEST="APPLICATION-ERROR">/AUTOSAR_WdgM/ASR40/PortInterfaces/WdgM_ASR40_AliveSupervision/E_NOT_OK</POSSIBLE-ERROR-REF>
                      </POSSIBLE-ERROR-REFS>
                    </CLIENT-SERVER-OPERATION>
                  </OPERATIONS>
                  <!-- posssible errors -->
                  <POSSIBLE-ERRORS>
                    <APPLICATION-ERROR>
                      <SHORT-NAME>E_NOT_OK</SHORT-NAME>
                      <ERROR-CODE>1</ERROR-CODE>
                    </APPLICATION-ERROR>
                  </POSSIBLE-ERRORS>
                </CLIENT-SERVER-INTERFACE>
                <!-- Interface WdgM_GlobalMode -->
                <MODE-SWITCH-INTERFACE>
                  <SHORT-NAME>WdgM_ASR40_GlobalMode</SHORT-NAME>
                  <IS-SERVICE>true</IS-SERVICE>
                  <MODE-GROUP>
                    <SHORT-NAME>currentMode</SHORT-NAME>
                    <TYPE-TREF DEST="MODE-DECLARATION-GROUP">/AUTOSAR_WdgM/ASR40/ModeDeclarationGroups/WdgM_ASR40_Mode</TYPE-TREF>
                  </MODE-GROUP>
                </MODE-SWITCH-INTERFACE>
                <!-- Interface WdgM_IndividualMode -->
                <MODE-SWITCH-INTERFACE>
                  <SHORT-NAME>WdgM_ASR40_IndividualMode</SHORT-NAME>
                  <IS-SERVICE>true</IS-SERVICE>
                  <MODE-GROUP>
                    <SHORT-NAME>currentMode</SHORT-NAME>
                    <TYPE-TREF DEST="MODE-DECLARATION-GROUP">/AUTOSAR_WdgM/ASR40/ModeDeclarationGroups/WdgM_ASR40_Mode</TYPE-TREF>
                  </MODE-GROUP>
                </MODE-SWITCH-INTERFACE>
              </ELEMENTS>
            </AR-PACKAGE>
          </AR-PACKAGES>
        </AR-PACKAGE>
[!ENDIF!]
[!IF "node:exists(WdgMGeneral/WdgMServiceAPI) and  WdgMGeneral/WdgMServiceAPI/WdgMDefaultASRServiceAPI = 'AUTOSAR_32'"!]
        <!-- Provide default service interface as AUTOSAR 3.2 -->
        <AR-PACKAGE> <!-- Datatypes -->
          <SHORT-NAME>Datatypes</SHORT-NAME>
            <!--
              We use AUTOSAR 3.2.2 package name here since the AUTOSAR 3.2.2 SWC will look in this package
            -->
          <CATEGORY>STANDARD</CATEGORY>
          <ELEMENTS>
            <IMPLEMENTATION-DATA-TYPE>
              <SHORT-NAME>WdgM_SupervisedEntityIdType</SHORT-NAME>
              <CATEGORY>TYPE_REFERENCE</CATEGORY>
              <SW-DATA-DEF-PROPS>
                <SW-DATA-DEF-PROPS-VARIANTS>
                  <SW-DATA-DEF-PROPS-CONDITIONAL>
                    <IMPLEMENTATION-DATA-TYPE-REF DEST="IMPLEMENTATION-DATA-TYPE">/AUTOSAR_Platform/ImplementationDataTypes/uint16</IMPLEMENTATION-DATA-TYPE-REF>
                      <!--
                        We intentionally referring to AUTSOAR 4.0.3 uint8 type here - There is no need to replicate uint16 for AUTOSAR 3.2.2
                      -->
                  </SW-DATA-DEF-PROPS-CONDITIONAL>
                </SW-DATA-DEF-PROPS-VARIANTS>
              </SW-DATA-DEF-PROPS>
            </IMPLEMENTATION-DATA-TYPE>
            <DATA-TYPE-MAPPING-SET>
              <SHORT-NAME>WdgMDataTypeMappingSet</SHORT-NAME>
              <MODE-REQUEST-TYPE-MAPS>
                <MODE-REQUEST-TYPE-MAP>
                  <IMPLEMENTATION-DATA-TYPE-REF DEST="IMPLEMENTATION-DATA-TYPE">/AUTOSAR_Platform/ImplementationDataTypes/uint8</IMPLEMENTATION-DATA-TYPE-REF>
                  <MODE-GROUP-REF DEST="MODE-DECLARATION-GROUP">/AUTOSAR_WdgM/ModeDeclarationGroups/WdgMMode</MODE-GROUP-REF>
                </MODE-REQUEST-TYPE-MAP>
              </MODE-REQUEST-TYPE-MAPS>
            </DATA-TYPE-MAPPING-SET>
          </ELEMENTS>
        </AR-PACKAGE>
        <AR-PACKAGE> <!-- ModeDeclarationGroups -->
          <SHORT-NAME>ModeDeclarationGroups</SHORT-NAME>
          <ELEMENTS>
            <MODE-DECLARATION-GROUP>
              <SHORT-NAME>WdgMMode</SHORT-NAME>
              <INITIAL-MODE-REF DEST="MODE-DECLARATION">/AUTOSAR_WdgM/ModeDeclarationGroups/WdgMMode/ALIVE_OK</INITIAL-MODE-REF>
              <MODE-DECLARATIONS>
                <MODE-DECLARATION>
                  <SHORT-NAME>ALIVE_OK</SHORT-NAME>
                </MODE-DECLARATION>
                <MODE-DECLARATION>
                  <SHORT-NAME>ALIVE_FAILED</SHORT-NAME>
                </MODE-DECLARATION>
                <MODE-DECLARATION>
                  <SHORT-NAME>ALIVE_EXPIRED</SHORT-NAME>
                </MODE-DECLARATION>
                <MODE-DECLARATION>
                  <SHORT-NAME>ALIVE_STOPPED</SHORT-NAME>
                </MODE-DECLARATION>
                <MODE-DECLARATION>
                  <SHORT-NAME>ALIVE_DEACTIVATED</SHORT-NAME>
                </MODE-DECLARATION>
              </MODE-DECLARATIONS>
            </MODE-DECLARATION-GROUP>
          </ELEMENTS>
        </AR-PACKAGE>
        <AR-PACKAGE> <!-- PortInterfaces -->
          <SHORT-NAME>PortInterfaces</SHORT-NAME>
          <ELEMENTS>
            <CLIENT-SERVER-INTERFACE>
              <SHORT-NAME>WdgM_AliveSupervision</SHORT-NAME>
              <IS-SERVICE>true</IS-SERVICE>
              <OPERATIONS>
                <!-- Operation UpdateAliveCounter -->
                <CLIENT-SERVER-OPERATION>
                  <SHORT-NAME>UpdateAliveCounter</SHORT-NAME>
                  <POSSIBLE-ERROR-REFS>
                    <POSSIBLE-ERROR-REF DEST="APPLICATION-ERROR">/AUTOSAR_WdgM/PortInterfaces/WdgM_AliveSupervision/E_NOT_OK</POSSIBLE-ERROR-REF>
                  </POSSIBLE-ERROR-REFS>
                </CLIENT-SERVER-OPERATION>
    [!IF "node:exists(WdgMGeneral/WdgMServiceAPI/WdgMEnableASR32ActivateAliveSupervisionAPI)"!]
                <!-- Operation ActivateAliveSupervision -->
                <CLIENT-SERVER-OPERATION>
                  <SHORT-NAME>ActivateAliveSupervision</SHORT-NAME>
                  <POSSIBLE-ERROR-REFS>
                    <POSSIBLE-ERROR-REF DEST="APPLICATION-ERROR">/AUTOSAR_WdgM/PortInterfaces/WdgM_AliveSupervision/E_NOT_OK</POSSIBLE-ERROR-REF>
                  </POSSIBLE-ERROR-REFS>
                </CLIENT-SERVER-OPERATION>
    [!ENDIF!]
    [!IF "node:exists(WdgMGeneral/WdgMServiceAPI/WdgMEnableASR32DeactivateAliveSupervisionAPI)"!]
                <!-- Operation DeactivateAliveSupervision -->
                <CLIENT-SERVER-OPERATION>
                  <SHORT-NAME>DeactivateAliveSupervision</SHORT-NAME>
                  <POSSIBLE-ERROR-REFS>
                    <POSSIBLE-ERROR-REF DEST="APPLICATION-ERROR">/AUTOSAR_WdgM/PortInterfaces/WdgM_AliveSupervision/E_NOT_OK</POSSIBLE-ERROR-REF>
                  </POSSIBLE-ERROR-REFS>
                </CLIENT-SERVER-OPERATION>
    [!ENDIF!]
              </OPERATIONS>
              <!-- PossibleErrors -->
              <POSSIBLE-ERRORS>
                <APPLICATION-ERROR>
                  <SHORT-NAME>E_NOT_OK</SHORT-NAME>
                  <ERROR-CODE>1</ERROR-CODE>
                </APPLICATION-ERROR>
              </POSSIBLE-ERRORS>
            </CLIENT-SERVER-INTERFACE>
            <!-- Interface WdgM_GlobalMode -->
            <MODE-SWITCH-INTERFACE>
              <SHORT-NAME>WdgM_GlobalMode</SHORT-NAME>
              <IS-SERVICE>true</IS-SERVICE>
              <MODE-GROUP>
                <SHORT-NAME>currentMode</SHORT-NAME>
                <TYPE-TREF DEST="MODE-DECLARATION-GROUP">/AUTOSAR_WdgM/ModeDeclarationGroups/WdgMMode</TYPE-TREF>
              </MODE-GROUP>
            </MODE-SWITCH-INTERFACE>
            <!-- Interface WdgM_IndividualMode -->
            <MODE-SWITCH-INTERFACE>
              <SHORT-NAME>WdgM_IndividualMode</SHORT-NAME>
              <IS-SERVICE>true</IS-SERVICE>
              <MODE-GROUP>
                <SHORT-NAME>currentMode</SHORT-NAME>
                <TYPE-TREF DEST="MODE-DECLARATION-GROUP">/AUTOSAR_WdgM/ModeDeclarationGroups/WdgMMode</TYPE-TREF>
              </MODE-GROUP>
            </MODE-SWITCH-INTERFACE>
          </ELEMENTS>
        </AR-PACKAGE>
[!ENDIF!]
[!IF "node:exists(WdgMGeneral/WdgMServiceAPI) and WdgMGeneral/WdgMServiceAPI/WdgMDefaultASRServiceAPI = 'AUTOSAR_40'"!]
        <!-- Provide default service interface as AUTOSAR 4.0 -->
        <AR-PACKAGE> <!-- ImplementationDataTypes -->
          <SHORT-NAME>ImplementationDataTypes</SHORT-NAME>
          <CATEGORY>STANDARD</CATEGORY>
          <ELEMENTS>
            <IMPLEMENTATION-DATA-TYPE>
              <SHORT-NAME>WdgM_SupervisedEntityIdType</SHORT-NAME>
              <CATEGORY>TYPE_REFERENCE</CATEGORY>
              <SW-DATA-DEF-PROPS>
                <SW-DATA-DEF-PROPS-VARIANTS>
                  <SW-DATA-DEF-PROPS-CONDITIONAL>
                    <IMPLEMENTATION-DATA-TYPE-REF DEST="IMPLEMENTATION-DATA-TYPE">/AUTOSAR_Platform/ImplementationDataTypes/uint16</IMPLEMENTATION-DATA-TYPE-REF>
                  </SW-DATA-DEF-PROPS-CONDITIONAL>
                </SW-DATA-DEF-PROPS-VARIANTS>
              </SW-DATA-DEF-PROPS>
            </IMPLEMENTATION-DATA-TYPE>
            <IMPLEMENTATION-DATA-TYPE>
              <SHORT-NAME>WdgM_CheckpointIdType</SHORT-NAME>
              <CATEGORY>TYPE_REFERENCE</CATEGORY>
              <SW-DATA-DEF-PROPS>
                <SW-DATA-DEF-PROPS-VARIANTS>
                  <SW-DATA-DEF-PROPS-CONDITIONAL>
                    <COMPU-METHOD-REF DEST="COMPU-METHOD">/AUTOSAR_WdgM/CompuMethods/WdgM_CheckpointIdTypeValues</COMPU-METHOD-REF>
                    <IMPLEMENTATION-DATA-TYPE-REF DEST="IMPLEMENTATION-DATA-TYPE">/AUTOSAR_Platform/ImplementationDataTypes/uint16</IMPLEMENTATION-DATA-TYPE-REF>
                  </SW-DATA-DEF-PROPS-CONDITIONAL>
                </SW-DATA-DEF-PROPS-VARIANTS>
              </SW-DATA-DEF-PROPS>
            </IMPLEMENTATION-DATA-TYPE>
            <DATA-TYPE-MAPPING-SET>
              <SHORT-NAME>WdgMDataTypeMappingSet</SHORT-NAME>
              <MODE-REQUEST-TYPE-MAPS>
                <MODE-REQUEST-TYPE-MAP>
                  <IMPLEMENTATION-DATA-TYPE-REF DEST="IMPLEMENTATION-DATA-TYPE">/AUTOSAR_Platform/ImplementationDataTypes/uint8</IMPLEMENTATION-DATA-TYPE-REF>
                  <MODE-GROUP-REF DEST="MODE-DECLARATION-GROUP">/AUTOSAR_WdgM/ModeDeclarationGroups/WdgMMode</MODE-GROUP-REF>
                </MODE-REQUEST-TYPE-MAP>
              </MODE-REQUEST-TYPE-MAPS>
            </DATA-TYPE-MAPPING-SET>
          </ELEMENTS>
        </AR-PACKAGE>
        <AR-PACKAGE> <!-- ModeDeclarationGroups -->
          <SHORT-NAME>ModeDeclarationGroups</SHORT-NAME>
          <ELEMENTS>
            <MODE-DECLARATION-GROUP>
              <SHORT-NAME>WdgMMode</SHORT-NAME>
              <INITIAL-MODE-REF DEST="MODE-DECLARATION">/AUTOSAR_WdgM/ModeDeclarationGroups/WdgMMode/SUPERVISION_OK</INITIAL-MODE-REF>
              <MODE-DECLARATIONS>
                <MODE-DECLARATION>
                  <SHORT-NAME>SUPERVISION_OK</SHORT-NAME>
                </MODE-DECLARATION>
                <MODE-DECLARATION>
                  <SHORT-NAME>SUPERVISION_FAILED</SHORT-NAME>
                </MODE-DECLARATION>
                <MODE-DECLARATION>
                  <SHORT-NAME>SUPERVISION_EXPIRED</SHORT-NAME>
                </MODE-DECLARATION>
                <MODE-DECLARATION>
                  <SHORT-NAME>SUPERVISION_STOPPED</SHORT-NAME>
                </MODE-DECLARATION>
                <MODE-DECLARATION>
                  <SHORT-NAME>SUPERVISION_DEACTIVATED</SHORT-NAME>
                </MODE-DECLARATION>
              </MODE-DECLARATIONS>
            </MODE-DECLARATION-GROUP>
          </ELEMENTS>
        </AR-PACKAGE>
        <AR-PACKAGE> <!-- CompuMethods -->
          <SHORT-NAME>CompuMethods</SHORT-NAME>
          <ELEMENTS>
            <COMPU-METHOD>
              <SHORT-NAME>WdgM_CheckpointIdTypeValues</SHORT-NAME>
              <CATEGORY>TEXTTABLE</CATEGORY>
              <COMPU-INTERNAL-TO-PHYS>
                <COMPU-SCALES>
                  [!// !LINKSTO WDGM.EB.RteCheckpointIDs,1
                  [!IF "count(WdgMGeneral/WdgMSupervisedEntity/eb-list::*) > 0"!]
                  [!LOOP "util:distinct(node:order(WdgMGeneral/WdgMSupervisedEntity/eb-list::*, 'WdgMSupervisedEntityId'))"!]
                  [!IF "count(WdgMCheckpoint/eb-list::*) > 0"!]
                  [!LOOP "util:distinct(node:order(WdgMCheckpoint/eb-list::*, 'WdgMCheckpointId'))"!]
                  <COMPU-SCALE>
                    <SYMBOL>WdgMConf_WdgMCheckpoint_[!"as:name(.)"!]</SYMBOL>
                    <LOWER-LIMIT INTERVAL-TYPE="CLOSED">[!"WdgMCheckpointId"!]</LOWER-LIMIT>
                    <UPPER-LIMIT INTERVAL-TYPE="CLOSED">[!"WdgMCheckpointId"!]</UPPER-LIMIT>
                    <COMPU-CONST>
                      <VT>WdgMConf_WdgMCheckpoint_[!"as:name(.)"!]</VT>
                    </COMPU-CONST>
                  </COMPU-SCALE>
                  [!ENDLOOP!]
                  [!ENDIF!]
                  [!ENDLOOP!]
                  [!ENDIF!]
                </COMPU-SCALES>
              </COMPU-INTERNAL-TO-PHYS>
            </COMPU-METHOD>
          </ELEMENTS>
        </AR-PACKAGE>
        <AR-PACKAGE> <!-- PortInterfaces -->
          <SHORT-NAME>PortInterfaces</SHORT-NAME>
          <ELEMENTS>
            <!-- Interface WdgM_AliveSupervision -->
            <CLIENT-SERVER-INTERFACE>
              <SHORT-NAME>WdgM_AliveSupervision</SHORT-NAME>
              <IS-SERVICE>true</IS-SERVICE>
              <OPERATIONS>
                <!-- operation UpdateAliveCounter -->
                <CLIENT-SERVER-OPERATION>
                  <SHORT-NAME>UpdateAliveCounter</SHORT-NAME>
                  <POSSIBLE-ERROR-REFS>
                    <POSSIBLE-ERROR-REF DEST="APPLICATION-ERROR">/AUTOSAR_WdgM/PortInterfaces/WdgM_AliveSupervision/E_NOT_OK</POSSIBLE-ERROR-REF>
                  </POSSIBLE-ERROR-REFS>
                </CLIENT-SERVER-OPERATION>
                <!-- operation CheckpointReached -->
                <CLIENT-SERVER-OPERATION>
                  <SHORT-NAME>CheckpointReached</SHORT-NAME>
                  <ARGUMENTS>
                    <ARGUMENT-DATA-PROTOTYPE>
                      <SHORT-NAME>CheckpointId</SHORT-NAME>
                      <TYPE-TREF DEST="IMPLEMENTATION-DATA-TYPE">/AUTOSAR_WdgM/ImplementationDataTypes/WdgM_CheckpointIdType</TYPE-TREF>
                      <DIRECTION>IN</DIRECTION>
                    </ARGUMENT-DATA-PROTOTYPE>
                  </ARGUMENTS>
                  <POSSIBLE-ERROR-REFS>
                    <POSSIBLE-ERROR-REF DEST="APPLICATION-ERROR">/AUTOSAR_WdgM/PortInterfaces/WdgM_AliveSupervision/E_NOT_OK</POSSIBLE-ERROR-REF>
                  </POSSIBLE-ERROR-REFS>
                </CLIENT-SERVER-OPERATION>
              </OPERATIONS>
              <!-- posssible errors -->
              <POSSIBLE-ERRORS>
                <APPLICATION-ERROR>
                  <SHORT-NAME>E_NOT_OK</SHORT-NAME>
                  <ERROR-CODE>1</ERROR-CODE>
                </APPLICATION-ERROR>
              </POSSIBLE-ERRORS>
            </CLIENT-SERVER-INTERFACE>
            <!-- Interface WdgM_GlobalMode -->
            <MODE-SWITCH-INTERFACE>
              <SHORT-NAME>WdgM_GlobalMode</SHORT-NAME>
              <IS-SERVICE>true</IS-SERVICE>
              <MODE-GROUP>
                <SHORT-NAME>currentMode</SHORT-NAME>
                <TYPE-TREF DEST="MODE-DECLARATION-GROUP">/AUTOSAR_WdgM/ModeDeclarationGroups/WdgMMode</TYPE-TREF>
              </MODE-GROUP>
            </MODE-SWITCH-INTERFACE>
            <!-- Interface WdgM_IndividualMode -->
            <MODE-SWITCH-INTERFACE>
              <SHORT-NAME>WdgM_IndividualMode</SHORT-NAME>
              <IS-SERVICE>true</IS-SERVICE>
              <MODE-GROUP>
                <SHORT-NAME>currentMode</SHORT-NAME>
                <TYPE-TREF DEST="MODE-DECLARATION-GROUP">/AUTOSAR_WdgM/ModeDeclarationGroups/WdgMMode</TYPE-TREF>
              </MODE-GROUP>
            </MODE-SWITCH-INTERFACE>
          </ELEMENTS>
        </AR-PACKAGE>
[!ENDIF!]
      </AR-PACKAGES>
    </AR-PACKAGE>
  </AR-PACKAGES>
</AUTOSAR>
