AUTOSAR XML (schema 00046)
package /TS_TxDxM6I3R0
  module config ComRecConfigurationStandard: definition=Com
    ComGeneral: ComConfigurationUseDet=1, ComVersionInfoApi=1
      VendorSpecific:
        ComRamSizeMax = INDEX_UINT16
        ComCbkTxTOutArraySizeMax = INDEX_UINT16
        ComCbkRxTOutArraySizeMax = INDEX_UINT16
        ComCbkRxAckPtrArraySizeMax = INDEX_UINT16
        ComCbkTxAckPtrArraySizeMax = INDEX_UINT16
        ComCallOutFuncPtrArraySizeMax = INDEX_UINT16
        ComTriggerTxCallOutEnable = 1
        ComRxDataTimeoutAction = RX_DATA_TIMEOUT_ACTION_CONFIG
        ComRxTimeoutFactorSize = SIZE_16_BIT
        ComRxFirstTimeoutFactorSize = SIZE_16_BIT
        ComTxTimeoutFactorSize = SIZE_16_BIT
        ComTxModeRepetitionPeriodFactorS = SIZE_16_BIT
        ComTxModeTimeOffsetFactorSize = SIZE_16_BIT
        ComTxModeTimePeriodFactorSize = SIZE_16_BIT
        ComTxIpduMDTFactorSize = SIZE_16_BIT
        ComUpdateBitRxConfig = UPDATE_BIT_INDIVIDUAL
        ComUpdateBitTxConfig = UPDATE_BIT_INDIVIDUAL
        ComTmsEnable = 1
        ComFilterReceiverEnable = 1
        ComTxDynLengthIPduEnable = 1
        ComRxDynLengthIPduEnable = 1
        ComFilterOneEveryNPeriodOffSMax = SIZE_16_BIT
        ComFilterOneEveryNOccuranceMax = SIZE_16_BIT
        ComTxModeDirectEnable = 1
        ComTxModeNTimesEnable = 1
        ComTxModePeriodicEnable = 1
        ComTxModeMixedDirectEnable = 1
        ComTxModeMixedNTimesEnable = 1
        ComTxSigConfDeferredEnable = 1
        ComTxSigConfImmediateEnable = 1
        ComRxSigConfDeferredEnable = 1
        ComRxSigConfImmediateEnable = 1
        ComSignalGwEnable = 1
        ComCheckValueSizeEnable = 0
        ComConstCfgAddressEnable = 0
        ComRelocatableCfgEnable = 1
        Com_TxF_MaskNewDiffersMaskOld_En = 1
