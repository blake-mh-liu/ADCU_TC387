AUTOSAR XML (schema 00046)
package /TS_TxDxM6I3R0
  module config ComRecConfigurationSmall: definition=Com
    ComGeneral: ComConfigurationUseDet=0, ComVersionInfoApi=0
      VendorSpecific:
        ComRamSizeMax = INDEX_UINT8
        ComCbkTxTOutArraySizeMax = INDEX_NONE
        ComCbkRxTOutArraySizeMax = INDEX_NONE
        ComCbkRxAckPtrArraySizeMax = INDEX_UINT8
        ComCbkTxAckPtrArraySizeMax = INDEX_NONE
        ComCallOutFuncPtrArraySizeMax = INDEX_NONE
        ComRxDataTimeoutAction = RX_DATA_TIMEOUT_ACTION_NONE
        ComRxTimeoutFactorSize = SIZE_0_BIT
        ComRxFirstTimeoutFactorSize = SIZE_0_BIT
        ComTxTimeoutFactorSize = SIZE_0_BIT
        ComTxModeRepetitionPeriodFactorS = SIZE_8_BIT
        ComTxModeTimeOffsetFactorSize = SIZE_8_BIT
        ComTxModeTimePeriodFactorSize = SIZE_8_BIT
        ComTxIpduMDTFactorSize = SIZE_0_BIT
        ComUpdateBitRxConfig = UPDATE_BIT_ABSENT_FOR_ALL
        ComUpdateBitTxConfig = UPDATE_BIT_ABSENT_FOR_ALL
        ComTmsEnable = 0
        ComFilterReceiverEnable = 0
        ComTxDynLengthIPduEnable = 0
        ComRxDynLengthIPduEnable = 0
        ComFilterOneEveryNPeriodOffSMax = SIZE_0_BIT
        ComFilterOneEveryNOccuranceMax = SIZE_0_BIT
        ComTxModeDirectEnable = 1
        ComTxModeNTimesEnable = 1
        ComTxModePeriodicEnable = 1
        ComTxModeMixedDirectEnable = 0
        ComTxModeMixedNTimesEnable = 0
        ComTxSigConfDeferredEnable = 0
        ComTxSigConfImmediateEnable = 1
        ComRxSigConfDeferredEnable = 0
        ComRxSigConfImmediateEnable = 1
        ComSignalGwEnable = 0
        ComCheckValueSizeEnable = 0
        ComConstCfgAddressEnable = 0
        ComRelocatableCfgEnable = 1
