<?xml version="1.0" encoding="ISO-8859-1"?>
[!AUTOSPACING!][!//
<AUTOSAR xmlns="http://autosar.org/schema/r4.0"
  xmlns:xsi="http://www.w3.org/2001/XMLSchema-instance"
  xsi:schemaLocation="http://autosar.org/schema/r4.0 AUTOSAR_4-2-1.xsd">
  <AR-PACKAGES>
    <AR-PACKAGE>
      <SHORT-NAME>AUTOSAR_Dcm</SHORT-NAME>
      <AR-PACKAGES>
        <AR-PACKAGE>
          <SHORT-NAME>BswModuleDescriptions</SHORT-NAME>
          <ELEMENTS>
            <BSW-MODULE-DESCRIPTION>
              <SHORT-NAME>Dcm</SHORT-NAME>
              <MODULE-ID>53</MODULE-ID>
              <PROVIDED-ENTRYS>
                <BSW-MODULE-ENTRY-REF-CONDITIONAL>
                  <BSW-MODULE-ENTRY-REF DEST="BSW-MODULE-ENTRY">/AUTOSAR_Dcm/BswModuleEntrys/Dcm_MainFunction</BSW-MODULE-ENTRY-REF>
                </BSW-MODULE-ENTRY-REF-CONDITIONAL>
              </PROVIDED-ENTRYS>
              <INTERNAL-BEHAVIORS>
                <BSW-INTERNAL-BEHAVIOR>
                  <SHORT-NAME>InternalBehavior_0</SHORT-NAME>
                  <ENTITYS>
                    <BSW-SCHEDULABLE-ENTITY>
                      <SHORT-NAME>Dcm_MainFunction</SHORT-NAME>
                      <MINIMUM-START-INTERVAL>0.0</MINIMUM-START-INTERVAL>
                      <IMPLEMENTED-ENTRY-REF DEST="BSW-MODULE-ENTRY">/AUTOSAR_Dcm/BswModuleEntrys/Dcm_MainFunction</IMPLEMENTED-ENTRY-REF>
                    </BSW-SCHEDULABLE-ENTITY>
                  </ENTITYS>
                  <EVENTS>
                    <BSW-TIMING-EVENT>
                      <SHORT-NAME>TimingEvent_MainFunction</SHORT-NAME>
                      <STARTS-ON-EVENT-REF DEST="BSW-SCHEDULABLE-ENTITY">/AUTOSAR_Dcm/BswModuleDescriptions/Dcm/InternalBehavior_0/Dcm_MainFunction</STARTS-ON-EVENT-REF>
                      <PERIOD>[!"DcmConfigSet/eb-list::*[1]/DcmGeneral/DcmTaskTime"!]</PERIOD>
                    </BSW-TIMING-EVENT>
                  </EVENTS>
                </BSW-INTERNAL-BEHAVIOR>
              </INTERNAL-BEHAVIORS>
            </BSW-MODULE-DESCRIPTION>
          </ELEMENTS>
        </AR-PACKAGE>
        <AR-PACKAGE>
          <SHORT-NAME>BswModuleEntrys</SHORT-NAME>
          <ELEMENTS>
            <BSW-MODULE-ENTRY>
              <SHORT-NAME>Dcm_MainFunction</SHORT-NAME>
              <SERVICE-ID>37</SERVICE-ID>
              <IS-REENTRANT>false</IS-REENTRANT>
              <IS-SYNCHRONOUS>true</IS-SYNCHRONOUS>
              <CALL-TYPE>SCHEDULED</CALL-TYPE>
              <EXECUTION-CONTEXT>TASK</EXECUTION-CONTEXT>
              <SW-SERVICE-IMPL-POLICY>STANDARD</SW-SERVICE-IMPL-POLICY>
              <ARGUMENTS>
              </ARGUMENTS>
            </BSW-MODULE-ENTRY>
          </ELEMENTS>
        </AR-PACKAGE>
      </AR-PACKAGES>
    </AR-PACKAGE>
    <AR-PACKAGE>
      <SHORT-NAME>EB_Dcm</SHORT-NAME>
      <AR-PACKAGES>
        <AR-PACKAGE>
          <SHORT-NAME>Implementations</SHORT-NAME>
          <ELEMENTS>
            <BSW-IMPLEMENTATION>
              <SHORT-NAME>BswImplementation_0</SHORT-NAME>
              <CODE-DESCRIPTORS>
                <CODE>
                  <SHORT-NAME>Files</SHORT-NAME>
                  <ARTIFACT-DESCRIPTORS>
                    <AUTOSAR-ENGINEERING-OBJECT>
                      <SHORT-LABEL>Autosar::include::Dcm.h</SHORT-LABEL>
                      <CATEGORY>SWHDR</CATEGORY>
                    </AUTOSAR-ENGINEERING-OBJECT>
                    <AUTOSAR-ENGINEERING-OBJECT>
                      <SHORT-LABEL>Autosar::include::Dcm_Authentication.h</SHORT-LABEL>
                      <CATEGORY>SWHDR</CATEGORY>
                    </AUTOSAR-ENGINEERING-OBJECT>
                    <AUTOSAR-ENGINEERING-OBJECT>
                      <SHORT-LABEL>Autosar::include::Dcm_Authentication_AuthenticationHandler.h</SHORT-LABEL>
                      <CATEGORY>SWHDR</CATEGORY>
                    </AUTOSAR-ENGINEERING-OBJECT>
                    <AUTOSAR-ENGINEERING-OBJECT>
                      <SHORT-LABEL>Autosar::include::Dcm_Authentication_CryptoStackFacade.h</SHORT-LABEL>
                      <CATEGORY>SWHDR</CATEGORY>
                    </AUTOSAR-ENGINEERING-OBJECT>
                    <AUTOSAR-ENGINEERING-OBJECT>
                      <SHORT-LABEL>Autosar::include::Dcm_Authentication_DiagnosticPolicyHandler.h</SHORT-LABEL>
                      <CATEGORY>SWHDR</CATEGORY>
                    </AUTOSAR-ENGINEERING-OBJECT>
                    <AUTOSAR-ENGINEERING-OBJECT>
                      <SHORT-LABEL>Autosar::include::Dcm_Cbk.h</SHORT-LABEL>
                      <CATEGORY>SWHDR</CATEGORY>
                    </AUTOSAR-ENGINEERING-OBJECT>
                    <AUTOSAR-ENGINEERING-OBJECT>
                      <SHORT-LABEL>Autosar::include::Dcm_Dsl_ComMChannelStateManager.h</SHORT-LABEL>
                      <CATEGORY>SWHDR</CATEGORY>
                    </AUTOSAR-ENGINEERING-OBJECT>
                    <AUTOSAR-ENGINEERING-OBJECT>
                      <SHORT-LABEL>Autosar::include::Dcm_Dsl_ComMChannelStateManager_External_Interface.h</SHORT-LABEL>
                      <CATEGORY>SWHDR</CATEGORY>
                    </AUTOSAR-ENGINEERING-OBJECT>
                    <AUTOSAR-ENGINEERING-OBJECT>
                      <SHORT-LABEL>Autosar::include::Dcm_Dsl_CommunicationServices.h</SHORT-LABEL>
                      <CATEGORY>SWHDR</CATEGORY>
                    </AUTOSAR-ENGINEERING-OBJECT>
                    <AUTOSAR-ENGINEERING-OBJECT>
                      <SHORT-LABEL>Autosar::include::Dcm_Dsl_CommunicationServices_BufferManager.h</SHORT-LABEL>
                      <CATEGORY>SWHDR</CATEGORY>
                    </AUTOSAR-ENGINEERING-OBJECT>
                    <AUTOSAR-ENGINEERING-OBJECT>
                      <SHORT-LABEL>Autosar::include::Dcm_Dsl_CommunicationServices_MetaData.h</SHORT-LABEL>
                      <CATEGORY>SWHDR</CATEGORY>
                    </AUTOSAR-ENGINEERING-OBJECT>
                    <AUTOSAR-ENGINEERING-OBJECT>
                      <SHORT-LABEL>Autosar::include::Dcm_Dsl_CommunicationServices_RxConnections.h</SHORT-LABEL>
                      <CATEGORY>SWHDR</CATEGORY>
                    </AUTOSAR-ENGINEERING-OBJECT>
                    <AUTOSAR-ENGINEERING-OBJECT>
                      <SHORT-LABEL>Autosar::include::Dcm_Dsl_CommunicationServices_TxConnections.h</SHORT-LABEL>
                      <CATEGORY>SWHDR</CATEGORY>
                    </AUTOSAR-ENGINEERING-OBJECT>
                    <AUTOSAR-ENGINEERING-OBJECT>
                      <SHORT-LABEL>Autosar::include::Dcm_Dsl_DiagnosticSessionHandler.h</SHORT-LABEL>
                      <CATEGORY>SWHDR</CATEGORY>
                    </AUTOSAR-ENGINEERING-OBJECT>
                    <AUTOSAR-ENGINEERING-OBJECT>
                      <SHORT-LABEL>Autosar::include::Dcm_Dsl_PostBootOperationsHandler.h</SHORT-LABEL>
                      <CATEGORY>SWHDR</CATEGORY>
                    </AUTOSAR-ENGINEERING-OBJECT>
                    <AUTOSAR-ENGINEERING-OBJECT>
                      <SHORT-LABEL>Autosar::include::Dcm_Dsl_RoeServices.h</SHORT-LABEL>
                      <CATEGORY>SWHDR</CATEGORY>
                    </AUTOSAR-ENGINEERING-OBJECT>
                    <AUTOSAR-ENGINEERING-OBJECT>
                      <SHORT-LABEL>Autosar::include::Dcm_Dsl_SecurityLevelHandler.h</SHORT-LABEL>
                      <CATEGORY>SWHDR</CATEGORY>
                    </AUTOSAR-ENGINEERING-OBJECT>
                    <AUTOSAR-ENGINEERING-OBJECT>
                      <SHORT-LABEL>Autosar::include::Dcm_Dsl_Supervisor.h</SHORT-LABEL>
                      <CATEGORY>SWHDR</CATEGORY>
                    </AUTOSAR-ENGINEERING-OBJECT>
                    <AUTOSAR-ENGINEERING-OBJECT>
                      <SHORT-LABEL>Autosar::include::Dcm_Dsl_Supervisor_CommunicationSessionHandling.h</SHORT-LABEL>
                      <CATEGORY>SWHDR</CATEGORY>
                    </AUTOSAR-ENGINEERING-OBJECT>
                    <AUTOSAR-ENGINEERING-OBJECT>
                      <SHORT-LABEL>Autosar::include::Dcm_Dsl_Supervisor_MainConnectionHandling.h</SHORT-LABEL>
                      <CATEGORY>SWHDR</CATEGORY>
                    </AUTOSAR-ENGINEERING-OBJECT>
                    <AUTOSAR-ENGINEERING-OBJECT>
                      <SHORT-LABEL>Autosar::include::Dcm_Dsl_Supervisor_ProtocolHandling.h</SHORT-LABEL>
                      <CATEGORY>SWHDR</CATEGORY>
                    </AUTOSAR-ENGINEERING-OBJECT>
                    <AUTOSAR-ENGINEERING-OBJECT>
                      <SHORT-LABEL>Autosar::include::Dcm_DspExternal.h</SHORT-LABEL>
                      <CATEGORY>SWHDR</CATEGORY>
                    </AUTOSAR-ENGINEERING-OBJECT>
                    <AUTOSAR-ENGINEERING-OBJECT>
                      <SHORT-LABEL>Autosar::include::Dcm_Dsp_ApplicationDiagnosticRequests.h</SHORT-LABEL>
                      <CATEGORY>SWHDR</CATEGORY>
                    </AUTOSAR-ENGINEERING-OBJECT>
                    <AUTOSAR-ENGINEERING-OBJECT>
                      <SHORT-LABEL>Autosar::include::Dcm_Dsp_Contexts.h</SHORT-LABEL>
                      <CATEGORY>SWHDR</CATEGORY>
                    </AUTOSAR-ENGINEERING-OBJECT>
                    <AUTOSAR-ENGINEERING-OBJECT>
                      <SHORT-LABEL>Autosar::include::Dcm_Dsp_DataTransferServices.h</SHORT-LABEL>
                      <CATEGORY>SWHDR</CATEGORY>
                    </AUTOSAR-ENGINEERING-OBJECT>
                    <AUTOSAR-ENGINEERING-OBJECT>
                      <SHORT-LABEL>Autosar::include::Dcm_Dsp_DemFacade.h</SHORT-LABEL>
                      <CATEGORY>SWHDR</CATEGORY>
                    </AUTOSAR-ENGINEERING-OBJECT>
                    <AUTOSAR-ENGINEERING-OBJECT>
                      <SHORT-LABEL>Autosar::include::Dcm_Dsp_DidServices.h</SHORT-LABEL>
                      <CATEGORY>SWHDR</CATEGORY>
                    </AUTOSAR-ENGINEERING-OBJECT>
                    <AUTOSAR-ENGINEERING-OBJECT>
                      <SHORT-LABEL>Autosar::include::Dcm_Dsp_DidSignals.h</SHORT-LABEL>
                      <CATEGORY>SWHDR</CATEGORY>
                    </AUTOSAR-ENGINEERING-OBJECT>
                    <AUTOSAR-ENGINEERING-OBJECT>
                      <SHORT-LABEL>Autosar::include::Dcm_Dsp_EndiannessInterpretation.h</SHORT-LABEL>
                      <CATEGORY>SWHDR</CATEGORY>
                    </AUTOSAR-ENGINEERING-OBJECT>
                    <AUTOSAR-ENGINEERING-OBJECT>
                      <SHORT-LABEL>Autosar::include::Dcm_Dsp_MemoryServices.h</SHORT-LABEL>
                      <CATEGORY>SWHDR</CATEGORY>
                    </AUTOSAR-ENGINEERING-OBJECT>
                    <AUTOSAR-ENGINEERING-OBJECT>
                      <SHORT-LABEL>Autosar::include::Dcm_Dsp_MidServices.h</SHORT-LABEL>
                      <CATEGORY>SWHDR</CATEGORY>
                    </AUTOSAR-ENGINEERING-OBJECT>
                    <AUTOSAR-ENGINEERING-OBJECT>
                      <SHORT-LABEL>Autosar::include::Dcm_Dsp_PidServices.h</SHORT-LABEL>
                      <CATEGORY>SWHDR</CATEGORY>
                    </AUTOSAR-ENGINEERING-OBJECT>
                    <AUTOSAR-ENGINEERING-OBJECT>
                      <SHORT-LABEL>Autosar::include::Dcm_Dsp_SvcH_Authentication.h</SHORT-LABEL>
                      <CATEGORY>SWHDR</CATEGORY>
                    </AUTOSAR-ENGINEERING-OBJECT>
                    <AUTOSAR-ENGINEERING-OBJECT>
                      <SHORT-LABEL>Autosar::include::Dcm_Dsp_SvcH_ClearDiagnosticInformation.h</SHORT-LABEL>
                      <CATEGORY>SWHDR</CATEGORY>
                    </AUTOSAR-ENGINEERING-OBJECT>
                    <AUTOSAR-ENGINEERING-OBJECT>
                      <SHORT-LABEL>Autosar::include::Dcm_Dsp_SvcH_CommunicationControl.h</SHORT-LABEL>
                      <CATEGORY>SWHDR</CATEGORY>
                    </AUTOSAR-ENGINEERING-OBJECT>
                    <AUTOSAR-ENGINEERING-OBJECT>
                      <SHORT-LABEL>Autosar::include::Dcm_Dsp_SvcH_ControlDTCSetting.h</SHORT-LABEL>
                      <CATEGORY>SWHDR</CATEGORY>
                    </AUTOSAR-ENGINEERING-OBJECT>
                    <AUTOSAR-ENGINEERING-OBJECT>
                      <SHORT-LABEL>Autosar::include::Dcm_Dsp_SvcH_DynamicallyDefineDataIdentifier.h</SHORT-LABEL>
                      <CATEGORY>SWHDR</CATEGORY>
                    </AUTOSAR-ENGINEERING-OBJECT>
                    <AUTOSAR-ENGINEERING-OBJECT>
                      <SHORT-LABEL>Autosar::include::Dcm_Dsp_SvcH_InputOutputControlByIdentifier.h</SHORT-LABEL>
                      <CATEGORY>SWHDR</CATEGORY>
                    </AUTOSAR-ENGINEERING-OBJECT>
                    <AUTOSAR-ENGINEERING-OBJECT>
                      <SHORT-LABEL>Autosar::include::Dcm_Dsp_SvcH_LinkControl.h</SHORT-LABEL>
                      <CATEGORY>SWHDR</CATEGORY>
                    </AUTOSAR-ENGINEERING-OBJECT>
                    <AUTOSAR-ENGINEERING-OBJECT>
                      <SHORT-LABEL>Autosar::include::Dcm_Dsp_SvcH_ReadDTCInformation.h</SHORT-LABEL>
                      <CATEGORY>SWHDR</CATEGORY>
                    </AUTOSAR-ENGINEERING-OBJECT>
                    <AUTOSAR-ENGINEERING-OBJECT>
                      <SHORT-LABEL>Autosar::include::Dcm_Dsp_SvcH_ReadDataByIdentifier.h</SHORT-LABEL>
                      <CATEGORY>SWHDR</CATEGORY>
                    </AUTOSAR-ENGINEERING-OBJECT>
                    <AUTOSAR-ENGINEERING-OBJECT>
                      <SHORT-LABEL>Autosar::include::Dcm_Dsp_SvcH_ReadDataByPeriodicIdentifier.h</SHORT-LABEL>
                      <CATEGORY>SWHDR</CATEGORY>
                    </AUTOSAR-ENGINEERING-OBJECT>
                    <AUTOSAR-ENGINEERING-OBJECT>
                      <SHORT-LABEL>Autosar::include::Dcm_Dsp_SvcH_ReadMemoryByAddress.h</SHORT-LABEL>
                      <CATEGORY>SWHDR</CATEGORY>
                    </AUTOSAR-ENGINEERING-OBJECT>
                    <AUTOSAR-ENGINEERING-OBJECT>
                      <SHORT-LABEL>Autosar::include::Dcm_Dsp_SvcH_ReadScalingDataByIdentifier.h</SHORT-LABEL>
                      <CATEGORY>SWHDR</CATEGORY>
                    </AUTOSAR-ENGINEERING-OBJECT>
                    <AUTOSAR-ENGINEERING-OBJECT>
                      <SHORT-LABEL>Autosar::include::Dcm_Dsp_SvcH_RequestControlOfOnBoardSysTstComp.h</SHORT-LABEL>
                      <CATEGORY>SWHDR</CATEGORY>
                    </AUTOSAR-ENGINEERING-OBJECT>
                    <AUTOSAR-ENGINEERING-OBJECT>
                      <SHORT-LABEL>Autosar::include::Dcm_Dsp_SvcH_RequestDownload.h</SHORT-LABEL>
                      <CATEGORY>SWHDR</CATEGORY>
                    </AUTOSAR-ENGINEERING-OBJECT>
                    <AUTOSAR-ENGINEERING-OBJECT>
                      <SHORT-LABEL>Autosar::include::Dcm_Dsp_SvcH_RequestOnboardMonitoringTestResults.h</SHORT-LABEL>
                      <CATEGORY>SWHDR</CATEGORY>
                    </AUTOSAR-ENGINEERING-OBJECT>
                    <AUTOSAR-ENGINEERING-OBJECT>
                      <SHORT-LABEL>Autosar::include::Dcm_Dsp_SvcH_RequestTransferExit.h</SHORT-LABEL>
                      <CATEGORY>SWHDR</CATEGORY>
                    </AUTOSAR-ENGINEERING-OBJECT>
                    <AUTOSAR-ENGINEERING-OBJECT>
                      <SHORT-LABEL>Autosar::include::Dcm_Dsp_SvcH_RequestUpload.h</SHORT-LABEL>
                      <CATEGORY>SWHDR</CATEGORY>
                    </AUTOSAR-ENGINEERING-OBJECT>
                    <AUTOSAR-ENGINEERING-OBJECT>
                      <SHORT-LABEL>Autosar::include::Dcm_Dsp_SvcH_RequestVehicleInformation.h</SHORT-LABEL>
                      <CATEGORY>SWHDR</CATEGORY>
                    </AUTOSAR-ENGINEERING-OBJECT>
                    <AUTOSAR-ENGINEERING-OBJECT>
                      <SHORT-LABEL>Autosar::include::Dcm_Dsp_SvcH_ResponseOnEvent.h</SHORT-LABEL>
                      <CATEGORY>SWHDR</CATEGORY>
                    </AUTOSAR-ENGINEERING-OBJECT>
                    <AUTOSAR-ENGINEERING-OBJECT>
                      <SHORT-LABEL>Autosar::include::Dcm_Dsp_SvcH_RoutineControl.h</SHORT-LABEL>
                      <CATEGORY>SWHDR</CATEGORY>
                    </AUTOSAR-ENGINEERING-OBJECT>
                    <AUTOSAR-ENGINEERING-OBJECT>
                      <SHORT-LABEL>Autosar::include::Dcm_Dsp_SvcH_SecurityAccess.h</SHORT-LABEL>
                      <CATEGORY>SWHDR</CATEGORY>
                    </AUTOSAR-ENGINEERING-OBJECT>
                    <AUTOSAR-ENGINEERING-OBJECT>
                      <SHORT-LABEL>Autosar::include::Dcm_Dsp_SvcH_TesterPresent.h</SHORT-LABEL>
                      <CATEGORY>SWHDR</CATEGORY>
                    </AUTOSAR-ENGINEERING-OBJECT>
                    <AUTOSAR-ENGINEERING-OBJECT>
                      <SHORT-LABEL>Autosar::include::Dcm_Dsp_SvcH_TransferData.h</SHORT-LABEL>
                      <CATEGORY>SWHDR</CATEGORY>
                    </AUTOSAR-ENGINEERING-OBJECT>
                    <AUTOSAR-ENGINEERING-OBJECT>
                      <SHORT-LABEL>Autosar::include::Dcm_Dsp_SvcH_WriteDataByIdentifier.h</SHORT-LABEL>
                      <CATEGORY>SWHDR</CATEGORY>
                    </AUTOSAR-ENGINEERING-OBJECT>
                    <AUTOSAR-ENGINEERING-OBJECT>
                      <SHORT-LABEL>Autosar::include::Dcm_Dsp_SvcH_WriteMemoryByAddress.h</SHORT-LABEL>
                      <CATEGORY>SWHDR</CATEGORY>
                    </AUTOSAR-ENGINEERING-OBJECT>
                    <AUTOSAR-ENGINEERING-OBJECT>
                      <SHORT-LABEL>Autosar::include::Dcm_Dsp_VinServices.h</SHORT-LABEL>
                      <CATEGORY>SWHDR</CATEGORY>
                    </AUTOSAR-ENGINEERING-OBJECT>
                    <AUTOSAR-ENGINEERING-OBJECT>
                      <SHORT-LABEL>Autosar::include::Dcm_GenericServiceHandlers.h</SHORT-LABEL>
                      <CATEGORY>SWHDR</CATEGORY>
                    </AUTOSAR-ENGINEERING-OBJECT>
                    <AUTOSAR-ENGINEERING-OBJECT>
                      <SHORT-LABEL>Autosar::include::Dcm_Hsm.h</SHORT-LABEL>
                      <CATEGORY>SWHDR</CATEGORY>
                    </AUTOSAR-ENGINEERING-OBJECT>
                    <AUTOSAR-ENGINEERING-OBJECT>
                      <SHORT-LABEL>Autosar::include::Dcm_HsmCfg.h</SHORT-LABEL>
                      <CATEGORY>SWHDR</CATEGORY>
                    </AUTOSAR-ENGINEERING-OBJECT>
                    <AUTOSAR-ENGINEERING-OBJECT>
                      <SHORT-LABEL>Autosar::include::Dcm_HsmDcm.h</SHORT-LABEL>
                      <CATEGORY>SWHDR</CATEGORY>
                    </AUTOSAR-ENGINEERING-OBJECT>
                    <AUTOSAR-ENGINEERING-OBJECT>
                      <SHORT-LABEL>Autosar::include::Dcm_HsmDcmInt.h</SHORT-LABEL>
                      <CATEGORY>SWHDR</CATEGORY>
                    </AUTOSAR-ENGINEERING-OBJECT>
                    <AUTOSAR-ENGINEERING-OBJECT>
                      <SHORT-LABEL>Autosar::include::Dcm_Int.h</SHORT-LABEL>
                      <CATEGORY>SWHDR</CATEGORY>
                    </AUTOSAR-ENGINEERING-OBJECT>
                    <AUTOSAR-ENGINEERING-OBJECT>
                      <SHORT-LABEL>Autosar::include::Dcm_SEVReportingServices.h</SHORT-LABEL>
                      <CATEGORY>SWHDR</CATEGORY>
                    </AUTOSAR-ENGINEERING-OBJECT>
                    <AUTOSAR-ENGINEERING-OBJECT>
                      <SHORT-LABEL>Autosar::include::Dcm_Trace.h</SHORT-LABEL>
                      <CATEGORY>SWHDR</CATEGORY>
                    </AUTOSAR-ENGINEERING-OBJECT>
                    <AUTOSAR-ENGINEERING-OBJECT>
                      <SHORT-LABEL>Autosar::include::Dcm_Trace_Internal.h</SHORT-LABEL>
                      <CATEGORY>SWHDR</CATEGORY>
                    </AUTOSAR-ENGINEERING-OBJECT>
                    <AUTOSAR-ENGINEERING-OBJECT>
                      <SHORT-LABEL>Autosar::include::Dcm_Types.h</SHORT-LABEL>
                      <CATEGORY>SWHDR</CATEGORY>
                    </AUTOSAR-ENGINEERING-OBJECT>
                    <AUTOSAR-ENGINEERING-OBJECT>
                      <SHORT-LABEL>Autosar::include::Dcm_Version.h</SHORT-LABEL>
                      <CATEGORY>SWHDR</CATEGORY>
                    </AUTOSAR-ENGINEERING-OBJECT>
                    <AUTOSAR-ENGINEERING-OBJECT>
                      <SHORT-LABEL>Autosar::src::Dcm.c</SHORT-LABEL>
                      <CATEGORY>SWSRC</CATEGORY>
                    </AUTOSAR-ENGINEERING-OBJECT>
                    <AUTOSAR-ENGINEERING-OBJECT>
                      <SHORT-LABEL>Autosar::src::Dcm_Authentication.c</SHORT-LABEL>
                      <CATEGORY>SWSRC</CATEGORY>
                    </AUTOSAR-ENGINEERING-OBJECT>
                    <AUTOSAR-ENGINEERING-OBJECT>
                      <SHORT-LABEL>Autosar::src::Dcm_Authentication_AuthenticationHandler.c</SHORT-LABEL>
                      <CATEGORY>SWSRC</CATEGORY>
                    </AUTOSAR-ENGINEERING-OBJECT>
                    <AUTOSAR-ENGINEERING-OBJECT>
                      <SHORT-LABEL>Autosar::src::Dcm_Authentication_CryptoStackFacade.c</SHORT-LABEL>
                      <CATEGORY>SWSRC</CATEGORY>
                    </AUTOSAR-ENGINEERING-OBJECT>
                    <AUTOSAR-ENGINEERING-OBJECT>
                      <SHORT-LABEL>Autosar::src::Dcm_Authentication_DiagnosticPolicyHandler.c</SHORT-LABEL>
                      <CATEGORY>SWSRC</CATEGORY>
                    </AUTOSAR-ENGINEERING-OBJECT>
                    <AUTOSAR-ENGINEERING-OBJECT>
                      <SHORT-LABEL>Autosar::src::Dcm_Dsd.c</SHORT-LABEL>
                      <CATEGORY>SWSRC</CATEGORY>
                    </AUTOSAR-ENGINEERING-OBJECT>
                    <AUTOSAR-ENGINEERING-OBJECT>
                      <SHORT-LABEL>Autosar::src::Dcm_Dsl_ComMChannelStateManager.c</SHORT-LABEL>
                      <CATEGORY>SWSRC</CATEGORY>
                    </AUTOSAR-ENGINEERING-OBJECT>
                    <AUTOSAR-ENGINEERING-OBJECT>
                      <SHORT-LABEL>Autosar::src::Dcm_Dsl_CommunicationServices.c</SHORT-LABEL>
                      <CATEGORY>SWSRC</CATEGORY>
                    </AUTOSAR-ENGINEERING-OBJECT>
                    <AUTOSAR-ENGINEERING-OBJECT>
                      <SHORT-LABEL>Autosar::src::Dcm_Dsl_CommunicationServices_BufferManager.c</SHORT-LABEL>
                      <CATEGORY>SWSRC</CATEGORY>
                    </AUTOSAR-ENGINEERING-OBJECT>
                    <AUTOSAR-ENGINEERING-OBJECT>
                      <SHORT-LABEL>Autosar::src::Dcm_Dsl_CommunicationServices_MetaData.c</SHORT-LABEL>
                      <CATEGORY>SWSRC</CATEGORY>
                    </AUTOSAR-ENGINEERING-OBJECT>
                    <AUTOSAR-ENGINEERING-OBJECT>
                      <SHORT-LABEL>Autosar::src::Dcm_Dsl_CommunicationServices_RxConnections.c</SHORT-LABEL>
                      <CATEGORY>SWSRC</CATEGORY>
                    </AUTOSAR-ENGINEERING-OBJECT>
                    <AUTOSAR-ENGINEERING-OBJECT>
                      <SHORT-LABEL>Autosar::src::Dcm_Dsl_CommunicationServices_TxConnections.c</SHORT-LABEL>
                      <CATEGORY>SWSRC</CATEGORY>
                    </AUTOSAR-ENGINEERING-OBJECT>
                    <AUTOSAR-ENGINEERING-OBJECT>
                      <SHORT-LABEL>Autosar::src::Dcm_Dsl_DiagnosticSessionHandler.c</SHORT-LABEL>
                      <CATEGORY>SWSRC</CATEGORY>
                    </AUTOSAR-ENGINEERING-OBJECT>
                    <AUTOSAR-ENGINEERING-OBJECT>
                      <SHORT-LABEL>Autosar::src::Dcm_Dsl_PostBootOperationsHandler.c</SHORT-LABEL>
                      <CATEGORY>SWSRC</CATEGORY>
                    </AUTOSAR-ENGINEERING-OBJECT>
                    <AUTOSAR-ENGINEERING-OBJECT>
                      <SHORT-LABEL>Autosar::src::Dcm_Dsl_RoeServices.c</SHORT-LABEL>
                      <CATEGORY>SWSRC</CATEGORY>
                    </AUTOSAR-ENGINEERING-OBJECT>
                    <AUTOSAR-ENGINEERING-OBJECT>
                      <SHORT-LABEL>Autosar::src::Dcm_Dsl_SecurityLevelHandler.c</SHORT-LABEL>
                      <CATEGORY>SWSRC</CATEGORY>
                    </AUTOSAR-ENGINEERING-OBJECT>
                    <AUTOSAR-ENGINEERING-OBJECT>
                      <SHORT-LABEL>Autosar::src::Dcm_Dsl_Supervisor.c</SHORT-LABEL>
                      <CATEGORY>SWSRC</CATEGORY>
                    </AUTOSAR-ENGINEERING-OBJECT>
                    <AUTOSAR-ENGINEERING-OBJECT>
                      <SHORT-LABEL>Autosar::src::Dcm_Dsl_Supervisor_CommunicationSessionHandling.c</SHORT-LABEL>
                      <CATEGORY>SWSRC</CATEGORY>
                    </AUTOSAR-ENGINEERING-OBJECT>
                    <AUTOSAR-ENGINEERING-OBJECT>
                      <SHORT-LABEL>Autosar::src::Dcm_Dsl_Supervisor_MainConnectionHandling.c</SHORT-LABEL>
                      <CATEGORY>SWSRC</CATEGORY>
                    </AUTOSAR-ENGINEERING-OBJECT>
                    <AUTOSAR-ENGINEERING-OBJECT>
                      <SHORT-LABEL>Autosar::src::Dcm_Dsl_Supervisor_ProtocolHandling.c</SHORT-LABEL>
                      <CATEGORY>SWSRC</CATEGORY>
                    </AUTOSAR-ENGINEERING-OBJECT>
                    <AUTOSAR-ENGINEERING-OBJECT>
                      <SHORT-LABEL>Autosar::src::Dcm_Dsp.c</SHORT-LABEL>
                      <CATEGORY>SWSRC</CATEGORY>
                    </AUTOSAR-ENGINEERING-OBJECT>
                    <AUTOSAR-ENGINEERING-OBJECT>
                      <SHORT-LABEL>Autosar::src::Dcm_Dsp_ApplicationDiagnosticRequests.c</SHORT-LABEL>
                      <CATEGORY>SWSRC</CATEGORY>
                    </AUTOSAR-ENGINEERING-OBJECT>
                    <AUTOSAR-ENGINEERING-OBJECT>
                      <SHORT-LABEL>Autosar::src::Dcm_Dsp_Contexts.c</SHORT-LABEL>
                      <CATEGORY>SWSRC</CATEGORY>
                    </AUTOSAR-ENGINEERING-OBJECT>
                    <AUTOSAR-ENGINEERING-OBJECT>
                      <SHORT-LABEL>Autosar::src::Dcm_Dsp_DataTransferServices.c</SHORT-LABEL>
                      <CATEGORY>SWSRC</CATEGORY>
                    </AUTOSAR-ENGINEERING-OBJECT>
                    <AUTOSAR-ENGINEERING-OBJECT>
                      <SHORT-LABEL>Autosar::src::Dcm_Dsp_DemFacade.c</SHORT-LABEL>
                      <CATEGORY>SWSRC</CATEGORY>
                    </AUTOSAR-ENGINEERING-OBJECT>
                    <AUTOSAR-ENGINEERING-OBJECT>
                      <SHORT-LABEL>Autosar::src::Dcm_Dsp_DidServices.c</SHORT-LABEL>
                      <CATEGORY>SWSRC</CATEGORY>
                    </AUTOSAR-ENGINEERING-OBJECT>
                    <AUTOSAR-ENGINEERING-OBJECT>
                      <SHORT-LABEL>Autosar::src::Dcm_Dsp_DidSignals.c</SHORT-LABEL>
                      <CATEGORY>SWSRC</CATEGORY>
                    </AUTOSAR-ENGINEERING-OBJECT>
                    <AUTOSAR-ENGINEERING-OBJECT>
                      <SHORT-LABEL>Autosar::src::Dcm_Dsp_EndiannessInterpretation.c</SHORT-LABEL>
                      <CATEGORY>SWSRC</CATEGORY>
                    </AUTOSAR-ENGINEERING-OBJECT>
                    <AUTOSAR-ENGINEERING-OBJECT>
                      <SHORT-LABEL>Autosar::src::Dcm_Dsp_MemoryServices.c</SHORT-LABEL>
                      <CATEGORY>SWSRC</CATEGORY>
                    </AUTOSAR-ENGINEERING-OBJECT>
                    <AUTOSAR-ENGINEERING-OBJECT>
                      <SHORT-LABEL>Autosar::src::Dcm_Dsp_MidServices.c</SHORT-LABEL>
                      <CATEGORY>SWSRC</CATEGORY>
                    </AUTOSAR-ENGINEERING-OBJECT>
                    <AUTOSAR-ENGINEERING-OBJECT>
                      <SHORT-LABEL>Autosar::src::Dcm_Dsp_PidServices.c</SHORT-LABEL>
                      <CATEGORY>SWSRC</CATEGORY>
                    </AUTOSAR-ENGINEERING-OBJECT>
                    <AUTOSAR-ENGINEERING-OBJECT>
                      <SHORT-LABEL>Autosar::src::Dcm_Dsp_SvcH_Authentication.c</SHORT-LABEL>
                      <CATEGORY>SWSRC</CATEGORY>
                    </AUTOSAR-ENGINEERING-OBJECT>
                    <AUTOSAR-ENGINEERING-OBJECT>
                      <SHORT-LABEL>Autosar::src::Dcm_Dsp_SvcH_ClearDiagnosticInformation.c</SHORT-LABEL>
                      <CATEGORY>SWSRC</CATEGORY>
                    </AUTOSAR-ENGINEERING-OBJECT>
                    <AUTOSAR-ENGINEERING-OBJECT>
                      <SHORT-LABEL>Autosar::src::Dcm_Dsp_SvcH_CommunicationControl.c</SHORT-LABEL>
                      <CATEGORY>SWSRC</CATEGORY>
                    </AUTOSAR-ENGINEERING-OBJECT>
                    <AUTOSAR-ENGINEERING-OBJECT>
                      <SHORT-LABEL>Autosar::src::Dcm_Dsp_SvcH_ControlDTCSetting.c</SHORT-LABEL>
                      <CATEGORY>SWSRC</CATEGORY>
                    </AUTOSAR-ENGINEERING-OBJECT>
                    <AUTOSAR-ENGINEERING-OBJECT>
                      <SHORT-LABEL>Autosar::src::Dcm_Dsp_SvcH_DynamicallyDefineDataIdentifier.c</SHORT-LABEL>
                      <CATEGORY>SWSRC</CATEGORY>
                    </AUTOSAR-ENGINEERING-OBJECT>
                    <AUTOSAR-ENGINEERING-OBJECT>
                      <SHORT-LABEL>Autosar::src::Dcm_Dsp_SvcH_InputOutputControlByIdentifier.c</SHORT-LABEL>
                      <CATEGORY>SWSRC</CATEGORY>
                    </AUTOSAR-ENGINEERING-OBJECT>
                    <AUTOSAR-ENGINEERING-OBJECT>
                      <SHORT-LABEL>Autosar::src::Dcm_Dsp_SvcH_LinkControl.c</SHORT-LABEL>
                      <CATEGORY>SWSRC</CATEGORY>
                    </AUTOSAR-ENGINEERING-OBJECT>
                    <AUTOSAR-ENGINEERING-OBJECT>
                      <SHORT-LABEL>Autosar::src::Dcm_Dsp_SvcH_ReadDTCInformation.c</SHORT-LABEL>
                      <CATEGORY>SWSRC</CATEGORY>
                    </AUTOSAR-ENGINEERING-OBJECT>
                    <AUTOSAR-ENGINEERING-OBJECT>
                      <SHORT-LABEL>Autosar::src::Dcm_Dsp_SvcH_ReadDataByIdentifier.c</SHORT-LABEL>
                      <CATEGORY>SWSRC</CATEGORY>
                    </AUTOSAR-ENGINEERING-OBJECT>
                    <AUTOSAR-ENGINEERING-OBJECT>
                      <SHORT-LABEL>Autosar::src::Dcm_Dsp_SvcH_ReadDataByPeriodicIdentifier.c</SHORT-LABEL>
                      <CATEGORY>SWSRC</CATEGORY>
                    </AUTOSAR-ENGINEERING-OBJECT>
                    <AUTOSAR-ENGINEERING-OBJECT>
                      <SHORT-LABEL>Autosar::src::Dcm_Dsp_SvcH_ReadMemoryByAddress.c</SHORT-LABEL>
                      <CATEGORY>SWSRC</CATEGORY>
                    </AUTOSAR-ENGINEERING-OBJECT>
                    <AUTOSAR-ENGINEERING-OBJECT>
                      <SHORT-LABEL>Autosar::src::Dcm_Dsp_SvcH_ReadScalingDataByIdentifier.c</SHORT-LABEL>
                      <CATEGORY>SWSRC</CATEGORY>
                    </AUTOSAR-ENGINEERING-OBJECT>
                    <AUTOSAR-ENGINEERING-OBJECT>
                      <SHORT-LABEL>Autosar::src::Dcm_Dsp_SvcH_RequestControlOfOnBoardSysTstComp.c</SHORT-LABEL>
                      <CATEGORY>SWSRC</CATEGORY>
                    </AUTOSAR-ENGINEERING-OBJECT>
                    <AUTOSAR-ENGINEERING-OBJECT>
                      <SHORT-LABEL>Autosar::src::Dcm_Dsp_SvcH_RequestDownload.c</SHORT-LABEL>
                      <CATEGORY>SWSRC</CATEGORY>
                    </AUTOSAR-ENGINEERING-OBJECT>
                    <AUTOSAR-ENGINEERING-OBJECT>
                      <SHORT-LABEL>Autosar::src::Dcm_Dsp_SvcH_RequestOnboardMonitoringTestResults.c</SHORT-LABEL>
                      <CATEGORY>SWSRC</CATEGORY>
                    </AUTOSAR-ENGINEERING-OBJECT>
                    <AUTOSAR-ENGINEERING-OBJECT>
                      <SHORT-LABEL>Autosar::src::Dcm_Dsp_SvcH_RequestTransferExit.c</SHORT-LABEL>
                      <CATEGORY>SWSRC</CATEGORY>
                    </AUTOSAR-ENGINEERING-OBJECT>
                    <AUTOSAR-ENGINEERING-OBJECT>
                      <SHORT-LABEL>Autosar::src::Dcm_Dsp_SvcH_RequestUpload.c</SHORT-LABEL>
                      <CATEGORY>SWSRC</CATEGORY>
                    </AUTOSAR-ENGINEERING-OBJECT>
                    <AUTOSAR-ENGINEERING-OBJECT>
                      <SHORT-LABEL>Autosar::src::Dcm_Dsp_SvcH_RequestVehicleInformation.c</SHORT-LABEL>
                      <CATEGORY>SWSRC</CATEGORY>
                    </AUTOSAR-ENGINEERING-OBJECT>
                    <AUTOSAR-ENGINEERING-OBJECT>
                      <SHORT-LABEL>Autosar::src::Dcm_Dsp_SvcH_ResponseOnEvent.c</SHORT-LABEL>
                      <CATEGORY>SWSRC</CATEGORY>
                    </AUTOSAR-ENGINEERING-OBJECT>
                    <AUTOSAR-ENGINEERING-OBJECT>
                      <SHORT-LABEL>Autosar::src::Dcm_Dsp_SvcH_RoutineControl.c</SHORT-LABEL>
                      <CATEGORY>SWSRC</CATEGORY>
                    </AUTOSAR-ENGINEERING-OBJECT>
                    <AUTOSAR-ENGINEERING-OBJECT>
                      <SHORT-LABEL>Autosar::src::Dcm_Dsp_SvcH_SecurityAccess.c</SHORT-LABEL>
                      <CATEGORY>SWSRC</CATEGORY>
                    </AUTOSAR-ENGINEERING-OBJECT>
                    <AUTOSAR-ENGINEERING-OBJECT>
                      <SHORT-LABEL>Autosar::src::Dcm_Dsp_SvcH_TesterPresent.c</SHORT-LABEL>
                      <CATEGORY>SWSRC</CATEGORY>
                    </AUTOSAR-ENGINEERING-OBJECT>
                    <AUTOSAR-ENGINEERING-OBJECT>
                      <SHORT-LABEL>Autosar::src::Dcm_Dsp_SvcH_TransferData.c</SHORT-LABEL>
                      <CATEGORY>SWSRC</CATEGORY>
                    </AUTOSAR-ENGINEERING-OBJECT>
                    <AUTOSAR-ENGINEERING-OBJECT>
                      <SHORT-LABEL>Autosar::src::Dcm_Dsp_SvcH_WriteDataByIdentifier.c</SHORT-LABEL>
                      <CATEGORY>SWSRC</CATEGORY>
                    </AUTOSAR-ENGINEERING-OBJECT>
                    <AUTOSAR-ENGINEERING-OBJECT>
                      <SHORT-LABEL>Autosar::src::Dcm_Dsp_SvcH_WriteMemoryByAddress.c</SHORT-LABEL>
                      <CATEGORY>SWSRC</CATEGORY>
                    </AUTOSAR-ENGINEERING-OBJECT>
                    <AUTOSAR-ENGINEERING-OBJECT>
                      <SHORT-LABEL>Autosar::src::Dcm_Dsp_VinServices.c</SHORT-LABEL>
                      <CATEGORY>SWSRC</CATEGORY>
                    </AUTOSAR-ENGINEERING-OBJECT>
                    <AUTOSAR-ENGINEERING-OBJECT>
                      <SHORT-LABEL>Autosar::src::Dcm_Hsm.c</SHORT-LABEL>
                      <CATEGORY>SWSRC</CATEGORY>
                    </AUTOSAR-ENGINEERING-OBJECT>
                    <AUTOSAR-ENGINEERING-OBJECT>
                      <SHORT-LABEL>Autosar::src::Dcm_HsmDcmData.c</SHORT-LABEL>
                      <CATEGORY>SWSRC</CATEGORY>
                    </AUTOSAR-ENGINEERING-OBJECT>
                    <AUTOSAR-ENGINEERING-OBJECT>
                      <SHORT-LABEL>Autosar::src::Dcm_HsmDcmFnct.c</SHORT-LABEL>
                      <CATEGORY>SWSRC</CATEGORY>
                    </AUTOSAR-ENGINEERING-OBJECT>
                    <AUTOSAR-ENGINEERING-OBJECT>
                      <SHORT-LABEL>Autosar::src::Dcm_SEVReportingServices.c</SHORT-LABEL>
                      <CATEGORY>SWSRC</CATEGORY>
                    </AUTOSAR-ENGINEERING-OBJECT>
                    <AUTOSAR-ENGINEERING-OBJECT>
                      <SHORT-LABEL>make::Dcm_defs.mak</SHORT-LABEL>
                      <CATEGORY>SWMAKE</CATEGORY>
                    </AUTOSAR-ENGINEERING-OBJECT>
                    <AUTOSAR-ENGINEERING-OBJECT>
                      <SHORT-LABEL>make::Dcm_rules.mak</SHORT-LABEL>
                      <CATEGORY>SWMAKE</CATEGORY>
                    </AUTOSAR-ENGINEERING-OBJECT>
                  </ARTIFACT-DESCRIPTORS>
                </CODE>
              </CODE-DESCRIPTORS>

              <MC-SUPPORT>
                <MC-PARAMETER-INSTANCES>
[!IF "node:exists(DcmConfigSet/eb-list::*[1]/DcmDsp/DcmDspPid/eb-list::*)"!]
                  <MC-DATA-INSTANCE>
                    <SHORT-NAME>Dcm_DspPidConfig</SHORT-NAME>
                    <CATEGORY>ARRAY</CATEGORY>
                    <ARRAY-SIZE>[!"num:i(count(DcmConfigSet/eb-list::*[1]/DcmDsp/DcmDspPid/eb-list::*))"!]</ARRAY-SIZE>
                    <SUB-ELEMENTS>
  [!VAR "Index" = "0"!]
  [!LOOP "util:distinct(node:order(DcmConfigSet/eb-list::*[1]/DcmDsp/DcmDspPid/eb-list::* , 'DcmDspPidIdentifier'))"!]
                      <MC-DATA-INSTANCE>
                        <SHORT-NAME>PidConfig_[!"as:name(.)"!]</SHORT-NAME>
                        <CATEGORY>STRUCTURE</CATEGORY>
                        <SUB-ELEMENTS>
                          <MC-DATA-INSTANCE>
                            <SHORT-NAME>BitField</SHORT-NAME>
                            <CATEGORY>STRUCTURE</CATEGORY>
                            <SUB-ELEMENTS>
                              <MC-DATA-INSTANCE>
                                <SHORT-NAME>OBDService_1</SHORT-NAME>
                                <DESC>
                                  <L-2 L="EN">Calibration of this bit is only allowed if the original configuration has the bit set to 1. A bit value of 1 enables the service.</L-2>
                                </DESC>
                                <CATEGORY>VALUE</CATEGORY>
                                <RESULTING-PROPERTIES>
                                  <SW-DATA-DEF-PROPS-VARIANTS>
                                    <SW-DATA-DEF-PROPS-CONDITIONAL>
                                      <BASE-TYPE-REF DEST="SW-BASE-TYPE">/AUTOSAR_Platform/BaseTypes/uint8</BASE-TYPE-REF>
                                      <SW-BIT-REPRESENTATION>
                                        <BIT-POSITION>0</BIT-POSITION>
                                        <NUMBER-OF-BITS>1</NUMBER-OF-BITS>
                                      </SW-BIT-REPRESENTATION>
                                      <SW-CALIBRATION-ACCESS>READ-WRITE</SW-CALIBRATION-ACCESS>
                                      <DATA-CONSTR-REF DEST="DATA-CONSTR">/AUTOSAR_Platform/DataConstrs/uint8</DATA-CONSTR-REF>
                                    </SW-DATA-DEF-PROPS-CONDITIONAL>
                                  </SW-DATA-DEF-PROPS-VARIANTS>
                                </RESULTING-PROPERTIES>
                                <SYMBOL>BitField</SYMBOL>
                              </MC-DATA-INSTANCE>
                              <MC-DATA-INSTANCE>
                                <SHORT-NAME>OBDService_2</SHORT-NAME>
                                <DESC>
                                  <L-2 L="EN">Calibration of this bit is only allowed if the original configuration has the bit set to 1. A bit value of 1 enables the service.</L-2>
                                </DESC>
                                <CATEGORY>VALUE</CATEGORY>
                                <RESULTING-PROPERTIES>
                                  <SW-DATA-DEF-PROPS-VARIANTS>
                                    <SW-DATA-DEF-PROPS-CONDITIONAL>
                                      <BASE-TYPE-REF DEST="SW-BASE-TYPE">/AUTOSAR_Platform/BaseTypes/uint8</BASE-TYPE-REF>
                                      <SW-BIT-REPRESENTATION>
                                        <BIT-POSITION>1</BIT-POSITION>
                                        <NUMBER-OF-BITS>1</NUMBER-OF-BITS>
                                      </SW-BIT-REPRESENTATION>
                                      <SW-CALIBRATION-ACCESS>READ-WRITE</SW-CALIBRATION-ACCESS>
                                      <DATA-CONSTR-REF DEST="DATA-CONSTR">/AUTOSAR_Platform/DataConstrs/uint8</DATA-CONSTR-REF>
                                    </SW-DATA-DEF-PROPS-CONDITIONAL>
                                  </SW-DATA-DEF-PROPS-VARIANTS>
                                </RESULTING-PROPERTIES>
                                <SYMBOL>BitField</SYMBOL>
                              </MC-DATA-INSTANCE>
                            </SUB-ELEMENTS>
                          </MC-DATA-INSTANCE>
                        </SUB-ELEMENTS>
                        <SYMBOL>[[!"num:i($Index)"!]]</SYMBOL>
                      </MC-DATA-INSTANCE>
    [!VAR "Index" = "$Index + 1"!]
  [!ENDLOOP!]
                    </SUB-ELEMENTS>
                    <SYMBOL>Dcm_DspPidConfig</SYMBOL>
                  </MC-DATA-INSTANCE>
[!ENDIF!]

[!IF "node:exists(DcmConfigSet/eb-list::*[1]/DcmDsp/DcmDspDid/eb-list::*)"!]
  [!VAR "BitIndex" = "0"!][!//
  [!VAR "Index" = "0"!][!//
  [!VAR "DidRemaining" = "num:i(count(DcmConfigSet/eb-list::*[1]/DcmDsp/DcmDspDid/eb-list::*[node:existsAndTrue(./DcmDspDidUsed)]))"!]
  [!VAR "Size" = "($DidRemaining + 7) div 8"!]
                  <MC-DATA-INSTANCE>
                    <SHORT-NAME>Dcm_DspDidUsed</SHORT-NAME>
                    <CATEGORY>ARRAY</CATEGORY>
                    <ARRAY-SIZE>[!"num:i($Size)"!]</ARRAY-SIZE>
                    <SUB-ELEMENTS>
  [!LOOP "util:distinct(node:order(DcmConfigSet/eb-list::*[1]/DcmDsp/DcmDspDid/eb-list::*[node:existsAndTrue(./DcmDspDidUsed)], 'DcmDspDidIdentifier'))"!]
                      <MC-DATA-INSTANCE>
                        <SHORT-NAME>[!"as:name(.)"!]</SHORT-NAME>
                        <DESC>
                          <L-2 L="EN">DcmDspDidUsed parameter for Did [!"num:inttohex(num:i(DcmDspDidIdentifier), 4)"!] ('1' means Did is available) - If the value is '0' the Did is not available in all services.</L-2>
                        </DESC>
                        <CATEGORY>VALUE</CATEGORY>
                        <RESULTING-PROPERTIES>
                          <SW-DATA-DEF-PROPS-VARIANTS>
                            <SW-DATA-DEF-PROPS-CONDITIONAL>
                              <BASE-TYPE-REF DEST="SW-BASE-TYPE">/AUTOSAR_Platform/BaseTypes/uint8</BASE-TYPE-REF>
                              <SW-BIT-REPRESENTATION>
                                <BIT-POSITION>[!"num:i($BitIndex)"!]</BIT-POSITION>
                                <NUMBER-OF-BITS>1</NUMBER-OF-BITS>
                              </SW-BIT-REPRESENTATION>
                              <SW-CALIBRATION-ACCESS>READ-WRITE</SW-CALIBRATION-ACCESS>
                              <DATA-CONSTR-REF DEST="DATA-CONSTR">/AUTOSAR_Platform/DataConstrs/uint8</DATA-CONSTR-REF>
                            </SW-DATA-DEF-PROPS-CONDITIONAL>
                          </SW-DATA-DEF-PROPS-VARIANTS>
                        </RESULTING-PROPERTIES>
                        <SYMBOL>[[!"num:i($Index)"!]]</SYMBOL>
                      </MC-DATA-INSTANCE>
    [!VAR "BitIndex" = "$BitIndex + 1"!]
    [!IF "($BitIndex mod 8) = 0"!]
      [!VAR "BitIndex" = "0"!]
      [!VAR "Index" = "$Index + 1"!]
    [!ENDIF!]
  [!ENDLOOP!]
                    </SUB-ELEMENTS>
                    <SYMBOL>Dcm_DspDidUsed</SYMBOL>
                  </MC-DATA-INSTANCE>
[!ENDIF!]

[!IF "node:exists(DcmConfigSet/eb-list::*[1]/DcmDsp/DcmDspPid/eb-list::*)"!]
  [!VAR "BitIndex" = "0"!][!//
  [!VAR "Index" = "0"!][!//
  [!VAR "PidRemaining" = "num:i(count(DcmConfigSet/eb-list::*[1]/DcmDsp/DcmDspPid/eb-list::*))"!]
  [!VAR "Size" = "($PidRemaining + 7) div 8"!]
                  <!-- !LINKSTO Dcm.EB.Config.Calibration.DcmDspPidUsed,1 -->
                  <MC-DATA-INSTANCE>
                    <SHORT-NAME>Dcm_DspPidUsed</SHORT-NAME>
                    <CATEGORY>ARRAY</CATEGORY>
                    <ARRAY-SIZE>[!"num:i($Size)"!]</ARRAY-SIZE>
                    <SUB-ELEMENTS>
  [!LOOP "util:distinct(node:order(DcmConfigSet/eb-list::*[1]/DcmDsp/DcmDspPid/eb-list::* , 'DcmDspPidIdentifier'))"!]
                      <MC-DATA-INSTANCE>
                        <SHORT-NAME>[!"as:name(.)"!]</SHORT-NAME>
                        <DESC>
                          <L-2 L="EN">DcmDspPidUsed parameter for Pid [!"num:inttohex(num:i(DcmDspPidIdentifier), 2)"!] ('1' means Pid is available) - If the value is '0' the Pid is not a available in all services.</L-2>
                        </DESC>
                        <CATEGORY>VALUE</CATEGORY>
                        <RESULTING-PROPERTIES>
                          <SW-DATA-DEF-PROPS-VARIANTS>
                            <SW-DATA-DEF-PROPS-CONDITIONAL>
                              <BASE-TYPE-REF DEST="SW-BASE-TYPE">/AUTOSAR_Platform/BaseTypes/uint8</BASE-TYPE-REF>
                              <SW-BIT-REPRESENTATION>
                                <BIT-POSITION>[!"num:i($BitIndex)"!]</BIT-POSITION>
                                <NUMBER-OF-BITS>1</NUMBER-OF-BITS>
                              </SW-BIT-REPRESENTATION>
                              <SW-CALIBRATION-ACCESS>READ-WRITE</SW-CALIBRATION-ACCESS>
                              <DATA-CONSTR-REF DEST="DATA-CONSTR">/AUTOSAR_Platform/DataConstrs/uint8</DATA-CONSTR-REF>
                            </SW-DATA-DEF-PROPS-CONDITIONAL>
                          </SW-DATA-DEF-PROPS-VARIANTS>
                        </RESULTING-PROPERTIES>
                        <SYMBOL>[[!"num:i($Index)"!]]</SYMBOL>
                      </MC-DATA-INSTANCE>
    [!VAR "BitIndex" = "$BitIndex + 1"!]
    [!IF "($BitIndex mod 8) = 0"!]
      [!VAR "BitIndex" = "0"!]
      [!VAR "Index" = "$Index + 1"!]
    [!ENDIF!]
  [!ENDLOOP!]
                    </SUB-ELEMENTS>
                    <SYMBOL>Dcm_DspPidUsed</SYMBOL>
                  </MC-DATA-INSTANCE>
[!ENDIF!]

[!IF "node:exists(DcmConfigSet/eb-list::*[1]/DcmDsd/DcmDsdServiceTable/eb-list::*/DcmDsdService/eb-list::*/DcmDsdSubService/eb-list::*)"!]
  [!VAR "MaxValue" = "0"!][!//
  [!LOOP "util:distinct(node:order(DcmConfigSet/eb-list::*[1]/DcmDsd/DcmDsdServiceTable/eb-list::*/DcmDsdService/eb-list::*, 'DcmDsdSidTabServiceId'))"!][!//
    [!IF "DcmDsdSidTabServiceId = 62"!]
      [!VAR "Count" = "num:integer(count(DcmDsdSubService/eb-list::*)) + 1"!]
    [!ELSE!]
      [!VAR "Count" = "num:integer(count(DcmDsdSubService/eb-list::*))"!]
    [!ENDIF!]
    [!IF "$Count > $MaxValue"!][!//
      [!VAR "MaxValue" = "$Count"!]
    [!ENDIF!]
  [!ENDLOOP!]
  [!VAR "NumberOfServices" = "count(DcmConfigSet/eb-list::*[1]/DcmDsd/DcmDsdServiceTable/eb-list::*/DcmDsdService/eb-list::*)"!]
  [!VAR "Size" = "num:i(($MaxValue + 7) div 8)"!]
                  <!-- !LINKSTO Dcm.EB.Config.Calibration.DcmDsdSubServiceUsed,1 -->
                  <MC-DATA-INSTANCE>
                    <SHORT-NAME>Dcm_DsdSubServiceUsed</SHORT-NAME>
                    <CATEGORY>ARRAY</CATEGORY>
                    <ARRAY-SIZE>[!"num:i($NumberOfServices * $Size)"!]</ARRAY-SIZE>
                    <SUB-ELEMENTS>
  [!VAR "TableIndex" = "0"!]
  [!LOOP "util:distinct(node:order(DcmConfigSet/eb-list::*[1]/DcmDsd/DcmDsdServiceTable/eb-list::*, 'DcmDsdSidTabId'))"!]
    [!VAR "ServiceIndex" = "0"!]
    [!LOOP "util:distinct(node:order(DcmDsdService/eb-list::*, 'DcmDsdSidTabServiceId'))"!]
      [!IF "DcmDsdSidTabServiceId = 62"!]
        [!VAR "BitIndex" = "1"!]
      [!ELSE!]
        [!VAR "BitIndex" = "0"!]
      [!ENDIF!]
      [!VAR "Index" = "0"!][!//
      [!LOOP "util:distinct(node:order(DcmDsdSubService/eb-list::*, 'DcmDsdSubServiceId'))"!]
                      <MC-DATA-INSTANCE>
                        <SHORT-NAME>ServiceTable_[!"num:i($TableIndex)"!]_ServiceId_[!"num:i($ServiceIndex)"!]_[!"as:name(.)"!]_SubServiceId_[!"DcmDsdSubServiceId"!]</SHORT-NAME>
                        <DESC>
                          <L-2 L="EN">DcmDsdSubServiceUsed parameter for subservice [!"as:name(.)"!] in Service [!"as:name(../..)"!] belonging to Servicetable [!"as:name(../../../..)"!]</L-2>
                        </DESC>
                        <CATEGORY>VALUE</CATEGORY>
                        <RESULTING-PROPERTIES>
                          <SW-DATA-DEF-PROPS-VARIANTS>
                            <SW-DATA-DEF-PROPS-CONDITIONAL>
                              <BASE-TYPE-REF DEST="SW-BASE-TYPE">/AUTOSAR_Platform/BaseTypes/uint8</BASE-TYPE-REF>
                              <SW-BIT-REPRESENTATION>
                                <BIT-POSITION>[!"num:i($BitIndex)"!]</BIT-POSITION>
                                <NUMBER-OF-BITS>1</NUMBER-OF-BITS>
                              </SW-BIT-REPRESENTATION>
                              <SW-CALIBRATION-ACCESS>READ-WRITE</SW-CALIBRATION-ACCESS>
                              <DATA-CONSTR-REF DEST="DATA-CONSTR">/AUTOSAR_Platform/DataConstrs/uint8</DATA-CONSTR-REF>
                            </SW-DATA-DEF-PROPS-CONDITIONAL>
                          </SW-DATA-DEF-PROPS-VARIANTS>
                        </RESULTING-PROPERTIES>
                        <SYMBOL>[[!"num:i($TableIndex)"!]][[!"num:i($ServiceIndex)"!]][[!"num:i($Index)"!]]</SYMBOL>
                      </MC-DATA-INSTANCE>
        [!VAR "BitIndex" = "$BitIndex + 1"!]
        [!IF "($BitIndex mod 8) = 0"!]
          [!VAR "BitIndex" = "0"!]
          [!VAR "Index" = "$Index + 1"!]
        [!ENDIF!]
      [!ENDLOOP!]
      [!VAR "ServiceIndex" = "$ServiceIndex + 1"!]
    [!ENDLOOP!]
  [!VAR "TableIndex" = "$TableIndex + 1"!]
  [!ENDLOOP!]
                    </SUB-ELEMENTS>
                    <SYMBOL>Dcm_DsdSubServiceUsed</SYMBOL>
                  </MC-DATA-INSTANCE>
[!ENDIF!]

[!IF "node:exists(DcmConfigSet/eb-list::*[1]/DcmDsd/DcmDsdServiceTable/eb-list::*/DcmDsdService/eb-list::*)"!]
  [!VAR "MaxValue" = "0"!][!//
  [!LOOP "util:distinct(node:order(DcmConfigSet/eb-list::*[1]/DcmDsd/DcmDsdServiceTable/eb-list::*, 'DcmDsdSidTabId'))"!][!//
    [!IF "count(DcmDsdService/eb-list::*) > $MaxValue"!][!//
      [!VAR "MaxValue" = "count(DcmDsdService/eb-list::*)"!]
    [!ENDIF!]
  [!ENDLOOP!]
  [!VAR "NumberOfTables" = "count(DcmConfigSet/eb-list::*[1]/DcmDsd/DcmDsdServiceTable/eb-list::*)"!]
  [!VAR "Size" = "num:i(($MaxValue + 7) div 8)"!]
                  <!-- !LINKSTO Dcm.EB.Config.Calibration.DcmDsdServiceUsed,1 -->
                  <MC-DATA-INSTANCE>
                    <SHORT-NAME>Dcm_DsdServiceUsed</SHORT-NAME>
                    <CATEGORY>ARRAY</CATEGORY>
                    <ARRAY-SIZE>[!"num:i($NumberOfTables * $Size)"!]</ARRAY-SIZE>
                    <SUB-ELEMENTS>
  [!VAR "TableIndex" = "0"!]
  [!LOOP "util:distinct(node:order(DcmConfigSet/eb-list::*[1]/DcmDsd/DcmDsdServiceTable/eb-list::*, 'DcmDsdSidTabId'))"!]
    [!VAR "BitIndex" = "0"!][!//
    [!VAR "Index" = "0"!][!//
    [!LOOP "util:distinct(node:order(DcmDsdService/eb-list::*, 'DcmDsdSidTabServiceId'))"!]
                      <MC-DATA-INSTANCE>
                        <SHORT-NAME>ServiceTable_[!"num:i($TableIndex)"!]_[!"as:name(.)"!]_ServiceId_[!"DcmDsdSidTabServiceId"!]</SHORT-NAME>
                        <DESC>
                          <L-2 L="EN">DcmDsdServiceUsed parameter for service [!"as:name(.)"!] in Servicetable [!"as:name(../..)"!]</L-2>
                        </DESC>
                        <CATEGORY>VALUE</CATEGORY>
                        <RESULTING-PROPERTIES>
                          <SW-DATA-DEF-PROPS-VARIANTS>
                            <SW-DATA-DEF-PROPS-CONDITIONAL>
                              <BASE-TYPE-REF DEST="SW-BASE-TYPE">/AUTOSAR_Platform/BaseTypes/uint8</BASE-TYPE-REF>
                              <SW-BIT-REPRESENTATION>
                                <BIT-POSITION>[!"num:i($BitIndex)"!]</BIT-POSITION>
                                <NUMBER-OF-BITS>1</NUMBER-OF-BITS>
                              </SW-BIT-REPRESENTATION>
                              <SW-CALIBRATION-ACCESS>READ-WRITE</SW-CALIBRATION-ACCESS>
                              <DATA-CONSTR-REF DEST="DATA-CONSTR">/AUTOSAR_Platform/DataConstrs/uint8</DATA-CONSTR-REF>
                            </SW-DATA-DEF-PROPS-CONDITIONAL>
                          </SW-DATA-DEF-PROPS-VARIANTS>
                        </RESULTING-PROPERTIES>
                        <SYMBOL>[[!"num:i($TableIndex)"!]][[!"num:i($Index)"!]]</SYMBOL>
                      </MC-DATA-INSTANCE>
      [!VAR "BitIndex" = "$BitIndex + 1"!]
      [!IF "($BitIndex mod 8) = 0"!]
        [!VAR "BitIndex" = "0"!]
        [!VAR "Index" = "$Index + 1"!]
      [!ENDIF!]
    [!ENDLOOP!]
    [!VAR "TableIndex" = "$TableIndex + 1"!]
  [!ENDLOOP!]
                    </SUB-ELEMENTS>
                    <SYMBOL>Dcm_DsdServiceUsed</SYMBOL>
                  </MC-DATA-INSTANCE>
[!ENDIF!]

[!IF "node:exists(as:modconf('Dcm')[1]/DcmConfigSet/eb-list::*[1]/DcmDsd/DcmDsdServiceTable/eb-list::*/DcmDsdService/eb-list::*[DcmDsdSidTabServiceId = num:i(6)])"!]
  [!VAR "IndexOBDMID" = "0"!]
  [!VAR "Index" = "0"!]
  [!VAR "Size" = "num:i((count(as:modconf('Dcm')[1]/DcmConfigSet/eb-list::*[1]/DcmDsp/DcmDspTestResultByObdmid/DcmDspTestResultObdmidTid/eb-list::*)+7)div 8)"!]
                  <!-- !LINKSTO Dcm.EB.Config.Calibration.DcmDspTestResultObdmidUsed,1 -->
                  <MC-DATA-INSTANCE>
                    <SHORT-NAME>Dcm_DspOBDMIDUsed</SHORT-NAME>
                    <CATEGORY>ARRAY</CATEGORY>
                    <ARRAY-SIZE>[!"num:i($Size)"!]</ARRAY-SIZE>
                    <SUB-ELEMENTS>
  [!LOOP "as:modconf('Dcm')[1]/DcmConfigSet/eb-list::*[1]/DcmDsp/DcmDspTestResultByObdmid/DcmDspTestResultObdmidTid/eb-list::*"!]
                      <MC-DATA-INSTANCE>
                        <SHORT-NAME>[!"as:name(.)"!]</SHORT-NAME>
                        <DESC>
                          <L-2 L="EN">DcmDspTestResultObdmidUsed parameter</L-2>
                        </DESC>
                        <CATEGORY>VALUE</CATEGORY>
                        <RESULTING-PROPERTIES>
                          <SW-DATA-DEF-PROPS-VARIANTS>
                            <SW-DATA-DEF-PROPS-CONDITIONAL>
                              <BASE-TYPE-REF DEST="SW-BASE-TYPE">/AUTOSAR_Platform/BaseTypes/uint8</BASE-TYPE-REF>
                              <SW-BIT-REPRESENTATION>
                                <BIT-POSITION>[!"num:i($IndexOBDMID)"!]</BIT-POSITION>
                                <NUMBER-OF-BITS>1</NUMBER-OF-BITS>
                              </SW-BIT-REPRESENTATION>
                              <SW-CALIBRATION-ACCESS>READ-WRITE</SW-CALIBRATION-ACCESS>
                              <DATA-CONSTR-REF DEST="DATA-CONSTR">/AUTOSAR_Platform/DataConstrs/uint8</DATA-CONSTR-REF>
                            </SW-DATA-DEF-PROPS-CONDITIONAL>
                          </SW-DATA-DEF-PROPS-VARIANTS>
                        </RESULTING-PROPERTIES>
                        <SYMBOL>[[!"num:i($Index)"!]]</SYMBOL>
                      </MC-DATA-INSTANCE>
    [!VAR "IndexOBDMID" = "$IndexOBDMID + 1"!]
    [!IF "($IndexOBDMID mod 8) = 0"!]
      [!VAR "IndexOBDMID" = "0"!]
      [!VAR "Index" = "$Index + 1"!]
    [!ENDIF!]
  [!ENDLOOP!]
                    </SUB-ELEMENTS>
                    <SYMBOL>Dcm_DspOBDMIDUsed</SYMBOL>
                  </MC-DATA-INSTANCE>
[!ENDIF!]

[!LOOP "as:modconf('Dcm')[1]/DcmConfigSet/eb-list::*[1]/DcmDsp/DcmDspTestResultByObdmid/DcmDspTestResultObdmidTid/eb-list::*"!]
  [!VAR "Size" = "num:i((count(./DcmDspTestResultObdmidTids/eb-list::*/DcmDspTestResultObdmidTidRefs/eb-list::*/DcmDspTestResultObdmidTidRef)+7)div 8)"!]
                  <!-- !LINKSTO Dcm.EB.Config.Calibration.DcmDspTestResultTid,1 -->
                  <MC-DATA-INSTANCE>
                    <SHORT-NAME>Dcm_DspTestResultTidUsed_[!"num:inttohex(node:value(./eb-list::*), 2)"!]</SHORT-NAME>
                    <CATEGORY>ARRAY</CATEGORY>
                    <ARRAY-SIZE>[!"num:i($Size)"!]</ARRAY-SIZE>
                    <SUB-ELEMENTS>
  [!VAR "Index" = "0"!]
  [!VAR "IndexTIDRef" = "0"!]
  [!LOOP "./DcmDspTestResultObdmidTids/eb-list::*/DcmDspTestResultObdmidTidRefs/eb-list::*"!]
                      <MC-DATA-INSTANCE>
                        <SHORT-NAME>[!"node:name(../..)"!]_[!"as:name(.)"!]</SHORT-NAME>
                        <DESC>
                          <L-2 L="EN">DcmDspTestResultTid parameter</L-2>
                        </DESC>
                        <CATEGORY>VALUE</CATEGORY>
                        <RESULTING-PROPERTIES>
                          <SW-DATA-DEF-PROPS-VARIANTS>
                            <SW-DATA-DEF-PROPS-CONDITIONAL>
                              <BASE-TYPE-REF DEST="SW-BASE-TYPE">/AUTOSAR_Platform/BaseTypes/uint8</BASE-TYPE-REF>
                              <SW-BIT-REPRESENTATION>
                                <BIT-POSITION>[!"num:i($IndexTIDRef)"!]</BIT-POSITION>
                                <NUMBER-OF-BITS>1</NUMBER-OF-BITS>
                              </SW-BIT-REPRESENTATION>
                              <SW-CALIBRATION-ACCESS>READ-WRITE</SW-CALIBRATION-ACCESS>
                              <DATA-CONSTR-REF DEST="DATA-CONSTR">/AUTOSAR_Platform/DataConstrs/uint8</DATA-CONSTR-REF>
                            </SW-DATA-DEF-PROPS-CONDITIONAL>
                          </SW-DATA-DEF-PROPS-VARIANTS>
                        </RESULTING-PROPERTIES>
                        <SYMBOL>[[!"num:i($Index)"!]]</SYMBOL>
                      </MC-DATA-INSTANCE>
    [!VAR "IndexTIDRef" = "$IndexTIDRef + 1"!]
    [!IF "($IndexTIDRef mod 8) = 0"!]
      [!VAR "IndexTIDRef" = "0"!]
      [!VAR "Index" = "$Index + 1"!]
    [!ENDIF!]
  [!ENDLOOP!]
                    </SUB-ELEMENTS>
                    <SYMBOL>Dcm_DspTestResultTidUsed_[!"num:inttohex(node:value(./eb-list::*), 2)"!]</SYMBOL>
                  </MC-DATA-INSTANCE>
[!ENDLOOP!]

[!IF "node:exists(DcmConfigSet/eb-list::*[1]/DcmDsp/DcmDspVehInfo/eb-list::*)"!]
  [!VAR "BitIndex" = "0"!][!//
  [!VAR "Index" = "0"!][!//
  [!VAR "VehInfoRemaining" = "num:i(count(DcmConfigSet/eb-list::*[1]/DcmDsp/DcmDspVehInfo/eb-list::*))"!][!//
  [!VAR "Size" = "($VehInfoRemaining + 7) div 8"!]
                  <!-- !LINKSTO Dcm.EB.Config.Calibration.DcmDspVehInfoUsed,1 -->
                  <MC-DATA-INSTANCE>
                    <SHORT-NAME>Dcm_DspVehInfoUsed</SHORT-NAME>
                    <CATEGORY>ARRAY</CATEGORY>
                    <ARRAY-SIZE>[!"num:i($Size)"!]</ARRAY-SIZE>
                    <SUB-ELEMENTS>
  [!LOOP "util:distinct(node:order(DcmConfigSet/eb-list::*[1]/DcmDsp/DcmDspVehInfo/eb-list::* , 'DcmDspVehInfoInfoType'))"!]
                      <MC-DATA-INSTANCE>
                        <SHORT-NAME>[!"as:name(.)"!]</SHORT-NAME>
                        <DESC>
                          <L-2 L="EN">DcmDspVehInfoUsed parameter</L-2>
                        </DESC>
                        <CATEGORY>VALUE</CATEGORY>
                        <RESULTING-PROPERTIES>
                          <SW-DATA-DEF-PROPS-VARIANTS>
                            <SW-DATA-DEF-PROPS-CONDITIONAL>
                              <BASE-TYPE-REF DEST="SW-BASE-TYPE">/AUTOSAR_Platform/BaseTypes/uint8</BASE-TYPE-REF>
                              <SW-BIT-REPRESENTATION>
                                <BIT-POSITION>[!"num:i($BitIndex)"!]</BIT-POSITION>
                                <NUMBER-OF-BITS>1</NUMBER-OF-BITS>
                              </SW-BIT-REPRESENTATION>
                              <SW-CALIBRATION-ACCESS>READ-WRITE</SW-CALIBRATION-ACCESS>
                              <DATA-CONSTR-REF DEST="DATA-CONSTR">/AUTOSAR_Platform/DataConstrs/uint8</DATA-CONSTR-REF>
                            </SW-DATA-DEF-PROPS-CONDITIONAL>
                          </SW-DATA-DEF-PROPS-VARIANTS>
                        </RESULTING-PROPERTIES>
                        <SYMBOL>[[!"num:i($Index)"!]]</SYMBOL>
                      </MC-DATA-INSTANCE>
    [!VAR "BitIndex" = "$BitIndex + 1"!]
    [!IF "($BitIndex mod 8) = 0"!]
      [!VAR "BitIndex" = "0"!]
      [!VAR "Index" = "$Index + 1"!]
    [!ENDIF!]
  [!ENDLOOP!]
                    </SUB-ELEMENTS>
                    <SYMBOL>Dcm_DspVehInfoUsed</SYMBOL>
                  </MC-DATA-INSTANCE>
[!ENDIF!]

[!IF "(node:exists(as:modconf('Dcm')[1]/DcmConfigSet/eb-list::*[1]/DcmDsd/DcmDsdServiceTable/eb-list::*/DcmDsdService/eb-list::*[DcmDsdSidTabServiceId = num:i(8)])) or ((node:exists(as:modconf('Dcm')[1]/DcmConfigSet/eb-list::*[1]/DcmDsd/DcmDsdServiceTable/eb-list::*/DcmDsdService/eb-list::*[DcmDsdSidTabServiceId = num:i(49)])) and ((node:existsAndTrue(as:modconf('Dcm')[1]/DcmConfigSet/eb-list::*[1]/DcmDsp/DcmDspEnableObdMirror))))"!][!//
  [!IF "node:exists(DcmConfigSet/eb-list::*[1]/DcmDsp/DcmDspRequestControl/eb-list::*)"!]
    [!VAR "Index" = "0"!]
    [!VAR "Size" = "num:i(count(DcmConfigSet/eb-list::*[1]/DcmDsp/DcmDspRequestControl/eb-list::*))"!]
                  <!-- !LINKSTO Dcm.EB.Config.Calibration.DcmDspRequestControlUsed,1 -->
                  <MC-DATA-INSTANCE>
                    <SHORT-NAME>Dcm_DspRequestControlUsedConfig</SHORT-NAME>
                    <CATEGORY>ARRAY</CATEGORY>
                    <ARRAY-SIZE>[!"num:i($Size)"!]</ARRAY-SIZE>
                    <SUB-ELEMENTS>
    [!LOOP "DcmConfigSet/eb-list::*[1]/DcmDsp/DcmDspRequestControl/eb-list::*"!]
                      <MC-DATA-INSTANCE>
                        <SHORT-NAME>DcmDspRequestControlUsed_[!"num:i($Index)"!]</SHORT-NAME>
                        <DESC>
                          <L-2 L="EN">DcmDspRequestControlUsed parameter</L-2>
                        </DESC>
                        <CATEGORY>VALUE</CATEGORY>
                        <RESULTING-PROPERTIES>
                          <SW-DATA-DEF-PROPS-VARIANTS>
                            <SW-DATA-DEF-PROPS-CONDITIONAL>
                              <BASE-TYPE-REF DEST="SW-BASE-TYPE">/AUTOSAR_Platform/BaseTypes/uint8</BASE-TYPE-REF>
                              <SW-BIT-REPRESENTATION>
                                <BIT-POSITION>0</BIT-POSITION>
                                <NUMBER-OF-BITS>1</NUMBER-OF-BITS>
                              </SW-BIT-REPRESENTATION>
                              <SW-CALIBRATION-ACCESS>READ-WRITE</SW-CALIBRATION-ACCESS>
                              <DATA-CONSTR-REF DEST="DATA-CONSTR">/AUTOSAR_Platform/DataConstrs/uint8</DATA-CONSTR-REF>
                            </SW-DATA-DEF-PROPS-CONDITIONAL>
                          </SW-DATA-DEF-PROPS-VARIANTS>
                        </RESULTING-PROPERTIES>
                        <SYMBOL>[[!"num:i($Index)"!]]</SYMBOL>
                      </MC-DATA-INSTANCE>
      [!VAR "Index" = "$Index + 1"!]
    [!ENDLOOP!]
                    </SUB-ELEMENTS>
                    <SYMBOL>Dcm_DspRequestControlUsedConfig</SYMBOL>
                  </MC-DATA-INSTANCE>
  [!ENDIF!]
[!ENDIF!]

                </MC-PARAMETER-INSTANCES>
              </MC-SUPPORT>

              <PROGRAMMING-LANGUAGE>C</PROGRAMMING-LANGUAGE>
              <RESOURCE-CONSUMPTION>
                <SHORT-NAME>ResourceConsumption</SHORT-NAME>
              </RESOURCE-CONSUMPTION>
              <SW-VERSION>5.0.24</SW-VERSION>
              <VENDOR-ID>1</VENDOR-ID>
              <AR-RELEASE-VERSION>4.0.3</AR-RELEASE-VERSION>
              <BEHAVIOR-REF DEST="BSW-INTERNAL-BEHAVIOR">/AUTOSAR_Dcm/BswModuleDescriptions/Dcm/InternalBehavior_0</BEHAVIOR-REF>
            </BSW-IMPLEMENTATION>
          </ELEMENTS>
        </AR-PACKAGE>
      </AR-PACKAGES>
    </AR-PACKAGE>
  </AR-PACKAGES>
</AUTOSAR>
