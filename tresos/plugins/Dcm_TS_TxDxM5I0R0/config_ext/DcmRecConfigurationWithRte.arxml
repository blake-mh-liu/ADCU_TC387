AUTOSAR XML (schema 00046)
package /TS_TxDxM5I0R0
  module config DcmRecConfigurationWithRte: definition=Dcm, implementation-config-variant=VARIANT-PRE-COMPILE
    DcmConfigSet_0 (DcmConfigSet)
      DcmDsd
        DcmDsdServiceTable_0 (DcmDsdServiceTable): DcmDsdSidTabId=0
          20 x DcmDsdService, all with DcmAsyncServiceExecution=0, DcmDsdServiceUsed=1:
            TesterPresent: DcmDsdSidTabServiceId=62, DcmDsdSidTabSubfuncAvail=1, DcmDsdSidTabSessionLevelRef=DCM_ALL_SESSION_LEVEL
            DiagnosticSessionControl: DcmDsdSidTabServiceId=16, DcmDsdSidTabSubfuncAvail=1
              5 x DcmDsdSubService:
                defaultSession: DcmDsdSubServiceId=1
                programmingSession: DcmDsdSubServiceId=2
                extendedDiagnosticSession: DcmDsdSubServiceId=3
                oem_Bl_ProgrammingSession: DcmDsdSubServiceId=64
                sys_Bl_ProgrammingSession: DcmDsdSubServiceId=65
            EcuReset: DcmDsdSidTabServiceId=17, DcmDsdSidTabSubfuncAvail=1, DcmDsdSidTabSessionLevelRef=DCM_ALL_SESSION_LEVEL, DcmDsdSidTabModeRuleRef=DcmModeRule_0
              5 x DcmDsdSubService:
                hardReset: DcmDsdSubServiceId=1
                keyOffOnReset: DcmDsdSubServiceId=2, DcmDsdSubServiceModeRuleRef=DcmModeRule_1
                softReset: DcmDsdSubServiceId=3
                enableRapidPowerShutDown: DcmDsdSubServiceId=4
                disableRapidPowerShutDown: DcmDsdSubServiceId=5
            SecurityAccess: DcmDsdSidTabServiceId=39, DcmDsdSidTabSubfuncAvail=1, DcmDsdSidTabSessionLevelRef=DCM_ALL_SESSION_LEVEL
            ReadDid: DcmDsdSidTabServiceId=34, DcmDsdSidTabSubfuncAvail=0, DcmDsdSidTabSessionLevelRef=DCM_ALL_SESSION_LEVEL
            WriteDid: DcmDsdSidTabServiceId=46, DcmDsdSidTabSubfuncAvail=0, DcmDsdSidTabSessionLevelRef=DCM_ALL_SESSION_LEVEL
            ReadDTCInformation: DcmDsdSidTabServiceId=25, DcmDsdSidTabSubfuncAvail=1, DcmDsdSidTabSessionLevelRef=DCM_ALL_SESSION_LEVEL
              6 x DcmDsdSubService:
                reportNumberOfDTCByStatusMask: DcmDsdSubServiceId=1
                reportDTCByStatusMask: DcmDsdSubServiceId=2
                reportDTCSnapshotRecordIdentification: DcmDsdSubServiceId=3
                reportDTCSnapshotRecordByDTCNumber: DcmDsdSubServiceId=4
                reportDTCExtendedDataRecordByDTCNumber: DcmDsdSubServiceId=6
                reportSupportedDTCs: DcmDsdSubServiceId=10
            ClearDiagnosticInformation: DcmDsdSidTabServiceId=20, DcmDsdSidTabSubfuncAvail=0, DcmDsdSidTabSessionLevelRef=DCM_ALL_SESSION_LEVEL
            CommunicationControl: DcmDsdSidTabServiceId=40, DcmDsdSidTabSubfuncAvail=1, DcmDsdSidTabSessionLevelRef=DCM_ALL_SESSION_LEVEL
              4 x DcmDsdSubService:
                enableRxAndTx: DcmDsdSubServiceId=0
                enableRxAndDisableTx: DcmDsdSubServiceId=1
                disableRxAndEnableTx: DcmDsdSubServiceId=2
                disableRxAndTx: DcmDsdSubServiceId=3
            RoutineControl: DcmDsdSidTabServiceId=49, DcmDsdSidTabSubfuncAvail=1, DcmDsdSidTabSessionLevelRef=DCM_ALL_SESSION_LEVEL
            RequestDownload: DcmDsdSidTabServiceId=52, DcmDsdSidTabSubfuncAvail=0, DcmDsdSidTabSessionLevelRef=DCM_ALL_SESSION_LEVEL
            RequestUpload: DcmDsdSidTabServiceId=53, DcmDsdSidTabSubfuncAvail=0, DcmDsdSidTabSessionLevelRef=DCM_ALL_SESSION_LEVEL
            TransferData: DcmDsdSidTabServiceId=54, DcmDsdSidTabSubfuncAvail=0, DcmDsdSidTabSessionLevelRef=DCM_ALL_SESSION_LEVEL
            RequestTransferExit: DcmDsdSidTabServiceId=55, DcmDsdSidTabSubfuncAvail=0, DcmDsdSidTabSessionLevelRef=DCM_ALL_SESSION_LEVEL
            LinkControl: DcmDsdSidTabServiceId=135, DcmDsdSidTabSubfuncAvail=1, DcmDsdSidTabSessionLevelRef=DCM_ALL_SESSION_LEVEL
              3 x DcmDsdSubService:
                verifyBaudrateTransitionWithFixedBaudrate: DcmDsdSubServiceId=1
                verifyBaudrateTransitionWithSpecificBaudrate: DcmDsdSubServiceId=2
                verifyBaudrateTransitionWithTransitionBaudrate: DcmDsdSubServiceId=3
            ControlDTCSetting: DcmDsdSidTabServiceId=133, DcmDsdSidTabSubfuncAvail=1, DcmDsdSidTabSessionLevelRef=DCM_ALL_SESSION_LEVEL
              DcmDsdSubService_0 (DcmDsdSubService): DcmDsdSubServiceId=1
              DcmDsdSubService_1 (DcmDsdSubService): DcmDsdSubServiceId=2
            ReadMemoryByAddress: DcmDsdSidTabServiceId=35, DcmDsdSidTabSubfuncAvail=0, DcmDsdSidTabSessionLevelRef=DCM_ALL_SESSION_LEVEL
            WriteMemoryByAddress: DcmDsdSidTabServiceId=61, DcmDsdSidTabSubfuncAvail=0, DcmDsdSidTabSessionLevelRef=DCM_ALL_SESSION_LEVEL
            InputOutputControlByIdentifier: DcmDsdSidTabServiceId=47, DcmDsdSidTabSubfuncAvail=0, DcmDsdSidTabSessionLevelRef=DCM_ALL_SESSION_LEVEL
            ResponseOnEvent: DcmDsdSidTabServiceId=134, DcmDsdSidTabSubfuncAvail=1, DcmDsdSidTabSessionLevelRef=DCM_ALL_SESSION_LEVEL
              6 x DcmDsdSubService:
                stopResponseOnEvent: DcmDsdSubServiceId=0
                onDTCStatusChange: DcmDsdSubServiceId=1
                onChangeOfDataIdentifier: DcmDsdSubServiceId=3
                reportActivatedEvents: DcmDsdSubServiceId=4
                startResponseOnEvent: DcmDsdSubServiceId=5
                clearResponseOnEvent: DcmDsdSubServiceId=6
      DcmDsp:
        DcmDspDDDIDcheckPerSourceDID = 0
        DcmDspGenerateOnlyNeededIOControlOperations = 0
        DcmDspMaxPeriodicDidToRead = 1
        DcmDspReturnControlToEcuTimeout = 1
        DcmDspSessionControlTiming = 0
        DcmDspMaxDidToRead = 1
        DcmDspPowerDownTime = 10
        DcmDspRoutineVariableLengthInBytes = 0
        DcmDspComControl
          DcmDspComControlSetting
        DcmDspControlDTCSetting: DcmSupportDTCSettingControlOptionRecord=0
        DcmDspReadGenericInformation
        DcmDspSession
          6 x DcmDspSessionRow:
            DCM_DEFAULT_SESSION: DcmDspSessionLevel=1, DcmDspSessionForBoot=DCM_NO_BOOT, DcmDspSessionP2ServerMax=0.05, DcmDspSessionP2StarServerMax=5.0
            DCM_EXTENDED_DIAGNOSTIC_SESSION: DcmDspSessionForBoot=DCM_NO_BOOT, DcmDspSessionLevel=3, DcmDspSessionP2ServerMax=0.1, DcmDspSessionP2StarServerMax=2.0
            DCM_PROGRAMMING_SESSION: DcmDspSessionForBoot=DCM_NO_BOOT, DcmDspSessionLevel=2, DcmDspSessionP2ServerMax=0.5, DcmDspSessionP2StarServerMax=7.0
            DCM_ALL_SESSION_LEVEL: DcmDspSessionForBoot=DCM_NO_BOOT, DcmDspSessionLevel=255, DcmDspSessionP2ServerMax=0.5, DcmDspSessionP2StarServerMax=5.0
            DcmDspSessionRow_0: DcmDspSessionForBoot=DCM_OEM_BOOT, DcmDspSessionLevel=65, DcmDspSessionP2ServerMax=0.3, DcmDspSessionP2StarServerMax=3.0
            DcmDspSessionRow_1: DcmDspSessionForBoot=DCM_SYS_BOOT, DcmDspSessionLevel=64, DcmDspSessionP2ServerMax=0.5, DcmDspSessionP2StarServerMax=5.0
        DcmDspData_0x100 (DcmDspData):
          DcmDspDataConditionCheckReadFncUsed = 1
          DcmDspDataConditionCheckReadFnc = ReadDIDDataCondition0
          DcmDspDataReadDataLengthFnc = ReadDIDDataLength0
          DcmDspDataReadFnc = ReadDIDData0
          DcmDspDataSize = 5
          DcmDspDataType = UINT8
          DcmDspDataUsePort = USE_DATA_ASYNCH_FNC
          DcmDspDataWriteFnc = WriteDIDData0
          DcmDspDataInfoRef = DcmDspDataInfo_0x100
        DcmDspData_0xF186 (DcmDspData):
          DcmDspDataConditionCheckReadFncUsed = 0
          DcmDspDataReadFnc = Dcm_Internalf186Readout
          DcmDspDataSize = 8
          DcmDspDataType = UINT8
          DcmDspDataUsePort = USE_DATA_SYNCH_FNC
          DcmDspDataInfoRef = DcmDspDataInfo_0xF186
        DcmDspDataInfo_0x100 (DcmDspDataInfo): DcmDspDataFixedLength=1
        DcmDspDataInfo_0xF186 (DcmDspDataInfo): DcmDspDataFixedLength=1
        DcmDspDidRange:
          DcmDspDidRangeHasGaps = 0
          DcmDspDidRangeIdentifierLowerLimit = 0
          DcmDspDidRangeIdentifierUpperLimit = 0
          DcmDspDidRangeMaxDataLength = 1
          DcmDspDidRangeUsePort = 1
          DcmDspDidRangeInfoRef = DcmDspDidInfo_0x100
        DcmDspDid_0x100 (DcmDspDid): DcmDspDidIdentifier=256, DcmDspDidUsed=1, DcmDspDidInfoRef=DcmDspDidInfo_0x100
          DcmDspDidSignal_0 (DcmDspDidSignal): DcmDspDidDataPos=2, DcmDspDidDataRef=DcmDspData_0x100
        DcmDspDid_0xF186 (DcmDspDid): DcmDspDidIdentifier=61830, DcmDspDidUsed=1, DcmDspDidInfoRef=DcmDspDidInfo_0xF186
          DcmDspDidSignal_0XF186 (DcmDspDidSignal): DcmDspDidDataPos=0, DcmDspDidDataRef=DcmDspData_0xF186
        DcmDspDidInfo_0x100 (DcmDspDidInfo): DcmDspDidDynamicallyDefined=0
          DcmDspDidAccess
            DcmDspDidRead
            DcmDspDidWrite
        DcmDspDidInfo_0xF186 (DcmDspDidInfo): DcmDspDidDynamicallyDefined=0
          DcmDspDidAccess
            DcmDspDidRead
        DcmDspRoe: DcmDspRoeInterMessageTime=0.0, DcmDspRoeBlockIdRef=(unset)
          DcmDspRoeEvent_0 (DcmDspRoeEvent): DcmDspRoeEventId=0, DcmDspRoeInitialEventStatus=DCM_ROE_CLEARED
            DcmDspRoeEventProperties
              DcmDspRoeEventProperties (DcmDspRoeOnChangeOfDataIdentifier): DcmDspRoeDidRef=DcmDspDid_0x100
          DcmDspRoeEventWindowTime_0 (DcmDspRoeEventWindowTime): DcmDspRoeEventWindowTime=DCM_ROE_EVENT_WINDOW_INFINITE, DcmDspRoeStorageState=0
        DcmDspRoutine_0 (DcmDspRoutine):
          DcmDspRoutineFixedLength = 1
          DcmDspRoutineIdentifier = 65530
          DcmDspRoutineUsePort = 1
          DcmDspRoutineUsed = 1
          DcmDspRequestResultsRoutineSupported = 1
          DcmDspStopRoutineSupported = 1
          DcmDspRoutineInfoRef = DcmDspRoutineInfo_0
        DcmDspRoutineInfo_0 (DcmDspRoutineInfo)
          DcmDspRoutineAuthorization:
            DcmDspRoutineSecurityLevelRef = DCM_SEC_LEV_L3
            DcmDspRoutineSessionRef = DCM_DEFAULT_SESSION
            DcmDspRoutineSessionRef = DCM_EXTENDED_DIAGNOSTIC_SESSION
          DcmDspRoutineRequestResOut
            DcmDspRoutineRequestResOutSignal_0 (DcmDspRoutineRequestResOutSignal): index=0, DcmDspRoutineSignalLength=8, DcmDspRoutineSignalPos=0, DcmDspRoutineSignalType=UINT8
            DcmDspRoutineRequestResOutSignal_1 (DcmDspRoutineRequestResOutSignal): index=1, DcmDspRoutineSignalLength=1, DcmDspRoutineSignalPos=8, DcmDspRoutineSignalType=BOOLEAN
          DcmDspRoutineStopIn
            DcmDspRoutineStopInSignal_0 (DcmDspRoutineStopInSignal): index=0, DcmDspRoutineSignalLength=16, DcmDspRoutineSignalPos=0, DcmDspRoutineSignalType=UINT16
            DcmDspRoutineStopInSignal_1 (DcmDspRoutineStopInSignal): index=1, DcmDspRoutineSignalLength=8, DcmDspRoutineSignalPos=16, DcmDspRoutineSignalType=UINT8
          DcmDspRoutineStopOut
            DcmDspRoutineStopOutSignal_0 (DcmDspRoutineStopOutSignal): index=0, DcmDspRoutineSignalLength=1, DcmDspRoutineSignalPos=0, DcmDspRoutineSignalType=BOOLEAN
            DcmDspRoutineStopOutSignal_1 (DcmDspRoutineStopOutSignal): index=1, DcmDspRoutineSignalLength=32, DcmDspRoutineSignalPos=1, DcmDspRoutineSignalType=UINT32
          DcmDspStartRoutineIn
            DcmDspStartRoutineInSignal_0 (DcmDspStartRoutineInSignal): index=0, DcmDspRoutineSignalLength=8, DcmDspRoutineSignalPos=0, DcmDspRoutineSignalType=SINT8
            DcmDspStartRoutineInSignal_1 (DcmDspStartRoutineInSignal): index=1, DcmDspRoutineSignalLength=8, DcmDspRoutineSignalPos=8, DcmDspRoutineSignalType=UINT8
          DcmDspStartRoutineOut
            DcmDspStartRoutineOutSignal_0 (DcmDspStartRoutineOutSignal): index=0, DcmDspRoutineSignalLength=16, DcmDspRoutineSignalPos=0, DcmDspRoutineSignalType=SINT16
            DcmDspStartRoutineOutSignal_1 (DcmDspStartRoutineOutSignal): index=1, DcmDspRoutineSignalLength=32, DcmDspRoutineSignalPos=16, DcmDspRoutineSignalType=SINT32
        DcmDspSecurity
          DCM_SEC_LEV_L1 (DcmDspSecurityRow):
            DcmDspSecurityADRSize = 1
            DcmDspSecurityUsePort = USE_SECURITY_ASYNCH_CLIENT_SERVER
            DcmDspSecurityDelayTime = 0.06
            DcmDspSecurityDelayTimeOnBoot = 0.0
            DcmDspSecurityKeySize = 2
            DcmDspSecurityLevel = 1
            DcmDspSecurityNumAttDelay = 1
            DcmDspSecuritySeedSize = 3
          DCM_SEC_LEV_L3 (DcmDspSecurityRow):
            DcmDspSecurityADRSize = 1
            DcmDspSecurityUsePort = USE_SECURITY_ASYNCH_CLIENT_SERVER
            DcmDspSecurityDelayTime = 0.06
            DcmDspSecurityDelayTimeOnBoot = 0.0
            DcmDspSecurityKeySize = 4
            DcmDspSecurityLevel = 5
            DcmDspSecurityNumAttDelay = 2
            DcmDspSecuritySeedSize = 4
        DcmDspMemory: DcmDspUseMemoryId=0
          DcmDspMemoryIdInfo_0 (DcmDspMemoryIdInfo)
            DcmDspReadMemoryRangeInfo_0 (DcmDspReadMemoryRangeInfo): DcmDspReadMemoryRangeHigh=0, DcmDspReadMemoryRangeLow=0
            DcmDspWriteMemoryRangeInfo_0 (DcmDspWriteMemoryRangeInfo): DcmDspWriteMemoryRangeHigh=0, DcmDspWriteMemoryRangeLow=0
      DcmDsl
        3 x DcmDslBuffer:
          DcmDslBuffer_Common: DcmDslBufferSize=256
          DcmDslBuffer_Rx: DcmDslBufferSize=8
          DcmDslBuffer_Tx: DcmDslBufferSize=8
        DcmDslCallbackDCMRequestService_0 (DcmDslCallbackDCMRequestService)
        DcmDslDiagResp: DcmDslDiagRespMaxNumRespPend=5, DcmDslDiagRespOnSecondDeclinedRequest=0
        DcmDslProtocol
          DcmDslProtocolRow_0 (DcmDslProtocolRow):
            DcmDslProtocolPriority = 0
            DcmSendRespPendOnTransToBoot = 1
            DcmDslProtocolEndiannessConvEnabled = 0
            DcmDslProtocolID = DCM_UDS_ON_CAN
            DcmDslProtocolIsParallelExecutab = 0
            DcmDslProtocolPreemptTimeout = 0.01
            DcmTimStrP2ServerAdjust = 0.0
            DcmTimStrP2StarServerAdjust = 0.0
            DcmDslProtocolTxBufferID = DcmDslBuffer_Common
            DcmDslProtocolSIDTable = DcmDsdServiceTable_0
            DcmDslProtocolSessionRef = DcmDspSession
            3 x DcmDslConnection:
              DcmDslConnection_0
                DcmDslConnection_0 (DcmDslMainConnection): DcmDslProtocolRxTesterSourceAddr=0
                  DcmDslProtocolRx_0 (DcmDslProtocolRx):
                    DcmDslProtocolRxPduId = 0
                    DcmDslProtocolRxAddrType = DCM_PHYSICAL_TYPE
                    DcmDslProtocolRxChannelId = 0
                    DcmDslProtocolRxComMChannelRef = (unset)
                    DcmDslProtocolRxBufferID = DcmDslBuffer_Common
                    DcmDslProtocolRxPduRef = (unset)
                  DcmDslProtocolRx_1 (DcmDslProtocolRx):
                    DcmDslProtocolRxPduId = 1
                    DcmDslProtocolRxAddrType = DCM_FUNCTIONAL_TYPE
                    DcmDslProtocolRxChannelId = 0
                    DcmDslProtocolRxComMChannelRef = (unset)
                    DcmDslProtocolRxBufferID = DcmDslBuffer_Common
                    DcmDslProtocolRxPduRef = (unset)
                  DcmDslProtocolTx: DcmDslTxConfirmationPduId=0, DcmDslProtocolTxPduRef=(unset)
              DcmDslConnection_1
                DcmDslConnection_1 (DcmDslPeriodicTransmission)
                  DcmDslPeriodicConnection: index=0, DcmDslPeriodicTxConfirmationPduId=1, DcmDslPeriodicTxPduRef=(unset)
              DcmDslConnection_2
                DcmDslConnection_2 (DcmDslResponseOnEvent): DcmDslRoeTxConfirmationPduId=2
          DcmDslProtocolRow_1 (DcmDslProtocolRow):
            DcmDslProtocolPriority = 1
            DcmSendRespPendOnTransToBoot = 1
            DcmDslProtocolEndiannessConvEnabled = 0
            DcmDslProtocolID = DCM_UDS_ON_FLEXRAY
            DcmDslProtocolIsParallelExecutab = 0
            DcmDslProtocolPreemptTimeout = 0.01
            DcmTimStrP2ServerAdjust = 0.0
            DcmTimStrP2StarServerAdjust = 0.0
            DcmDslProtocolTxBufferID = DcmDslBuffer_Tx
            DcmDslProtocolSIDTable = DcmDsdServiceTable_0
            DcmDslProtocolSessionRef = DcmDspSession
            3 x DcmDslConnection:
              DcmDslConnection_3
                DcmDslConnection_3 (DcmDslMainConnection): DcmDslProtocolRxTesterSourceAddr=0
                  DcmDslProtocolRx_0 (DcmDslProtocolRx):
                    DcmDslProtocolRxPduId = 2
                    DcmDslProtocolRxAddrType = DCM_PHYSICAL_TYPE
                    DcmDslProtocolRxChannelId = 0
                    DcmDslProtocolRxComMChannelRef = (unset)
                    DcmDslProtocolRxBufferID = DcmDslBuffer_Rx
                    DcmDslProtocolRxPduRef = (unset)
                  DcmDslProtocolRx_1 (DcmDslProtocolRx):
                    DcmDslProtocolRxPduId = 3
                    DcmDslProtocolRxAddrType = DCM_FUNCTIONAL_TYPE
                    DcmDslProtocolRxChannelId = 0
                    DcmDslProtocolRxComMChannelRef = (unset)
                    DcmDslProtocolRxBufferID = DcmDslBuffer_Rx
                    DcmDslProtocolRxPduRef = (unset)
                  DcmDslProtocolTx: DcmDslTxConfirmationPduId=3, DcmDslProtocolTxPduRef=(unset)
              DcmDslConnection_4
                DcmDslConnection_4 (DcmDslPeriodicTransmission)
                  DcmDslPeriodicConnection_0 (DcmDslPeriodicConnection): index=0, DcmDslPeriodicTxConfirmationPduId=4, DcmDslPeriodicTxPduRef=(unset)
              DcmDslConnection_5
                DcmDslConnection_5 (DcmDslResponseOnEvent)
        DcmDslServiceRequestManufacturerNotification_0 (DcmDslServiceRequestManufacturerNotification): index=0
        DcmDslServiceRequestSupplierNotification_0 (DcmDslServiceRequestSupplierNotification): index=0
      DcmDefensiveProgramming:
        DcmDefProgEnabled = 0
        DcmPrecondAssertEnabled = 0
        DcmPostcondAssertEnabled = 0
        DcmStaticAssertEnabled = 0
        DcmUnreachAssertEnabled = 0
        DcmInvariantAssertEnabled = 0
      DcmGeneral:
        DcmDDDIDStorage = 0
        DcmDevErrorDetect = 1
        DcmDslEnableSetActiveDiagnosis = 0
        DcmNRCPolicyISOVersion = ISO14229_2013
        DcmModeDeclarationSupport = 0
        DcmRequestManufacturerNotificationEnabled = 1
        DcmRequestSupplierNotificationEnabled = 1
        DcmRespondAllRequest = 1
        DcmTaskTime = 0.01
        DcmVersionInfoApi = 1
        DcmRteUsage = 1
        DcmRequestSeedAfterFailedCompareKey = 0
        DcmServiceAPI: DcmEnableASR40ServiceAPI=0, DcmEnableASR42ServiceAPI=0, DcmDefaultASRServiceAPI=AUTOSAR_40
      DcmPageBufferCfg: DcmPagedBufferEnabled=1, DcmPagedBufferTimeout=0.05
      DcmProcessingConditions
        DcmModeCondition_0 (DcmModeCondition): DcmConditionType=DCM_EQUALS, DcmSwcModeRef=(unset)
        DcmModeCondition_1 (DcmModeCondition): DcmConditionType=DCM_EQUALS_NOT, DcmSwcModeRef=(unset)
        DcmModeRule_0 (DcmModeRule): DcmLogicalOperator=DCM_OR, DcmModeRuleNrcValue=10, DcmArgumentRef=DcmModeCondition_0, DcmArgumentRef=DcmModeCondition_1
        DcmModeRule_1 (DcmModeRule):
          DcmLogicalOperator = DCM_AND
          DcmModeRuleNrcValue = 22
          DcmArgumentRef = DcmModeCondition_0
          DcmArgumentRef = DcmModeCondition_1
          DcmArgumentRef = DcmModeRule_0
