AUTOSAR XML (schema 00046)
package /TS_TxDxM5I0R0
  module config DcmRecConfigurationBasic: definition=Dcm, implementation-config-variant=VARIANT-PRE-COMPILE
    DcmConfigSet_0 (DcmConfigSet)
      DcmDsd
        DcmDsdServiceTable_0 (DcmDsdServiceTable): DcmDsdSidTabId=0
          10 x DcmDsdService, all with DcmAsyncServiceExecution=0, DcmDsdServiceUsed=1:
            TesterPresent: DcmDsdSidTabServiceId=62, DcmDsdSidTabSubfuncAvail=1, DcmDsdSidTabSessionLevelRef=DCM_ALL_SESSION_LEVEL
            DiagnosticSessionControl: DcmDsdSidTabServiceId=16, DcmDsdSidTabSubfuncAvail=1
              3 x DcmDsdSubService:
                defaultSession: DcmDsdSubServiceId=1
                programmingSession: DcmDsdSubServiceId=2
                extendedDiagnosticSession: DcmDsdSubServiceId=3
            EcuReset: DcmDsdSidTabServiceId=17, DcmDsdSidTabSubfuncAvail=1, DcmDsdSidTabSessionLevelRef=DCM_ALL_SESSION_LEVEL
              5 x DcmDsdSubService:
                hardReset: DcmDsdSubServiceId=1
                keyOffOnReset: DcmDsdSubServiceId=2
                softReset: DcmDsdSubServiceId=3
                enableRapidPowerShutDown: DcmDsdSubServiceId=4
                disableRapidPowerShutDown: DcmDsdSubServiceId=5
            SecurityAccess: DcmDsdSidTabServiceId=39, DcmDsdSidTabSubfuncAvail=1, DcmDsdSidTabSessionLevelRef=DCM_EXTENDED_DIAGNOSTIC_SESSION
            ReadDid: DcmDsdSidTabServiceId=34, DcmDsdSidTabSubfuncAvail=0, DcmDsdSidTabSessionLevelRef=DCM_ALL_SESSION_LEVEL
            WriteDid: DcmDsdSidTabServiceId=46, DcmDsdSidTabSubfuncAvail=0, DcmDsdSidTabSessionLevelRef=DCM_ALL_SESSION_LEVEL
            ReadDTCInformation: DcmDsdSidTabServiceId=25, DcmDsdSidTabSubfuncAvail=1, DcmDsdSidTabSessionLevelRef=DCM_ALL_SESSION_LEVEL
              6 x DcmDsdSubService:
                reportNumberOfDTCByStatusMask: DcmDsdSubServiceId=1
                reportDTCByStatusMask: DcmDsdSubServiceId=2
                reportDTCSnapshotRecordIdentification: DcmDsdSubServiceId=3
                reportDTCSnapshotRecordByDTCNumber: DcmDsdSubServiceId=4
                reportDTCExtendedDataRecordByDTCNumber: DcmDsdSubServiceId=6
                reportSupportedDTCs: DcmDsdSubServiceId=10
            ClearDiagnosticInformation: DcmDsdSidTabServiceId=20, DcmDsdSidTabSubfuncAvail=0, DcmDsdSidTabSessionLevelRef=DCM_ALL_SESSION_LEVEL
            CommunicationControl: DcmDsdSidTabServiceId=40, DcmDsdSidTabSubfuncAvail=1, DcmDsdSidTabSessionLevelRef=DCM_EXTENDED_DIAGNOSTIC_SESSION
              4 x DcmDsdSubService:
                enableRxAndTx: DcmDsdSubServiceId=0
                enableRxAndDisableTx: DcmDsdSubServiceId=1
                disableRxAndEnableTx: DcmDsdSubServiceId=2
                disableRxAndTx: DcmDsdSubServiceId=3
            ControlDTCSetting: DcmDsdSidTabServiceId=133, DcmDsdSidTabSubfuncAvail=1, DcmDsdSidTabSessionLevelRef=DCM_EXTENDED_DIAGNOSTIC_SESSION
              DcmDsdSubService_0 (DcmDsdSubService): DcmDsdSubServiceId=1
              DcmDsdSubService_1 (DcmDsdSubService): DcmDsdSubServiceId=2
      DcmDsp:
        DcmDspDDDIDcheckPerSourceDID = 0
        DcmDspGenerateOnlyNeededIOControlOperations = 0
        DcmDspMaxPeriodicDidToRead = 1
        DcmDspReturnControlToEcuTimeout = 1
        DcmDspSessionControlTiming = 0
        DcmDspMaxDidToRead = 1
        DcmDspPowerDownTime = 10
        DcmDspRoutineVariableLengthInBytes = 0
        DcmDspComControl
          DcmDspComControlSetting
        DcmDspControlDTCSetting: DcmSupportDTCSettingControlOptionRecord=0
        DcmDspReadGenericInformation
        DcmDspSession
          4 x DcmDspSessionRow, all with DcmDspSessionForBoot=DCM_NO_BOOT:
            DCM_DEFAULT_SESSION: DcmDspSessionLevel=1, DcmDspSessionP2ServerMax=0.05, DcmDspSessionP2StarServerMax=5.0
            DCM_EXTENDED_DIAGNOSTIC_SESSION: DcmDspSessionLevel=3, DcmDspSessionP2ServerMax=0.1, DcmDspSessionP2StarServerMax=2.0
            DCM_PROGRAMMING_SESSION: DcmDspSessionLevel=2, DcmDspSessionP2ServerMax=0.5, DcmDspSessionP2StarServerMax=7.0
            DCM_ALL_SESSION_LEVEL: DcmDspSessionLevel=255, DcmDspSessionP2ServerMax=0.5, DcmDspSessionP2StarServerMax=5.0
        DcmDspData_0x100 (DcmDspData):
          DcmDspDataConditionCheckReadFncUsed = 1
          DcmDspDataConditionCheckReadFnc = ReadDIDDataCondition0
          DcmDspDataReadDataLengthFnc = ReadDIDDataLength0
          DcmDspDataReadFnc = ReadDIDData0
          DcmDspDataSize = 5
          DcmDspDataType = UINT8
          DcmDspDataUsePort = USE_DATA_ASYNCH_FNC
          DcmDspDataWriteFnc = WriteDIDData0
          DcmDspDataInfoRef = DcmDspDataInfo_0x100
        DcmDspData_0xF186 (DcmDspData):
          DcmDspDataConditionCheckReadFncUsed = 0
          DcmDspDataReadFnc = Dcm_Internalf186Readout
          DcmDspDataSize = 8
          DcmDspDataType = UINT8
          DcmDspDataUsePort = USE_DATA_SYNCH_FNC
          DcmDspDataInfoRef = DcmDspDataInfo_0xF186
        DcmDspDataInfo_0x100 (DcmDspDataInfo): DcmDspDataFixedLength=1
        DcmDspDataInfo_0xF186 (DcmDspDataInfo): DcmDspDataFixedLength=1
        DcmDspDid_0x100 (DcmDspDid): DcmDspDidIdentifier=256, DcmDspDidUsed=1, DcmDspDidInfoRef=DcmDspDidInfo_0x100
          DcmDspDidSignal_0 (DcmDspDidSignal): DcmDspDidDataPos=2, DcmDspDidDataRef=DcmDspData_0x100
        DcmDspDid_0xF186 (DcmDspDid): DcmDspDidIdentifier=61830, DcmDspDidUsed=1, DcmDspDidInfoRef=DcmDspDidInfo_0xF186
          DcmDspDidSignal_0XF186 (DcmDspDidSignal): DcmDspDidDataPos=0, DcmDspDidDataRef=DcmDspData_0xF186
        DcmDspDidInfo_0x100 (DcmDspDidInfo): DcmDspDidDynamicallyDefined=0
          DcmDspDidAccess
            DcmDspDidRead
            DcmDspDidWrite
        DcmDspDidInfo_0xF186 (DcmDspDidInfo): DcmDspDidDynamicallyDefined=0
          DcmDspDidAccess
            DcmDspDidRead
        DcmDspRoutine_0 (DcmDspRoutine):
          DcmDspRequestResultsRoutineFnc = Routine0_RequestResult
          DcmDspRoutineFixedLength = 1
          DcmDspRoutineIdentifier = 65530
          DcmDspRoutineUsePort = 0
          DcmDspRoutineUsed = 1
          DcmDspStartRoutineFnc = Routine0_Start
          DcmDspStopRoutineFnc = Routine0_Stop
          DcmDspRequestResultsRoutineSupported = 1
          DcmDspStopRoutineSupported = 1
          DcmDspRoutineInfoRef = DcmDspRoutineInfo_0
        DcmDspRoutineInfo_0 (DcmDspRoutineInfo)
          DcmDspRoutineAuthorization:
            DcmDspRoutineSecurityLevelRef = DCM_SEC_LEV_L3
            DcmDspRoutineSessionRef = DCM_DEFAULT_SESSION
            DcmDspRoutineSessionRef = DCM_EXTENDED_DIAGNOSTIC_SESSION
          DcmDspRoutineRequestResOut
            DcmDspRoutineRequestResOutSignal_0 (DcmDspRoutineRequestResOutSignal): index=0, DcmDspRoutineSignalLength=8, DcmDspRoutineSignalPos=0, DcmDspRoutineSignalType=UINT8
            DcmDspRoutineRequestResOutSignal_1 (DcmDspRoutineRequestResOutSignal): index=1, DcmDspRoutineSignalLength=1, DcmDspRoutineSignalPos=8, DcmDspRoutineSignalType=BOOLEAN
          DcmDspRoutineStopIn
            DcmDspRoutineStopInSignal_0 (DcmDspRoutineStopInSignal): index=0, DcmDspRoutineSignalLength=16, DcmDspRoutineSignalPos=0, DcmDspRoutineSignalType=UINT16
            DcmDspRoutineStopInSignal_1 (DcmDspRoutineStopInSignal): index=1, DcmDspRoutineSignalLength=8, DcmDspRoutineSignalPos=16, DcmDspRoutineSignalType=UINT8
          DcmDspRoutineStopOut
            DcmDspRoutineStopOutSignal_0 (DcmDspRoutineStopOutSignal): index=0, DcmDspRoutineSignalLength=1, DcmDspRoutineSignalPos=0, DcmDspRoutineSignalType=BOOLEAN
            DcmDspRoutineStopOutSignal_1 (DcmDspRoutineStopOutSignal): index=1, DcmDspRoutineSignalLength=32, DcmDspRoutineSignalPos=1, DcmDspRoutineSignalType=UINT32
          DcmDspStartRoutineIn
            DcmDspStartRoutineInSignal_0 (DcmDspStartRoutineInSignal): index=0, DcmDspRoutineSignalLength=8, DcmDspRoutineSignalPos=0, DcmDspRoutineSignalType=SINT8
            DcmDspStartRoutineInSignal_1 (DcmDspStartRoutineInSignal): index=1, DcmDspRoutineSignalLength=8, DcmDspRoutineSignalPos=8, DcmDspRoutineSignalType=UINT8
          DcmDspStartRoutineOut
            DcmDspStartRoutineOutSignal_0 (DcmDspStartRoutineOutSignal): index=0, DcmDspRoutineSignalLength=16, DcmDspRoutineSignalPos=0, DcmDspRoutineSignalType=SINT16
            DcmDspStartRoutineOutSignal_1 (DcmDspStartRoutineOutSignal): index=1, DcmDspRoutineSignalLength=32, DcmDspRoutineSignalPos=16, DcmDspRoutineSignalType=SINT32
        DcmDspSecurity
          DCM_SEC_LEV_L1 (DcmDspSecurityRow):
            DcmDspSecurityADRSize = 1
            DcmDspSecurityUsePort = USE_SECURITY_ASYNCH_FNC
            DcmDspSecurityGetSeedFnc = SecurityGetSeedADR0
            DcmDspSecurityCompareKeyFnc = SecurityCompareKey0
            DcmDspSecurityDelayTime = 0.06
            DcmDspSecurityDelayTimeOnBoot = 0.0
            DcmDspSecurityKeySize = 2
            DcmDspSecurityLevel = 1
            DcmDspSecurityNumAttDelay = 1
            DcmDspSecuritySeedSize = 3
          DCM_SEC_LEV_L3 (DcmDspSecurityRow):
            DcmDspSecurityADRSize = 1
            DcmDspSecurityUsePort = USE_SECURITY_SYNCH_FNC
            DcmDspSecurityGetSeedFnc = SecurityGetSeedADR0
            DcmDspSecurityCompareKeyFnc = SecurityCompareKey0
            DcmDspSecurityDelayTime = 0.06
            DcmDspSecurityDelayTimeOnBoot = 0.0
            DcmDspSecurityKeySize = 4
            DcmDspSecurityLevel = 5
            DcmDspSecurityNumAttDelay = 2
            DcmDspSecuritySeedSize = 4
      DcmDsl
        DcmDslBuffer_Common (DcmDslBuffer): DcmDslBufferSize=256
        DcmDslDiagResp: DcmDslDiagRespMaxNumRespPend=5, DcmDslDiagRespOnSecondDeclinedRequest=0
        DcmDslProtocol
          DcmDslProtocolRow_0 (DcmDslProtocolRow):
            DcmDslProtocolPriority = 0
            DcmSendRespPendOnTransToBoot = 1
            DcmDslProtocolEndiannessConvEnabled = 0
            DcmDslProtocolID = DCM_UDS_ON_CAN
            DcmDslProtocolIsParallelExecutab = 0
            DcmDslProtocolPreemptTimeout = 0.01
            DcmTimStrP2ServerAdjust = 0.0
            DcmTimStrP2StarServerAdjust = 0.0
            DcmDslProtocolTxBufferID = DcmDslBuffer_Common
            DcmDslProtocolSIDTable = DcmDsdServiceTable_0
            DcmDslProtocolSessionRef = DcmDspSession
            DcmDslConnection_0 (DcmDslConnection)
              DcmDslConnection_0 (DcmDslMainConnection): DcmDslProtocolRxTesterSourceAddr=0
                DcmDslProtocolRx_0 (DcmDslProtocolRx):
                  DcmDslProtocolRxPduId = 0
                  DcmDslProtocolRxAddrType = DCM_PHYSICAL_TYPE
                  DcmDslProtocolRxChannelId = 0
                  DcmDslProtocolRxComMChannelRef = (unset)
                  DcmDslProtocolRxBufferID = DcmDslBuffer_Common
                  DcmDslProtocolRxPduRef = (unset)
                DcmDslProtocolRx_1 (DcmDslProtocolRx):
                  DcmDslProtocolRxPduId = 1
                  DcmDslProtocolRxAddrType = DCM_FUNCTIONAL_TYPE
                  DcmDslProtocolRxChannelId = 0
                  DcmDslProtocolRxComMChannelRef = (unset)
                  DcmDslProtocolRxBufferID = DcmDslBuffer_Common
                  DcmDslProtocolRxPduRef = (unset)
                DcmDslProtocolTx: DcmDslTxConfirmationPduId=0, DcmDslProtocolTxPduRef=(unset)
      DcmDefensiveProgramming:
        DcmDefProgEnabled = 1
        DcmPrecondAssertEnabled = 1
        DcmPostcondAssertEnabled = 1
        DcmStaticAssertEnabled = 1
        DcmUnreachAssertEnabled = 1
        DcmInvariantAssertEnabled = 1
      DcmGeneral:
        DcmDDDIDStorage = 0
        DcmDevErrorDetect = 1
        DcmDslEnableSetActiveDiagnosis = 0
        DcmNRCPolicyISOVersion = ISO14229_2013
        DcmModeDeclarationSupport = 0
        DcmRequestManufacturerNotificationEnabled = 0
        DcmRequestSupplierNotificationEnabled = 0
        DcmRespondAllRequest = 1
        DcmTaskTime = 0.01
        DcmVersionInfoApi = 1
        DcmRteUsage = 0
        DcmRequestSeedAfterFailedCompareKey = 0
        DcmServiceAPI: DcmEnableASR40ServiceAPI=0, DcmEnableASR42ServiceAPI=0, DcmDefaultASRServiceAPI=AUTOSAR_40
      DcmPageBufferCfg: DcmPagedBufferEnabled=0, DcmPagedBufferTimeout=0.05
