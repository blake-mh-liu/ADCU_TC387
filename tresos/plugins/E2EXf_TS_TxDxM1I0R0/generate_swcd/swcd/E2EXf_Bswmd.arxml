<?xml version="1.0" encoding="ISO-8859-1"?>
[!/* Generation of invalid BSWMD file is prevented.
     Rationale: Some workflows need to generate swcd despite some configurations have errors.
     In this case transformers XfrmImplementationMapping list may not yet be generated and would
     produce an invalid BSWMD file. Invalid BSWMD files prevent the generation of
     XfrmImplementationMappings, leading to a dead lock in the workflow.
*/!][!//
[!IF "not(count(as:modconf('Xfrm')[name(../..)='E2EXf']/XfrmImplementationMapping/*)>0)"!][!//
[!SKIPFILE!][!//
[!WARNING "Generation of file is skipped because XfrmImplementationMapping list is empty."!][!//
[!ENDIF!][!//
[!AUTOSPACING!][!//
<AUTOSAR xmlns="http://autosar.org/schema/r4.0"
  xmlns:xsi="http://www.w3.org/2001/XMLSchema-instance"
  xsi:schemaLocation="http://autosar.org/schema/r4.0 AUTOSAR_4-0-3.xsd">
  <AR-PACKAGES>
    <AR-PACKAGE>
      <SHORT-NAME>AUTOSAR_E2EXf</SHORT-NAME>
      <AR-PACKAGES>
        <AR-PACKAGE>
          <SHORT-NAME>ImplementationDataTypes</SHORT-NAME>
          <CATEGORY>STANDARD</CATEGORY>
          <ELEMENTS>
            <IMPLEMENTATION-DATA-TYPE>
              <SHORT-NAME>E2EXf_CSTransactionHandleType</SHORT-NAME>
              <CATEGORY>STRUCTURE</CATEGORY>
              <SUB-ELEMENTS>
                <IMPLEMENTATION-DATA-TYPE-ELEMENT>
                  <SHORT-NAME>e2eCounter</SHORT-NAME>
                  <CATEGORY>TYPE_REFERENCE</CATEGORY>
                  <SW-DATA-DEF-PROPS>
                    <SW-DATA-DEF-PROPS-VARIANTS>
                      <SW-DATA-DEF-PROPS-CONDITIONAL>
                        <IMPLEMENTATION-DATA-TYPE-REF DEST="IMPLEMENTATION-DATA-TYPE">/AUTOSAR_Platform/ImplementationDataTypes/uint32</IMPLEMENTATION-DATA-TYPE-REF>
                      </SW-DATA-DEF-PROPS-CONDITIONAL>
                    </SW-DATA-DEF-PROPS-VARIANTS>
                  </SW-DATA-DEF-PROPS>
                </IMPLEMENTATION-DATA-TYPE-ELEMENT>
                <IMPLEMENTATION-DATA-TYPE-ELEMENT>
                  <SHORT-NAME>e2eSourceId</SHORT-NAME>
                  <CATEGORY>TYPE_REFERENCE</CATEGORY>
                  <SW-DATA-DEF-PROPS>
                    <SW-DATA-DEF-PROPS-VARIANTS>
                      <SW-DATA-DEF-PROPS-CONDITIONAL>
                        <IMPLEMENTATION-DATA-TYPE-REF DEST="IMPLEMENTATION-DATA-TYPE">/AUTOSAR_Platform/ImplementationDataTypes/uint32</IMPLEMENTATION-DATA-TYPE-REF>
                      </SW-DATA-DEF-PROPS-CONDITIONAL>
                    </SW-DATA-DEF-PROPS-VARIANTS>
                  </SW-DATA-DEF-PROPS>
                </IMPLEMENTATION-DATA-TYPE-ELEMENT>
              </SUB-ELEMENTS>
              <TYPE-EMITTER>E2EXf.h</TYPE-EMITTER>
            </IMPLEMENTATION-DATA-TYPE>
          </ELEMENTS>
        </AR-PACKAGE>
        <AR-PACKAGE>
          <SHORT-NAME>BswModuleDescriptions</SHORT-NAME>
          <ELEMENTS>
            <BSW-MODULE-DESCRIPTION>
              <SHORT-NAME>E2EXf</SHORT-NAME>
              <MODULE-ID>176</MODULE-ID>
              <PROVIDED-ENTRYS>
[!VAR "BswCalledEntity" = "''"!]
[!IF "node:value(as:modconf('Xfrm')[name(../..)='E2EXf']/XfrmGeneral/XfrmVersionInfoApi) = 'true'"!][!//
                <BSW-MODULE-ENTRY-REF-CONDITIONAL>
                  <BSW-MODULE-ENTRY-REF DEST="BSW-MODULE-ENTRY">/AUTOSAR_E2EXf/BswModuleEntrys/E2EXf_GetVersionInfo</BSW-MODULE-ENTRY-REF>
                </BSW-MODULE-ENTRY-REF-CONDITIONAL>
[!ENDIF!][!//
[!LOOP "as:modconf('Xfrm')[name(../..)='E2EXf']/XfrmImplementationMapping/*"!][!//
[!VAR "BswCalledEntity" = "node:name(.)"!]
                <BSW-MODULE-ENTRY-REF-CONDITIONAL>
                  <BSW-MODULE-ENTRY-REF DEST="BSW-MODULE-ENTRY">/AUTOSAR_E2EXf/BswModuleEntrys/[!"$BswCalledEntity"!]</BSW-MODULE-ENTRY-REF>
                </BSW-MODULE-ENTRY-REF-CONDITIONAL>
[!ENDLOOP!][!//
              </PROVIDED-ENTRYS>
              <INTERNAL-BEHAVIORS>
                <BSW-INTERNAL-BEHAVIOR>
                  <SHORT-NAME>InternalBehavior_0</SHORT-NAME>
                  <EXCLUSIVE-AREAS/>  <!-- The E2EXf module does not use any exclusive area -->
                  <ENTITYS>
                    <BSW-CALLED-ENTITY>
                      <SHORT-NAME>E2EXf_[!"$BswCalledEntity"!]</SHORT-NAME>
                      <MINIMUM-START-INTERVAL>0.0</MINIMUM-START-INTERVAL>
                      <IMPLEMENTED-ENTRY-REF DEST="BSW-MODULE-ENTRY">/AUTOSAR_E2EXf/BswModuleEntrys/[!"$BswCalledEntity"!]</IMPLEMENTED-ENTRY-REF>
                    </BSW-CALLED-ENTITY>
                  </ENTITYS>
                </BSW-INTERNAL-BEHAVIOR>
              </INTERNAL-BEHAVIORS>
            </BSW-MODULE-DESCRIPTION>
          </ELEMENTS>
        </AR-PACKAGE>
        <AR-PACKAGE>
          <SHORT-NAME>BswModuleEntrys</SHORT-NAME>
          <ELEMENTS>
[!IF "node:value(as:modconf('Xfrm')[name(../..)='E2EXf']/XfrmGeneral/XfrmVersionInfoApi) = 'true'"!][!//
            <BSW-MODULE-ENTRY>
              <SHORT-NAME>E2EXf_GetVersionInfo</SHORT-NAME>
              <SERVICE-ID>0</SERVICE-ID>
              <IS-REENTRANT>true</IS-REENTRANT>
              <IS-SYNCHRONOUS>true</IS-SYNCHRONOUS>
              <CALL-TYPE>REGULAR</CALL-TYPE>
              <EXECUTION-CONTEXT>TASK</EXECUTION-CONTEXT>
              <SW-SERVICE-IMPL-POLICY>STANDARD</SW-SERVICE-IMPL-POLICY>
              <ARGUMENTS>
                <SW-SERVICE-ARG>
                  <SHORT-NAME>VersionInfo</SHORT-NAME>
                  <DIRECTION>OUT</DIRECTION>
                  <SW-DATA-DEF-PROPS>
                    <SW-DATA-DEF-PROPS-VARIANTS>
                      <SW-DATA-DEF-PROPS-CONDITIONAL>
                        <IMPLEMENTATION-DATA-TYPE-REF DEST="IMPLEMENTATION-DATA-TYPE">/AUTOSAR_Platform/ImplementationDataTypes/VoidPtr</IMPLEMENTATION-DATA-TYPE-REF>
                      </SW-DATA-DEF-PROPS-CONDITIONAL>
                    </SW-DATA-DEF-PROPS-VARIANTS>
                  </SW-DATA-DEF-PROPS>
                </SW-SERVICE-ARG>
              </ARGUMENTS>
            </BSW-MODULE-ENTRY>
[!ENDIF!][!//
<!-- Attention: The arguments are not of interest for BSWMD generation, just the short name.
     To avoid usage of a Java generator, if even possible, or Java based Xpath expressions,
     the APIs are generated with the arguments of the sender/receiver communication     -->
[!LOOP "as:modconf('Xfrm')[name(../..)='E2EXf']/XfrmImplementationMapping/*"!][!//
[!IF "node:exists(XfrmTransformerBswModuleEntryRef)"!][!//
            <BSW-MODULE-ENTRY>
              <SHORT-NAME>[!"node:name(.)"!]</SHORT-NAME>
              <SERVICE-ID>3</SERVICE-ID>
              <IS-REENTRANT>false</IS-REENTRANT>
              <IS-SYNCHRONOUS>true</IS-SYNCHRONOUS>
              <CALL-TYPE>REGULAR</CALL-TYPE>
              <EXECUTION-CONTEXT>TASK</EXECUTION-CONTEXT>
              <SW-SERVICE-IMPL-POLICY>STANDARD</SW-SERVICE-IMPL-POLICY>
              <ARGUMENTS>
                <SW-SERVICE-ARG>
                  <SHORT-NAME>Buffer</SHORT-NAME>
                  <DIRECTION>OUT</DIRECTION>
                  <SW-DATA-DEF-PROPS>
                    <SW-DATA-DEF-PROPS-VARIANTS>
                      <SW-DATA-DEF-PROPS-CONDITIONAL>
                        <IMPLEMENTATION-DATA-TYPE-REF DEST="IMPLEMENTATION-DATA-TYPE">/AUTOSAR_Platform/ImplementationDataTypes/VoidPtr</IMPLEMENTATION-DATA-TYPE-REF>
                      </SW-DATA-DEF-PROPS-CONDITIONAL>
                    </SW-DATA-DEF-PROPS-VARIANTS>
                  </SW-DATA-DEF-PROPS>
                </SW-SERVICE-ARG>
                <SW-SERVICE-ARG>
                  <SHORT-NAME>BufferLength</SHORT-NAME>
                  <DIRECTION>OUT</DIRECTION>
                  <SW-DATA-DEF-PROPS>
                    <SW-DATA-DEF-PROPS-VARIANTS>
                      <SW-DATA-DEF-PROPS-CONDITIONAL>
                        <IMPLEMENTATION-DATA-TYPE-REF DEST="IMPLEMENTATION-DATA-TYPE">/AUTOSAR_Platform/ImplementationDataTypes/VoidPtr</IMPLEMENTATION-DATA-TYPE-REF>
                      </SW-DATA-DEF-PROPS-CONDITIONAL>
                    </SW-DATA-DEF-PROPS-VARIANTS>
                  </SW-DATA-DEF-PROPS>
                </SW-SERVICE-ARG>
                <SW-SERVICE-ARG>
                  <SHORT-NAME>DataElement</SHORT-NAME>
                  <DIRECTION>IN</DIRECTION>
                  <SW-DATA-DEF-PROPS>
                    <SW-DATA-DEF-PROPS-VARIANTS>
                      <SW-DATA-DEF-PROPS-CONDITIONAL>
                        <IMPLEMENTATION-DATA-TYPE-REF DEST="IMPLEMENTATION-DATA-TYPE">/AUTOSAR_Platform/ImplementationDataTypes/ConstVoidPtr</IMPLEMENTATION-DATA-TYPE-REF>
                      </SW-DATA-DEF-PROPS-CONDITIONAL>
                    </SW-DATA-DEF-PROPS-VARIANTS>
                  </SW-DATA-DEF-PROPS>
                </SW-SERVICE-ARG>
              </ARGUMENTS>
            </BSW-MODULE-ENTRY>
[!ENDIF!][!//
<!-- Attention: The arguments are not of interest for BSWMD generation, just the short name.
     To avoid usage of a Java generator, if even possible, or Java based Xpath expressions,
     the APIs are generated with the arguments of the sender/receiver communication     -->
[!IF "node:exists(XfrmInvTransformerBswModuleEntryRef)"!][!//
            <BSW-MODULE-ENTRY>
              <SHORT-NAME>[!"node:name(.)"!]</SHORT-NAME>
              <SERVICE-ID>4</SERVICE-ID>
              <IS-REENTRANT>false</IS-REENTRANT>
              <IS-SYNCHRONOUS>true</IS-SYNCHRONOUS>
              <CALL-TYPE>REGULAR</CALL-TYPE>
              <EXECUTION-CONTEXT>TASK</EXECUTION-CONTEXT>
              <SW-SERVICE-IMPL-POLICY>STANDARD</SW-SERVICE-IMPL-POLICY>
              <ARGUMENTS>
                <SW-SERVICE-ARG>
                  <SHORT-NAME>Buffer</SHORT-NAME>
                  <DIRECTION>IN</DIRECTION>
                  <SW-DATA-DEF-PROPS>
                    <SW-DATA-DEF-PROPS-VARIANTS>
                      <SW-DATA-DEF-PROPS-CONDITIONAL>
                        <IMPLEMENTATION-DATA-TYPE-REF DEST="IMPLEMENTATION-DATA-TYPE">/AUTOSAR_Platform/ImplementationDataTypes/ConstVoidPtr</IMPLEMENTATION-DATA-TYPE-REF>
                      </SW-DATA-DEF-PROPS-CONDITIONAL>
                    </SW-DATA-DEF-PROPS-VARIANTS>
                  </SW-DATA-DEF-PROPS>
                </SW-SERVICE-ARG>
                <SW-SERVICE-ARG>
                  <SHORT-NAME>BufferLength</SHORT-NAME>
                  <DIRECTION>IN</DIRECTION>
                  <SW-DATA-DEF-PROPS>
                    <SW-DATA-DEF-PROPS-VARIANTS>
                      <SW-DATA-DEF-PROPS-CONDITIONAL>
[!IF "(node:value(as:modconf('Xfrm')[name(../..)='E2EXf']/XfrmGeneral/XfrmBufferLengthType) = 'UINT16')"!][!//
                        <IMPLEMENTATION-DATA-TYPE-REF DEST="IMPLEMENTATION-DATA-TYPE">/AUTOSAR_Platform/ImplementationDataTypes/uint16</IMPLEMENTATION-DATA-TYPE-REF>
[!ELSE!][!//
                        <IMPLEMENTATION-DATA-TYPE-REF DEST="IMPLEMENTATION-DATA-TYPE">/AUTOSAR_Platform/ImplementationDataTypes/uint32</IMPLEMENTATION-DATA-TYPE-REF>
[!ENDIF!][!//
                      </SW-DATA-DEF-PROPS-CONDITIONAL>
                    </SW-DATA-DEF-PROPS-VARIANTS>
                  </SW-DATA-DEF-PROPS>
                </SW-SERVICE-ARG>
                <SW-SERVICE-ARG>
                  <SHORT-NAME>DataElement</SHORT-NAME>
                  <DIRECTION>OUT</DIRECTION>
                  <SW-DATA-DEF-PROPS>
                    <SW-DATA-DEF-PROPS-VARIANTS>
                      <SW-DATA-DEF-PROPS-CONDITIONAL>
                        <IMPLEMENTATION-DATA-TYPE-REF DEST="IMPLEMENTATION-DATA-TYPE">/AUTOSAR_Platform/ImplementationDataTypes/VoidPtr</IMPLEMENTATION-DATA-TYPE-REF>
                      </SW-DATA-DEF-PROPS-CONDITIONAL>
                    </SW-DATA-DEF-PROPS-VARIANTS>
                  </SW-DATA-DEF-PROPS>
                </SW-SERVICE-ARG>
              </ARGUMENTS>
            </BSW-MODULE-ENTRY>
[!ENDIF!][!//
[!ENDLOOP!][!//
          </ELEMENTS>
        </AR-PACKAGE>
      </AR-PACKAGES>
    </AR-PACKAGE>

    <AR-PACKAGE>
      <SHORT-NAME>EB_E2EXf</SHORT-NAME>
      <AR-PACKAGES>
        <AR-PACKAGE>
          <SHORT-NAME>Implementations</SHORT-NAME>
          <ELEMENTS>
            <BSW-IMPLEMENTATION>
              <SHORT-NAME>BswImplementation_0</SHORT-NAME>
              <CODE-DESCRIPTORS>
                <CODE>
                  <SHORT-NAME>Files</SHORT-NAME>
                  <ARTIFACT-DESCRIPTORS>
                    <!-- static files -->
                    <AUTOSAR-ENGINEERING-OBJECT>
                      <SHORT-LABEL>Autosar::include::E2EXf.h</SHORT-LABEL>
                      <CATEGORY>SWHDR</CATEGORY>
                    </AUTOSAR-ENGINEERING-OBJECT>
                    <AUTOSAR-ENGINEERING-OBJECT>
                      <SHORT-LABEL>Autosar::include::E2EXf_Version.h</SHORT-LABEL>
                      <CATEGORY>SWHDR</CATEGORY>
                    </AUTOSAR-ENGINEERING-OBJECT>
                    <AUTOSAR-ENGINEERING-OBJECT>
                      <SHORT-LABEL>Autosar::src::E2EXf.c</SHORT-LABEL>
                      <CATEGORY>SWSRC</CATEGORY>
                    </AUTOSAR-ENGINEERING-OBJECT>
                    <AUTOSAR-ENGINEERING-OBJECT>
                      <SHORT-LABEL>make::E2EXf_defs.mak</SHORT-LABEL>
                      <CATEGORY>SWMAKE</CATEGORY>
                    </AUTOSAR-ENGINEERING-OBJECT>
                    <AUTOSAR-ENGINEERING-OBJECT>
                      <SHORT-LABEL>make::E2EXf_rules.mak</SHORT-LABEL>
                      <CATEGORY>SWMAKE</CATEGORY>
                    </AUTOSAR-ENGINEERING-OBJECT>
                  </ARTIFACT-DESCRIPTORS>
                </CODE>
              </CODE-DESCRIPTORS>
              <PROGRAMMING-LANGUAGE>C</PROGRAMMING-LANGUAGE>
              <RESOURCE-CONSUMPTION>
                <SHORT-NAME>ResourceConsumption</SHORT-NAME>
                <MEMORY-SECTIONS>
                  <MEMORY-SECTION>
                    <SHORT-NAME>CODE</SHORT-NAME>
                    <SW-ADDRMETHOD-REF DEST="SW-ADDR-METHOD">/AUTOSAR_MemMap/SwAddrMethods/CODE</SW-ADDRMETHOD-REF>
                  </MEMORY-SECTION>
                  <MEMORY-SECTION>
                    <SHORT-NAME>VAR_FAST_INIT_UNSPECIFIED</SHORT-NAME>
                    <ALIGNMENT>UNSPECIFIED</ALIGNMENT>
                    <SW-ADDRMETHOD-REF DEST="SW-ADDR-METHOD">/AUTOSAR_MemMap/SwAddrMethods/VAR_FAST</SW-ADDRMETHOD-REF>
                  </MEMORY-SECTION>
                  <MEMORY-SECTION>
                    <SHORT-NAME>CONFIG_DATA_UNSPECIFIED</SHORT-NAME>
                    <ALIGNMENT>UNSPECIFIED</ALIGNMENT>
                    <SW-ADDRMETHOD-REF DEST="SW-ADDR-METHOD">/AUTOSAR_MemMap/SwAddrMethods/CONFIG_DATA</SW-ADDRMETHOD-REF>
                  </MEMORY-SECTION>
                  <MEMORY-SECTION>
                    <SHORT-NAME>VAR_INIT_8</SHORT-NAME>
                    <ALIGNMENT>8</ALIGNMENT>
                    <SW-ADDRMETHOD-REF DEST="SW-ADDR-METHOD">/AUTOSAR_MemMap/SwAddrMethods/VAR_INIT</SW-ADDRMETHOD-REF>
                  </MEMORY-SECTION>
                  <MEMORY-SECTION>
                    <SHORT-NAME>VAR_CLEARED_UNSPECIFIED</SHORT-NAME>
                    <ALIGNMENT>UNSPECIFIED</ALIGNMENT>
                    <SW-ADDRMETHOD-REF DEST="SW-ADDR-METHOD">/AUTOSAR_MemMap/SwAddrMethods/VAR_CLEARED</SW-ADDRMETHOD-REF>
                  </MEMORY-SECTION>
                  <MEMORY-SECTION>
                    <SHORT-NAME>CONST_32</SHORT-NAME>
                    <ALIGNMENT>32</ALIGNMENT>
                    <SW-ADDRMETHOD-REF DEST="SW-ADDR-METHOD">/AUTOSAR_MemMap/SwAddrMethods/CONST</SW-ADDRMETHOD-REF>
                  </MEMORY-SECTION>
[!LOOP "as:modconf('Xfrm')[name(../..)='E2EXf']/XfrmImplementationMapping/*"!][!//
[!IF "node:empty(./XfrmOsApplicationRef) or not(node:exists(./XfrmOsApplicationRef))"!][!//
                  <MEMORY-SECTION>
                    <SHORT-NAME>DEFAULTPARTITION_VAR_INIT_ASIL_D_8</SHORT-NAME>
                    <ALIGNMENT>8</ALIGNMENT>
                    <OPTIONS> <!-- see TPS_SWCT_01456 -->
                      <OPTION>safetyAsilD</OPTION>
                    </OPTIONS>
                    <PREFIX-REF DEST="SECTION-NAME-PREFIX">/EB_E2EXf/Implementations/BswImplementation_0/ResourceConsumption/E2EXF</PREFIX-REF>
                    <SW-ADDRMETHOD-REF DEST="SW-ADDR-METHOD">/AUTOSAR_MemMap/SwAddrMethods/VAR_INIT_ASIL_D</SW-ADDRMETHOD-REF>
                    <SYMBOL>VAR_INIT_ASIL_D_8</SYMBOL>
                  </MEMORY-SECTION>
                  <MEMORY-SECTION>
                    <SHORT-NAME>DEFAULTPARTITION_VAR_CLEARED_ASIL_D_UNSPECIFIED</SHORT-NAME>
                    <ALIGNMENT>UNSPECIFIED</ALIGNMENT>
                    <OPTIONS> <!-- see TPS_SWCT_01456 -->
                      <OPTION>safetyAsilD</OPTION>
                    </OPTIONS>
                    <PREFIX-REF DEST="SECTION-NAME-PREFIX">/EB_E2EXf/Implementations/BswImplementation_0/ResourceConsumption/E2EXF</PREFIX-REF>
                    <SW-ADDRMETHOD-REF DEST="SW-ADDR-METHOD">/AUTOSAR_MemMap/SwAddrMethods/VAR_CLEARED_ASIL_D</SW-ADDRMETHOD-REF>
                    <SYMBOL>VAR_CLEARED_ASIL_D_UNSPECIFIED</SYMBOL>
                  </MEMORY-SECTION>
[!BREAK!][!//
[!ENDIF!][!//
[!ENDLOOP!][!//
[!LOOP "node:refs(as:modconf('Xfrm')[name(../..)='E2EXf']/XfrmImplementationMapping/*/XfrmOsApplicationRef)"!][!//
                  <MEMORY-SECTION>
                    <SHORT-NAME>[!"text:toupper(node:name(.))"!]_VAR_INIT_ASIL_D_8</SHORT-NAME>
                    <ALIGNMENT>8</ALIGNMENT>
                    <OPTIONS> <!-- see TPS_SWCT_01456 -->
                      <OPTION>safetyAsilD</OPTION>
                    </OPTIONS>
                    <PREFIX-REF DEST="SECTION-NAME-PREFIX">/EB_E2EXf/Implementations/BswImplementation_0/ResourceConsumption/E2EXF_[!"text:toupper(node:name(.))"!]</PREFIX-REF>
                    <SW-ADDRMETHOD-REF DEST="SW-ADDR-METHOD">/AUTOSAR_MemMap/SwAddrMethods/VAR_INIT_ASIL_D</SW-ADDRMETHOD-REF>
                    <SYMBOL>VAR_INIT_ASIL_D_8</SYMBOL>
                  </MEMORY-SECTION>
                  <MEMORY-SECTION>
                    <SHORT-NAME>[!"text:toupper(node:name(.))"!]_VAR_CLEARED_ASIL_D_UNSPECIFIED</SHORT-NAME>
                    <ALIGNMENT>UNSPECIFIED</ALIGNMENT>
                    <OPTIONS> <!-- see TPS_SWCT_01456 -->
                      <OPTION>safetyAsilD</OPTION>
                    </OPTIONS>
                    <PREFIX-REF DEST="SECTION-NAME-PREFIX">/EB_E2EXf/Implementations/BswImplementation_0/ResourceConsumption/E2EXF_[!"text:toupper(node:name(.))"!]</PREFIX-REF>
                    <SW-ADDRMETHOD-REF DEST="SW-ADDR-METHOD">/AUTOSAR_MemMap/SwAddrMethods/VAR_CLEARED_ASIL_D</SW-ADDRMETHOD-REF>
                    <SYMBOL>VAR_CLEARED_ASIL_D_UNSPECIFIED</SYMBOL>
                  </MEMORY-SECTION>
[!ENDLOOP!][!//
                </MEMORY-SECTIONS>
                <SECTION-NAME-PREFIXS>
[!LOOP "as:modconf('Xfrm')[name(../..)='E2EXf']/XfrmImplementationMapping/*"!][!//
[!IF "node:empty(./XfrmOsApplicationRef) or not(node:exists(./XfrmOsApplicationRef))"!][!//
                  <SECTION-NAME-PREFIX>
                    <SHORT-NAME>E2EXF</SHORT-NAME>
                    <SYMBOL>E2EXF</SYMBOL>
                  </SECTION-NAME-PREFIX>
[!BREAK!][!//
[!ENDIF!][!//
[!ENDLOOP!][!//
[!LOOP "node:refs(as:modconf('Xfrm')[name(../..)='E2EXf']/XfrmImplementationMapping/*/XfrmOsApplicationRef)"!][!//
                  <SECTION-NAME-PREFIX>
                    <SHORT-NAME>E2EXF_[!"text:toupper(node:name(.))"!]</SHORT-NAME>
                    <SYMBOL>E2EXF_[!"text:toupper(node:name(.))"!]</SYMBOL>
                  </SECTION-NAME-PREFIX>
[!ENDLOOP!][!//
                </SECTION-NAME-PREFIXS>
              </RESOURCE-CONSUMPTION>
              <SW-VERSION>1.0.42</SW-VERSION>
              <VENDOR-ID>1</VENDOR-ID>
              <AR-RELEASE-VERSION>4.2.1</AR-RELEASE-VERSION>
              <BEHAVIOR-REF DEST="BSW-INTERNAL-BEHAVIOR">/AUTOSAR_E2EXf/BswModuleDescriptions/E2EXf/InternalBehavior_0</BEHAVIOR-REF>
              <VENDOR-SPECIFIC-MODULE-DEF-REFS>
                <VENDOR-SPECIFIC-MODULE-DEF-REF DEST="ECUC-MODULE-DEF">/E2EXf_TS_TxDxM1I0R0/Xfrm</VENDOR-SPECIFIC-MODULE-DEF-REF>
              </VENDOR-SPECIFIC-MODULE-DEF-REFS>
            </BSW-IMPLEMENTATION>
          </ELEMENTS>
        </AR-PACKAGE>
      </AR-PACKAGES>
    </AR-PACKAGE>
  </AR-PACKAGES>
</AUTOSAR>
