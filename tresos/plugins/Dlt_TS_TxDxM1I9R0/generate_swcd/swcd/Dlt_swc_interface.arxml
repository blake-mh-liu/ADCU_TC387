<?xml version="1.0" encoding="UTF-8"?>
<AUTOSAR xmlns="http://autosar.org/schema/r4.0"
  xmlns:xsi="http://www.w3.org/2001/XMLSchema-instance"
  xsi:schemaLocation="http://autosar.org/schema/r4.0 AUTOSAR_4-2-1.xsd">
[!INCLUDE "Dlt_Vars.m"!][!//
[!/* do not generate this file if RTE is not used */!][!//
[!SKIPFILE "DltGeneral/DltRteUsage = 'false'"!][!//
  <!-- !LINKSTO Dlt.swdd.DltConfig.Template.Dlt_swc_interfaces.arxml.m4,1 -->
  <AR-PACKAGES>
    <AR-PACKAGE>
      <SHORT-NAME>AUTOSAR_Dlt</SHORT-NAME>
      <ELEMENTS/>
      <AR-PACKAGES>
        <AR-PACKAGE>
          <SHORT-NAME>CompuMethods</SHORT-NAME>
          <ELEMENTS>
            <COMPU-METHOD>
              <SHORT-NAME>CM_MessageTypeType</SHORT-NAME>
              <CATEGORY>TEXTTABLE</CATEGORY>
              <COMPU-INTERNAL-TO-PHYS>
                <COMPU-SCALES>
                  <COMPU-SCALE>
                    <LOWER-LIMIT INTERVAL-TYPE="CLOSED">0</LOWER-LIMIT>
                    <UPPER-LIMIT INTERVAL-TYPE="CLOSED">0</UPPER-LIMIT>
                    <COMPU-CONST>
                      <VT>DLT_TYPE_LOG</VT>
                    </COMPU-CONST>
                  </COMPU-SCALE>
                  <COMPU-SCALE>
                    <LOWER-LIMIT INTERVAL-TYPE="CLOSED">1</LOWER-LIMIT>
                    <UPPER-LIMIT INTERVAL-TYPE="CLOSED">1</UPPER-LIMIT>
                    <COMPU-CONST>
                      <VT>DLT_TYPE_APP_TRACE</VT>
                    </COMPU-CONST>
                  </COMPU-SCALE>
                  <COMPU-SCALE>
                    <LOWER-LIMIT INTERVAL-TYPE="CLOSED">2</LOWER-LIMIT>
                    <UPPER-LIMIT INTERVAL-TYPE="CLOSED">2</UPPER-LIMIT>
                    <COMPU-CONST>
                      <VT>DLT_TYPE_NW_TRACE</VT>
                    </COMPU-CONST>
                  </COMPU-SCALE>
                  <COMPU-SCALE>
                    <LOWER-LIMIT INTERVAL-TYPE="CLOSED">3</LOWER-LIMIT>
                    <UPPER-LIMIT INTERVAL-TYPE="CLOSED">3</UPPER-LIMIT>
                    <COMPU-CONST>
                      <VT>DLT_TYPE_CONTROL</VT>
                    </COMPU-CONST>
                  </COMPU-SCALE>
                </COMPU-SCALES>
              </COMPU-INTERNAL-TO-PHYS>
            </COMPU-METHOD>
          </ELEMENTS>
        </AR-PACKAGE>
        <AR-PACKAGE>
          <SHORT-NAME>ImplementationDataTypes</SHORT-NAME>
          <ELEMENTS>
            <!-- !LINKSTO Dlt.EB_Ref.SWS_Dlt_00224.Dlt_MessageTypeType,1 -->
            <IMPLEMENTATION-DATA-TYPE>
              <SHORT-NAME>Dlt_MessageTypeType</SHORT-NAME>
              <CATEGORY>TYPE_REFERENCE</CATEGORY>
              <SW-DATA-DEF-PROPS>
                <SW-DATA-DEF-PROPS-VARIANTS>
                  <SW-DATA-DEF-PROPS-CONDITIONAL>
                    <COMPU-METHOD-REF DEST="COMPU-METHOD">/AUTOSAR_Dlt/CompuMethods/CM_MessageTypeType</COMPU-METHOD-REF>
                    <IMPLEMENTATION-DATA-TYPE-REF DEST="IMPLEMENTATION-DATA-TYPE">/AUTOSAR_Platform/ImplementationDataTypes/uint8</IMPLEMENTATION-DATA-TYPE-REF>
                  </SW-DATA-DEF-PROPS-CONDITIONAL>
                </SW-DATA-DEF-PROPS-VARIANTS>
              </SW-DATA-DEF-PROPS>
              <TYPE-EMITTER>RTE</TYPE-EMITTER>
            </IMPLEMENTATION-DATA-TYPE>
          </ELEMENTS>
        </AR-PACKAGE>
        <AR-PACKAGE>
          <SHORT-NAME>PortInterfaces</SHORT-NAME>
          <ELEMENTS>
[!IF "(num:i($DltServiceAPI) >= $AUTOSAR_431) and (DltSwc/*/DltProvideControlServicePort = 'true')"!][!//
            <CLIENT-SERVER-INTERFACE>
              <SHORT-NAME>DltControlService</SHORT-NAME>
              <IS-SERVICE>true</IS-SERVICE>
              <OPERATIONS>
                <CLIENT-SERVER-OPERATION>
                  <!-- !LINKSTO Dlt.EB_Ref.SWS_Dlt_00772.GetDefaultLogLevel, 1 -->
                  <SHORT-NAME>GetDefaultLogLevel</SHORT-NAME>
                  <ARGUMENTS>
                    <ARGUMENT-DATA-PROTOTYPE>
                      <SHORT-NAME>defaultLogLevel</SHORT-NAME>
                      <TYPE-TREF DEST="IMPLEMENTATION-DATA-TYPE">/AUTOSAR_Dlt/ImplementationDataTypes/Dlt_MessageLogLevelType</TYPE-TREF>
                      <DIRECTION>OUT</DIRECTION>
                    </ARGUMENT-DATA-PROTOTYPE>
                  </ARGUMENTS>
                  <POSSIBLE-ERROR-REFS>
                    <POSSIBLE-ERROR-REF DEST="APPLICATION-ERROR">/AUTOSAR_Dlt/PortInterfaces/DltControlService/E_OK</POSSIBLE-ERROR-REF>
                    <POSSIBLE-ERROR-REF DEST="APPLICATION-ERROR">/AUTOSAR_Dlt/PortInterfaces/DltControlService/DLT_E_ERROR</POSSIBLE-ERROR-REF>
                  </POSSIBLE-ERROR-REFS>
                </CLIENT-SERVER-OPERATION>
                <CLIENT-SERVER-OPERATION>
                  <!-- !LINKSTO Dlt.EB_Ref.SWS_Dlt_00772.SetDefaultLogLevel, 1 -->
                  <SHORT-NAME>SetDefaultLogLevel</SHORT-NAME>
                  <ARGUMENTS>
                    <ARGUMENT-DATA-PROTOTYPE>
                      <SHORT-NAME>newDefaultLogLevel</SHORT-NAME>
                      <TYPE-TREF DEST="IMPLEMENTATION-DATA-TYPE">/AUTOSAR_Dlt/ImplementationDataTypes/Dlt_MessageLogLevelType</TYPE-TREF>
                      <DIRECTION>IN</DIRECTION>
                    </ARGUMENT-DATA-PROTOTYPE>
                  </ARGUMENTS>
                  <POSSIBLE-ERROR-REFS>
                    <POSSIBLE-ERROR-REF DEST="APPLICATION-ERROR">/AUTOSAR_Dlt/PortInterfaces/DltControlService/E_OK</POSSIBLE-ERROR-REF>
                    <POSSIBLE-ERROR-REF DEST="APPLICATION-ERROR">/AUTOSAR_Dlt/PortInterfaces/DltControlService/DLT_E_ERROR</POSSIBLE-ERROR-REF>
                  </POSSIBLE-ERROR-REFS>
                </CLIENT-SERVER-OPERATION>
                <CLIENT-SERVER-OPERATION>
                  <!-- !LINKSTO Dlt.EB_Ref.SWS_Dlt_00772.GetDefaultTraceStatus, 1 -->
                  <SHORT-NAME>GetDefaultTraceStatus</SHORT-NAME>
                  <ARGUMENTS>
                    <ARGUMENT-DATA-PROTOTYPE>
                      <SHORT-NAME>traceStatus</SHORT-NAME>
                      <TYPE-TREF DEST="IMPLEMENTATION-DATA-TYPE">/AUTOSAR_Platform/ImplementationDataTypes/boolean</TYPE-TREF>
                      <DIRECTION>OUT</DIRECTION>
                    </ARGUMENT-DATA-PROTOTYPE>
                  </ARGUMENTS>
                  <POSSIBLE-ERROR-REFS>
                    <POSSIBLE-ERROR-REF DEST="APPLICATION-ERROR">/AUTOSAR_Dlt/PortInterfaces/DltControlService/E_OK</POSSIBLE-ERROR-REF>
                    <POSSIBLE-ERROR-REF DEST="APPLICATION-ERROR">/AUTOSAR_Dlt/PortInterfaces/DltControlService/DLT_E_ERROR</POSSIBLE-ERROR-REF>
                  </POSSIBLE-ERROR-REFS>
                </CLIENT-SERVER-OPERATION>
                <CLIENT-SERVER-OPERATION>
                  <!-- !LINKSTO Dlt.EB_Ref.SWS_Dlt_00772.SetDefaultTraceStatus, 1 -->
                  <SHORT-NAME>SetDefaultTraceStatus</SHORT-NAME>
                  <ARGUMENTS>
                    <ARGUMENT-DATA-PROTOTYPE>
                      <SHORT-NAME>newTraceStatus</SHORT-NAME>
                      <TYPE-TREF DEST="IMPLEMENTATION-DATA-TYPE">/AUTOSAR_Platform/ImplementationDataTypes/boolean</TYPE-TREF>
                      <DIRECTION>IN</DIRECTION>
                    </ARGUMENT-DATA-PROTOTYPE>
                  </ARGUMENTS>
                  <POSSIBLE-ERROR-REFS>
                    <POSSIBLE-ERROR-REF DEST="APPLICATION-ERROR">/AUTOSAR_Dlt/PortInterfaces/DltControlService/E_OK</POSSIBLE-ERROR-REF>
                    <POSSIBLE-ERROR-REF DEST="APPLICATION-ERROR">/AUTOSAR_Dlt/PortInterfaces/DltControlService/DLT_E_ERROR</POSSIBLE-ERROR-REF>
                  </POSSIBLE-ERROR-REFS>
                </CLIENT-SERVER-OPERATION>
                <CLIENT-SERVER-OPERATION>
                  <!-- !LINKSTO Dlt.EB_Ref.SWS_Dlt_00772.SetMessageFiltering, 1 -->
                  <SHORT-NAME>SetMessageFiltering</SHORT-NAME>
                  <ARGUMENTS>
                    <ARGUMENT-DATA-PROTOTYPE>
                      <SHORT-NAME>status</SHORT-NAME>
                      <TYPE-TREF DEST="IMPLEMENTATION-DATA-TYPE">/AUTOSAR_Platform/ImplementationDataTypes/boolean</TYPE-TREF>
                      <DIRECTION>IN</DIRECTION>
                    </ARGUMENT-DATA-PROTOTYPE>
                  </ARGUMENTS>
                  <POSSIBLE-ERROR-REFS>
                    <POSSIBLE-ERROR-REF DEST="APPLICATION-ERROR">/AUTOSAR_Dlt/PortInterfaces/DltControlService/E_OK</POSSIBLE-ERROR-REF>
                    <POSSIBLE-ERROR-REF DEST="APPLICATION-ERROR">/AUTOSAR_Dlt/PortInterfaces/DltControlService/DLT_E_ERROR</POSSIBLE-ERROR-REF>
                  </POSSIBLE-ERROR-REFS>
                </CLIENT-SERVER-OPERATION>
                <CLIENT-SERVER-OPERATION>
                  <!-- !LINKSTO Dlt.EB_Ref.SWS_Dlt_00772.ResetToFactoryDefault, 1 -->
                  <SHORT-NAME>ResetToFactoryDefault</SHORT-NAME>
                  <POSSIBLE-ERROR-REFS>
                    <POSSIBLE-ERROR-REF DEST="APPLICATION-ERROR">/AUTOSAR_Dlt/PortInterfaces/DltControlService/E_OK</POSSIBLE-ERROR-REF>
                    <POSSIBLE-ERROR-REF DEST="APPLICATION-ERROR">/AUTOSAR_Dlt/PortInterfaces/DltControlService/DLT_E_ERROR</POSSIBLE-ERROR-REF>
                  </POSSIBLE-ERROR-REFS>
                </CLIENT-SERVER-OPERATION>
                <CLIENT-SERVER-OPERATION>
                  <!-- !LINKSTO Dlt.EB_Ref.SWS_Dlt_00772.StoreConfiguration, 1 -->
                  <SHORT-NAME>StoreConfiguration</SHORT-NAME>
                  <POSSIBLE-ERROR-REFS>
                    <POSSIBLE-ERROR-REF DEST="APPLICATION-ERROR">/AUTOSAR_Dlt/PortInterfaces/DltControlService/E_OK</POSSIBLE-ERROR-REF>
                    <POSSIBLE-ERROR-REF DEST="APPLICATION-ERROR">/AUTOSAR_Dlt/PortInterfaces/DltControlService/DLT_E_NOT_SUPPORTED</POSSIBLE-ERROR-REF>
                    <POSSIBLE-ERROR-REF DEST="APPLICATION-ERROR">/AUTOSAR_Dlt/PortInterfaces/DltControlService/DLT_E_ERROR</POSSIBLE-ERROR-REF>
                  </POSSIBLE-ERROR-REFS>
                </CLIENT-SERVER-OPERATION>
                <CLIENT-SERVER-OPERATION>
                  <!-- !LINKSTO Dlt.EB_Ref.SWS_Dlt_00772.SetLogChannelAssignment, 1 -->
                  <SHORT-NAME>SetLogChannelAssignment</SHORT-NAME>
                  <ARGUMENTS>
                    <ARGUMENT-DATA-PROTOTYPE>
                      <SHORT-NAME>appId</SHORT-NAME>
                      <TYPE-TREF DEST="IMPLEMENTATION-DATA-TYPE">/AUTOSAR_Dlt/ImplementationDataTypes/Dlt_ApplicationIDType</TYPE-TREF>
                      <DIRECTION>IN</DIRECTION>
                    </ARGUMENT-DATA-PROTOTYPE>
                    <ARGUMENT-DATA-PROTOTYPE>
                      <SHORT-NAME>contextId</SHORT-NAME>
                      <TYPE-TREF DEST="IMPLEMENTATION-DATA-TYPE">/AUTOSAR_Dlt/ImplementationDataTypes/Dlt_ContextIDType</TYPE-TREF>
                      <DIRECTION>IN</DIRECTION>
                    </ARGUMENT-DATA-PROTOTYPE>
                    <ARGUMENT-DATA-PROTOTYPE>
                      <SHORT-NAME>logChannelName</SHORT-NAME>
                      <TYPE-TREF DEST="IMPLEMENTATION-DATA-TYPE">/AUTOSAR_Dlt/ImplementationDataTypes/Dlt_LogChannelNameType</TYPE-TREF>
                      <DIRECTION>IN</DIRECTION>
                    </ARGUMENT-DATA-PROTOTYPE>
                    <ARGUMENT-DATA-PROTOTYPE>
                      <SHORT-NAME>addRemoveOp</SHORT-NAME>
                      <TYPE-TREF DEST="IMPLEMENTATION-DATA-TYPE">/AUTOSAR_Dlt/ImplementationDataTypes/Dlt_AssignmentOperationType</TYPE-TREF>
                      <DIRECTION>IN</DIRECTION>
                    </ARGUMENT-DATA-PROTOTYPE>
                  </ARGUMENTS>
                  <POSSIBLE-ERROR-REFS>
                    <POSSIBLE-ERROR-REF DEST="APPLICATION-ERROR">/AUTOSAR_Dlt/PortInterfaces/DltControlService/E_OK</POSSIBLE-ERROR-REF>
                    <POSSIBLE-ERROR-REF DEST="APPLICATION-ERROR">/AUTOSAR_Dlt/PortInterfaces/DltControlService/DLT_E_ERROR</POSSIBLE-ERROR-REF>
                  </POSSIBLE-ERROR-REFS>
                </CLIENT-SERVER-OPERATION>
                <CLIENT-SERVER-OPERATION>
                  <!-- !LINKSTO Dlt.EB_Ref.SWS_Dlt_00772.SetLogChannelThreshold, 1 -->
                  <SHORT-NAME>SetLogChannelThreshold</SHORT-NAME>
                  <ARGUMENTS>
                    <ARGUMENT-DATA-PROTOTYPE>
                      <SHORT-NAME>logChannelName</SHORT-NAME>
                      <TYPE-TREF DEST="IMPLEMENTATION-DATA-TYPE">/AUTOSAR_Dlt/ImplementationDataTypes/Dlt_LogChannelNameType</TYPE-TREF>
                      <DIRECTION>IN</DIRECTION>
                    </ARGUMENT-DATA-PROTOTYPE>
                    <ARGUMENT-DATA-PROTOTYPE>
                      <SHORT-NAME>newThreshold</SHORT-NAME>
                      <TYPE-TREF DEST="IMPLEMENTATION-DATA-TYPE">/AUTOSAR_Dlt/ImplementationDataTypes/Dlt_MessageLogLevelType</TYPE-TREF>
                      <DIRECTION>IN</DIRECTION>
                    </ARGUMENT-DATA-PROTOTYPE>
                    <ARGUMENT-DATA-PROTOTYPE>
                      <SHORT-NAME>newTraceStatus</SHORT-NAME>
                      <TYPE-TREF DEST="IMPLEMENTATION-DATA-TYPE">/AUTOSAR_Platform/ImplementationDataTypes/boolean</TYPE-TREF>
                      <DIRECTION>IN</DIRECTION>
                    </ARGUMENT-DATA-PROTOTYPE>
                  </ARGUMENTS>
                  <POSSIBLE-ERROR-REFS>
                    <POSSIBLE-ERROR-REF DEST="APPLICATION-ERROR">/AUTOSAR_Dlt/PortInterfaces/DltControlService/E_OK</POSSIBLE-ERROR-REF>
                    <POSSIBLE-ERROR-REF DEST="APPLICATION-ERROR">/AUTOSAR_Dlt/PortInterfaces/DltControlService/DLT_E_ERROR</POSSIBLE-ERROR-REF>
                  </POSSIBLE-ERROR-REFS>
                </CLIENT-SERVER-OPERATION>
                <CLIENT-SERVER-OPERATION>
                  <!-- !LINKSTO Dlt.EB_Ref.SWS_Dlt_00772.GetLogChannelThreshold, 1 -->
                  <SHORT-NAME>GetLogChannelThreshold</SHORT-NAME>
                  <ARGUMENTS>
                    <ARGUMENT-DATA-PROTOTYPE>
                      <SHORT-NAME>logChannelName</SHORT-NAME>
                      <TYPE-TREF DEST="IMPLEMENTATION-DATA-TYPE">/AUTOSAR_Dlt/ImplementationDataTypes/Dlt_LogChannelNameType</TYPE-TREF>
                      <DIRECTION>IN</DIRECTION>
                    </ARGUMENT-DATA-PROTOTYPE>
                    <ARGUMENT-DATA-PROTOTYPE>
                      <SHORT-NAME>newThreshold</SHORT-NAME>
                      <TYPE-TREF DEST="IMPLEMENTATION-DATA-TYPE">/AUTOSAR_Dlt/ImplementationDataTypes/Dlt_MessageLogLevelType</TYPE-TREF>
                      <DIRECTION>OUT</DIRECTION>
                    </ARGUMENT-DATA-PROTOTYPE>
                    <ARGUMENT-DATA-PROTOTYPE>
                      <SHORT-NAME>newTraceStatus</SHORT-NAME>
                      <TYPE-TREF DEST="IMPLEMENTATION-DATA-TYPE">/AUTOSAR_Platform/ImplementationDataTypes/boolean</TYPE-TREF>
                      <DIRECTION>OUT</DIRECTION>
                    </ARGUMENT-DATA-PROTOTYPE>
                  </ARGUMENTS>
                  <POSSIBLE-ERROR-REFS>
                    <POSSIBLE-ERROR-REF DEST="APPLICATION-ERROR">/AUTOSAR_Dlt/PortInterfaces/DltControlService/E_OK</POSSIBLE-ERROR-REF>
                    <POSSIBLE-ERROR-REF DEST="APPLICATION-ERROR">/AUTOSAR_Dlt/PortInterfaces/DltControlService/DLT_E_ERROR</POSSIBLE-ERROR-REF>
                  </POSSIBLE-ERROR-REFS>
                </CLIENT-SERVER-OPERATION>
                <CLIENT-SERVER-OPERATION>
                  <SHORT-NAME>GetLogChannelNames</SHORT-NAME>
                  <ARGUMENTS>
[!IF "num:i($DltServiceAPI) >= $AUTOSAR_20_11"!][!//
                  <!-- !LINKSTO Dlt.EB_Ref.SWS_Dlt_00772.GetLogChannelNames, 1 -->
                    <ARGUMENT-DATA-PROTOTYPE>
                      <SHORT-NAME>numberOfLogChannels</SHORT-NAME>
                      <TYPE-TREF DEST="IMPLEMENTATION-DATA-TYPE">/AUTOSAR_Platform/ImplementationDataTypes/uint8</TYPE-TREF>
                      <DIRECTION>INOUT</DIRECTION>
                    </ARGUMENT-DATA-PROTOTYPE>
[!ELSE!][!//
                  <!-- !LINKSTO Dlt.EB_Ref.ASR431.SWS_Dlt_00772.GetLogChannelNames, 1 -->
                    <ARGUMENT-DATA-PROTOTYPE>
                      <SHORT-NAME>numberOfLogChannels</SHORT-NAME>
                      <TYPE-TREF DEST="IMPLEMENTATION-DATA-TYPE">/AUTOSAR_Platform/ImplementationDataTypes/uint8</TYPE-TREF>
                      <DIRECTION>OUT</DIRECTION>
                    </ARGUMENT-DATA-PROTOTYPE>
[!ENDIF!][!//
                    <ARGUMENT-DATA-PROTOTYPE>
                      <SHORT-NAME>logChannelNames</SHORT-NAME>
                      <TYPE-TREF DEST="IMPLEMENTATION-DATA-TYPE">/AUTOSAR_Dlt/ImplementationDataTypes/Dlt_LogChannelNameArrayType</TYPE-TREF>
                      <DIRECTION>OUT</DIRECTION>
                    </ARGUMENT-DATA-PROTOTYPE>
                  </ARGUMENTS>
                  <POSSIBLE-ERROR-REFS>
                    <POSSIBLE-ERROR-REF DEST="APPLICATION-ERROR">/AUTOSAR_Dlt/PortInterfaces/DltControlService/E_OK</POSSIBLE-ERROR-REF>
                    <POSSIBLE-ERROR-REF DEST="APPLICATION-ERROR">/AUTOSAR_Dlt/PortInterfaces/DltControlService/DLT_E_ERROR</POSSIBLE-ERROR-REF>
                  </POSSIBLE-ERROR-REFS>
                </CLIENT-SERVER-OPERATION>
                <CLIENT-SERVER-OPERATION>
                  <!-- !LINKSTO Dlt.EB_Ref.SWS_Dlt_00772.SetLogLevel, 1 -->
                  <SHORT-NAME>SetLogLevel</SHORT-NAME>
                  <ARGUMENTS>
                    <ARGUMENT-DATA-PROTOTYPE>
                      <SHORT-NAME>appId</SHORT-NAME>
                      <TYPE-TREF DEST="IMPLEMENTATION-DATA-TYPE">/AUTOSAR_Dlt/ImplementationDataTypes/Dlt_ApplicationIDType</TYPE-TREF>
                      <DIRECTION>IN</DIRECTION>
                    </ARGUMENT-DATA-PROTOTYPE>
                    <ARGUMENT-DATA-PROTOTYPE>
                      <SHORT-NAME>contextId</SHORT-NAME>
                      <TYPE-TREF DEST="IMPLEMENTATION-DATA-TYPE">/AUTOSAR_Dlt/ImplementationDataTypes/Dlt_ContextIDType</TYPE-TREF>
                      <DIRECTION>IN</DIRECTION>
                    </ARGUMENT-DATA-PROTOTYPE>
                    <ARGUMENT-DATA-PROTOTYPE>
                      <SHORT-NAME>newLogLevel</SHORT-NAME>
                      <TYPE-TREF DEST="IMPLEMENTATION-DATA-TYPE">/AUTOSAR_Dlt/ImplementationDataTypes/Dlt_MessageLogLevelType</TYPE-TREF>
                      <DIRECTION>IN</DIRECTION>
                    </ARGUMENT-DATA-PROTOTYPE>
                  </ARGUMENTS>
                  <POSSIBLE-ERROR-REFS>
                    <POSSIBLE-ERROR-REF DEST="APPLICATION-ERROR">/AUTOSAR_Dlt/PortInterfaces/DltControlService/E_OK</POSSIBLE-ERROR-REF>
                    <POSSIBLE-ERROR-REF DEST="APPLICATION-ERROR">/AUTOSAR_Dlt/PortInterfaces/DltControlService/DLT_E_ERROR</POSSIBLE-ERROR-REF>
                  </POSSIBLE-ERROR-REFS>
                </CLIENT-SERVER-OPERATION>
                <CLIENT-SERVER-OPERATION>
                  <!-- !LINKSTO Dlt.EB_Ref.SWS_Dlt_00772.SetTraceStatus, 1 -->
                  <SHORT-NAME>SetTraceStatus</SHORT-NAME>
                  <ARGUMENTS>
                    <ARGUMENT-DATA-PROTOTYPE>
                      <SHORT-NAME>appId</SHORT-NAME>
                      <TYPE-TREF DEST="IMPLEMENTATION-DATA-TYPE">/AUTOSAR_Dlt/ImplementationDataTypes/Dlt_ApplicationIDType</TYPE-TREF>
                      <DIRECTION>IN</DIRECTION>
                    </ARGUMENT-DATA-PROTOTYPE>
                    <ARGUMENT-DATA-PROTOTYPE>
                      <SHORT-NAME>contextId</SHORT-NAME>
                      <TYPE-TREF DEST="IMPLEMENTATION-DATA-TYPE">/AUTOSAR_Dlt/ImplementationDataTypes/Dlt_ContextIDType</TYPE-TREF>
                      <DIRECTION>IN</DIRECTION>
                    </ARGUMENT-DATA-PROTOTYPE>
                    <ARGUMENT-DATA-PROTOTYPE>
                      <SHORT-NAME>newTraceStatus</SHORT-NAME>
                      <TYPE-TREF DEST="IMPLEMENTATION-DATA-TYPE">/AUTOSAR_Platform/ImplementationDataTypes/boolean</TYPE-TREF>
                      <DIRECTION>IN</DIRECTION>
                    </ARGUMENT-DATA-PROTOTYPE>
                  </ARGUMENTS>
                  <POSSIBLE-ERROR-REFS>
                    <POSSIBLE-ERROR-REF DEST="APPLICATION-ERROR">/AUTOSAR_Dlt/PortInterfaces/DltControlService/E_OK</POSSIBLE-ERROR-REF>
                    <POSSIBLE-ERROR-REF DEST="APPLICATION-ERROR">/AUTOSAR_Dlt/PortInterfaces/DltControlService/DLT_E_ERROR</POSSIBLE-ERROR-REF>
                  </POSSIBLE-ERROR-REFS>
                </CLIENT-SERVER-OPERATION>
                <CLIENT-SERVER-OPERATION>
                  <!-- !LINKSTO Dlt.EB_Ref.SWS_Dlt_00772.GetTraceStatus, 1 -->
                  <SHORT-NAME>GetTraceStatus</SHORT-NAME>
                  <ARGUMENTS>
                    <ARGUMENT-DATA-PROTOTYPE>
                      <SHORT-NAME>appId</SHORT-NAME>
                      <TYPE-TREF DEST="IMPLEMENTATION-DATA-TYPE">/AUTOSAR_Dlt/ImplementationDataTypes/Dlt_ApplicationIDType</TYPE-TREF>
                      <DIRECTION>IN</DIRECTION>
                    </ARGUMENT-DATA-PROTOTYPE>
                    <ARGUMENT-DATA-PROTOTYPE>
                      <SHORT-NAME>contextId</SHORT-NAME>
                      <TYPE-TREF DEST="IMPLEMENTATION-DATA-TYPE">/AUTOSAR_Dlt/ImplementationDataTypes/Dlt_ContextIDType</TYPE-TREF>
                      <DIRECTION>IN</DIRECTION>
                    </ARGUMENT-DATA-PROTOTYPE>
                    <ARGUMENT-DATA-PROTOTYPE>
                      <SHORT-NAME>traceStatus</SHORT-NAME>
                      <TYPE-TREF DEST="IMPLEMENTATION-DATA-TYPE">/AUTOSAR_Platform/ImplementationDataTypes/boolean</TYPE-TREF>
                      <DIRECTION>OUT</DIRECTION>
                    </ARGUMENT-DATA-PROTOTYPE>
                  </ARGUMENTS>
                  <POSSIBLE-ERROR-REFS>
                    <POSSIBLE-ERROR-REF DEST="APPLICATION-ERROR">/AUTOSAR_Dlt/PortInterfaces/DltControlService/E_OK</POSSIBLE-ERROR-REF>
                    <POSSIBLE-ERROR-REF DEST="APPLICATION-ERROR">/AUTOSAR_Dlt/PortInterfaces/DltControlService/DLT_E_ERROR</POSSIBLE-ERROR-REF>
                  </POSSIBLE-ERROR-REFS>
                </CLIENT-SERVER-OPERATION>
                <CLIENT-SERVER-OPERATION>
                  <!-- !LINKSTO Dlt.EB_Ref.SWS_Dlt_00772.GetLogInfo, 1 -->
                  <SHORT-NAME>GetLogInfo</SHORT-NAME>
                  <ARGUMENTS>
                    <ARGUMENT-DATA-PROTOTYPE>
                      <SHORT-NAME>options</SHORT-NAME>
                      <TYPE-TREF DEST="IMPLEMENTATION-DATA-TYPE">/AUTOSAR_Platform/ImplementationDataTypes/uint8</TYPE-TREF>
                      <DIRECTION>IN</DIRECTION>
                    </ARGUMENT-DATA-PROTOTYPE>
                    <ARGUMENT-DATA-PROTOTYPE>
                      <SHORT-NAME>appId</SHORT-NAME>
                      <TYPE-TREF DEST="IMPLEMENTATION-DATA-TYPE">/AUTOSAR_Dlt/ImplementationDataTypes/Dlt_ApplicationIDType</TYPE-TREF>
                      <DIRECTION>IN</DIRECTION>
                    </ARGUMENT-DATA-PROTOTYPE>
                    <ARGUMENT-DATA-PROTOTYPE>
                      <SHORT-NAME>contextId</SHORT-NAME>
                      <TYPE-TREF DEST="IMPLEMENTATION-DATA-TYPE">/AUTOSAR_Dlt/ImplementationDataTypes/Dlt_ContextIDType</TYPE-TREF>
                      <DIRECTION>IN</DIRECTION>
                    </ARGUMENT-DATA-PROTOTYPE>
                    <ARGUMENT-DATA-PROTOTYPE>
                      <SHORT-NAME>status</SHORT-NAME>
                      <TYPE-TREF DEST="IMPLEMENTATION-DATA-TYPE">/AUTOSAR_Platform/ImplementationDataTypes/uint8</TYPE-TREF>
                      <DIRECTION>OUT</DIRECTION>
                    </ARGUMENT-DATA-PROTOTYPE>
                    <ARGUMENT-DATA-PROTOTYPE>
                      <SHORT-NAME>logInfo</SHORT-NAME>
                      <TYPE-TREF DEST="IMPLEMENTATION-DATA-TYPE">/AUTOSAR_Dlt/ImplementationDataTypes/Dlt_LogInfoType</TYPE-TREF>
                      <DIRECTION>OUT</DIRECTION>
                    </ARGUMENT-DATA-PROTOTYPE>
                  </ARGUMENTS>
                  <POSSIBLE-ERROR-REFS>
                    <POSSIBLE-ERROR-REF DEST="APPLICATION-ERROR">/AUTOSAR_Dlt/PortInterfaces/DltControlService/E_OK</POSSIBLE-ERROR-REF>
                    <POSSIBLE-ERROR-REF DEST="APPLICATION-ERROR">/AUTOSAR_Dlt/PortInterfaces/DltControlService/DLT_E_ERROR</POSSIBLE-ERROR-REF>
                  </POSSIBLE-ERROR-REFS>
                </CLIENT-SERVER-OPERATION>
              </OPERATIONS>
              <POSSIBLE-ERRORS>
                <APPLICATION-ERROR>
                  <SHORT-NAME>E_OK</SHORT-NAME>
                  <ERROR-CODE>0</ERROR-CODE>
                </APPLICATION-ERROR>
                <APPLICATION-ERROR>
                  <SHORT-NAME>DLT_E_NOT_SUPPORTED</SHORT-NAME>
                  <ERROR-CODE>7</ERROR-CODE>
                </APPLICATION-ERROR>
                <APPLICATION-ERROR>
                  <SHORT-NAME>DLT_E_ERROR</SHORT-NAME>
                  <ERROR-CODE>9</ERROR-CODE>
                </APPLICATION-ERROR>
              </POSSIBLE-ERRORS>
            </CLIENT-SERVER-INTERFACE>
[!ENDIF!][!//
[!IF "(num:i($DltServiceAPI) >= $AUTOSAR_431) and (DltSwc/*/DltProvideSwcMessageServicePort = 'true')"!][!//
            <!-- !LINKSTO Dlt.SWS_Dlt_00495, 1 -->
            <CLIENT-SERVER-INTERFACE>
              <SHORT-NAME>DltSwcMessageService</SHORT-NAME>
              <IS-SERVICE>true</IS-SERVICE>
              <OPERATIONS>
                <!-- !LINKSTO Dlt.EB_Ref.SWS_Dlt_00495.RegisterContext, 1 -->
                <CLIENT-SERVER-OPERATION>
                  <SHORT-NAME>RegisterContext</SHORT-NAME>
                  <ARGUMENTS>
                    <ARGUMENT-DATA-PROTOTYPE>
                      <SHORT-NAME>appId</SHORT-NAME>
                      <TYPE-TREF DEST="IMPLEMENTATION-DATA-TYPE">/AUTOSAR_Dlt/ImplementationDataTypes/Dlt_ApplicationIDType</TYPE-TREF>
                      <DIRECTION>IN</DIRECTION>
                    </ARGUMENT-DATA-PROTOTYPE>
                    <ARGUMENT-DATA-PROTOTYPE>
                      <SHORT-NAME>contextId</SHORT-NAME>
                      <TYPE-TREF DEST="IMPLEMENTATION-DATA-TYPE">/AUTOSAR_Dlt/ImplementationDataTypes/Dlt_ContextIDType</TYPE-TREF>
                      <DIRECTION>IN</DIRECTION>
                    </ARGUMENT-DATA-PROTOTYPE>
                    <ARGUMENT-DATA-PROTOTYPE>
                      <SHORT-NAME>appDescription</SHORT-NAME>
                      <TYPE-TREF DEST="IMPLEMENTATION-DATA-TYPE">/AUTOSAR_Dlt/ImplementationDataTypes/Dlt_Uint8Ptr</TYPE-TREF>
                      <DIRECTION>IN</DIRECTION>
                    </ARGUMENT-DATA-PROTOTYPE>
                    <ARGUMENT-DATA-PROTOTYPE>
                      <SHORT-NAME>lenAppDescription</SHORT-NAME>
                      <TYPE-TREF DEST="IMPLEMENTATION-DATA-TYPE">/AUTOSAR_Platform/ImplementationDataTypes/uint8</TYPE-TREF>
                      <DIRECTION>IN</DIRECTION>
                    </ARGUMENT-DATA-PROTOTYPE>
                    <ARGUMENT-DATA-PROTOTYPE>
                      <SHORT-NAME>contextDescription</SHORT-NAME>
                      <TYPE-TREF DEST="IMPLEMENTATION-DATA-TYPE">/AUTOSAR_Dlt/ImplementationDataTypes/Dlt_Uint8Ptr</TYPE-TREF>
                      <DIRECTION>IN</DIRECTION>
                    </ARGUMENT-DATA-PROTOTYPE>
                    <ARGUMENT-DATA-PROTOTYPE>
                      <SHORT-NAME>lenContextDescription</SHORT-NAME>
                      <TYPE-TREF DEST="IMPLEMENTATION-DATA-TYPE">/AUTOSAR_Platform/ImplementationDataTypes/uint8</TYPE-TREF>
                      <DIRECTION>IN</DIRECTION>
                    </ARGUMENT-DATA-PROTOTYPE>
                  </ARGUMENTS>
                  <POSSIBLE-ERROR-REFS>
                    <POSSIBLE-ERROR-REF DEST="APPLICATION-ERROR">/AUTOSAR_Dlt/PortInterfaces/DltSwcMessageService/E_OK</POSSIBLE-ERROR-REF>
                    <POSSIBLE-ERROR-REF DEST="APPLICATION-ERROR">/AUTOSAR_Dlt/PortInterfaces/DltSwcMessageService/DLT_E_UNKNOWN_SESSION_ID</POSSIBLE-ERROR-REF>
                    <POSSIBLE-ERROR-REF DEST="APPLICATION-ERROR">/AUTOSAR_Dlt/PortInterfaces/DltSwcMessageService/DLT_E_CONTEXT_ALREADY_REG</POSSIBLE-ERROR-REF>
                  </POSSIBLE-ERROR-REFS>
                </CLIENT-SERVER-OPERATION>
                <!-- !LINKSTO Dlt.EB_Ref.SWS_Dlt_00495.UnregisterContext, 1 -->
                <CLIENT-SERVER-OPERATION>
                  <SHORT-NAME>UnregisterContext</SHORT-NAME>
                  <ARGUMENTS>
                    <ARGUMENT-DATA-PROTOTYPE>
                      <SHORT-NAME>appId</SHORT-NAME>
                      <TYPE-TREF DEST="IMPLEMENTATION-DATA-TYPE">/AUTOSAR_Dlt/ImplementationDataTypes/Dlt_ApplicationIDType</TYPE-TREF>
                      <DIRECTION>IN</DIRECTION>
                    </ARGUMENT-DATA-PROTOTYPE>
                    <ARGUMENT-DATA-PROTOTYPE>
                      <SHORT-NAME>contextId</SHORT-NAME>
                      <TYPE-TREF DEST="IMPLEMENTATION-DATA-TYPE">/AUTOSAR_Dlt/ImplementationDataTypes/Dlt_ContextIDType</TYPE-TREF>
                      <DIRECTION>IN</DIRECTION>
                    </ARGUMENT-DATA-PROTOTYPE>
                  </ARGUMENTS>
                  <POSSIBLE-ERROR-REFS>
                    <POSSIBLE-ERROR-REF DEST="APPLICATION-ERROR">/AUTOSAR_Dlt/PortInterfaces/DltSwcMessageService/E_OK</POSSIBLE-ERROR-REF>
                    <POSSIBLE-ERROR-REF DEST="APPLICATION-ERROR">/AUTOSAR_Dlt/PortInterfaces/DltSwcMessageService/DLT_E_UNKNOWN_SESSION_ID</POSSIBLE-ERROR-REF>
                    <POSSIBLE-ERROR-REF DEST="APPLICATION-ERROR">/AUTOSAR_Dlt/PortInterfaces/DltSwcMessageService/DLT_E_CONTEXT_NOT_YET_REG</POSSIBLE-ERROR-REF>
                  </POSSIBLE-ERROR-REFS>
                </CLIENT-SERVER-OPERATION>
                <!-- !LINKSTO Dlt.EB_Ref.SWS_Dlt_00495.SendLogMessage, 1 -->
                <CLIENT-SERVER-OPERATION>
                  <SHORT-NAME>SendLogMessage</SHORT-NAME>
                  <ARGUMENTS>
                    <ARGUMENT-DATA-PROTOTYPE>
                      <SHORT-NAME>log_info</SHORT-NAME>
                      <TYPE-TREF DEST="IMPLEMENTATION-DATA-TYPE">/AUTOSAR_Dlt/ImplementationDataTypes/Dlt_MessageLogInfoType</TYPE-TREF>
                      <DIRECTION>IN</DIRECTION>
                    </ARGUMENT-DATA-PROTOTYPE>
                    <ARGUMENT-DATA-PROTOTYPE>
                      <SHORT-NAME>log_data</SHORT-NAME>
                      <TYPE-TREF DEST="IMPLEMENTATION-DATA-TYPE">/AUTOSAR_Dlt/ImplementationDataTypes/Dlt_Uint8Ptr</TYPE-TREF>
                      <DIRECTION>IN</DIRECTION>
                    </ARGUMENT-DATA-PROTOTYPE>
                    <ARGUMENT-DATA-PROTOTYPE>
                      <SHORT-NAME>log_data_length</SHORT-NAME>
                      <TYPE-TREF DEST="IMPLEMENTATION-DATA-TYPE">/AUTOSAR_Platform/ImplementationDataTypes/uint16</TYPE-TREF>
                      <DIRECTION>IN</DIRECTION>
                    </ARGUMENT-DATA-PROTOTYPE>
                  </ARGUMENTS>
                  <POSSIBLE-ERROR-REFS>
                    <POSSIBLE-ERROR-REF DEST="APPLICATION-ERROR">/AUTOSAR_Dlt/PortInterfaces/DltSwcMessageService/E_OK</POSSIBLE-ERROR-REF>
                    <POSSIBLE-ERROR-REF DEST="APPLICATION-ERROR">/AUTOSAR_Dlt/PortInterfaces/DltSwcMessageService/DLT_E_UNKNOWN_SESSION_ID</POSSIBLE-ERROR-REF>
                    <POSSIBLE-ERROR-REF DEST="APPLICATION-ERROR">/AUTOSAR_Dlt/PortInterfaces/DltSwcMessageService/DLT_E_MSG_TOO_LARGE</POSSIBLE-ERROR-REF>
                    <POSSIBLE-ERROR-REF DEST="APPLICATION-ERROR">/AUTOSAR_Dlt/PortInterfaces/DltSwcMessageService/DLT_E_NO_BUFFER</POSSIBLE-ERROR-REF>
                  </POSSIBLE-ERROR-REFS>
                </CLIENT-SERVER-OPERATION>
                <!-- !LINKSTO EB_Req_DltSwcMessageService_Operation_SendLogMessageWithAttributes,1 -->
                <CLIENT-SERVER-OPERATION>
                  <SHORT-NAME>SendLogMessageWithAttributes</SHORT-NAME>
                  <ARGUMENTS>
                    <ARGUMENT-DATA-PROTOTYPE>
                      <SHORT-NAME>log_info</SHORT-NAME>
                      <TYPE-TREF DEST="IMPLEMENTATION-DATA-TYPE">/AUTOSAR_Dlt/ImplementationDataTypes/Dlt_MessageLogInfoType</TYPE-TREF>
                      <DIRECTION>IN</DIRECTION>
                    </ARGUMENT-DATA-PROTOTYPE>
                    <ARGUMENT-DATA-PROTOTYPE>
                      <SHORT-NAME>log_data</SHORT-NAME>
                      <TYPE-TREF DEST="IMPLEMENTATION-DATA-TYPE">/AUTOSAR_Dlt/ImplementationDataTypes/Dlt_Uint8Ptr</TYPE-TREF>
                      <DIRECTION>IN</DIRECTION>
                    </ARGUMENT-DATA-PROTOTYPE>
                    <ARGUMENT-DATA-PROTOTYPE>
                      <SHORT-NAME>log_data_length</SHORT-NAME>
                      <TYPE-TREF DEST="IMPLEMENTATION-DATA-TYPE">/AUTOSAR_Platform/ImplementationDataTypes/uint16</TYPE-TREF>
                      <DIRECTION>IN</DIRECTION>
                    </ARGUMENT-DATA-PROTOTYPE>
                    <ARGUMENT-DATA-PROTOTYPE>
                      <SHORT-NAME>attributes</SHORT-NAME>
                      <TYPE-TREF DEST="IMPLEMENTATION-DATA-TYPE">/AUTOSAR_Dlt/ImplementationDataTypes/Dlt_MessageAttributesType</TYPE-TREF>
                      <DIRECTION>IN</DIRECTION>
                    </ARGUMENT-DATA-PROTOTYPE>
                  </ARGUMENTS>
                  <POSSIBLE-ERROR-REFS>
                    <POSSIBLE-ERROR-REF DEST="APPLICATION-ERROR">/AUTOSAR_Dlt/PortInterfaces/DltSwcMessageService/E_OK</POSSIBLE-ERROR-REF>
                    <POSSIBLE-ERROR-REF DEST="APPLICATION-ERROR">/AUTOSAR_Dlt/PortInterfaces/DltSwcMessageService/DLT_E_UNKNOWN_SESSION_ID</POSSIBLE-ERROR-REF>
                    <POSSIBLE-ERROR-REF DEST="APPLICATION-ERROR">/AUTOSAR_Dlt/PortInterfaces/DltSwcMessageService/DLT_E_MSG_TOO_LARGE</POSSIBLE-ERROR-REF>
                    <POSSIBLE-ERROR-REF DEST="APPLICATION-ERROR">/AUTOSAR_Dlt/PortInterfaces/DltSwcMessageService/DLT_E_NO_BUFFER</POSSIBLE-ERROR-REF>
                    <POSSIBLE-ERROR-REF DEST="APPLICATION-ERROR">/AUTOSAR_Dlt/PortInterfaces/DltSwcMessageService/DLT_E_NOT_SUPPORTED</POSSIBLE-ERROR-REF>
                  </POSSIBLE-ERROR-REFS>
                </CLIENT-SERVER-OPERATION>
                <!-- !LINKSTO Dlt.EB_Ref.SWS_Dlt_00495.SendTraceMessage, 1 -->
                <CLIENT-SERVER-OPERATION>
                  <SHORT-NAME>SendTraceMessage</SHORT-NAME>
                  <ARGUMENTS>
                    <ARGUMENT-DATA-PROTOTYPE>
                      <SHORT-NAME>traceInfo</SHORT-NAME>
                      <TYPE-TREF DEST="IMPLEMENTATION-DATA-TYPE">/AUTOSAR_Dlt/ImplementationDataTypes/Dlt_MessageTraceInfoType</TYPE-TREF>
                      <DIRECTION>IN</DIRECTION>
                    </ARGUMENT-DATA-PROTOTYPE>
                    <ARGUMENT-DATA-PROTOTYPE>
                      <SHORT-NAME>traceData</SHORT-NAME>
                      <TYPE-TREF DEST="IMPLEMENTATION-DATA-TYPE">/AUTOSAR_Dlt/ImplementationDataTypes/Dlt_Uint8Ptr</TYPE-TREF>
                      <DIRECTION>IN</DIRECTION>
                    </ARGUMENT-DATA-PROTOTYPE>
                    <ARGUMENT-DATA-PROTOTYPE>
                      <SHORT-NAME>traceDataLength</SHORT-NAME>
                      <TYPE-TREF DEST="IMPLEMENTATION-DATA-TYPE">/AUTOSAR_Platform/ImplementationDataTypes/uint16</TYPE-TREF>
                      <DIRECTION>IN</DIRECTION>
                    </ARGUMENT-DATA-PROTOTYPE>
                  </ARGUMENTS>
                  <POSSIBLE-ERROR-REFS>
                    <POSSIBLE-ERROR-REF DEST="APPLICATION-ERROR">/AUTOSAR_Dlt/PortInterfaces/DltSwcMessageService/E_OK</POSSIBLE-ERROR-REF>
                    <POSSIBLE-ERROR-REF DEST="APPLICATION-ERROR">/AUTOSAR_Dlt/PortInterfaces/DltSwcMessageService/DLT_E_MSG_TOO_LARGE</POSSIBLE-ERROR-REF>
                    <POSSIBLE-ERROR-REF DEST="APPLICATION-ERROR">/AUTOSAR_Dlt/PortInterfaces/DltSwcMessageService/DLT_E_UNKNOWN_SESSION_ID</POSSIBLE-ERROR-REF>
                    <POSSIBLE-ERROR-REF DEST="APPLICATION-ERROR">/AUTOSAR_Dlt/PortInterfaces/DltSwcMessageService/DLT_E_NO_BUFFER</POSSIBLE-ERROR-REF>
                  </POSSIBLE-ERROR-REFS>
                </CLIENT-SERVER-OPERATION>
                <!-- !LINKSTO EB_Req_DltSwcMessageService_Operation_SendTraceMessageWithAttributes,1 -->
                <CLIENT-SERVER-OPERATION>
                  <SHORT-NAME>SendTraceMessageWithAttributes</SHORT-NAME>
                  <ARGUMENTS>
                    <ARGUMENT-DATA-PROTOTYPE>
                      <SHORT-NAME>traceInfo</SHORT-NAME>
                      <TYPE-TREF DEST="IMPLEMENTATION-DATA-TYPE">/AUTOSAR_Dlt/ImplementationDataTypes/Dlt_MessageTraceInfoType</TYPE-TREF>
                      <DIRECTION>IN</DIRECTION>
                    </ARGUMENT-DATA-PROTOTYPE>
                    <ARGUMENT-DATA-PROTOTYPE>
                      <SHORT-NAME>traceData</SHORT-NAME>
                      <TYPE-TREF DEST="IMPLEMENTATION-DATA-TYPE">/AUTOSAR_Dlt/ImplementationDataTypes/Dlt_Uint8Ptr</TYPE-TREF>
                      <DIRECTION>IN</DIRECTION>
                    </ARGUMENT-DATA-PROTOTYPE>
                    <ARGUMENT-DATA-PROTOTYPE>
                      <SHORT-NAME>traceDataLength</SHORT-NAME>
                      <TYPE-TREF DEST="IMPLEMENTATION-DATA-TYPE">/AUTOSAR_Platform/ImplementationDataTypes/uint16</TYPE-TREF>
                      <DIRECTION>IN</DIRECTION>
                    </ARGUMENT-DATA-PROTOTYPE>
                    <ARGUMENT-DATA-PROTOTYPE>
                      <SHORT-NAME>attributes</SHORT-NAME>
                      <TYPE-TREF DEST="IMPLEMENTATION-DATA-TYPE">/AUTOSAR_Dlt/ImplementationDataTypes/Dlt_MessageAttributesType</TYPE-TREF>
                      <DIRECTION>IN</DIRECTION>
                    </ARGUMENT-DATA-PROTOTYPE>
                  </ARGUMENTS>
                  <POSSIBLE-ERROR-REFS>
                    <POSSIBLE-ERROR-REF DEST="APPLICATION-ERROR">/AUTOSAR_Dlt/PortInterfaces/DltSwcMessageService/E_OK</POSSIBLE-ERROR-REF>
                    <POSSIBLE-ERROR-REF DEST="APPLICATION-ERROR">/AUTOSAR_Dlt/PortInterfaces/DltSwcMessageService/DLT_E_MSG_TOO_LARGE</POSSIBLE-ERROR-REF>
                    <POSSIBLE-ERROR-REF DEST="APPLICATION-ERROR">/AUTOSAR_Dlt/PortInterfaces/DltSwcMessageService/DLT_E_UNKNOWN_SESSION_ID</POSSIBLE-ERROR-REF>
                    <POSSIBLE-ERROR-REF DEST="APPLICATION-ERROR">/AUTOSAR_Dlt/PortInterfaces/DltSwcMessageService/DLT_E_NO_BUFFER</POSSIBLE-ERROR-REF>
                    <POSSIBLE-ERROR-REF DEST="APPLICATION-ERROR">/AUTOSAR_Dlt/PortInterfaces/DltSwcMessageService/DLT_E_NOT_SUPPORTED</POSSIBLE-ERROR-REF>
                  </POSSIBLE-ERROR-REFS>
                </CLIENT-SERVER-OPERATION>
              </OPERATIONS>
              <!-- !LINKSTO Dlt.EB_Ref.SWS_Dlt_00495.Errors, 2 -->
              <POSSIBLE-ERRORS>
                <APPLICATION-ERROR>
                  <SHORT-NAME>E_OK</SHORT-NAME>
                  <ERROR-CODE>0</ERROR-CODE>
                </APPLICATION-ERROR>
                <APPLICATION-ERROR>
                  <SHORT-NAME>DLT_E_MSG_TOO_LARGE</SHORT-NAME>
                  <ERROR-CODE>2</ERROR-CODE>
                </APPLICATION-ERROR>
                <APPLICATION-ERROR>
                  <SHORT-NAME>DLT_E_CONTEXT_ALREADY_REG</SHORT-NAME>
                  <ERROR-CODE>3</ERROR-CODE>
                </APPLICATION-ERROR>
                <APPLICATION-ERROR>
                  <SHORT-NAME>DLT_E_UNKNOWN_SESSION_ID</SHORT-NAME>
                  <ERROR-CODE>4</ERROR-CODE>
                </APPLICATION-ERROR>
                <APPLICATION-ERROR>
                  <SHORT-NAME>DLT_E_NO_BUFFER</SHORT-NAME>
                  <ERROR-CODE>5</ERROR-CODE>
                </APPLICATION-ERROR>
                <APPLICATION-ERROR>
                  <SHORT-NAME>DLT_E_CONTEXT_NOT_YET_REG</SHORT-NAME>
                  <ERROR-CODE>6</ERROR-CODE>
                </APPLICATION-ERROR>
                <APPLICATION-ERROR>
                  <SHORT-NAME>DLT_E_ERROR</SHORT-NAME>
                  <ERROR-CODE>9</ERROR-CODE>
                </APPLICATION-ERROR>
		<APPLICATION-ERROR>
                  <SHORT-NAME>DLT_E_NOT_SUPPORTED</SHORT-NAME>
                  <ERROR-CODE>7</ERROR-CODE>
                </APPLICATION-ERROR>
              </POSSIBLE-ERRORS>
            </CLIENT-SERVER-INTERFACE>
[!ENDIF!][!//
[!IF "num:i($DltServiceAPI) < $AUTOSAR_431"!][!//
            <!-- description of interfaces -->
            <!-- description of DLTService -->
            <CLIENT-SERVER-INTERFACE>
              <SHORT-NAME>DLTService</SHORT-NAME>
              <IS-SERVICE>true</IS-SERVICE>
              <OPERATIONS>
                <CLIENT-SERVER-OPERATION>
                  <!-- !LINKSTO EB_Ref_DltService_Operation_RegisterContext,1 -->
                  <SHORT-NAME>RegisterContext</SHORT-NAME>
                  <ARGUMENTS>
                    <ARGUMENT-DATA-PROTOTYPE>
                      <SHORT-NAME>app_id</SHORT-NAME>
                      <TYPE-TREF DEST="IMPLEMENTATION-DATA-TYPE">/AUTOSAR_Dlt/ImplementationDataTypes/Dlt_ApplicationIDType</TYPE-TREF>
                      <DIRECTION>IN</DIRECTION>
                    </ARGUMENT-DATA-PROTOTYPE>
                    <ARGUMENT-DATA-PROTOTYPE>
                      <SHORT-NAME>context_id</SHORT-NAME>
                      <TYPE-TREF DEST="IMPLEMENTATION-DATA-TYPE">/AUTOSAR_Dlt/ImplementationDataTypes/Dlt_ContextIDType</TYPE-TREF>
                      <DIRECTION>IN</DIRECTION>
                    </ARGUMENT-DATA-PROTOTYPE>
                    <ARGUMENT-DATA-PROTOTYPE>
                      <SHORT-NAME>app_description</SHORT-NAME>
                      <TYPE-TREF DEST="IMPLEMENTATION-DATA-TYPE">/AUTOSAR_Dlt/ImplementationDataTypes/Dlt_Uint8Ptr</TYPE-TREF>
                      <DIRECTION>IN</DIRECTION>
                    </ARGUMENT-DATA-PROTOTYPE>
                    <ARGUMENT-DATA-PROTOTYPE>
                      <SHORT-NAME>len_app_description</SHORT-NAME>
                      <TYPE-TREF DEST="IMPLEMENTATION-DATA-TYPE">/AUTOSAR_Platform/ImplementationDataTypes/uint8</TYPE-TREF>
                      <DIRECTION>IN</DIRECTION>
                    </ARGUMENT-DATA-PROTOTYPE>
                    <ARGUMENT-DATA-PROTOTYPE>
                      <SHORT-NAME>context_description</SHORT-NAME>
                      <TYPE-TREF DEST="IMPLEMENTATION-DATA-TYPE">/AUTOSAR_Dlt/ImplementationDataTypes/Dlt_Uint8Ptr</TYPE-TREF>
                      <DIRECTION>IN</DIRECTION>
                    </ARGUMENT-DATA-PROTOTYPE>
                    <ARGUMENT-DATA-PROTOTYPE>
                      <SHORT-NAME>len_context_description</SHORT-NAME>
                      <TYPE-TREF DEST="IMPLEMENTATION-DATA-TYPE">/AUTOSAR_Platform/ImplementationDataTypes/uint8</TYPE-TREF>
                      <DIRECTION>IN</DIRECTION>
                    </ARGUMENT-DATA-PROTOTYPE>
                  </ARGUMENTS>
                  <POSSIBLE-ERROR-REFS>
                    <POSSIBLE-ERROR-REF DEST="APPLICATION-ERROR">/AUTOSAR_Dlt/PortInterfaces/DLTService/DLT_E_OK</POSSIBLE-ERROR-REF>
                    <POSSIBLE-ERROR-REF DEST="APPLICATION-ERROR">/AUTOSAR_Dlt/PortInterfaces/DLTService/DLT_E_CONTEXT_ALREADY_REG</POSSIBLE-ERROR-REF>
                  </POSSIBLE-ERROR-REFS>
                </CLIENT-SERVER-OPERATION>
  [!IF "DltGeneral/DltImplementNVRamStorage = 'true'"!][!//
                <CLIENT-SERVER-OPERATION>
                  <SHORT-NAME>StorePersistent</SHORT-NAME>
                  <POSSIBLE-ERROR-REFS>
                    <POSSIBLE-ERROR-REF DEST="APPLICATION-ERROR">/AUTOSAR_Dlt/PortInterfaces/DLTService/DLT_E_OK</POSSIBLE-ERROR-REF>
                    <POSSIBLE-ERROR-REF DEST="APPLICATION-ERROR">/AUTOSAR_Dlt/PortInterfaces/DLTService/DLT_E_ERROR_UNKNOWN</POSSIBLE-ERROR-REF>
                  </POSSIBLE-ERROR-REFS>
                </CLIENT-SERVER-OPERATION>
  [!ENDIF!][!//
                <CLIENT-SERVER-OPERATION>
                  <!-- !LINKSTO EB_Ref_DltService_Operation_SendLogMessage,1 -->
                  <SHORT-NAME>SendLogMessage</SHORT-NAME>
                  <ARGUMENTS>
                    <ARGUMENT-DATA-PROTOTYPE>
                      <SHORT-NAME>log_info</SHORT-NAME>
                      <TYPE-TREF DEST="IMPLEMENTATION-DATA-TYPE">/AUTOSAR_Dlt/ImplementationDataTypes/Dlt_MessageLogInfoType</TYPE-TREF>
                      <DIRECTION>IN</DIRECTION>
                    </ARGUMENT-DATA-PROTOTYPE>
                    <ARGUMENT-DATA-PROTOTYPE>
                      <SHORT-NAME>log_data</SHORT-NAME>
                      <TYPE-TREF DEST="IMPLEMENTATION-DATA-TYPE">/AUTOSAR_Dlt/ImplementationDataTypes/Dlt_Uint8Ptr</TYPE-TREF>
                      <DIRECTION>IN</DIRECTION>
                    </ARGUMENT-DATA-PROTOTYPE>
                    <ARGUMENT-DATA-PROTOTYPE>
                      <SHORT-NAME>log_data_length</SHORT-NAME>
                      <TYPE-TREF DEST="IMPLEMENTATION-DATA-TYPE">/AUTOSAR_Platform/ImplementationDataTypes/uint16</TYPE-TREF>
                      <DIRECTION>IN</DIRECTION>
                    </ARGUMENT-DATA-PROTOTYPE>
                  </ARGUMENTS>
                  <POSSIBLE-ERROR-REFS>
                    <POSSIBLE-ERROR-REF DEST="APPLICATION-ERROR">/AUTOSAR_Dlt/PortInterfaces/DLTService/DLT_E_OK</POSSIBLE-ERROR-REF>
                    <POSSIBLE-ERROR-REF DEST="APPLICATION-ERROR">/AUTOSAR_Dlt/PortInterfaces/DLTService/DLT_E_MSG_TOO_LARGE</POSSIBLE-ERROR-REF>
                    <POSSIBLE-ERROR-REF DEST="APPLICATION-ERROR">/AUTOSAR_Dlt/PortInterfaces/DLTService/DLT_E_UNKNOWN_SESSION_ID</POSSIBLE-ERROR-REF>
                    <POSSIBLE-ERROR-REF DEST="APPLICATION-ERROR">/AUTOSAR_Dlt/PortInterfaces/DLTService/DLT_E_IF_NOT_AVAILABLE</POSSIBLE-ERROR-REF>
                    <POSSIBLE-ERROR-REF DEST="APPLICATION-ERROR">/AUTOSAR_Dlt/PortInterfaces/DLTService/DLT_E_NOT_IN_VERBOSE_MODE</POSSIBLE-ERROR-REF>
                  </POSSIBLE-ERROR-REFS>
                </CLIENT-SERVER-OPERATION>
                <CLIENT-SERVER-OPERATION>
                  <!-- !LINKSTO EB_Ref_DltService_Operation_SendTraceMessage,1 -->
                  <SHORT-NAME>SendTraceMessage</SHORT-NAME>
                  <ARGUMENTS>
                    <ARGUMENT-DATA-PROTOTYPE>
                      <SHORT-NAME>trace_info</SHORT-NAME>
                      <TYPE-TREF DEST="IMPLEMENTATION-DATA-TYPE">/AUTOSAR_Dlt/ImplementationDataTypes/Dlt_MessageTraceInfoType</TYPE-TREF>
                      <DIRECTION>IN</DIRECTION>
                    </ARGUMENT-DATA-PROTOTYPE>
                    <ARGUMENT-DATA-PROTOTYPE>
                      <SHORT-NAME>trace_data</SHORT-NAME>
                      <TYPE-TREF DEST="IMPLEMENTATION-DATA-TYPE">/AUTOSAR_Dlt/ImplementationDataTypes/Dlt_Uint8Ptr</TYPE-TREF>
                      <DIRECTION>IN</DIRECTION>
                    </ARGUMENT-DATA-PROTOTYPE>
                    <ARGUMENT-DATA-PROTOTYPE>
                      <SHORT-NAME>trace_data_length</SHORT-NAME>
                      <TYPE-TREF DEST="IMPLEMENTATION-DATA-TYPE">/AUTOSAR_Platform/ImplementationDataTypes/uint16</TYPE-TREF>
                      <DIRECTION>IN</DIRECTION>
                    </ARGUMENT-DATA-PROTOTYPE>
                  </ARGUMENTS>
                  <POSSIBLE-ERROR-REFS>
                    <POSSIBLE-ERROR-REF DEST="APPLICATION-ERROR">/AUTOSAR_Dlt/PortInterfaces/DLTService/DLT_E_OK</POSSIBLE-ERROR-REF>
                    <POSSIBLE-ERROR-REF DEST="APPLICATION-ERROR">/AUTOSAR_Dlt/PortInterfaces/DLTService/DLT_E_MSG_TOO_LARGE</POSSIBLE-ERROR-REF>
                    <POSSIBLE-ERROR-REF DEST="APPLICATION-ERROR">/AUTOSAR_Dlt/PortInterfaces/DLTService/DLT_E_UNKNOWN_SESSION_ID</POSSIBLE-ERROR-REF>
                    <POSSIBLE-ERROR-REF DEST="APPLICATION-ERROR">/AUTOSAR_Dlt/PortInterfaces/DLTService/DLT_E_IF_NOT_AVAILABLE</POSSIBLE-ERROR-REF>
                    <POSSIBLE-ERROR-REF DEST="APPLICATION-ERROR">/AUTOSAR_Dlt/PortInterfaces/DLTService/DLT_E_NOT_IN_VERBOSE_MODE</POSSIBLE-ERROR-REF>
                  </POSSIBLE-ERROR-REFS>
                </CLIENT-SERVER-OPERATION>
              </OPERATIONS>
              <POSSIBLE-ERRORS>
                <APPLICATION-ERROR>
                  <SHORT-NAME>DLT_E_OK</SHORT-NAME>
                  <ERROR-CODE>0</ERROR-CODE>
                </APPLICATION-ERROR>
                <!-- !LINKSTO EB_Ref_DltService_Errors_AUTOSAR421,1 -->
[!IF "num:i($DltServiceAPI) = $AUTOSAR_421"!][!//
                <APPLICATION-ERROR>
                  <SHORT-NAME>DLT_E_MSG_TOO_LARGE</SHORT-NAME>
                  <ERROR-CODE>1</ERROR-CODE>
                </APPLICATION-ERROR>
                <APPLICATION-ERROR>
                  <SHORT-NAME>DLT_E_CONTEXT_ALREADY_REG</SHORT-NAME>
                  <ERROR-CODE>2</ERROR-CODE>
                </APPLICATION-ERROR>
                <APPLICATION-ERROR>
                  <SHORT-NAME>DLT_E_UNKNOWN_SESSION_ID</SHORT-NAME>
                  <ERROR-CODE>3</ERROR-CODE>
                </APPLICATION-ERROR>
                <APPLICATION-ERROR>
                  <SHORT-NAME>DLT_E_IF_NOT_AVAILABLE</SHORT-NAME>
                  <ERROR-CODE>4</ERROR-CODE>
                </APPLICATION-ERROR>
  [!IF "DltGeneral/DltImplementNVRamStorage = 'true'"!][!//
                <APPLICATION-ERROR>
                  <SHORT-NAME>DLT_E_ERROR_UNKNOWN</SHORT-NAME>
                  <ERROR-CODE>6</ERROR-CODE>
                </APPLICATION-ERROR>
  [!ENDIF!][!//
                <APPLICATION-ERROR>
                  <SHORT-NAME>DLT_E_NOT_IN_VERBOSE_MODE</SHORT-NAME>
                  <ERROR-CODE>8</ERROR-CODE>
                </APPLICATION-ERROR>
[!ELSE!][!//
                <!-- !LINKSTO EB_Ref_DltService_Errors_AUTOSAR422,1 -->
                <APPLICATION-ERROR>
                  <SHORT-NAME>DLT_E_MSG_TOO_LARGE</SHORT-NAME>
                  <ERROR-CODE>2</ERROR-CODE>
                </APPLICATION-ERROR>
                <APPLICATION-ERROR>
                  <SHORT-NAME>DLT_E_CONTEXT_ALREADY_REG</SHORT-NAME>
                  <ERROR-CODE>3</ERROR-CODE>
                </APPLICATION-ERROR>
                <APPLICATION-ERROR>
                  <SHORT-NAME>DLT_E_UNKNOWN_SESSION_ID</SHORT-NAME>
                  <ERROR-CODE>4</ERROR-CODE>
                </APPLICATION-ERROR>
                <APPLICATION-ERROR>
                  <SHORT-NAME>DLT_E_IF_NOT_AVAILABLE</SHORT-NAME>
                  <ERROR-CODE>5</ERROR-CODE>
                </APPLICATION-ERROR>
  [!IF "DltGeneral/DltImplementNVRamStorage = 'true'"!][!//
                <APPLICATION-ERROR>
                  <SHORT-NAME>DLT_E_ERROR_UNKNOWN</SHORT-NAME>
                  <ERROR-CODE>7</ERROR-CODE>
                </APPLICATION-ERROR>
  [!ENDIF!]
                <APPLICATION-ERROR>
                  <SHORT-NAME>DLT_E_NOT_IN_VERBOSE_MODE</SHORT-NAME>
                  <ERROR-CODE>9</ERROR-CODE>
                </APPLICATION-ERROR>
[!ENDIF!][!//
              </POSSIBLE-ERRORS>
            </CLIENT-SERVER-INTERFACE>
[!ENDIF!][!//
[!IF "(num:i($DltServiceAPI) < $AUTOSAR_431) or (DltSwc/*/DltProvideLogTraceSessionControlPort = 'true')"!][!//
            <CLIENT-SERVER-INTERFACE>
              <SHORT-NAME>LogTraceSessionControl</SHORT-NAME>
              <IS-SERVICE>true</IS-SERVICE>
              <OPERATIONS>
  [!IF "num:i($DltServiceAPI) < $AUTOSAR_431"!][!//
                <CLIENT-SERVER-OPERATION>
                  <SHORT-NAME>SetLogLevel</SHORT-NAME>
                  <ARGUMENTS>
                    <ARGUMENT-DATA-PROTOTYPE>
                      <SHORT-NAME>app_id</SHORT-NAME>
                      <TYPE-TREF DEST="IMPLEMENTATION-DATA-TYPE">/AUTOSAR_Dlt/ImplementationDataTypes/Dlt_ApplicationIDType</TYPE-TREF>
                      <DIRECTION>IN</DIRECTION>
                    </ARGUMENT-DATA-PROTOTYPE>
                    <ARGUMENT-DATA-PROTOTYPE>
                      <SHORT-NAME>context_id</SHORT-NAME>
                      <TYPE-TREF DEST="IMPLEMENTATION-DATA-TYPE">/AUTOSAR_Dlt/ImplementationDataTypes/Dlt_ContextIDType</TYPE-TREF>
                      <DIRECTION>IN</DIRECTION>
                    </ARGUMENT-DATA-PROTOTYPE>
                    <ARGUMENT-DATA-PROTOTYPE>
                      <SHORT-NAME>loglevel</SHORT-NAME>
                      <TYPE-TREF DEST="IMPLEMENTATION-DATA-TYPE">/AUTOSAR_Dlt/ImplementationDataTypes/Dlt_MessageLogLevelType</TYPE-TREF>
                      <DIRECTION>IN</DIRECTION>
                    </ARGUMENT-DATA-PROTOTYPE>
                  </ARGUMENTS>
                  <POSSIBLE-ERROR-REFS>
                    <POSSIBLE-ERROR-REF DEST="APPLICATION-ERROR">/AUTOSAR_Dlt/PortInterfaces/LogTraceSessionControl/E_OK</POSSIBLE-ERROR-REF>
                    <POSSIBLE-ERROR-REF DEST="APPLICATION-ERROR">/AUTOSAR_Dlt/PortInterfaces/LogTraceSessionControl/E_NOT_OK</POSSIBLE-ERROR-REF>
                  </POSSIBLE-ERROR-REFS>
                </CLIENT-SERVER-OPERATION>
                <CLIENT-SERVER-OPERATION>
                  <SHORT-NAME>SetTraceStatus</SHORT-NAME>
                  <ARGUMENTS>
                    <ARGUMENT-DATA-PROTOTYPE>
                      <SHORT-NAME>app_id</SHORT-NAME>
                      <TYPE-TREF DEST="IMPLEMENTATION-DATA-TYPE">/AUTOSAR_Dlt/ImplementationDataTypes/Dlt_ApplicationIDType</TYPE-TREF>
                      <DIRECTION>IN</DIRECTION>
                    </ARGUMENT-DATA-PROTOTYPE>
                    <ARGUMENT-DATA-PROTOTYPE>
                      <SHORT-NAME>context_id</SHORT-NAME>
                      <TYPE-TREF DEST="IMPLEMENTATION-DATA-TYPE">/AUTOSAR_Dlt/ImplementationDataTypes/Dlt_ContextIDType</TYPE-TREF>
                      <DIRECTION>IN</DIRECTION>
                    </ARGUMENT-DATA-PROTOTYPE>
                    <ARGUMENT-DATA-PROTOTYPE>
                      <SHORT-NAME>new_trace_status</SHORT-NAME>
                      <TYPE-TREF DEST="IMPLEMENTATION-DATA-TYPE">/AUTOSAR_Platform/ImplementationDataTypes/boolean</TYPE-TREF>
                      <DIRECTION>IN</DIRECTION>
                    </ARGUMENT-DATA-PROTOTYPE>
                  </ARGUMENTS>
                  <POSSIBLE-ERROR-REFS>
                    <POSSIBLE-ERROR-REF DEST="APPLICATION-ERROR">/AUTOSAR_Dlt/PortInterfaces/LogTraceSessionControl/E_OK</POSSIBLE-ERROR-REF>
                    <POSSIBLE-ERROR-REF DEST="APPLICATION-ERROR">/AUTOSAR_Dlt/PortInterfaces/LogTraceSessionControl/E_NOT_OK</POSSIBLE-ERROR-REF>
                  </POSSIBLE-ERROR-REFS>
                </CLIENT-SERVER-OPERATION>
  [!ELSE!][!//
                <!-- !LINKSTO Dlt.EB_Ref.SWS_Dlt_00496.LogLevelChangedNotification, 1 -->
                <CLIENT-SERVER-OPERATION>
                  <SHORT-NAME>LogLevelChangedNotification</SHORT-NAME>
                  <ARGUMENTS>
                    <ARGUMENT-DATA-PROTOTYPE>
                      <SHORT-NAME>appId</SHORT-NAME>
                      <TYPE-TREF DEST="IMPLEMENTATION-DATA-TYPE">/AUTOSAR_Dlt/ImplementationDataTypes/Dlt_ApplicationIDType</TYPE-TREF>
                      <DIRECTION>IN</DIRECTION>
                    </ARGUMENT-DATA-PROTOTYPE>
                    <ARGUMENT-DATA-PROTOTYPE>
                      <SHORT-NAME>contextId</SHORT-NAME>
                      <TYPE-TREF DEST="IMPLEMENTATION-DATA-TYPE">/AUTOSAR_Dlt/ImplementationDataTypes/Dlt_ContextIDType</TYPE-TREF>
                      <DIRECTION>IN</DIRECTION>
                    </ARGUMENT-DATA-PROTOTYPE>
                    <ARGUMENT-DATA-PROTOTYPE>
                      <SHORT-NAME>logLevel</SHORT-NAME>
                      <TYPE-TREF DEST="IMPLEMENTATION-DATA-TYPE">/AUTOSAR_Dlt/ImplementationDataTypes/Dlt_MessageLogLevelType</TYPE-TREF>
                      <DIRECTION>IN</DIRECTION>
                    </ARGUMENT-DATA-PROTOTYPE>
                  </ARGUMENTS>
                  <POSSIBLE-ERROR-REFS>
                    <POSSIBLE-ERROR-REF DEST="APPLICATION-ERROR">/AUTOSAR_Dlt/PortInterfaces/LogTraceSessionControl/E_OK</POSSIBLE-ERROR-REF>
                    <POSSIBLE-ERROR-REF DEST="APPLICATION-ERROR">/AUTOSAR_Dlt/PortInterfaces/LogTraceSessionControl/E_NOT_OK</POSSIBLE-ERROR-REF>
                  </POSSIBLE-ERROR-REFS>
                </CLIENT-SERVER-OPERATION>
                <!-- !LINKSTO Dlt.EB_Ref.SWS_Dlt_00496.TraceStatusChangedNotification, 1 -->
                <CLIENT-SERVER-OPERATION>
                  <SHORT-NAME>TraceStatusChangedNotification</SHORT-NAME>
                  <ARGUMENTS>
                    <ARGUMENT-DATA-PROTOTYPE>
                      <SHORT-NAME>appId</SHORT-NAME>
                      <TYPE-TREF DEST="IMPLEMENTATION-DATA-TYPE">/AUTOSAR_Dlt/ImplementationDataTypes/Dlt_ApplicationIDType</TYPE-TREF>
                      <DIRECTION>IN</DIRECTION>
                    </ARGUMENT-DATA-PROTOTYPE>
                    <ARGUMENT-DATA-PROTOTYPE>
                      <SHORT-NAME>contextId</SHORT-NAME>
                      <TYPE-TREF DEST="IMPLEMENTATION-DATA-TYPE">/AUTOSAR_Dlt/ImplementationDataTypes/Dlt_ContextIDType</TYPE-TREF>
                      <DIRECTION>IN</DIRECTION>
                    </ARGUMENT-DATA-PROTOTYPE>
                    <ARGUMENT-DATA-PROTOTYPE>
                      <SHORT-NAME>newTraceStatus</SHORT-NAME>
                      <TYPE-TREF DEST="IMPLEMENTATION-DATA-TYPE">/AUTOSAR_Platform/ImplementationDataTypes/boolean</TYPE-TREF>
                      <DIRECTION>IN</DIRECTION>
                    </ARGUMENT-DATA-PROTOTYPE>
                  </ARGUMENTS>
                  <POSSIBLE-ERROR-REFS>
                    <POSSIBLE-ERROR-REF DEST="APPLICATION-ERROR">/AUTOSAR_Dlt/PortInterfaces/LogTraceSessionControl/E_OK</POSSIBLE-ERROR-REF>
                    <POSSIBLE-ERROR-REF DEST="APPLICATION-ERROR">/AUTOSAR_Dlt/PortInterfaces/LogTraceSessionControl/E_NOT_OK</POSSIBLE-ERROR-REF>
                  </POSSIBLE-ERROR-REFS>
                </CLIENT-SERVER-OPERATION>
  [!ENDIF!][!//
              </OPERATIONS>
              <POSSIBLE-ERRORS>
                <APPLICATION-ERROR>
                  <SHORT-NAME>E_OK</SHORT-NAME>
                  <ERROR-CODE>0</ERROR-CODE>
                </APPLICATION-ERROR>
                <APPLICATION-ERROR>
                  <SHORT-NAME>E_NOT_OK</SHORT-NAME>
                  <ERROR-CODE>1</ERROR-CODE>
                </APPLICATION-ERROR>
              </POSSIBLE-ERRORS>
            </CLIENT-SERVER-INTERFACE>
[!ENDIF!][!//
[!IF "(num:i($DltServiceAPI) < $AUTOSAR_431) and (DltGeneral/DltImplementVerboseMode = 'true')"!][!//
            <!-- !LINKSTO Dlt.ASR421.SWS_Dlt_00497,1 -->
            <CLIENT-SERVER-INTERFACE>
              <SHORT-NAME>VerboseModeControl</SHORT-NAME>
              <IS-SERVICE>true</IS-SERVICE>
              <OPERATIONS>
                <CLIENT-SERVER-OPERATION>
                  <SHORT-NAME>SetVerboseMode</SHORT-NAME>
                  <ARGUMENTS>
                    <ARGUMENT-DATA-PROTOTYPE>
                      <SHORT-NAME>app_id</SHORT-NAME>
                      <TYPE-TREF DEST="IMPLEMENTATION-DATA-TYPE">/AUTOSAR_Dlt/ImplementationDataTypes/Dlt_ApplicationIDType</TYPE-TREF>
                      <DIRECTION>IN</DIRECTION>
                    </ARGUMENT-DATA-PROTOTYPE>
                    <ARGUMENT-DATA-PROTOTYPE>
                      <SHORT-NAME>context_id</SHORT-NAME>
                      <TYPE-TREF DEST="IMPLEMENTATION-DATA-TYPE">/AUTOSAR_Dlt/ImplementationDataTypes/Dlt_ContextIDType</TYPE-TREF>
                      <DIRECTION>IN</DIRECTION>
                    </ARGUMENT-DATA-PROTOTYPE>
                    <ARGUMENT-DATA-PROTOTYPE>
                      <SHORT-NAME>is_verbose_mode</SHORT-NAME>
                      <TYPE-TREF DEST="IMPLEMENTATION-DATA-TYPE">/AUTOSAR_Platform/ImplementationDataTypes/boolean</TYPE-TREF>
                      <DIRECTION>IN</DIRECTION>
                    </ARGUMENT-DATA-PROTOTYPE>
                  </ARGUMENTS>
                  <POSSIBLE-ERROR-REFS>
                    <POSSIBLE-ERROR-REF DEST="APPLICATION-ERROR">/AUTOSAR_Dlt/PortInterfaces/VerboseModeControl/E_OK</POSSIBLE-ERROR-REF>
                    <POSSIBLE-ERROR-REF DEST="APPLICATION-ERROR">/AUTOSAR_Dlt/PortInterfaces/VerboseModeControl/E_NOT_OK</POSSIBLE-ERROR-REF>
                  </POSSIBLE-ERROR-REFS>
                </CLIENT-SERVER-OPERATION>
              </OPERATIONS>
              <POSSIBLE-ERRORS>
                <APPLICATION-ERROR>
                  <SHORT-NAME>E_OK</SHORT-NAME>
                  <ERROR-CODE>0</ERROR-CODE>
                </APPLICATION-ERROR>
                <APPLICATION-ERROR>
                  <SHORT-NAME>E_NOT_OK</SHORT-NAME>
                  <ERROR-CODE>1</ERROR-CODE>
                </APPLICATION-ERROR>
              </POSSIBLE-ERRORS>
            </CLIENT-SERVER-INTERFACE>
[!ENDIF!][!//
[!IF "num:i($DltServiceAPI) >= $AUTOSAR_431"!][!//
[!IF "DltGeneral/DltPollingBufferRemainingSpace = 'true'"!]
            <CLIENT-SERVER-INTERFACE>
              <SHORT-NAME>DltBufferSizePolling</SHORT-NAME>
              <IS-SERVICE>true</IS-SERVICE>
              <OPERATIONS>
                <CLIENT-SERVER-OPERATION>
                  <SHORT-NAME>GetRemainingBufferSize</SHORT-NAME>
                  <ARGUMENTS>
                    <ARGUMENT-DATA-PROTOTYPE>
                      <SHORT-NAME>logChannelName</SHORT-NAME>
                      <TYPE-TREF DEST="IMPLEMENTATION-DATA-TYPE">/AUTOSAR_Dlt/ImplementationDataTypes/Dlt_LogChannelNameType</TYPE-TREF>
                      <DIRECTION>IN</DIRECTION>
                    </ARGUMENT-DATA-PROTOTYPE>
                    <ARGUMENT-DATA-PROTOTYPE>
                      <SHORT-NAME>AvailableBufferSize</SHORT-NAME>
                      <TYPE-TREF DEST="IMPLEMENTATION-DATA-TYPE">/AUTOSAR_Platform/ImplementationDataTypes/uint32</TYPE-TREF>
                      <DIRECTION>OUT</DIRECTION>
                    </ARGUMENT-DATA-PROTOTYPE>
                  </ARGUMENTS>
                  <POSSIBLE-ERROR-REFS>
                    <POSSIBLE-ERROR-REF DEST="APPLICATION-ERROR">/AUTOSAR_Dlt/PortInterfaces/DltBufferSizePolling/E_OK</POSSIBLE-ERROR-REF>
                    <POSSIBLE-ERROR-REF DEST="APPLICATION-ERROR">/AUTOSAR_Dlt/PortInterfaces/DltBufferSizePolling/E_NOT_OK</POSSIBLE-ERROR-REF>
                  </POSSIBLE-ERROR-REFS>
                </CLIENT-SERVER-OPERATION>
              </OPERATIONS>
              <POSSIBLE-ERRORS>
                <APPLICATION-ERROR>
                  <SHORT-NAME>E_OK</SHORT-NAME>
                  <ERROR-CODE>0</ERROR-CODE>
                </APPLICATION-ERROR>
                <APPLICATION-ERROR>
                  <SHORT-NAME>E_NOT_OK</SHORT-NAME>
                  <ERROR-CODE>1</ERROR-CODE>
                </APPLICATION-ERROR>
              </POSSIBLE-ERRORS>
            </CLIENT-SERVER-INTERFACE>
[!ENDIF!][!//
[!ENDIF!][!//
[!IF "(num:i(count(DltConfigSet/*/DltLogOutput/*/DltLogChannel/*/DltBufferThresholdForNotification)) != 0)"!][!//
            <CLIENT-SERVER-INTERFACE>
              <SHORT-NAME>BufferSizeThresholdReached</SHORT-NAME>
              <IS-SERVICE>true</IS-SERVICE>
              <OPERATIONS>
                <CLIENT-SERVER-OPERATION>
                  <SHORT-NAME>SendNotification</SHORT-NAME>
                  <ARGUMENTS>
                    <ARGUMENT-DATA-PROTOTYPE>
                      <SHORT-NAME>logChannelName</SHORT-NAME>
                      <TYPE-TREF DEST="IMPLEMENTATION-DATA-TYPE">/AUTOSAR_Dlt/ImplementationDataTypes/Dlt_LogChannelNameType</TYPE-TREF>
                      <DIRECTION>IN</DIRECTION>
                    </ARGUMENT-DATA-PROTOTYPE>
                  </ARGUMENTS>
                  <POSSIBLE-ERROR-REFS>
                    <POSSIBLE-ERROR-REF DEST="APPLICATION-ERROR">/AUTOSAR_Dlt/PortInterfaces/BufferSizeThresholdReached/E_NOT_OK</POSSIBLE-ERROR-REF>
                  </POSSIBLE-ERROR-REFS>
                </CLIENT-SERVER-OPERATION>
              </OPERATIONS>
              <POSSIBLE-ERRORS>
                <APPLICATION-ERROR>
                  <SHORT-NAME>E_NOT_OK</SHORT-NAME>
                  <ERROR-CODE>1</ERROR-CODE>
                </APPLICATION-ERROR>
              </POSSIBLE-ERRORS>
            </CLIENT-SERVER-INTERFACE>
[!ENDIF!][!//
          </ELEMENTS>
        </AR-PACKAGE>
      </AR-PACKAGES>
    </AR-PACKAGE>
  </AR-PACKAGES>
</AUTOSAR>
