AUTOSAR XML (schema 00046)
package /TS_TxDxM6I5R0
  module config DemRecConfigurationDtcGroupsOpCycle: definition=Dem
    DemGeneral
      5 x DemGroupOfDTC:
        DEM_DTC_GROUP_EMISSION_REL_DTCS: DemGroupDTCs=0
        DEM_DTC_GROUP_POWERTRAIN_DTCS: DemGroupDTCs=2
        DEM_DTC_GROUP_CHASSIS_DTCS: DemGroupDTCs=4
        DEM_DTC_GROUP_BODY_DTCS: DemGroupDTCs=6
        DEM_DTC_GROUP_NETWORK_COM_DTCS: DemGroupDTCs=8
      DEM_OPCYC_POWER (DemOperationCycle): DemOperationCycleType=DEM_OPCYC_POWER
