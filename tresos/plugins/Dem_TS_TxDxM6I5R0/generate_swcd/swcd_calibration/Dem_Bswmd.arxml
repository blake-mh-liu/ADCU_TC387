[part 1 of 2]
<?xml version="1.0" encoding="ISO-8859-1"?>
[!AUTOSPACING!][!//
[!INCLUDE "../../generate_common/Dem_Include.m"!]
[!VAR "NumberIndicatorAttribute" = "count(DemConfigSet/eb-list::*/DemEventParameter/eb-list::*/DemEventClass/DemIndicatorAttribute/eb-list::*)"!][!//
[!CALL "CREATE_DTCCLASS_LIST_FROM_EVENTS"!][!//
[!IF "DemGeneral/DemEventCombinationSupport = 'DEM_EVCOMB_TYPE1'"!][!//
  [!CALL "CALC_DESCRIPTION", "Array" = "$DTCDescStr"!][!//
[!ENDIF!][!//
[!CALL "CALC_DESCRIPTION", "Array" = "$EventDescStr"!][!//
[!CALL "CALCULATE_MULTICORE_SETTINGS"!][!//
[!IF "$CalibrationSupport = 'true'"!][!//
  [!CALL "DEBOUNCE_COUNTER_GET_CLASS_COUNT"!][!//
  [!CALL "DEBOUNCE_TIME_GET_CLASS_COUNT"!][!//
  [!CALL "GET_NUMBER_RG_EVENTS"!]
  [!IF "node:existsAndTrue(as:modconf('Dem')[1]/DemGeneral/DemEventDisplacementSupport)"!]
    [!CALL "GET_NUMBER_OF_EVENT_PRIORITIES"!][!//
  [!ENDIF!]
  [!CALL "GET_NUMBER_OF_INDICATOR_CLASSES_WITH_DEMMAXNUMBERINDICATORCLASSES"!][!//
[!ENDIF!]

<AUTOSAR xmlns="http://autosar.org/schema/r4.0"
  xmlns:xsi="http://www.w3.org/2001/XMLSchema-instance"
  xsi:schemaLocation="http://autosar.org/schema/r4.0 AUTOSAR_4-1-3.xsd">
  <AR-PACKAGES>
    <AR-PACKAGE>
      <SHORT-NAME>AUTOSAR_Dem</SHORT-NAME>
      <AR-PACKAGES>
        <AR-PACKAGE>
          <SHORT-NAME>CompuMethods</SHORT-NAME>
          <ELEMENTS>
[!IF "$CalibrationSupport = 'true'"!]
  [!VAR "OBDSupport" = "node:value('DemGeneral/DemOBDSupport')"!]
  [!VAR "FreezeFrameRecordCapture" = "node:value('DemGeneral/DemFreezeFrameCapture')"!]
  [!IF "($OBDSupport = 'true') or ($FreezeFrameRecordCapture = 'DEM_TRIGGER_ON_FDC_THRESHOLD')"!][!//
            <COMPU-METHOD>
              <SHORT-NAME>CM_MinRatioEvent</SHORT-NAME>
              <CATEGORY>TEXTTABLE</CATEGORY>
              <COMPU-INTERNAL-TO-PHYS>
                <COMPU-SCALES>
                  <COMPU-SCALE>
                    <LOWER-LIMIT INTERVAL-TYPE="CLOSED">0</LOWER-LIMIT>
                    <UPPER-LIMIT INTERVAL-TYPE="CLOSED">0</UPPER-LIMIT>
                    <COMPU-CONST>
                      <VT>DEM_MIN_RATIO_EVENT_FALSE</VT>
                    </COMPU-CONST>
                  </COMPU-SCALE>
                  <COMPU-SCALE>
                    <LOWER-LIMIT INTERVAL-TYPE="CLOSED">1</LOWER-LIMIT>
                    <UPPER-LIMIT INTERVAL-TYPE="CLOSED">1</UPPER-LIMIT>
                    <COMPU-CONST>
                      <VT>DEM_MIN_RATIO_EVENT_TRUE</VT>
                    </COMPU-CONST>
                  </COMPU-SCALE>
                </COMPU-SCALES>
              </COMPU-INTERNAL-TO-PHYS>
            </COMPU-METHOD>
            <COMPU-METHOD>
              <SHORT-NAME>CM_FreezeFrameUpdate</SHORT-NAME>
              <CATEGORY>TEXTTABLE</CATEGORY>
              <COMPU-INTERNAL-TO-PHYS>
                <COMPU-SCALES>
                  <COMPU-SCALE>
                    <LOWER-LIMIT INTERVAL-TYPE="CLOSED">0</LOWER-LIMIT>
                    <UPPER-LIMIT INTERVAL-TYPE="CLOSED">0</UPPER-LIMIT>
                    <COMPU-CONST>
                      <VT>DEM_FREEZE_FRAME_UPDATE_FALSE</VT>
                    </COMPU-CONST>
                  </COMPU-SCALE>
                  <COMPU-SCALE>
                    <LOWER-LIMIT INTERVAL-TYPE="CLOSED">1</LOWER-LIMIT>
                    <UPPER-LIMIT INTERVAL-TYPE="CLOSED">1</UPPER-LIMIT>
                    <COMPU-CONST>
                      <VT>DEM_FREEZE_FRAME_UPDATE_TRUE</VT>
                    </COMPU-CONST>
                  </COMPU-SCALE>
                </COMPU-SCALES>
              </COMPU-INTERNAL-TO-PHYS>
            </COMPU-METHOD>
  [!ENDIF!]
            <COMPU-METHOD>
              <SHORT-NAME>CM_DemDTCSeverity</SHORT-NAME>
              <CATEGORY>TEXTTABLE</CATEGORY>
              <COMPU-INTERNAL-TO-PHYS>
                <COMPU-SCALES>
                  <COMPU-SCALE>
                    <LOWER-LIMIT INTERVAL-TYPE="CLOSED">0</LOWER-LIMIT>
                    <UPPER-LIMIT INTERVAL-TYPE="CLOSED">0</UPPER-LIMIT>
                    <COMPU-CONST>
                      <VT>DEM_DTC_SEV_NO_SEVERITY</VT>
                    </COMPU-CONST>
                  </COMPU-SCALE>
                  <COMPU-SCALE>
                    <LOWER-LIMIT INTERVAL-TYPE="CLOSED">1</LOWER-LIMIT>
                    <UPPER-LIMIT INTERVAL-TYPE="CLOSED">1</UPPER-LIMIT>
                    <COMPU-CONST>
                      <VT>DEM_DTC_SEV_MAINTENANCE_ONLY</VT>
                    </COMPU-CONST>
                  </COMPU-SCALE>
                  <COMPU-SCALE>
                    <LOWER-LIMIT INTERVAL-TYPE="CLOSED">2</LOWER-LIMIT>
                    <UPPER-LIMIT INTERVAL-TYPE="CLOSED">2</UPPER-LIMIT>
                    <COMPU-CONST>
                      <VT>DEM_DTC_SEV_CHECK_AT_NEXT_HALT</VT>
                    </COMPU-CONST>
                  </COMPU-SCALE>
                  <COMPU-SCALE>
                    <LOWER-LIMIT INTERVAL-TYPE="CLOSED">3</LOWER-LIMIT>
                    <UPPER-LIMIT INTERVAL-TYPE="CLOSED">3</UPPER-LIMIT>
                    <COMPU-CONST>
                      <VT>DEM_DTC_SEV_IMMEDIATELY</VT>
                    </COMPU-CONST>
                  </COMPU-SCALE>
                </COMPU-SCALES>
              </COMPU-INTERNAL-TO-PHYS>
            </COMPU-METHOD>
  [!IF "$OBDSupport = 'true'"!]
    [!IF "((node:exists(DemGeneral/DemObdVariant)) and (DemGeneral/DemObdVariant = 'DEM_OBD_VARIANT_OBD_CLASSIC')) and
      (not(node:exists(DemGeneral/DemCalloutObdVariantFnc))) and
      (DemGeneral/DemReadinessGroupCalibrationConfigKind = 'DEM_NUMBER_OF_SLOTS_COMMON_CONFIG')"!]
            <COMPU-METHOD>
              <SHORT-NAME>CM_DemOBDEngineType</SHORT-NAME>
              <CATEGORY>TEXTTABLE</CATEGORY>
              <COMPU-INTERNAL-TO-PHYS>
                <COMPU-SCALES>
                  <COMPU-SCALE>
                    <LOWER-LIMIT INTERVAL-TYPE="CLOSED">0</LOWER-LIMIT>
                    <UPPER-LIMIT INTERVAL-TYPE="CLOSED">0</UPPER-LIMIT>
                    <COMPU-CONST>
                      <VT>DEM_IGNITION_SPARK</VT>
                    </COMPU-CONST>
                  </COMPU-SCALE>
                  <COMPU-SCALE>
                    <LOWER-LIMIT INTERVAL-TYPE="CLOSED">1</LOWER-LIMIT>
                    <UPPER-LIMIT INTERVAL-TYPE="CLOSED">1</UPPER-LIMIT>
                    <COMPU-CONST>
                      <VT>DEM_IGNITION_COMPRESSION</VT>
                    </COMPU-CONST>
                  </COMPU-SCALE>
                </COMPU-SCALES>
              </COMPU-INTERNAL-TO-PHYS>
            </COMPU-METHOD>
    [!ENDIF!]
    [!IF "$DTCClassAvailable = 'true'"!]
            <COMPU-METHOD>
              <SHORT-NAME>CM_DemWWHOBDDTCClass</SHORT-NAME>
              <CATEGORY>TEXTTABLE</CATEGORY>
              <COMPU-INTERNAL-TO-PHYS>
                <COMPU-SCALES>
                  <COMPU-SCALE>
                    <LOWER-LIMIT INTERVAL-TYPE="CLOSED">0</LOWER-LIMIT>
                    <UPPER-LIMIT INTERVAL-TYPE="CLOSED">0</UPPER-LIMIT>
                    <COMPU-CONST>
                      <VT>DEM_DTC_WWHOBD_CLASS_UNSUPPORTED</VT>
                    </COMPU-CONST>
                  </COMPU-SCALE>
                  <COMPU-SCALE>
                    <LOWER-LIMIT INTERVAL-TYPE="CLOSED">1</LOWER-LIMIT>
                    <UPPER-LIMIT INTERVAL-TYPE="CLOSED">1</UPPER-LIMIT>
                    <COMPU-CONST>
                      <VT>DEM_DTC_WWHOBD_CLASS_NOCLASS</VT>
                    </COMPU-CONST>
                  </COMPU-SCALE>
                  <COMPU-SCALE>
                    <LOWER-LIMIT INTERVAL-TYPE="CLOSED">2</LOWER-LIMIT>
                    <UPPER-LIMIT INTERVAL-TYPE="CLOSED">2</UPPER-LIMIT>
                    <COMPU-CONST>
                      <VT>DEM_DTC_WWHOBD_CLASS_A</VT>
                    </COMPU-CONST>
                  </COMPU-SCALE>
                  <COMPU-SCALE>
                    <LOWER-LIMIT INTERVAL-TYPE="CLOSED">3</LOWER-LIMIT>
                    <UPPER-LIMIT INTERVAL-TYPE="CLOSED">3</UPPER-LIMIT>
                    <COMPU-CONST>
                      <VT>DEM_DTC_WWHOBD_CLASS_B1</VT>
                    </COMPU-CONST>
                  </COMPU-SCALE>
                  <COMPU-SCALE>
                    <LOWER-LIMIT INTERVAL-TYPE="CLOSED">4</LOWER-LIMIT>
                    <UPPER-LIMIT INTERVAL-TYPE="CLOSED">4</UPPER-LIMIT>
                    <COMPU-CONST>
                      <VT>DEM_DTC_WWHOBD_CLASS_B2</VT>
                    </COMPU-CONST>
                  </COMPU-SCALE>
                  <COMPU-SCALE>
                    <LOWER-LIMIT INTERVAL-TYPE="CLOSED">5</LOWER-LIMIT>
                    <UPPER-LIMIT INTERVAL-TYPE="CLOSED">5</UPPER-LIMIT>
                    <COMPU-CONST>
                      <VT>DEM_DTC_WWHOBD_CLASS_C</VT>
                    </COMPU-CONST>
                  </COMPU-SCALE>
                </COMPU-SCALES>
              </COMPU-INTERNAL-TO-PHYS>
            </COMPU-METHOD>
    [!ENDIF!]
            <COMPU-METHOD>
              <SHORT-NAME>CM_DemOBDForceMisfireMonitoringReady</SHORT-NAME>
              <CATEGORY>TEXTTABLE</CATEGORY>
              <COMPU-INTERNAL-TO-PHYS>
                <COMPU-SCALES>
                  <COMPU-SCALE>
                    <LOWER-LIMIT INTERVAL-TYPE="CLOSED">0</LOWER-LIMIT>
                    <UPPER-LIMIT INTERVAL-TYPE="CLOSED">0</UPPER-LIMIT>
                    <COMPU-CONST>
                      <VT>DEM_OBD_FORCE_MISFIRE_MONITORING_READY_TRUE</VT>
                    </COMPU-CONST>
                  </COMPU-SCALE>
                  <COMPU-SCALE>
                    <LOWER-LIMIT INTERVAL-TYPE="CLOSED">1</LOWER-LIMIT>
                    <UPPER-LIMIT INTERVAL-TYPE="CLOSED">1</UPPER-LIMIT>
                    <COMPU-CONST>
                      <VT>DEM_OBD_FORCE_MISFIRE_MONITORING_READY_FALSE</VT>
                    </COMPU-CONST>
                  </COMPU-SCALE>
                </COMPU-SCALES>
              </COMPU-INTERNAL-TO-PHYS>
            </COMPU-METHOD>
            <COMPU-METHOD>
              <SHORT-NAME>CM_DemOBDForceFuelSysMonitoringReady</SHORT-NAME>
              <CATEGORY>TEXTTABLE</CATEGORY>
              <COMPU-INTERNAL-TO-PHYS>
                <COMPU-SCALES>
                  <COMPU-SCALE>
                    <LOWER-LIMIT INTERVAL-TYPE="CLOSED">0</LOWER-LIMIT>
                    <UPPER-LIMIT INTERVAL-TYPE="CLOSED">0</UPPER-LIMIT>
                    <COMPU-CONST>
                      <VT>DEM_OBD_FORCE_FUEL_SYS_MONITORING_READY_TRUE</VT>
                    </COMPU-CONST>
                  </COMPU-SCALE>
                  <COMPU-SCALE>
                    <LOWER-LIMIT INTERVAL-TYPE="CLOSED">1</LOWER-LIMIT>
                    <UPPER-LIMIT INTERVAL-TYPE="CLOSED">1</UPPER-LIMIT>
                    <COMPU-CONST>
                      <VT>DEM_OBD_FORCE_FUEL_SYS_MONITORING_READY_FALSE</VT>
                    </COMPU-CONST>
                  </COMPU-SCALE>
                </COMPU-SCALES>
              </COMPU-INTERNAL-TO-PHYS>
            </COMPU-METHOD>
            <COMPU-METHOD>
              <SHORT-NAME>CM_DemOBDForceCCMonitoringReady</SHORT-NAME>
              <CATEGORY>TEXTTABLE</CATEGORY>
              <COMPU-INTERNAL-TO-PHYS>
                <COMPU-SCALES>
                  <COMPU-SCALE>
                    <LOWER-LIMIT INTERVAL-TYPE="CLOSED">0</LOWER-LIMIT>
                    <UPPER-LIMIT INTERVAL-TYPE="CLOSED">0</UPPER-LIMIT>
                    <COMPU-CONST>
                      <VT>DEM_OBD_FORCE_CC_MONITORING_READY_TRUE</VT>
                    </COMPU-CONST>
                  </COMPU-SCALE>
                  <COMPU-SCALE>
                    <LOWER-LIMIT INTERVAL-TYPE="CLOSED">1</LOWER-LIMIT>
                    <UPPER-LIMIT INTERVAL-TYPE="CLOSED">1</UPPER-LIMIT>
                    <COMPU-CONST>
                      <VT>DEM_OBD_FORCE_CC_MONITORING_READY_FALSE</VT>
                    </COMPU-CONST>
                  </COMPU-SCALE>
                </COMPU-SCALES>
              </COMPU-INTERNAL-TO-PHYS>
            </COMPU-METHOD>
            <COMPU-METHOD>
              <SHORT-NAME>CM_DemOBDSetCCMenabled</SHORT-NAME>
              <CATEGORY>TEXTTABLE</CATEGORY>
              <COMPU-INTERNAL-TO-PHYS>
                <COMPU-SCALES>
                  <COMPU-SCALE>
                    <LOWER-LIMIT INTERVAL-TYPE="CLOSED">0</LOWER-LIMIT>
                    <UPPER-LIMIT INTERVAL-TYPE="CLOSED">0</UPPER-LIMIT>
                    <COMPU-CONST>
                      <VT>DEM_OBD_SET_CCM_DISABLED</VT>
                    </COMPU-CONST>
                  </COMPU-SCALE>
                  <COMPU-SCALE>
                    <LOWER-LIMIT INTERVAL-TYPE="CLOSED">1</LOWER-LIMIT>
                    <UPPER-LIMIT INTERVAL-TYPE="CLOSED">1</UPPER-LIMIT>
                    <COMPU-CONST>
                      <VT>DEM_OBD_SET_CCM_ENABLED</VT>
                    </COMPU-CONST>
                  </COMPU-SCALE>
                </COMPU-SCALES>
              </COMPU-INTERNAL-TO-PHYS>
            </COMPU-METHOD>
  [!ENDIF!]
            <COMPU-METHOD>
              <SHORT-NAME>CM_DemEventEnabled</SHORT-NAME>
              <CATEGORY>TEXTTABLE</CATEGORY>
              <COMPU-INTERNAL-TO-PHYS>
                <COMPU-SCALES>
                  <COMPU-SCALE>
                    <LOWER-LIMIT INTERVAL-TYPE="CLOSED">0</LOWER-LIMIT>
                    <UPPER-LIMIT INTERVAL-TYPE="CLOSED">0</UPPER-LIMIT>
                    <COMPU-CONST>
                      <VT>DEM_EVENT_AVAILABILITY_DISABLED</VT>
                    </COMPU-CONST>
                  </COMPU-SCALE>
                  <COMPU-SCALE>
                    <LOWER-LIMIT INTERVAL-TYPE="CLOSED">1</LOWER-LIMIT>
                    <UPPER-LIMIT INTERVAL-TYPE="CLOSED">1</UPPER-LIMIT>
                    <COMPU-CONST>
                      <VT>DEM_EVENT_AVAILABILITY_ENABLED</VT>
                    </COMPU-CONST>
                  </COMPU-SCALE>
                </COMPU-SCALES>
              </COMPU-INTERNAL-TO-PHYS>
            </COMPU-METHOD>
            <COMPU-METHOD>
              <SHORT-NAME>CM_OperationCycle</SHORT-NAME>
              <CATEGORY>TEXTTABLE</CATEGORY>
              <COMPU-INTERNAL-TO-PHYS>
                <COMPU-SCALES>
  [!VAR "CycCtr" = "0"!]
  [!LOOP "DemGeneral/DemOperationCycle/eb-list::*"!]
                  <COMPU-SCALE>
                    <LOWER-LIMIT INTERVAL-TYPE="CLOSED">[!"num:integer($CycCtr)"!]</LOWER-LIMIT>
                    <UPPER-LIMIT INTERVAL-TYPE="CLOSED">[!"num:integer($CycCtr)"!]</UPPER-LIMIT>
                    <COMPU-CONST>
                      <VT>[!"as:name(.)"!]</VT>
                    </COMPU-CONST>
                  </COMPU-SCALE>
    [!VAR "CycCtr" = "$CycCtr + 1"!]
  [!ENDLOOP!]
                </COMPU-SCALES>
              </COMPU-INTERNAL-TO-PHYS>
            </COMPU-METHOD>
            <COMPU-METHOD>
              <SHORT-NAME>CM_DemIndicatorClassEnabled</SHORT-NAME>
              <CATEGORY>TEXTTABLE</CATEGORY>
              <COMPU-INTERNAL-TO-PHYS>
                <COMPU-SCALES>
                  <COMPU-SCALE>
                    <LOWER-LIMIT INTERVAL-TYPE="CLOSED">0</LOWER-LIMIT>
                    <UPPER-LIMIT INTERVAL-TYPE="CLOSED">0</UPPER-LIMIT>
                    <COMPU-CONST>
                      <VT>DEM_INDICATORCLASS_DISABLED</VT>
                    </COMPU-CONST>
                  </COMPU-SCALE>
                  <COMPU-SCALE>
                    <LOWER-LIMIT INTERVAL-TYPE="CLOSED">1</LOWER-LIMIT>
                    <UPPER-LIMIT INTERVAL-TYPE="CLOSED">1</UPPER-LIMIT>
                    <COMPU-CONST>
                      <VT>DEM_INDICATORCLASS_ENABLED</VT>
                    </COMPU-CONST>
                  </COMPU-SCALE>
                </COMPU-SCALES>
              </COMPU-INTERNAL-TO-PHYS>
            </COMPU-METHOD>
            <COMPU-METHOD>
              <SHORT-NAME>CM_DemIndicatorClassBehaviour</SHORT-NAME>
              <CATEGORY>TEXTTABLE</CATEGORY>
              <COMPU-INTERNAL-TO-PHYS>
                <COMPU-SCALES>
                  <COMPU-SCALE>
                    <LOWER-LIMIT INTERVAL-TYPE="CLOSED">0</LOWER-LIMIT>
                    <UPPER-LIMIT INTERVAL-TYPE="CLOSED">0</UPPER-LIMIT>
                    <COMPU-CONST>
                      <VT>DEM_INDICATOR_OFF</VT>
                    </COMPU-CONST>
                  </COMPU-SCALE>
                  <COMPU-SCALE>
                    <LOWER-LIMIT INTERVAL-TYPE="CLOSED">1</LOWER-LIMIT>
                    <UPPER-LIMIT INTERVAL-TYPE="CLOSED">1</UPPER-LIMIT>
                    <COMPU-CONST>
                      <VT>DEM_INDICATOR_CONTINUOUS</VT>
                    </COMPU-CONST>
                  </COMPU-SCALE>
                  <COMPU-SCALE>
                    <LOWER-LIMIT INTERVAL-TYPE="CLOSED">2</LOWER-LIMIT>
                    <UPPER-LIMIT INTERVAL-TYPE="CLOSED">2</UPPER-LIMIT>
                    <COMPU-CONST>
                      <VT>DEM_INDICATOR_BLINKING</VT>
                    </COMPU-CONST>
                  </COMPU-SCALE>
                  <COMPU-SCALE>
                    <LOWER-LIMIT INTERVAL-TYPE="CLOSED">3</LOWER-LIMIT>
                    <UPPER-LIMIT INTERVAL-TYPE="CLOSED">3</UPPER-LIMIT>
                    <COMPU-CONST>
                      <VT>DEM_INDICATOR_BLINK_CONT</VT>
                    </COMPU-CONST>
                  </COMPU-SCALE>
                  <COMPU-SCALE>
                    <LOWER-LIMIT INTERVAL-TYPE="CLOSED">4</LOWER-LIMIT>
                    <UPPER-LIMIT INTERVAL-TYPE="CLOSED">4</UPPER-LIMIT>
                    <COMPU-CONST>
                      <VT>DEM_INDICATOR_SLOW_FLASH</VT>
                    </COMPU-CONST>
                  </COMPU-SCALE>
                  <COMPU-SCALE>
                    <LOWER-LIMIT INTERVAL-TYPE="CLOSED">5</LOWER-LIMIT>
                    <UPPER-LIMIT INTERVAL-TYPE="CLOSED">5</UPPER-LIMIT>
                    <COMPU-CONST>
                      <VT>DEM_INDICATOR_FAST_FLASH</VT>
                    </COMPU-CONST>
                  </COMPU-SCALE>
                </COMPU-SCALES>
              </COMPU-INTERNAL-TO-PHYS>
            </COMPU-METHOD>
  [!IF "$AgingAllowedSeperateFlag = 'true'"!]
            <COMPU-METHOD>
              <SHORT-NAME>CM_DemAgingAllowed</SHORT-NAME>
              <CATEGORY>TEXTTABLE</CATEGORY>
              <COMPU-INTERNAL-TO-PHYS>
                <COMPU-SCALES>
                  <COMPU-SCALE>
                    <LOWER-LIMIT INTERVAL-TYPE="CLOSED">0</LOWER-LIMIT>
                    <UPPER-LIMIT INTERVAL-TYPE="CLOSED">0</UPPER-LIMIT>
                    <COMPU-CONST>
                      <VT>DEM_AGING_ALLOWED_FALSE</VT>
                    </COMPU-CONST>
                  </COMPU-SCALE>
                  <COMPU-SCALE>
                    <LOWER-LIMIT INTERVAL-TYPE="CLOSED">1</LOWER-LIMIT>
                    <UPPER-LIMIT INTERVAL-TYPE="CLOSED">1</UPPER-LIMIT>
                    <COMPU-CONST>
                      <VT>DEM_AGING_ALLOWED_TRUE</VT>
                    </COMPU-CONST>
                  </COMPU-SCALE>
                </COMPU-SCALES>
              </COMPU-INTERNAL-TO-PHYS>
            </COMPU-METHOD>
  [!ENDIF!]
  [!IF "$DebounceCounterClassCount > 0"!]
            <COMPU-METHOD>
              <SHORT-NAME>CM_DemDebounceCounterJumpActiviationMethod</SHORT-NAME>
              <CATEGORY>TEXTTABLE</CATEGORY>
              <COMPU-INTERNAL-TO-PHYS>
                <COMPU-SCALES>
                  <COMPU-SCALE>
                    <LOWER-LIMIT INTERVAL-TYPE="CLOSED">0</LOWER-LIMIT>
                    <UPPER-LIMIT INTERVAL-TYPE="CLOSED">0</UPPER-LIMIT>
                    <COMPU-CONST>
                      <VT>DEM_DEBOUNCECOUNTER_JUMPMETHOD_DEACTIVATED</VT>
                    </COMPU-CONST>
                  </COMPU-SCALE>
                  <COMPU-SCALE>
                    <LOWER-LIMIT INTERVAL-TYPE="CLOSED">1</LOWER-LIMIT>
                    <UPPER-LIMIT INTERVAL-TYPE="CLOSED">1</UPPER-LIMIT>
                    <COMPU-CONST>
                      <VT>DEM_DEBOUNCECOUNTER_JUMPMETHOD_ACTIVATED</VT>
                    </COMPU-CONST>
                  </COMPU-SCALE>
                </COMPU-SCALES>
              </COMPU-INTERNAL-TO-PHYS>
            </COMPU-METHOD>
  [!ENDIF!]
[!ENDIF!]
          </ELEMENTS>
        </AR-PACKAGE>
        <AR-PACKAGE>
          <SHORT-NAME>DataConstrs</SHORT-NAME>
          <ELEMENTS>
[!IF "$CalibrationSupport = 'true'"!]
  [!IF "$DebounceTimeClassCount > 0"!]
            <DATA-CONSTR>
              <SHORT-NAME>CONSTR_DebounceTimeClassIdx</SHORT-NAME>
              <DATA-CONSTR-RULES>
                <DATA-CONSTR-RULE>
                  <INTERNAL-CONSTRS>
                    <LOWER-LIMIT INTERVAL-TYPE="CLOSED">0</LOWER-LIMIT>
                    <UPPER-LIMIT INTERVAL-TYPE="CLOSED">[!"num:integer($DebounceTimeClassCount - 1)"!]</UPPER-LIMIT>
                  </INTERNAL-CONSTRS>
                </DATA-CONSTR-RULE>
              </DATA-CONSTR-RULES>
            </DATA-CONSTR>
  [!ENDIF!]
            <DATA-CONSTR>
              <SHORT-NAME>CONSTR_DemUdsDTC</SHORT-NAME>
              <DATA-CONSTR-RULES>
                <DATA-CONSTR-RULE>
                  <INTERNAL-CONSTRS>
                    <LOWER-LIMIT INTERVAL-TYPE="CLOSED">0x00000000</LOWER-LIMIT>
                    <UPPER-LIMIT INTERVAL-TYPE="CLOSED">0x00FFFFFF</UPPER-LIMIT>
                  </INTERNAL-CONSTRS>
                </DATA-CONSTR-RULE>
              </DATA-CONSTR-RULES>
            </DATA-CONSTR>
  [!IF "$ObdUdsDtcSeparationSupport = 'true'"!][!//
            <DATA-CONSTR>
              <SHORT-NAME>CONSTR_DemDtcValue3Byte</SHORT-NAME>
              <DATA-CONSTR-RULES>
                <DATA-CONSTR-RULE>
                  <INTERNAL-CONSTRS>
                    <LOWER-LIMIT INTERVAL-TYPE="CLOSED">0x00000000</LOWER-LIMIT>
                    <UPPER-LIMIT INTERVAL-TYPE="CLOSED">0x00FFFEFF</UPPER-LIMIT>
                  </INTERNAL-CONSTRS>
                </DATA-CONSTR-RULE>
              </DATA-CONSTR-RULES>
            </DATA-CONSTR>
  [!ENDIF!]
  [!IF "(num:integer($EventFailureClassIdx) > 0)"!]
            <DATA-CONSTR>
              <SHORT-NAME>CONSTR_EventFailureCycleCounterThreshold</SHORT-NAME>
              <DATA-CONSTR-RULES>
                <DATA-CONSTR-RULE>
                  <INTERNAL-CONSTRS>
                    <LOWER-LIMIT INTERVAL-TYPE="CLOSED">0</LOWER-LIMIT>
                    <UPPER-LIMIT INTERVAL-TYPE="CLOSED">254</UPPER-LIMIT>
                  </INTERNAL-CONSTRS>
                </DATA-CONSTR-RULE>
              </DATA-CONSTR-RULES>
            </DATA-CONSTR>
    [!IF "($CalibrationWithEvCombSupport = 'true')"!]
            <DATA-CONSTR>
              <SHORT-NAME>CONSTR_EventFailureClassIdx</SHORT-NAME>
              <DATA-CONSTR-RULES>
                <DATA-CONSTR-RULE>
                  <INTERNAL-CONSTRS>
                    <LOWER-LIMIT INTERVAL-TYPE="CLOSED">0</LOWER-LIMIT>
                    <UPPER-LIMIT INTERVAL-TYPE="CLOSED">[!"num:integer($EventFailureClassIdx)"!]</UPPER-LIMIT>
                  </INTERNAL-CONSTRS>
                </DATA-CONSTR-RULE>
              </DATA-CONSTR-RULES>
            </DATA-CONSTR>
    [!ENDIF!]
  [!ENDIF!]
            <DATA-CONSTR>
              <SHORT-NAME>CONSTR_DemFFClassIdx</SHORT-NAME>
              <DATA-CONSTR-RULES>
                <DATA-CONSTR-RULE>
                  <INTERNAL-CONSTRS>
                    <LOWER-LIMIT INTERVAL-TYPE="CLOSED">0</LOWER-LIMIT>
                    <UPPER-LIMIT INTERVAL-TYPE="CLOSED">[!"num:integer(bit:shl(1,$CalFFClassIdxWidth)-1)"!]</UPPER-LIMIT>
                  </INTERNAL-CONSTRS>
                </DATA-CONSTR-RULE>
              </DATA-CONSTR-RULES>
            </DATA-CONSTR>
  [!IF "$CalibrationWithoutEvCombSupport = 'true'"!]
            <DATA-CONSTR>
              <SHORT-NAME>CONSTR_DemEventClassIndex</SHORT-NAME>
              <DATA-CONSTR-RULES>
                <DATA-CONSTR-RULE>
                  <INTERNAL-CONSTRS>
                    <LOWER-LIMIT INTERVAL-TYPE="CLOSED">0</LOWER-LIMIT>
                    <UPPER-LIMIT INTERVAL-TYPE="CLOSED">[!"num:integer(bit:shl(1,$CalEventClassWidth)-1)"!]</UPPER-LIMIT>
                  </INTERNAL-CONSTRS>
                </DATA-CONSTR-RULE>
              </DATA-CONSTR-RULES>
            </DATA-CONSTR>
  [!ENDIF!]
            <DATA-CONSTR>
              <SHORT-NAME>CONSTR_DemDTCFunctionalUnit</SHORT-NAME>
              <DATA-CONSTR-RULES>
                <DATA-CONSTR-RULE>
                  <INTERNAL-CONSTRS>
                    <LOWER-LIMIT INTERVAL-TYPE="CLOSED">0</LOWER-LIMIT>
                    <UPPER-LIMIT INTERVAL-TYPE="CLOSED">[!"num:integer(bit:shl(1,$CalFunctionalUnitWidth)-1)"!]</UPPER-LIMIT>
                  </INTERNAL-CONSTRS>
                </DATA-CONSTR-RULE>
              </DATA-CONSTR-RULES>
            </DATA-CONSTR>
  [!IF "node:existsAndTrue(as:modconf('Dem')[1]/DemGeneral/DemEventDisplacementSupport)"!]
            <DATA-CONSTR>
              <SHORT-NAME>CONSTR_EventPriorityIdx</SHORT-NAME>
              <DATA-CONSTR-RULES>
                <DATA-CONSTR-RULE>
                  <INTERNAL-CONSTRS>
                    <LOWER-LIMIT INTERVAL-TYPE="CLOSED">0</LOWER-LIMIT>
                    <UPPER-LIMIT INTERVAL-TYPE="CLOSED">[!"num:integer($NumberOfPriorities - 1)"!]</UPPER-LIMIT>
                  </INTERNAL-CONSTRS>
                </DATA-CONSTR-RULE>
              </DATA-CONSTR-RULES>
            </DATA-CONSTR>
  [!ENDIF!]
            <DATA-CONSTR>
              <SHORT-NAME>CONSTR_IndicatorClassIdx</SHORT-NAME>
              <DATA-CONSTR-RULES>
                <DATA-CONSTR-RULE>
                  <INTERNAL-CONSTRS>
                    <LOWER-LIMIT INTERVAL-TYPE="CLOSED">0</LOWER-LIMIT>
                    <UPPER-LIMIT INTERVAL-TYPE="CLOSED">[!"num:integer($NumberOfIndicatorClasses + 1)"!]</UPPER-LIMIT>
                  </INTERNAL-CONSTRS>
                </DATA-CONSTR-RULE>
              </DATA-CONSTR-RULES>
            </DATA-CONSTR>
  [!IF "$NumberOfIndicatorClasses > 0"!]
            <DATA-CONSTR>
              <SHORT-NAME>CONSTR_IndicatorId</SHORT-NAME>
              <DATA-CONSTR-RULES>
                <DATA-CONSTR-RULE>
                  <INTERNAL-CONSTRS>
                    <LOWER-LIMIT INTERVAL-TYPE="CLOSED">0</LOWER-LIMIT>
                    <UPPER-LIMIT INTERVAL-TYPE="CLOSED">[!"num:integer(count(DemGeneral/DemIndicator/eb-list::*) - 1)"!]</UPPER-LIMIT>
                  </INTERNAL-CONSTRS>
                </DATA-CONSTR-RULE>
              </DATA-CONSTR-RULES>
            </DATA-CONSTR>
  [!ENDIF!]
            <DATA-CONSTR>
              <SHORT-NAME>CONSTR_HealingCycleThreshold</SHORT-NAME>
              <DATA-CONSTR-RULES>
                <DATA-CONSTR-RULE>
                  <INTERNAL-CONSTRS>
  [!IF "(DemGeneral/DemFreezeFrameCapture = 'DEM_TRIGGER_ON_FDC_THRESHOLD') or
      (DemGeneral/DemExtendedDataCapture = 'DEM_TRIGGER_ON_FDC_THRESHOLD')"!]
                    <LOWER-LIMIT INTERVAL-TYPE="CLOSED">1</LOWER-LIMIT>
  [!ELSE!]
                    <LOWER-LIMIT INTERVAL-TYPE="CLOSED">0</LOWER-LIMIT>
  [!ENDIF!]
                    <UPPER-LIMIT INTERVAL-TYPE="CLOSED">255</UPPER-LIMIT>
                  </INTERNAL-CONSTRS>
                </DATA-CONSTR-RULE>
              </DATA-CONSTR-RULES>
            </DATA-CONSTR>
  [!IF "$DebounceCounterClassCount > 0"!]
            <DATA-CONSTR>
              <SHORT-NAME>CONSTR_DebounceCounterClassIdx</SHORT-NAME>
              <DATA-CONSTR-RULES>
                <DATA-CONSTR-RULE>
                  <INTERNAL-CONSTRS>
                    <LOWER-LIMIT INTERVAL-TYPE="CLOSED">0</LOWER-LIMIT>
                    <UPPER-LIMIT INTERVAL-TYPE="CLOSED">[!"num:integer($DebounceCounterClassCount - 1)"!]</UPPER-LIMIT>
                  </INTERNAL-CONSTRS>
                </DATA-CONSTR-RULE>
              </DATA-CONSTR-RULES>
            </DATA-CONSTR>
            <DATA-CONSTR>
              <SHORT-NAME>CONSTR_DemDebounceCounterDecrementStepSize</SHORT-NAME>
              <DATA-CONSTR-RULES>
                <DATA-CONSTR-RULE>
                  <INTERNAL-CONSTRS>
                    <LOWER-LIMIT INTERVAL-TYPE="CLOSED">1</LOWER-LIMIT>
                    <UPPER-LIMIT INTERVAL-TYPE="CLOSED">32768</UPPER-LIMIT>
                  </INTERNAL-CONSTRS>
                </DATA-CONSTR-RULE>
              </DATA-CONSTR-RULES>
            </DATA-CONSTR>
            <DATA-CONSTR>
              <SHORT-NAME>CONSTR_DemDebounceCounterIncrementStepSize</SHORT-NAME>
              <DATA-CONSTR-RULES>
                <DATA-CONSTR-RULE>
                  <INTERNAL-CONSTRS>
                    <LOWER-LIMIT INTERVAL-TYPE="CLOSED">1</LOWER-LIMIT>
                    <UPPER-LIMIT INTERVAL-TYPE="CLOSED">32767</UPPER-LIMIT>
                  </INTERNAL-CONSTRS>
                </DATA-CONSTR-RULE>
              </DATA-CONSTR-RULES>
            </DATA-CONSTR>
            <DATA-CONSTR>
              <SHORT-NAME>CONSTR_DemDebounceCounterPassedThreshold</SHORT-NAME>
              <DATA-CONSTR-RULES>
                <DATA-CONSTR-RULE>
                  <INTERNAL-CONSTRS>
                    <LOWER-LIMIT INTERVAL-TYPE="CLOSED">-32768</LOWER-LIMIT>
                    <UPPER-LIMIT INTERVAL-TYPE="CLOSED">-1</UPPER-LIMIT>
                  </INTERNAL-CONSTRS>
                </DATA-CONSTR-RULE>
              </DATA-CONSTR-RULES>
            </DATA-CONSTR>
            <DATA-CONSTR>
              <SHORT-NAME>CONSTR_DemDebounceCounterFailedThreshold</SHORT-NAME>
              <DATA-CONSTR-RULES>
                <DATA-CONSTR-RULE>
                  <INTERNAL-CONSTRS>
                    <LOWER-LIMIT INTERVAL-TYPE="CLOSED">1</LOWER-LIMIT>
                    <UPPER-LIMIT INTERVAL-TYPE="CLOSED">32767</UPPER-LIMIT>
                  </INTERNAL-CONSTRS>
                </DATA-CONSTR-RULE>
              </DATA-CONSTR-RULES>
            </DATA-CONSTR>
            <DATA-CONSTR>
              <SHORT-NAME>CONSTR_DemDebounceCounterUnconfirmedThreshold</SHORT-NAME>
              <DATA-CONSTR-RULES>
                <DATA-CONSTR-RULE>
                  <INTERNAL-CONSTRS>
                    <LOWER-LIMIT INTERVAL-TYPE="CLOSED">1</LOWER-LIMIT>
                    <UPPER-LIMIT INTERVAL-TYPE="CLOSED">32767</UPPER-LIMIT>
                  </INTERNAL-CONSTRS>
                </DATA-CONSTR-RULE>
              </DATA-CONSTR-RULES>
            </DATA-CONSTR>
  [!ENDIF!]
            <DATA-CONSTR>
              <SHORT-NAME>CONSTR_DemValidEventIdRange</SHORT-NAME>
              <DATA-CONSTR-RULES>
                <DATA-CONSTR-RULE>
                  <INTERNAL-CONSTRS>
                    <LOWER-LIMIT INTERVAL-TYPE="CLOSED">1</LOWER-LIMIT>
                    <UPPER-LIMIT INTERVAL-TYPE="CLOSED">[!"num:integer($NumberOfConfiguredDemEvents)"!]</UPPER-LIMIT>
                  </INTERNAL-CONSTRS>
                </DATA-CONSTR-RULE>
              </DATA-CONSTR-RULES>
            </DATA-CONSTR>
  [!IF "$EventIdSlots > 0"!]
            <DATA-CONSTR>
              <SHORT-NAME>CONSTR_DemAllEventIdRange</SHORT-NAME>
              <DATA-CONSTR-RULES>
                <DATA-CONSTR-RULE>
                  <INTERNAL-CONSTRS>
                    <LOWER-LIMIT INTERVAL-TYPE="CLOSED">0</LOWER-LIMIT>
                    <UPPER-LIMIT INTERVAL-TYPE="CLOSED">[!"num:integer($NumberOfConfiguredDemEvents)"!]</UPPER-LIMIT>
                  </INTERNAL-CONSTRS>
                </DATA-CONSTR-RULE>
              </DATA-CONSTR-RULES>
            </DATA-CONSTR>
  [!ENDIF!]
  [!IF "(node:refexists(DemGeneral/DemCommonFFDataClassRef)) or
      (node:existsAndTrue(DemGeneral/DemDevFreezeFrameSupport))"!]
            <DATA-CONSTR>
              <SHORT-NAME>CONSTR_DemDevFFClassIdx</SHORT-NAME>
              <DATA-CONSTR-RULES>
                <DATA-CONSTR-RULE>
                  <INTERNAL-CONSTRS>
                    <LOWER-LIMIT INTERVAL-TYPE="CLOSED">0</LOWER-LIMIT>
                    <UPPER-LIMIT INTERVAL-TYPE="CLOSED">[!"num:integer($NumFFCls)"!]</UPPER-LIMIT>
                  </INTERNAL-CONSTRS>
                </DATA-CONSTR-RULE>
              </DATA-CONSTR-RULES>
            </DATA-CONSTR>
  [!ENDIF!]
  [!IF "node:exists(DemConfigSet/eb-list::*/DemEventParameter/eb-list::*[node:existsAndTrue(DemEventClass/DemAgingAllowed)])"!]
            <DATA-CONSTR>
              <SHORT-NAME>CONSTR_AgingCycleThreshold</SHORT-NAME>
              <DATA-CONSTR-RULES>
                <DATA-CONSTR-RULE>
                  <INTERNAL-CONSTRS>
                    <LOWER-LIMIT INTERVAL-TYPE="CLOSED">1</LOWER-LIMIT>
                    <UPPER-LIMIT INTERVAL-TYPE="CLOSED">[!"num:integer(bit:shl(1,$CalAgingCycleIdWidth)-1)"!]</UPPER-LIMIT>
                  </INTERNAL-CONSTRS>
                </DATA-CONSTR-RULE>
              </DATA-CONSTR-RULES>
            </DATA-CONSTR>
  [!ENDIF!]
  [!IF "node:exists(DemConfigSet/eb-list::*/DemEventParameter/eb-list::*[node:exists(DemEventClass/DemEnableConditionGroupRef)])"!]
            <DATA-CONSTR>
              <SHORT-NAME>CONSTR_EnableConditionGroup</SHORT-NAME>
              <DATA-CONSTR-RULES>
                <DATA-CONSTR-RULE>
                  <INTERNAL-CONSTRS>
                    <LOWER-LIMIT INTERVAL-TYPE="CLOSED">0</LOWER-LIMIT>
                    <UPPER-LIMIT INTERVAL-TYPE="CLOSED">[!"num:integer($DemNumEnCondGroups)"!]</UPPER-LIMIT>
                  </INTERNAL-CONSTRS>
                </DATA-CONSTR-RULE>
              </DATA-CONSTR-RULES>
            </DATA-CONSTR>
  [!ENDIF!]
[!ENDIF!]
          </ELEMENTS>
        </AR-PACKAGE>
        <AR-PACKAGE>
          <SHORT-NAME>BswModuleDescriptions</SHORT-NAME>
          <ELEMENTS>
            <BSW-MODULE-DESCRIPTION>
              <SHORT-NAME>Dem</SHORT-NAME>
              <MODULE-ID>54</MODULE-ID>
              <PROVIDED-ENTRYS>
                <BSW-MODULE-ENTRY-REF-CONDITIONAL>
                  <BSW-MODULE-ENTRY-REF DEST="BSW-MODULE-ENTRY">/AUTOSAR_Dem/BswModuleEntrys/Dem_MainFunction</BSW-MODULE-ENTRY-REF>
                </BSW-MODULE-ENTRY-REF-CONDITIONAL>
              </PROVIDED-ENTRYS>
              <INTERNAL-BEHAVIORS>
                <!-- BSW Internal Behaviour of the Master Dem instance -->
                <BSW-INTERNAL-BEHAVIOR>
                  <SHORT-NAME>InternalBehavior_[!"$MasterCoreId"!]</SHORT-NAME>
                  <ENTITYS>
                    <BSW-SCHEDULABLE-ENTITY>
                      <SHORT-NAME>Dem_MainFunction</SHORT-NAME>
                      <MINIMUM-START-INTERVAL>0.0</MINIMUM-START-INTERVAL>
                      <IMPLEMENTED-ENTRY-REF DEST="BSW-MODULE-ENTRY">/AUTOSAR_Dem/BswModuleEntrys/Dem_MainFunction</IMPLEMENTED-ENTRY-REF>
                    </BSW-SCHEDULABLE-ENTITY>
                  </ENTITYS>
                  <EVENTS>
                    <BSW-TIMING-EVENT>
                      <SHORT-NAME>TimingEvent_MainFunction</SHORT-NAME>
                      <STARTS-ON-EVENT-REF DEST="BSW-SCHEDULABLE-ENTITY">/AUTOSAR_Dem/BswModuleDescriptions/Dem/InternalBehavior_[!"$MasterCoreId"!]/Dem_MainFunction</STARTS-ON-EVENT-REF>
                      <PERIOD>[!"DemGeneral/DemTaskTime"!]</PERIOD>
                    </BSW-TIMING-EVENT>
                  </EVENTS>
                </BSW-INTERNAL-BEHAVIOR>
              </INTERNAL-BEHAVIORS>
            </BSW-MODULE-DESCRIPTION>
          </ELEMENTS>
        </AR-PACKAGE>
        <AR-PACKAGE>
          <SHORT-NAME>BswModuleEntrys</SHORT-NAME>
          <ELEMENTS>
            <BSW-MODULE-ENTRY>
              <SHORT-NAME>Dem_MainFunction</SHORT-NAME>
              <!-- ADMIN-DATA For ACG-6 compatibility -->
              <ADMIN-DATA>
                <SDGS>
                  <SDG GID="EB:DnT">
                    <SD GID="FunctionGroup">Extern</SD>
                    <SD GID="EnableTracing">false</SD>
                  </SDG>
                </SDGS>
              </ADMIN-DATA>
              <SERVICE-ID>85</SERVICE-ID>
              <IS-REENTRANT>false</IS-REENTRANT>
              <IS-SYNCHRONOUS>true</IS-SYNCHRONOUS>
              <CALL-TYPE>SCHEDULED</CALL-TYPE>
              <EXECUTION-CONTEXT>TASK</EXECUTION-CONTEXT>
              <SW-SERVICE-IMPL-POLICY>STANDARD</SW-SERVICE-IMPL-POLICY>
              <ARGUMENTS>
              </ARGUMENTS>
            </BSW-MODULE-ENTRY>
          </ELEMENTS>
        </AR-PACKAGE>
      </AR-PACKAGES>
    </AR-PACKAGE>
    <AR-PACKAGE>
      <SHORT-NAME>EB_Dem</SHORT-NAME>
      <AR-PACKAGES>
        <AR-PACKAGE>
          <SHORT-NAME>Implementations</SHORT-NAME>
          <ELEMENTS>
            <BSW-IMPLEMENTATION>
              <SHORT-NAME>BswImplementation_[!"$MasterCoreId"!]</SHORT-NAME>
              <CODE-DESCRIPTORS>
                <CODE>
                  <SHORT-NAME>Files</SHORT-NAME>
                  <ARTIFACT-DESCRIPTORS>
                    <AUTOSAR-ENGINEERING-OBJECT>
                      <SHORT-LABEL>Autosar::include::Dem.h</SHORT-LABEL>
                      <CATEGORY>SWHDR</CATEGORY>
                    </AUTOSAR-ENGINEERING-OBJECT>
                    <AUTOSAR-ENGINEERING-OBJECT>
                      <SHORT-LABEL>Autosar::include::Dem_BSW_Types.h</SHORT-LABEL>
                      <CATEGORY>SWHDR</CATEGORY>
                    </AUTOSAR-ENGINEERING-OBJECT>
                    <AUTOSAR-ENGINEERING-OBJECT>
                      <SHORT-LABEL>Autosar::include::Dem_Int.h</SHORT-LABEL>
                      <CATEGORY>SWHDR</CATEGORY>
                    </AUTOSAR-ENGINEERING-OBJECT>
                    <AUTOSAR-ENGINEERING-OBJECT>
                      <SHORT-LABEL>Autosar::include::Dem_Int_Stc.h</SHORT-LABEL>
                      <CATEGORY>SWHDR</CATEGORY>
                    </AUTOSAR-ENGINEERING-OBJECT>
                    <AUTOSAR-ENGINEERING-OBJECT>
                      <SHORT-LABEL>Autosar::include::Dem_NvMCbk.h</SHORT-LABEL>
                      <CATEGORY>SWHDR</CATEGORY>
                    </AUTOSAR-ENGINEERING-OBJECT>
                    <AUTOSAR-ENGINEERING-OBJECT>
                      <SHORT-LABEL>Autosar::include::Dem_Stc.h</SHORT-LABEL>
                      <CATEGORY>SWHDR</CATEGORY>
                    </AUTOSAR-ENGINEERING-OBJECT>
                    <AUTOSAR-ENGINEERING-OBJECT>
                      <SHORT-LABEL>Autosar::include::Dem_Trace.h</SHORT-LABEL>
                      <CATEGORY>SWHDR</CATEGORY>
                    </AUTOSAR-ENGINEERING-OBJECT>
                    <AUTOSAR-ENGINEERING-OBJECT>
                      <SHORT-LABEL>Autosar::include::Dem_Types.h</SHORT-LABEL>
                      <CATEGORY>SWHDR</CATEGORY>
                    </AUTOSAR-ENGINEERING-OBJECT>
                    <AUTOSAR-ENGINEERING-OBJECT>
                      <SHORT-LABEL>Autosar::include::Dem_Version.h</SHORT-LABEL>
                      <CATEGORY>SWHDR</CATEGORY>
                    </AUTOSAR-ENGINEERING-OBJECT>
                    <AUTOSAR-ENGINEERING-OBJECT>
                      <SHORT-LABEL>Autosar::src::Dem.c</SHORT-LABEL>
                      <CATEGORY>SWSRC</CATEGORY>
                    </AUTOSAR-ENGINEERING-OBJECT>
                    <AUTOSAR-ENGINEERING-OBJECT>
                      <SHORT-LABEL>Autosar::src::Dem_Core.c</SHORT-LABEL>
                      <CATEGORY>SWSRC</CATEGORY>
                    </AUTOSAR-ENGINEERING-OBJECT>
                    <AUTOSAR-ENGINEERING-OBJECT>
                      <SHORT-LABEL>Autosar::src::Dem_DcmIfAccess.c</SHORT-LABEL>
                      <CATEGORY>SWSRC</CATEGORY>
                    </AUTOSAR-ENGINEERING-OBJECT>
                    <AUTOSAR-ENGINEERING-OBJECT>
                      <SHORT-LABEL>Autosar::src::Dem_DcmIfFFandED.c</SHORT-LABEL>
                      <CATEGORY>SWSRC</CATEGORY>
                    </AUTOSAR-ENGINEERING-OBJECT>
                    <AUTOSAR-ENGINEERING-OBJECT>
                      <SHORT-LABEL>Autosar::src::Dem_DcmIfOBD.c</SHORT-LABEL>
                      <CATEGORY>SWSRC</CATEGORY>
                    </AUTOSAR-ENGINEERING-OBJECT>
                    <AUTOSAR-ENGINEERING-OBJECT>
                      <SHORT-LABEL>Autosar::src::Dem_DcmIfStatusInfo.c</SHORT-LABEL>
                      <CATEGORY>SWSRC</CATEGORY>
                    </AUTOSAR-ENGINEERING-OBJECT>
                    <AUTOSAR-ENGINEERING-OBJECT>
                      <SHORT-LABEL>Autosar::src::Dem_J1939Dcm.c</SHORT-LABEL>
                      <CATEGORY>SWSRC</CATEGORY>
                    </AUTOSAR-ENGINEERING-OBJECT>
                    <AUTOSAR-ENGINEERING-OBJECT>
                      <SHORT-LABEL>Autosar::src::Dem_J1939FF.c</SHORT-LABEL>
                      <CATEGORY>SWSRC</CATEGORY>
                    </AUTOSAR-ENGINEERING-OBJECT>
                    <AUTOSAR-ENGINEERING-OBJECT>
                      <SHORT-LABEL>make::Dem_defs.mak</SHORT-LABEL>
                      <CATEGORY>SWMAKE</CATEGORY>
                    </AUTOSAR-ENGINEERING-OBJECT>
                    <AUTOSAR-ENGINEERING-OBJECT>
                      <SHORT-LABEL>make::Dem_rules.mak</SHORT-LABEL>
                      <CATEGORY>SWMAKE</CATEGORY>
                    </AUTOSAR-ENGINEERING-OBJECT>
                  </ARTIFACT-DESCRIPTORS>
                </CODE>
              </CODE-DESCRIPTORS>
              <MC-SUPPORT>
                <MC-PARAMETER-INSTANCES>
[!IF "$CalibrationSupport = 'true'"!]
  [!/*  - Generate calibration data independent of DemEventCombination - */!][!//
  [!/* NumberOfIndicatorClasses shall be increamented by 1 to also inlcude
       maximum value (DEM_NUM_INDICATOR_GROUPS) for disabling an indicator */!][!//
  [!IF "($NumberOfIndicatorClasses + 1) < 256"!]
    [!VAR "DemIndicatorGrpIdxType" = "'uint8'"!]
  [!ELSEIF "($NumberOfIndicatorClasses + 1) < 65536"!]
    [!VAR "DemIndicatorGrpIdxType" = "'uint16'"!]
  [!ELSE!]
    [!VAR "DemIndicatorGrpIdxType" = "'uint32'"!]
  [!ENDIF!]
  [!IF "$NumberOfIndicatorClasses > 0"!]
                  <MC-DATA-INSTANCE>
                    <SHORT-NAME>Dem_IndicatorClasses</SHORT-NAME>
                    <CATEGORY>ARRAY</CATEGORY>
                    <ARRAY-SIZE>[!"num:i($NumIndicatorLinks)"!]</ARRAY-SIZE>
                    <SUB-ELEMENTS>
    [!VAR "ClassIndex" = "0"!]
    [!VAR "LinkIndex" = "0"!]
    [!LOOP "text:split($IndicatorClassList, '#')"!]
      [!VAR "SubClassIndex" = "0"!]
      [!VAR "NumSubClasses" = "count(text:split(., '+'))"!]
      [!LOOP "text:split(., '+')"!]
                      <MC-DATA-INSTANCE>
        [!IF "$NumSubClasses = 1"!]
                        <SHORT-NAME>IndicatorClasses_[!"num:i($ClassIndex)"!]</SHORT-NAME>
        [!ELSE!]
                        <SHORT-NAME>IndicatorClasses_[!"num:i($ClassIndex)"!]_[!"num:i($SubClassIndex)"!]</SHORT-NAME>
        [!ENDIF!]
                        <CATEGORY>STRUCTURE</CATEGORY>
                        <SUB-ELEMENTS>
                          <MC-DATA-INSTANCE>
                            <SHORT-NAME>Enabled</SHORT-NAME>
                            <DESC>
                              <L-2 L="EN">
                                Enabled state of the Indicator class.
                              </L-2>
                            </DESC>
                            <CATEGORY>VALUE</CATEGORY>
                            <RESULTING-PROPERTIES>
                              <SW-DATA-DEF-PROPS-VARIANTS>
                                <SW-DATA-DEF-PROPS-CONDITIONAL>
                                  <BASE-TYPE-REF DEST="SW-BASE-TYPE">/AUTOSAR_Platform/BaseTypes/boolean</BASE-TYPE-REF>
                                  <SW-CALIBRATION-ACCESS>READ-WRITE</SW-CALIBRATION-ACCESS>
                                  <COMPU-METHOD-REF DEST="COMPU-METHOD">/AUTOSAR_Dem/CompuMethods/CM_DemIndicatorClassEnabled</COMPU-METHOD-REF>
                                  <DATA-CONSTR-REF DEST="DATA-CONSTR">/AUTOSAR_Platform/DataConstrs/boolean</DATA-CONSTR-REF>
                                </SW-DATA-DEF-PROPS-CONDITIONAL>
                              </SW-DATA-DEF-PROPS-VARIANTS>
                            </RESULTING-PROPERTIES>
                            <SYMBOL>Enabled</SYMBOL>
                          </MC-DATA-INSTANCE>
                          <MC-DATA-INSTANCE>
                            <SHORT-NAME>IndicatorId</SHORT-NAME>
                            <DESC>
                              <L-2 L="EN">
                                Id of the indicator referenced by Indicator class. If MIL indicator is referenced then the ObdDTC of the respective event shall be enabled.
                              </L-2>
                            </DESC>
                            <CATEGORY>VALUE</CATEGORY>
                            <RESULTING-PROPERTIES>
                              <SW-DATA-DEF-PROPS-VARIANTS>
                                <SW-DATA-DEF-PROPS-CONDITIONAL>
                                  <BASE-TYPE-REF DEST="SW-BASE-TYPE">/AUTOSAR_Platform/BaseTypes/uint8</BASE-TYPE-REF>
                                  <SW-CALIBRATION-ACCESS>READ-WRITE</SW-CALIBRATION-ACCESS>
                                  <DATA-CONSTR-REF DEST="DATA-CONSTR">/AUTOSAR_Dem/DataConstrs/CONSTR_IndicatorId</DATA-CONSTR-REF>
                                </SW-DATA-DEF-PROPS-CONDITIONAL>
                              </SW-DATA-DEF-PROPS-VARIANTS>
                            </RESULTING-PROPERTIES>
                            <SYMBOL>IndicatorId</SYMBOL>
                          </MC-DATA-INSTANCE>
                          <MC-DATA-INSTANCE>
                            <SHORT-NAME>Behaviour</SHORT-NAME>
                            <DESC>
                              <L-2 L="EN">
                                Behaviour of the Indicator class.
                              </L-2>
                            </DESC>
                            <CATEGORY>VALUE</CATEGORY>
                            <RESULTING-PROPERTIES>
                              <SW-DATA-DEF-PROPS-VARIANTS>
                                <SW-DATA-DEF-PROPS-CONDITIONAL>
                                  <BASE-TYPE-REF DEST="SW-BASE-TYPE">/AUTOSAR_Platform/BaseTypes/uint8</BASE-TYPE-REF>
                                  <SW-CALIBRATION-ACCESS>READ-WRITE</SW-CALIBRATION-ACCESS>
                                  <COMPU-METHOD-REF DEST="COMPU-METHOD">/AUTOSAR_Dem/CompuMethods/CM_DemIndicatorClassBehaviour</COMPU-METHOD-REF>
                                  <DATA-CONSTR-REF DEST="DATA-CONSTR">/AUTOSAR_Platform/DataConstrs/uint8</DATA-CONSTR-REF>
                                </SW-DATA-DEF-PROPS-CONDITIONAL>
                              </SW-DATA-DEF-PROPS-VARIANTS>
                            </RESULTING-PROPERTIES>
                            <SYMBOL>Behaviour</SYMBOL>
                          </MC-DATA-INSTANCE>
                          <MC-DATA-INSTANCE>
                            <SHORT-NAME>HealingCycleThreshold</SHORT-NAME>
                            <DESC>
                              <L-2 L="EN">
                                HealingCycleThreshold of Indicator class. Calibration of this value is only allowed before Dem_PreInit() is called. If the threshold will be re-calibrated the effect will be considered at the next processing and not during initialization.
                              </L-2>
                            </DESC>
                            <CATEGORY>VALUE</CATEGORY>
                            <RESULTING-PROPERTIES>
                              <SW-DATA-DEF-PROPS-VARIANTS>
                                <SW-DATA-DEF-PROPS-CONDITIONAL>
                                  <BASE-TYPE-REF DEST="SW-BASE-TYPE">/AUTOSAR_Platform/BaseTypes/uint8</BASE-TYPE-REF>
                                  <SW-CALIBRATION-ACCESS>READ-WRITE</SW-CALIBRATION-ACCESS>
                                  <DATA-CONSTR-REF DEST="DATA-CONSTR">/AUTOSAR_Dem/DataConstrs/CONSTR_HealingCycleThreshold</DATA-CONSTR-REF>
                                </SW-DATA-DEF-PROPS-CONDITIONAL>
                              </SW-DATA-DEF-PROPS-VARIANTS>
                            </RESULTING-PROPERTIES>
                            <SYMBOL>HealingCycleThreshold</SYMBOL>
                          </MC-DATA-INSTANCE>
                          <MC-DATA-INSTANCE>
                            <SHORT-NAME>FailureCycleThreshold</SHORT-NAME>
                            <DESC>
                              <L-2 L="EN">
                                FailureCycleThreshold of Indicator class. Calibration of this value is only allowed before Dem_PreInit() is called. If the threshold will be re-calibrated the effect will be considered at the next processing and not during initialization.
                                <!--Range is limited to 0..255. For rationale see deviation "Fault
                                Confirmation and Warning Indicator behavior". Value 0 is only limited
                                to the MIL of events assigned to a driving cycle i.e. Zero-trip events.-->
                              </L-2>
                            </DESC>
                            <CATEGORY>VALUE</CATEGORY>
                            <RESULTING-PROPERTIES>
                              <SW-DATA-DEF-PROPS-VARIANTS>
                                <SW-DATA-DEF-PROPS-CONDITIONAL>
                                  <BASE-TYPE-REF DEST="SW-BASE-TYPE">/AUTOSAR_Platform/BaseTypes/uint8</BASE-TYPE-REF>
                                  <SW-CALIBRATION-ACCESS>READ-WRITE</SW-CALIBRATION-ACCESS>
                                  <DATA-CONSTR-REF DEST="DATA-CONSTR">/AUTOSAR_Platform/DataConstrs/uint8</DATA-CONSTR-REF>
                                </SW-DATA-DEF-PROPS-CONDITIONAL>
                              </SW-DATA-DEF-PROPS-VARIANTS>
                            </RESULTING-PROPERTIES>
                            <SYMBOL>FailureCycleThreshold</SYMBOL>
                          </MC-DATA-INSTANCE>
        [!IF "$CommonOperationCycleEnabled = 'false'"!]
                          <MC-DATA-INSTANCE>
                            <SHORT-NAME>HealingCycle</SHORT-NAME>
                            <DESC>
                              <L-2 L="EN">
                                OperationCycle type used as HealingCycle for the Indicator class. It has to reference a configured operation cycle.
                              </L-2>
                            </DESC>
                            <CATEGORY>VALUE</CATEGORY>
                            <RESULTING-PROPERTIES>
                              <SW-DATA-DEF-PROPS-VARIANTS>
                                <SW-DATA-DEF-PROPS-CONDITIONAL>
                                  <BASE-TYPE-REF DEST="SW-BASE-TYPE">/AUTOSAR_Platform/BaseTypes/uint8</BASE-TYPE-REF>
                                  <SW-CALIBRATION-ACCESS>READ-WRITE</SW-CALIBRATION-ACCESS>
                                  <COMPU-METHOD-REF DEST="COMPU-METHOD">/AUTOSAR_Dem/CompuMethods/CM_OperationCycle</COMPU-METHOD-REF>
                                  <DATA-CONSTR-REF DEST="DATA-CONSTR">/AUTOSAR_Platform/DataConstrs/uint8</DATA-CONSTR-REF>
                                </SW-DATA-DEF-PROPS-CONDITIONAL>
                              </SW-DATA-DEF-PROPS-VARIANTS>
                            </RESULTING-PROPERTIES>
                            <SYMBOL>HealingCycle</SYMBOL>
                          </MC-DATA-INSTANCE>
                          <MC-DATA-INSTANCE>
                            <SHORT-NAME>FailureCycle</SHORT-NAME>
                            <DESC>
                              <L-2 L="EN">
                                OperationCycle type used as FailureCycle for the Indicator class. It has to reference a configured operation cycle.
                                <!-- If parameter DemIndicatorFailureCycleSource is set to
                                DEM_FAILURE_CYCLE_EVENT then FailureCycle is disabled.
                                Range of allowed values is 0..254, as maximum operation cycles that
                                can be configured is limited to 255.-->
                              </L-2>
                            </DESC>
                            <CATEGORY>VALUE</CATEGORY>
                            <RESULTING-PROPERTIES>
                              <SW-DATA-DEF-PROPS-VARIANTS>
                                <SW-DATA-DEF-PROPS-CONDITIONAL>
                                  <BASE-TYPE-REF DEST="SW-BASE-TYPE">/AUTOSAR_Platform/BaseTypes/uint8</BASE-TYPE-REF>
                                  <SW-CALIBRATION-ACCESS>READ-WRITE</SW-CALIBRATION-ACCESS>
                                  <COMPU-METHOD-REF DEST="COMPU-METHOD">/AUTOSAR_Dem/CompuMethods/CM_OperationCycle</COMPU-METHOD-REF>
                                  <DATA-CONSTR-REF DEST="DATA-CONSTR">/AUTOSAR_Platform/DataConstrs/uint8</DATA-CONSTR-REF>
                                </SW-DATA-DEF-PROPS-CONDITIONAL>
                              </SW-DATA-DEF-PROPS-VARIANTS>
                            </RESULTING-PROPERTIES>
                            <SYMBOL>FailureCycle</SYMBOL>
                          </MC-DATA-INSTANCE>
        [!ENDIF!]
                        </SUB-ELEMENTS>
                        <SYMBOL>[[!"num:i($LinkIndex)"!]]</SYMBOL>
                      </MC-DATA-INSTANCE>
        [!VAR "SubClassIndex" = "$SubClassIndex + 1"!]
        [!VAR "LinkIndex" = "$LinkIndex + 1"!]
      [!ENDLOOP!]
      [!VAR "ClassIndex" = "$ClassIndex + 1"!]
    [!ENDLOOP!]
    [!IF "$NumIndicatorLinks > $LinkIndex"!]
      [!FOR "DummyClassIndex" = "$LinkIndex" TO "$NumIndicatorLinks - 1"!]
                      <MC-DATA-INSTANCE>
                        <SHORT-NAME>IndicatorClasses_[!"num:i($ClassIndex)"!]</SHORT-NAME>
                        <CATEGORY>STRUCTURE</CATEGORY>
                        <SUB-ELEMENTS>
                          <MC-DATA-INSTANCE>
                            <SHORT-NAME>Enabled</SHORT-NAME>
                            <DESC>
                              <L-2 L="EN">
                                Enabled state of the Indicator class (enabled == 1, disabled == 0).
                              </L-2>
                            </DESC>
                            <CATEGORY>VALUE</CATEGORY>
                            <RESULTING-PROPERTIES>
                              <SW-DATA-DEF-PROPS-VARIANTS>
                                <SW-DATA-DEF-PROPS-CONDITIONAL>
                                  <BASE-TYPE-REF DEST="SW-BASE-TYPE">/AUTOSAR_Platform/BaseTypes/uint8</BASE-TYPE-REF>
                                  <SW-CALIBRATION-ACCESS>READ-WRITE</SW-CALIBRATION-ACCESS>
                                  <COMPU-METHOD-REF DEST="COMPU-METHOD">/AUTOSAR_Dem/CompuMethods/CM_DemIndicatorClassEnabled</COMPU-METHOD-REF>
                                  <DATA-CONSTR-REF DEST="DATA-CONSTR">/AUTOSAR_Platform/DataConstrs/boolean</DATA-CONSTR-REF>
                                </SW-DATA-DEF-PROPS-CONDITIONAL>
                              </SW-DATA-DEF-PROPS-VARIANTS>
                            </RESULTING-PROPERTIES>
                            <SYMBOL>Enabled</SYMBOL>
                          </MC-DATA-INSTANCE>
                          <MC-DATA-INSTANCE>
                            <SHORT-NAME>IndicatorId</SHORT-NAME>
                            <DESC>
                              <L-2 L="EN">
                                Id of the indicator referenced by Indicator class. If MIL indicator is referenced then the ObdDTC of the respective event shall be enabled.
                              </L-2>
                            </DESC>
                            <CATEGORY>VALUE</CATEGORY>
                            <RESULTING-PROPERTIES>
                              <SW-DATA-DEF-PROPS-VARIANTS>
                                <SW-DATA-DEF-PROPS-CONDITIONAL>
                                  <BASE-TYPE-REF DEST="SW-BASE-TYPE">/AUTOSAR_Platform/BaseTypes/uint8</BASE-TYPE-REF>
                                  <SW-CALIBRATION-ACCESS>READ-WRITE</SW-CALIBRATION-ACCESS>
                                  <DATA-CONSTR-REF DEST="DATA-CONSTR">/AUTOSAR_Dem/DataConstrs/CONSTR_IndicatorId</DATA-CONSTR-REF>
                                </SW-DATA-DEF-PROPS-CONDITIONAL>
                              </SW-DATA-DEF-PROPS-VARIANTS>
                            </RESULTING-PROPERTIES>
                            <SYMBOL>IndicatorId</SYMBOL>
                          </MC-DATA-INSTANCE>
                          <MC-DATA-INSTANCE>
                            <SHORT-NAME>Behaviour</SHORT-NAME>
                            <DESC>
                              <L-2 L="EN">
                                Behaviour of Indicator class has the range 0..3 corresponding to the indicator modes DEM_INDICATOR_OFF, DEM_INDICATOR_CONTINUOUS, DEM_INDICATOR_BLINKING and DEM_INDICATOR_BLINK_CONT.
                              </L-2>
                            </DESC>
                            <CATEGORY>VALUE</CATEGORY>
                            <RESULTING-PROPERTIES>
                              <SW-DATA-DEF-PROPS-VARIANTS>
                                <SW-DATA-DEF-PROPS-CONDITIONAL>
                                  <BASE-TYPE-REF DEST="SW-BASE-TYPE">/AUTOSAR_Platform/BaseTypes/uint8</BASE-TYPE-REF>
                                  <SW-CALIBRATION-ACCESS>READ-WRITE</SW-CALIBRATION-ACCESS>
                                  <COMPU-METHOD-REF DEST="COMPU-METHOD">/AUTOSAR_Dem/CompuMethods/CM_DemIndicatorClassBehaviour</COMPU-METHOD-REF>
                                  <DATA-CONSTR-REF DEST="DATA-CONSTR">/AUTOSAR_Platform/DataConstrs/uint8</DATA-CONSTR-REF>
                                </SW-DATA-DEF-PROPS-CONDITIONAL>
                              </SW-DATA-DEF-PROPS-VARIANTS>
                            </RESULTING-PROPERTIES>
                            <SYMBOL>Behaviour</SYMBOL>
                          </MC-DATA-INSTANCE>
                          <MC-DATA-INSTANCE>
                            <SHORT-NAME>HealingCycleThreshold</SHORT-NAME>
                            <DESC>
                              <L-2 L="EN">
                                HealingCycleThreshold of Indicator class. Calibration of this value is only allowed before Dem_PreInit() is called. If the threshold will be re-calibrated the effect will be considered at the next processing and not during initialization.
                              </L-2>
                            </DESC>
                            <CATEGORY>VALUE</CATEGORY>
                            <RESULTING-PROPERTIES>
                              <SW-DATA-DEF-PROPS-VARIANTS>
                                <SW-DATA-DEF-PROPS-CONDITIONAL>
                                  <BASE-TYPE-REF DEST="SW-BASE-TYPE">/AUTOSAR_Platform/BaseTypes/uint8</BASE-TYPE-REF>
                                  <SW-CALIBRATION-ACCESS>READ-WRITE</SW-CALIBRATION-ACCESS>
                                  <DATA-CONSTR-REF DEST="DATA-CONSTR">/AUTOSAR_Dem/DataConstrs/CONSTR_HealingCycleThreshold</DATA-CONSTR-REF>
                                </SW-DATA-DEF-PROPS-CONDITIONAL>
                              </SW-DATA-DEF-PROPS-VARIANTS>
                            </RESULTING-PROPERTIES>
                            <SYMBOL>HealingCycleThreshold</SYMBOL>
                          </MC-DATA-INSTANCE>
                          <MC-DATA-INSTANCE>
                            <SHORT-NAME>FailureCycleThreshold</SHORT-NAME>
                            <DESC>
                              <L-2 L="EN">
                                FailureCycleThreshold of Indicator class. Calibration of this value is only allowed before Dem_PreInit() is called. If the threshold will be re-calibrated the effect will be considered at the next processing and not during initialization.
                                <!--Range is limited to 0..255. For rationale see deviation "Fault
                                Confirmation and Warning Indicator behavior". Value 0 is only limited
                                to the MIL of events assigned to a driving cycle i.e. Zero-trip events.-->
                              </L-2>
                            </DESC>
                            <CATEGORY>VALUE</CATEGORY>
                            <RESULTING-PROPERTIES>
                              <SW-DATA-DEF-PROPS-VARIANTS>
                                <SW-DATA-DEF-PROPS-CONDITIONAL>
                                  <BASE-TYPE-REF DEST="SW-BASE-TYPE">/AUTOSAR_Platform/BaseTypes/uint8</BASE-TYPE-REF>
                                  <SW-CALIBRATION-ACCESS>READ-WRITE</SW-CALIBRATION-ACCESS>
                                  <DATA-CONSTR-REF DEST="DATA-CONSTR">/AUTOSAR_Platform/DataConstrs/uint8</DATA-CONSTR-REF>
                                </SW-DATA-DEF-PROPS-CONDITIONAL>
                              </SW-DATA-DEF-PROPS-VARIANTS>
                            </RESULTING-PROPERTIES>
                            <SYMBOL>FailureCycleThreshold</SYMBOL>
                          </MC-DATA-INSTANCE>
        [!IF "$CommonOperationCycleEnabled = 'false'"!]
                          <MC-DATA-INSTANCE>
                            <SHORT-NAME>HealingCycle</SHORT-NAME>
                            <DESC>
                              <L-2 L="EN">
                                OperationCycle type used as HealingCycle for the Indicator class. It has to reference a configured operation cycle.
                              </L-2>
                            </DESC>
                            <CATEGORY>VALUE</CATEGORY>
                            <RESULTING-PROPERTIES>
                              <SW-DATA-DEF-PROPS-VARIANTS>
                                <SW-DATA-DEF-PROPS-CONDITIONAL>
                                  <BASE-TYPE-REF DEST="SW-BASE-TYPE">/AUTOSAR_Platform/BaseTypes/uint8</BASE-TYPE-REF>
                                  <SW-CALIBRATION-ACCESS>READ-WRITE</SW-CALIBRATION-ACCESS>
                                  <COMPU-METHOD-REF DEST="COMPU-METHOD">/AUTOSAR_Dem/CompuMethods/CM_OperationCycle</COMPU-METHOD-REF>
                                  <DATA-CONSTR-REF DEST="DATA-CONSTR">/AUTOSAR_Platform/DataConstrs/uint8</DATA-CONSTR-REF>
                                </SW-DATA-DEF-PROPS-CONDITIONAL>
                              </SW-DATA-DEF-PROPS-VARIANTS>
                            </RESULTING-PROPERTIES>
                            <SYMBOL>HealingCycle</SYMBOL>
                          </MC-DATA-INSTANCE>
                          <MC-DATA-INSTANCE>
                            <SHORT-NAME>FailureCycle</SHORT-NAME>
                            <DESC>
                              <L-2 L="EN">
                                OperationCycle type used as FailureCycle for the Indicator class. It has to reference a configured operation cycle.
                                <!-- If parameter DemIndicatorFailureCycleSource is set to
                                DEM_FAILURE_CYCLE_EVENT then FailureCycle is disabled.
                                Range of allowed values is 0..254, as maximum operation cycles that
                                can be configured is limited to 255.-->
                              </L-2>
                            </DESC>
                            <CATEGORY>VALUE</CATEGORY>
                            <RESULTING-PROPERTIES>
                              <SW-DATA-DEF-PROPS-VARIANTS>
                                <SW-DATA-DEF-PROPS-CONDITIONAL>
                                  <BASE-TYPE-REF DEST="SW-BASE-TYPE">/AUTOSAR_Platform/BaseTypes/uint8</BASE-TYPE-REF>
                                  <SW-CALIBRATION-ACCESS>READ-WRITE</SW-CALIBRATION-ACCESS>
                                  <COMPU-METHOD-REF DEST="COMPU-METHOD">/AUTOSAR_Dem/CompuMethods/CM_OperationCycle</COMPU-METHOD-REF>
                                  <DATA-CONSTR-REF DEST="DATA-CONSTR">/AUTOSAR_Platform/DataConstrs/uint8</DATA-CONSTR-REF>
                                </SW-DATA-DEF-PROPS-CONDITIONAL>
                              </SW-DATA-DEF-PROPS-VARIANTS>
                            </RESULTING-PROPERTIES>
                            <SYMBOL>FailureCycle</SYMBOL>
                          </MC-DATA-INSTANCE>
        [!ENDIF!]
                        </SUB-ELEMENTS>
                        <SYMBOL>[[!"num:i($DummyClassIndex)"!]]</SYMBOL>
                      </MC-DATA-INSTANCE>
        [!VAR "ClassIndex" = "$ClassIndex + 1"!]
      [!ENDFOR!]
    [!ENDIF!]
                    </SUB-ELEMENTS>
                    <SYMBOL>Dem_IndicatorClasses</SYMBOL>
                  </MC-DATA-INSTANCE>
  [!ENDIF!]

  [!IF "$EventIdSlots > 0"!]
    [!CALL "CREATE_READINESSGROUPS_CONFIG_LIST"!]
                  <!-- !LINKSTO VCC_DEM_006_Req102v1,1 -->
                  <MC-DATA-INSTANCE>
                    <SHORT-NAME>Dem_OBDReadinessGroup</SHORT-NAME>
                    <CATEGORY>ARRAY</CATEGORY>
    [!IF "node:exists(DemGeneral/DemMaxNumEventsPerReadinessGroup)
          and (DemGeneral/DemGeneralOBD/DemOBDEngineType = 'DEM_IGNITION_COMPRESSION')"!][!//
                    <!-- !LINKSTO dsn.Dem.Calibration.ReadinessGroup.UNUSED,1 -->
                    <ARRAY-SIZE>[!"num:integer($EventIdSlots - (2 * (DemGeneral/DemMaxNumEventsPerReadinessGroup)))"!]</ARRAY-SIZE>
    [!ELSE!]
                    <ARRAY-SIZE>[!"$EventIdSlots"!]</ARRAY-SIZE>
    [!ENDIF!][!//
                    <SUB-ELEMENTS>
    [!VAR "ReadinessEventSlotNumber" = "0"!]
    [!LOOP "text:split($ReadinessGroupsConfigList, '#')"!][!//
      [!VAR "GroupName" = "text:split(., ':')[position() = 2]"!][!//
      [!IF "starts-with($GroupName, 'UNUSED')"!][!//
        [!VAR "RGName" = "$GroupName"!]
      [!ELSE!]
        [!VAR "RGName" = "concat('DEM_OBD_RDY_',$GroupName)"!]
      [!ENDIF!][!//
      [!VAR "MaxNumEventsInRG" = "text:split(., ':')[position() = 3]"!][!//
      [!VAR "GroupCounter" = "0"!]
      [!FOR "GroupCounter" = "0" TO "$MaxNumEventsInRG - 1"!]
        [!IF "not(starts-with($RGName, 'UNUSED'))"!][!//
                      <MC-DATA-INSTANCE>
                        <SHORT-NAME>[!"$RGName"!]_Slot_[!"$GroupCounter"!]</SHORT-NAME>
                        <DESC>
                          <L-2 L="EN">
                            Event of slot [!"$GroupCounter"!] from [!"$MaxNumEventsInRG"!] slots for Readiness Group [!"$RGName"!]. The event can be assigned to multiple groups.
                            <!--Being an EventId the calibrated value must be within the DemEventId limits.
          [!IF "((node:exists(DemGeneral/DemObdVariant)) and (DemGeneral/DemObdVariant = 'DEM_OBD_VARIANT_OBDONUDS')) or
                (node:exists(DemGeneral/DemCalloutObdVariantFnc)) or
                (DemGeneral/DemReadinessGroupCalibrationConfigKind = 'DEM_NUMBER_OF_SLOTS_INDIVIDUAL_CONFIG')"!]
                            Only master events can be calibrated if event combination is enabled.
                            The calibration of this array is only allowed before Dem_Init() is called. If it is re-calibrated, the reports w.r.t. events assigned to readiness group NONE will be synchronized with the calibrated values only after the Dem re-initialization.
          [!ENDIF!]            -->
                          </L-2>
                        </DESC>
                        <CATEGORY>VALUE</CATEGORY>
                        <RESULTING-PROPERTIES>
                          <SW-DATA-DEF-PROPS-VARIANTS>
                            <SW-DATA-DEF-PROPS-CONDITIONAL>
                              <BASE-TYPE-REF DEST="SW-BASE-TYPE">/AUTOSAR_Platform/BaseTypes/uint16</BASE-TYPE-REF>
                              <SW-CALIBRATION-ACCESS>READ-WRITE</SW-CALIBRATION-ACCESS>
                              <DATA-CONSTR-REF DEST="DATA-CONSTR">/AUTOSAR_Dem/DataConstrs/CONSTR_DemAllEventIdRange</DATA-CONSTR-REF>
                            </SW-DATA-DEF-PROPS-CONDITIONAL>
                          </SW-DATA-DEF-PROPS-VARIANTS>
                        </RESULTING-PROPERTIES>
                        <SYMBOL>[[!"num:integer($ReadinessEventSlotNumber)"!]]</SYMBOL>
                      </MC-DATA-INSTANCE>
        [!ENDIF!]
        [!VAR "ReadinessEventSlotNumber" = "$ReadinessEventSlotNumber + 1"!][!//
      [!ENDFOR!]
    [!ENDLOOP!]
                    </SUB-ELEMENTS>
                    <SYMBOL>Dem_OBDReadinessGroup</SYMBOL>
                  </MC-DATA-INSTANCE>
  [!ENDIF!]

  <!-- !LINKSTO Dem.Calibration.DebounceCounterBased,1 -->
  [!IF "$DebounceCounterClassCount > 0"!]
                  <MC-DATA-INSTANCE>
                    <SHORT-NAME>Dem_DebounceCounterClassIdx</SHORT-NAME>
                    <CATEGORY>ARRAY</CATEGORY>
                    <ARRAY-SIZE>[!"num:i(count(DemConfigSet/eb-list::*/DemEventParameter/eb-list::*[DemEventClass/DemDebounceAlgorithmClass = 'DemDebounceCounterBased']))"!]</ARRAY-SIZE>
                    <SUB-ELEMENTS>
    [!IF "$DebounceCounterClassCount <= 127"!]
      [!VAR "BitWidth" = "7"!]
      [!VAR "Type" = "'uint8'"!]
    [!ELSE!]
      [!VAR "BitWidth" = "15"!]
      [!VAR "Type" = "'uint16'"!]
    [!ENDIF!]
    [!VAR "Index" = "0"!]
    [!LOOP "util:distinct(node:order(DemConfigSet/eb-list::*/DemEventParameter/eb-list::*[DemEventClass/DemDebounceAlgorithmClass = 'DemDebounceCounterBased'], 'DemEventId'))"!]
                      <MC-DATA-INSTANCE>
                        <SHORT-NAME>[!"as:name(.)"!]</SHORT-NAME>
                        <DESC>
                          <L-2 L="EN">
                            Debounce counter based class index must be in range of 0 to [!"$DebounceCounterClassCount - 1"!]. Depending on configuration, a maximum value of 32767, displayable on 15 bits can be referenced.
                          </L-2>
                        </DESC>
                        <CATEGORY>VALUE</CATEGORY>
                        <RESULTING-PROPERTIES>
                          <SW-DATA-DEF-PROPS-VARIANTS>
                            <SW-DATA-DEF-PROPS-CONDITIONAL>
                              <BASE-TYPE-REF DEST="SW-BASE-TYPE">/AUTOSAR_Platform/BaseTypes/[!"$Type"!]</BASE-TYPE-REF>
                              <SW-BIT-REPRESENTATION>
                                <BIT-POSITION>0</BIT-POSITION>
                                <NUMBER-OF-BITS>[!"num:i($BitWidth)"!]</NUMBER-OF-BITS>
                              </SW-BIT-REPRESENTATION>
                              <SW-CALIBRATION-ACCESS>READ-WRITE</SW-CALIBRATION-ACCESS>
                              <DATA-CONSTR-REF DEST="DATA-CONSTR">/AUTOSAR_Dem/DataConstrs/CONSTR_DebounceCounterClassIdx</DATA-CONSTR-REF>
                            </SW-DATA-DEF-PROPS-CONDITIONAL>
                          </SW-DATA-DEF-PROPS-VARIANTS>
                        </RESULTING-PROPERTIES>
                        <SYMBOL>[[!"num:i($Index)"!]]</SYMBOL>
                      </MC-DATA-INSTANCE>
      [!VAR "Index" = "$Index + 1"!]
    [!ENDLOOP!]
                    </SUB-ELEMENTS>
                    <SYMBOL>Dem_DebounceCounterClassIdx</SYMBOL>
                  </MC-DATA-INSTANCE>


                  <MC-DATA-INSTANCE>
                    <!-- !LINKSTO VCC_DEM_006_Req105v1,1 -->
                    <SHORT-NAME>Dem_DebounceCounterClass</SHORT-NAME>
                    <CATEGORY>ARRAY</CATEGORY>
                    <ARRAY-SIZE>[!"num:i($DebounceCounterClassCount)"!]</ARRAY-SIZE>
                    <SUB-ELEMENTS>
    [!VAR "DebounceIdx" = "0"!]
    [!FOR "DebounceCtrIndex" = "0" TO "$DebounceCounterClassCount - 1"!]
                      <MC-DATA-INSTANCE>
                        <SHORT-NAME>DemDebounceCounterBasedClass_[!"num:i($DebounceIdx)"!]</SHORT-NAME>
                        <CATEGORY>STRUCTURE</CATEGORY>
                        <SUB-ELEMENTS>
                          <MC-DATA-INSTANCE>
                            <SHORT-NAME>DemDebounceCounterDecrementStepSize</SHORT-NAME>
                            <DESC>
                              <L-2 L="EN">
                                Defines the step size for decrementing the internal fault detection counter (PREPASSED).
                              </L-2>
                            </DESC>
                            <CATEGORY>VALUE</CATEGORY>
                            <RESULTING-PROPERTIES>
                              <SW-DATA-DEF-PROPS-VARIANTS>
                                <SW-DATA-DEF-PROPS-CONDITIONAL>
                                  <BASE-TYPE-REF DEST="SW-BASE-TYPE">/AUTOSAR_Platform/BaseTypes/uint16</BASE-TYPE-REF>
                                  <SW-CALIBRATION-ACCESS>READ-WRITE</SW-CALIBRATION-ACCESS>
                                  <DATA-CONSTR-REF DEST="DATA-CONSTR">/AUTOSAR_Dem/DataConstrs/CONSTR_DemDebounceCounterDecrementStepSize</DATA-CONSTR-REF>
                                </SW-DATA-DEF-PROPS-CONDITIONAL>
                              </SW-DATA-DEF-PROPS-VARIANTS>
                            </RESULTING-PROPERTIES>
                            <SYMBOL>CountDecStepSize</SYMBOL>
                          </MC-DATA-INSTANCE>
                          <MC-DATA-INSTANCE>
                            <SHORT-NAME>DemDebounceCounterIncrementStepSize</SHORT-NAME>
                            <DESC>
                              <L-2 L="EN">
                                Defines the step size for incrementing the internal fault detection counter (PREFAILED).
                              </L-2>
                            </DESC>
                            <CATEGORY>VALUE</CATEGORY>
                            <RESULTING-PROPERTIES>
                              <SW-DATA-DEF-PROPS-VARIANTS>
                                <SW-DATA-DEF-PROPS-CONDITIONAL>
                                  <BASE-TYPE-REF DEST="SW-BASE-TYPE">/AUTOSAR_Platform/BaseTypes/uint16</BASE-TYPE-REF>
                                  <SW-CALIBRATION-ACCESS>READ-WRITE</SW-CALIBRATION-ACCESS>
                                  <DATA-CONSTR-REF DEST="DATA-CONSTR">/AUTOSAR_Dem/DataConstrs/CONSTR_DemDebounceCounterIncrementStepSize</DATA-CONSTR-REF>
                                </SW-DATA-DEF-PROPS-CONDITIONAL>
                              </SW-DATA-DEF-PROPS-VARIANTS>
                            </RESULTING-PROPERTIES>
                            <SYMBOL>CountIncStepSize</SYMBOL>
                          </MC-DATA-INSTANCE>
                          <MC-DATA-INSTANCE>
                            <SHORT-NAME>DemDebounceCounterPassedThreshold</SHORT-NAME>
                            <DESC>
                              <L-2 L="EN">
                                Defines the value of the internal fault detection counter, which indicates the passed status.
                              </L-2>
                            </DESC>
                            <CATEGORY>VALUE</CATEGORY>
                            <RESULTING-PROPERTIES>
                              <SW-DATA-DEF-PROPS-VARIANTS>
                                <SW-DATA-DEF-PROPS-CONDITIONAL>
                                  <BASE-TYPE-REF DEST="SW-BASE-TYPE">/AUTOSAR_Platform/BaseTypes/sint16</BASE-TYPE-REF>
                                  <SW-CALIBRATION-ACCESS>READ-WRITE</SW-CALIBRATION-ACCESS>
                                  <DATA-CONSTR-REF DEST="DATA-CONSTR">/AUTOSAR_Dem/DataConstrs/CONSTR_DemDebounceCounterPassedThreshold</DATA-CONSTR-REF>
                                </SW-DATA-DEF-PROPS-CONDITIONAL>
                              </SW-DATA-DEF-PROPS-VARIANTS>
                            </RESULTING-PROPERTIES>
                            <SYMBOL>CounterPassedThreshold</SYMBOL>
                          </MC-DATA-INSTANCE>
                          <MC-DATA-INSTANCE>
                            <SHORT-NAME>DemDebounceCounterFailedThreshold</SHORT-NAME>
                            <DESC>
                              <L-2 L="EN">
                                Defines the value of the internal fault detection counter, which indicates the failed status.
                              </L-2>
                            </DESC>
                            <CATEGORY>VALUE</CATEGORY>
                            <RESULTING-PROPERTIES>
                              <SW-DATA-DEF-PROPS-VARIANTS>
                                <SW-DATA-DEF-PROPS-CONDITIONAL>
                                  <BASE-TYPE-REF DEST="SW-BASE-TYPE">/AUTOSAR_Platform/BaseTypes/sint16</BASE-TYPE-REF>
                                  <SW-CALIBRATION-ACCESS>READ-WRITE</SW-CALIBRATION-ACCESS>
                                  <DATA-CONSTR-REF DEST="DATA-CONSTR">/AUTOSAR_Dem/DataConstrs/CONSTR_DemDebounceCounterFailedThreshold</DATA-CONSTR-REF>
                                </SW-DATA-DEF-PROPS-CONDITIONAL>
                              </SW-DATA-DEF-PROPS-VARIANTS>
                            </RESULTING-PROPERTIES>
                            <SYMBOL>CounterFailedThreshold</SYMBOL>
                          </MC-DATA-INSTANCE>
      [!IF "(DemGeneral/DemFreezeFrameCapture = 'DEM_TRIGGER_ON_FDC_THRESHOLD') or
            (DemGeneral/DemExtendedDataCapture = 'DEM_TRIGGER_ON_FDC_THRESHOLD')"!]
                          <MC-DATA-INSTANCE>
                            <SHORT-NAME>DemDebounceCounterUnconfirmedThreshold</SHORT-NAME>
                            <DESC>
                              <L-2 L="EN">
                                Value of internal fault detection counter, which indicates unconfirmedDTC status. In case unconfirmedDTC threshold is set to be same as failed threshold, the unconfirmedDTC threshold is deactivated for this event.
                              </L-2>
                            </DESC>
                            <CATEGORY>VALUE</CATEGORY>
                            <RESULTING-PROPERTIES>
                              <SW-DATA-DEF-PROPS-VARIANTS>
                                <SW-DATA-DEF-PROPS-CONDITIONAL>
                                  <BASE-TYPE-REF DEST="SW-BASE-TYPE">/AUTOSAR_Platform/BaseTypes/sint16</BASE-TYPE-REF>
                                  <SW-CALIBRATION-ACCESS>READ-WRITE</SW-CALIBRATION-ACCESS>
                                  <DATA-CONSTR-REF DEST="DATA-CONSTR">/AUTOSAR_Dem/DataConstrs/CONSTR_DemDebounceCounterUnconfirmedThreshold</DATA-CONSTR-REF>
                                </SW-DATA-DEF-PROPS-CONDITIONAL>
                              </SW-DATA-DEF-PROPS-VARIANTS>
                            </RESULTING-PROPERTIES>
                            <SYMBOL>CounterUnconfirmedThreshold</SYMBOL>
                          </MC-DATA-INSTANCE>
      [!ENDIF!]
                          <MC-DATA-INSTANCE>
                            <SHORT-NAME>DemDebounceCounterJumpDownValue</SHORT-NAME>
                            <DESC>
                              <L-2 L="EN">
                                Jump-Down value of the internal fault detection counter. Range is -32768..32767.
                              </L-2>
                            </DESC>
                            <CATEGORY>VALUE</CATEGORY>
                            <RESULTING-PROPERTIES>
                              <SW-DATA-DEF-PROPS-VARIANTS>
                                <SW-DATA-DEF-PROPS-CONDITIONAL>
                                  <BASE-TYPE-REF DEST="SW-BASE-TYPE">/AUTOSAR_Platform/BaseTypes/sint16</BASE-TYPE-REF>
                                  <SW-CALIBRATION-ACCESS>READ-WRITE</SW-CALIBRATION-ACCESS>
                                  <DATA-CONSTR-REF DEST="DATA-CONSTR">/AUTOSAR_Platform/DataConstrs/sint16</DATA-CONSTR-REF>
                                </SW-DATA-DEF-PROPS-CONDITIONAL>
                              </SW-DATA-DEF-PROPS-VARIANTS>
                            </RESULTING-PROPERTIES>
                            <SYMBOL>JumpDownValue</SYMBOL>
                          </MC-DATA-INSTANCE>
                          <MC-DATA-INSTANCE>
                            <SHORT-NAME>DemDebounceCounterJumpUpValue</SHORT-NAME>
                            <DESC>
                              <L-2 L="EN">
                                Jump-Up value of the internal fault detection counter. Range is -32768..32767.
                              </L-2>
                            </DESC>
                            <CATEGORY>VALUE</CATEGORY>
                            <RESULTING-PROPERTIES>
                              <SW-DATA-DEF-PROPS-VARIANTS>
                                <SW-DATA-DEF-PROPS-CONDITIONAL>
                                  <BASE-TYPE-REF DEST="SW-BASE-TYPE">/AUTOSAR_Platform/BaseTypes/sint16</BASE-TYPE-REF>
                                  <SW-CALIBRATION-ACCESS>READ-WRITE</SW-CALIBRATION-ACCESS>
                                  <DATA-CONSTR-REF DEST="DATA-CONSTR">/AUTOSAR_Platform/DataConstrs/sint16</DATA-CONSTR-REF>
                                </SW-DATA-DEF-PROPS-CONDITIONAL>
                              </SW-DATA-DEF-PROPS-VARIANTS>
                            </RESULTING-PROPERTIES>
                            <SYMBOL>JumpUpValue</SYMBOL>
                          </MC-DATA-INSTANCE>
                          <MC-DATA-INSTANCE>
                            <SHORT-NAME>DemDebounceCounterJumpDown</SHORT-NAME>
                            <DESC>
                              <L-2 L="EN">
                                Switch for the activation of Jump-Down.
                              </L-2>
                            </DESC>
                            <CATEGORY>VALUE</CATEGORY>
                            <RESULTING-PROPERTIES>
                              <SW-DATA-DEF-PROPS-VARIANTS>
                                <SW-DATA-DEF-PROPS-CONDITIONAL>
                                  <BASE-TYPE-REF DEST="SW-BASE-TYPE">/AUTOSAR_Platform/BaseTypes/boolean</BASE-TYPE-REF>
                                  <SW-CALIBRATION-ACCESS>READ-WRITE</SW-CALIBRATION-ACCESS>
                                  <COMPU-METHOD-REF DEST="COMPU-METHOD">/AUTOSAR_Dem/CompuMethods/CM_DemDebounceCounterJumpActiviationMethod</COMPU-METHOD-REF>
                                  <DATA-CONSTR-REF DEST="DATA-CONSTR">/AUTOSAR_Platform/DataConstrs/boolean</DATA-CONSTR-REF>
                                </SW-DATA-DEF-PROPS-CONDITIONAL>
                              </SW-DATA-DEF-PROPS-VARIANTS>
                            </RESULTING-PROPERTIES>
                            <SYMBOL>JumpDown</SYMBOL>
                          </MC-DATA-INSTANCE>
                          <MC-DATA-INSTANCE>
                            <SHORT-NAME>DemDebounceCounterJumpUp</SHORT-NAME>
                            <DESC>
                              <L-2 L="EN">
                                Switch for the activation of Jump-Up.
                              </L-2>
                            </DESC>
                            <CATEGORY>VALUE</CATEGORY>
                            <RESULTING-PROPERTIES>
                              <SW-DATA-DEF-PROPS-VARIANTS>
                                <SW-DATA-DEF-PROPS-CONDITIONAL>
                                  <BASE-TYPE-REF DEST="SW-BASE-TYPE">/AUTOSAR_Platform/BaseTypes/boolean</BASE-TYPE-REF>
                                  <SW-CALIBRATION-ACCESS>READ-WRITE</SW-CALIBRATION-ACCESS>
                                  <COMPU-METHOD-REF DEST="COMPU-METHOD">/AUTOSAR_Dem/CompuMethods/CM_DemDebounceCounterJumpActiviationMethod</COMPU-METHOD-REF>
                                  <DATA-CONSTR-REF DEST="DATA-CONSTR">/AUTOSAR_Platform/DataConstrs/boolean</DATA-CONSTR-REF>
                                </SW-DATA-DEF-PROPS-CONDITIONAL>
                              </SW-DATA-DEF-PROPS-VARIANTS>
                            </RESULTING-PROPERTIES>
                            <SYMBOL>JumpUp</SYMBOL>
                          </MC-DATA-INSTANCE>
                        </SUB-ELEMENTS>
                        <SYMBOL>[[!"num:i($DebounceIdx)"!]]</SYMBOL>
                      </MC-DATA-INSTANCE>
      [!VAR "DebounceIdx" = "$DebounceIdx + 1"!]
    [!ENDFOR!]
                    </SUB-ELEMENTS>
                    <SYMBOL>Dem_DebounceCounterClass</SYMBOL>
                  </MC-DATA-INSTANCE>
  [!ENDIF!]

  <!-- !LINKSTO Dem.Calibration.DemTimeBasedDebounceClassConcept.arxml,1 -->
  [!IF "$DebounceTimeClassCount > 0"!]
                  <MC-DATA-INSTANCE>
                    <SHORT-NAME>Dem_DebounceTimeClassIdx</SHORT-NAME>
                    <CATEGORY>ARRAY</CATEGORY>
                    <ARRAY-SIZE>[!"num:i(count(DemConfigSet/eb-list::*/DemEventParameter/eb-list::*[DemEventClass/DemDebounceAlgorithmClass = 'DemDebounceTimeBase']))"!]</ARRAY-SIZE>
                    <SUB-ELEMENTS>
    [!IF "$DebounceTimeClassCount <= 255"!]
      [!VAR "BitWidth" = "8"!]
      [!VAR "Type" = "'uint8'"!]
    [!ELSE!]
      [!VAR "BitWidth" = "16"!]
      [!VAR "Type" = "'uint16'"!]
    [!ENDIF!]
    [!VAR "Index" = "0"!]
    [!LOOP "util:distinct(node:order(DemConfigSet/eb-list::*/DemEventParameter/eb-list::*[DemEventClass/DemDebounceAlgorithmClass = 'DemDebounceTimeBase'], './DemEventId'))"!]
                      <MC-DATA-INSTANCE>
                        <SHORT-NAME>[!"as:name(.)"!]</SHORT-NAME>
                        <DESC>
                          <L-2 L="EN">Debounce Time based class index.</L-2>
                        </DESC>
                        <CATEGORY>VALUE</CATEGORY>
                        <RESULTING-PROPERTIES>
                          <SW-DATA-DEF-PROPS-VARIANTS>
                            <SW-DATA-DEF-PROPS-CONDITIONAL>
                              <BASE-TYPE-REF DEST="SW-BASE-TYPE">/AUTOSAR_Platform/BaseTypes/[!"$Type"!]</BASE-TYPE-REF>
                              <SW-CALIBRATION-ACCESS>READ-WRITE</SW-CALIBRATION-ACCESS>
                              <DATA-CONSTR-REF DEST="DATA-CONSTR">/AUTOSAR_Dem/DataConstrs/CONSTR_DebounceTimeClassIdx</DATA-CONSTR-REF>
                            </SW-DATA-DEF-PROPS-CONDITIONAL>
                          </SW-DATA-DEF-PROPS-VARIANTS>
                        </RESULTING-PROPERTIES>
                        <SYMBOL>[[!"num:i($Index)"!]]</SYMBOL>
                      </MC-DATA-INSTANCE>
      [!VAR "Index" = "$Index + 1"!]
    [!ENDLOOP!]
                    </SUB-ELEMENTS>
                    <SYMBOL>Dem_DebounceTimeClassIdx</SYMBOL>
                  </MC-DATA-INSTANCE>

                  <MC-DATA-INSTANCE>

                    <SHORT-NAME>Dem_DebounceTimeClass</SHORT-NAME>
                    <CATEGORY>ARRAY</CATEGORY>
                    <ARRAY-SIZE>[!"num:i($DebounceTimeClassCount)"!]</ARRAY-SIZE>
                    <SUB-ELEMENTS>
    [!VAR "TimeDebounceIdx" = "0"!]
    [!FOR "TimeDebounceCtrIndex" = "0" TO "$DebounceTimeClassCount - 1"!]
                      <MC-DATA-INSTANCE>
                        <SHORT-NAME>DemDebounceTimeBasedClass_[!"num:i($TimeDebounceIdx)"!]</SHORT-NAME>
                        <CATEGORY>STRUCTURE</CATEGORY>
                        <SUB-ELEMENTS>
                          <MC-DATA-INSTANCE>
                            <SHORT-NAME>TimeFailedThreshold</SHORT-NAME>
                            <CATEGORY>VALUE</CATEGORY>
                            <RESULTING-PROPERTIES>
                              <SW-DATA-DEF-PROPS-VARIANTS>
                                <SW-DATA-DEF-PROPS-CONDITIONAL>
                                  <BASE-TYPE-REF DEST="SW-BASE-TYPE">/AUTOSAR_Platform/BaseTypes/uint32</BASE-TYPE-REF>
                                  <SW-CALIBRATION-ACCESS>READ-WRITE</SW-CALIBRATION-ACCESS>
                                  <DATA-CONSTR-REF DEST="DATA-CONSTR">/AUTOSAR_Platform/DataConstrs/uint32</DATA-CONSTR-REF>
                                </SW-DATA-DEF-PROPS-CONDITIONAL>
                              </SW-DATA-DEF-PROPS-VARIANTS>
                            </RESULTING-PROPERTIES>
                            <SYMBOL>TimeFailedThreshold</SYMBOL>
                          </MC-DATA-INSTANCE>
                          <MC-DATA-INSTANCE>
                            <SHORT-NAME>TimePassedThreshold</SHORT-NAME>
                            <CATEGORY>VALUE</CATEGORY>
                            <RESULTING-PROPERTIES>
                              <SW-DATA-DEF-PROPS-VARIANTS>
                                <SW-DATA-DEF-PROPS-CONDITIONAL>
                                  <BASE-TYPE-REF DEST="SW-BASE-TYPE">/AUTOSAR_Platform/BaseTypes/uint32</BASE-TYPE-REF>
                                  <SW-CALIBRATION-ACCESS>READ-WRITE</SW-CALIBRATION-ACCESS>
                                  <DATA-CONSTR-REF DEST="DATA-CONSTR">/AUTOSAR_Platform/DataConstrs/uint32</DATA-CONSTR-REF>
                                </SW-DATA-DEF-PROPS-CONDITIONAL>
                              </SW-DATA-DEF-PROPS-VARIANTS>
                            </RESULTING-PROPERTIES>
                            <SYMBOL>TimePassedThreshold</SYMBOL>
                          </MC-DATA-INSTANCE>
                        </SUB-ELEMENTS>
                        <SYMBOL>[[!"num:i($TimeDebounceIdx)"!]]</SYMBOL>
                      </MC-DATA-INSTANCE>
      [!VAR "TimeDebounceIdx" = "$TimeDebounceIdx + 1"!]
    [!ENDFOR!]
                    </SUB-ELEMENTS>
                    <SYMBOL>Dem_DebounceTimeClass</SYMBOL>
                  </MC-DATA-INSTANCE>
  [!ENDIF!]

  <!-- !LINKSTO VCC_DEM_006_Req104v1,1 -->
                  <MC-DATA-INSTANCE>
                    <SHORT-NAME>Dem_EventEnabled</SHORT-NAME>
                    <CATEGORY>ARRAY</CATEGORY>
                    <ARRAY-SIZE>[!"num:i((count(DemConfigSet/eb-list::*/DemEventParameter/eb-list::*) + 1 + 7) div 8)"!]</ARRAY-SIZE>
                    <SUB-ELEMENTS>
  [!LOOP "util:distinct(node:order(DemConfigSet/eb-list::*/DemEventParameter/eb-list::*, 'DemEventId'))"!]
                      <MC-DATA-INSTANCE>
                        <SHORT-NAME>EventAvailable_[!"num:i(DemEventId)"!]</SHORT-NAME>
                          <DESC>
                            <L-2 L="EN">
                              Availability of event (1 means enabled, 0 means disabled). Calibration of this value is only allowed before Dem_PreInit() is called.
                              <!--If the event which provides the OBD freeze frame is disabled
                              the OBD freeze frame will not be updated and no OBD freeze frame will
                              be provided to the Dcm. If an event which is stored in event memory is
                              disabled the event memory entry is not available anymore. The Dem
                              NvM-blocks has to be invalidated after re-calibration is performed
                              (in order to avoid data inconsistency). If the event stored in event
                              memory is also combined, disabling it could lead to an inconsistent UDS
                              DTC status and shall be avoided at any case. For service 0x19, if the DTC
                              referenced by the event ID is identified by the algorithm, the value
                              of the DTC will be returned. In case calibration occurs with 0 for the
                              event ID and the service is called again, the DTC referenced by the
                              disabled event is identified by the algorithm, the DTC returned by the
                              service is DEM_NO_DTC. If re-calibration is performed during Dem
                              processing or without invalidation of outdated Dem NvM-blocks the Dem
                              behavior is undefined (can lead e.g. to segmentation faults in the
                              worst case).-->
                            </L-2>
                          </DESC>
                        <CATEGORY>VALUE</CATEGORY>
                        <RESULTING-PROPERTIES>
                          <SW-DATA-DEF-PROPS-VARIANTS>
                            <SW-DATA-DEF-PROPS-CONDITIONAL>
                              <BASE-TYPE-REF DEST="SW-BASE-TYPE">/AUTOSAR_Platform/BaseTypes/uint8</BASE-TYPE-REF>
                              <SW-BIT-REPRESENTATION>
                                <BIT-POSITION>[!"num:i(DemEventId mod 8)"!]</BIT-POSITION>
                                <NUMBER-OF-BITS>1</NUMBER-OF-BITS>
                              </SW-BIT-REPRESENTATION>
                              <SW-CALIBRATION-ACCESS>READ-WRITE</SW-CALIBRATION-ACCESS>
                              <COMPU-METHOD-REF DEST="COMPU-METHOD">/AUTOSAR_Dem/CompuMethods/CM_DemEventEnabled</COMPU-METHOD-REF>
                              <DATA-CONSTR-REF DEST="DATA-CONSTR">/AUTOSAR_Platform/DataConstrs/uint8</DATA-CONSTR-REF>
                            </SW-DATA-DEF-PROPS-CONDITIONAL>
                          </SW-DATA-DEF-PROPS-VARIANTS>
                        </RESULTING-PROPERTIES>
                        <SYMBOL>[[!"num:i(DemEventId div 8)"!]]</SYMBOL>
                      </MC-DATA-INSTANCE>
  [!ENDLOOP!]
                    </SUB-ELEMENTS>
                    <SYMBOL>Dem_EventEnabled</SYMBOL>
                  </MC-DATA-INSTANCE>

  [!/*  - Generate calibration data for DEM_EVCOMB_DISABLED - */!][!//
  [!IF "$CalibrationWithoutEvCombSupport = 'true'"!]
    [!IF "node:existsAndTrue(DemGeneral/DemDevFreezeFrameSupport)"!]
                  <!-- !LINKSTO Dem.Calibration.IndividualDevFF,1 -->
                  <MC-DATA-INSTANCE>
                    <SHORT-NAME>Dem_EventDescDevFF</SHORT-NAME>
                    <CATEGORY>ARRAY</CATEGORY>
                    <ARRAY-SIZE>[!"num:integer(count(DemConfigSet/eb-list::*/DemEventParameter/eb-list::*) + 1)"!]</ARRAY-SIZE>
                    <SUB-ELEMENTS>
      [!LOOP "util:distinct(node:order(DemConfigSet/eb-list::*/DemEventParameter/eb-list::*, 'DemEventId'))"!]
                      <MC-DATA-INSTANCE>
                        <SHORT-NAME>DevFreezeFrames_[!"num:i(DemEventId)"!]</SHORT-NAME>
                        <CATEGORY>ARRAY</CATEGORY>
                        <ARRAY-SIZE>2</ARRAY-SIZE>
                        <SUB-ELEMENTS>
                          <MC-DATA-INSTANCE>
                            <SHORT-NAME>DevFF_A</SHORT-NAME>
                            <CATEGORY>STRUCTURE</CATEGORY>
                            <SUB-ELEMENTS>
                              <MC-DATA-INSTANCE>
                                <SHORT-NAME>DevFFClassIdx</SHORT-NAME>
                                <DESC>
                                  <L-2 L="EN">
                                    Development Freeze Frame A class index (Event: [!"as:name(.)"!]). Value [!"num:i($NumFFCls)"!] is used to disable.
                                    <!--Ranges between 0 and [!"$NumFFCls"!] defined as number of
                                    configured DemFreezeFrameClasses.
                                    Values bigger than [!"$NumFFCls"!] are not allowed.
                                    It is not allowed to calibrate freeze frames that are larger than
                                    the largest freeze frame referenced via DemDevFreezeFrameAClassRef.
                                    Note: Development freeze frame data must not include data elements with
                                    parameter DemDataElementCaptureTrigger configured to
                                    DEM_TRIGGER_ON_DEQUALIFICATION.-->
                                  </L-2>
                                </DESC>
                                <CATEGORY>VALUE</CATEGORY>
                                <RESULTING-PROPERTIES>
                                  <SW-DATA-DEF-PROPS-VARIANTS>
                                    <SW-DATA-DEF-PROPS-CONDITIONAL>
                                      <BASE-TYPE-REF DEST="SW-BASE-TYPE">/AUTOSAR_Platform/BaseTypes/uint16</BASE-TYPE-REF>
                                      <SW-CALIBRATION-ACCESS>READ-WRITE</SW-CALIBRATION-ACCESS>
                                      <DATA-CONSTR-REF DEST="DATA-CONSTR">/AUTOSAR_Dem/DataConstrs/CONSTR_DemDevFFClassIdx</DATA-CONSTR-REF>
                                    </SW-DATA-DEF-PROPS-CONDITIONAL>
                                  </SW-DATA-DEF-PROPS-VARIANTS>
                                </RESULTING-PROPERTIES>
                                <SYMBOL>DevFFClassIdx</SYMBOL>
                              </MC-DATA-INSTANCE>
                            </SUB-ELEMENTS>
                            <SYMBOL>[0]</SYMBOL>
                          </MC-DATA-INSTANCE>
                          <MC-DATA-INSTANCE>
                            <SHORT-NAME>DevFF_B</SHORT-NAME>
                            <CATEGORY>STRUCTURE</CATEGORY>
                            <SUB-ELEMENTS>
                              <MC-DATA-INSTANCE>
                                <SHORT-NAME>DevFFClassIdx</SHORT-NAME>
                                <DESC>
                                  <L-2 L="EN">
                                    Development Freeze Frame B class index (Event: [!"as:name(.)"!]).
                                    <!--Ranges between 0 and [!"$NumFFCls"!] defined as number of
                                    configured DemFreezeFrameClasses. Calibrating this class index to the value
                                    [!"$NumFFCls"!] will disable the DevFF_B functionality.
                                    Values bigger than [!"$NumFFCls"!] are not allowed.
                                    It is not allowed to calibrate freeze frames that are larger than
                                    the largest freeze frame referenced via DemDevFreezeFrameBClassRef.
                                    Note: Development freeze frame data must not include data elements with
                                    parameter DemDataElementCaptureTrigger configured to
                                    DEM_TRIGGER_ON_DEQUALIFICATION.-->
                                  </L-2>
                                </DESC>
                                <CATEGORY>VALUE</CATEGORY>
                                <RESULTING-PROPERTIES>
                                  <SW-DATA-DEF-PROPS-VARIANTS>
                                    <SW-DATA-DEF-PROPS-CONDITIONAL>
                                      <BASE-TYPE-REF DEST="SW-BASE-TYPE">/AUTOSAR_Platform/BaseTypes/uint16</BASE-TYPE-REF>
                                      <SW-CALIBRATION-ACCESS>READ-WRITE</SW-CALIBRATION-ACCESS>
                                      <DATA-CONSTR-REF DEST="DATA-CONSTR">/AUTOSAR_Dem/DataConstrs/CONSTR_DemDevFFClassIdx</DATA-CONSTR-REF>
                                    </SW-DATA-DEF-PROPS-CONDITIONAL>
                                  </SW-DATA-DEF-PROPS-VARIANTS>
                                </RESULTING-PROPERTIES>
                                <SYMBOL>DevFFClassIdx</SYMBOL>
                              </MC-DATA-INSTANCE>
                            </SUB-ELEMENTS>
                            <SYMBOL>[1]</SYMBOL>
                          </MC-DATA-INSTANCE>
                        </SUB-ELEMENTS>
                        <SYMBOL>[[!"DemEventId"!]]</SYMBOL>
                      </MC-DATA-INSTANCE>
      [!ENDLOOP!]
                    </SUB-ELEMENTS>
                    <SYMBOL>Dem_EventDescDevFF</SYMBOL>
                  </MC-DATA-INSTANCE>
    [!ENDIF!]

    [!IF "(node:refexists(DemGeneral/DemCommonFFDataClassRef)) or
        ( (node:existsAndTrue(DemGeneral/DemDevFreezeFrameSupport)) and
            (node:refexists(DemGeneral/DemCommonFFDataDevAClassRef)) )"!]
                  <!-- !LINKSTO Dem.Calibration.CommonFF,1 -->
                  <MC-DATA-INSTANCE>
                    <SHORT-NAME>Dem_CommonPartFFClassIdx</SHORT-NAME>
                    <CATEGORY>ARRAY</CATEGORY>
                    <ARRAY-SIZE>2</ARRAY-SIZE>
                    <SUB-ELEMENTS>
                      <MC-DATA-INSTANCE>
                        <SHORT-NAME>Common_DevFF_A_Class_Index</SHORT-NAME>
                        <DESC>
                          <L-2 L="EN">
                            Class index of the common freeze frame part of DevFF_A.
                            <!-- Ranges between 0 and [!"$NumFFCls"!] defined as number of configured
                            DemFreezeFrameClasses.Calibrating this class index to the value [!"$NumFFCls"!]
                            will disable the common freeze frame part of development freeze
                            frame A functionality. Values bigger than [!"$NumFFCls"!] are not allowed.
                            Note: The common freeze frame data must not include data elements with
                            parameter DemDataElementCaptureTrigger configured to
                            DEM_TRIGGER_ON_DEQUALIFICATION.-->
                          </L-2>
                        </DESC>
                        <CATEGORY>VALUE</CATEGORY>
                        <RESULTING-PROPERTIES>
                          <SW-DATA-DEF-PROPS-VARIANTS>
                            <SW-DATA-DEF-PROPS-CONDITIONAL>
                              <BASE-TYPE-REF DEST="SW-BASE-TYPE">/AUTOSAR_Platform/BaseTypes/uint16</BASE-TYPE-REF>
                              <SW-CALIBRATION-ACCESS>READ-WRITE</SW-CALIBRATION-ACCESS>
                              <DATA-CONSTR-REF DEST="DATA-CONSTR">/AUTOSAR_Dem/DataConstrs/CONSTR_DemDevFFClassIdx</DATA-CONSTR-REF>
                            </SW-DATA-DEF-PROPS-CONDITIONAL>
                          </SW-DATA-DEF-PROPS-VARIANTS>
                        </RESULTING-PROPERTIES>
                        <SYMBOL>[0]</SYMBOL>
                      </MC-DATA-INSTANCE>
                      <MC-DATA-INSTANCE>
                        <SHORT-NAME>Common_RegularFF_Class_Index</SHORT-NAME>
                        <DESC>
                          <L-2 L="EN">
                            Class index of the common freeze frame part of regular freeze frame.
                            <!-- Calibrating this class index to the value [!"$NumFFCls"!] will
                            disable the common freeze frame part of regular freeze frame functionality.
                            Ranges between 0 and [!"$NumFFCls"!] defined as number of configured
                            DemFreezeFrameClasses. Values bigger than [!"$NumFFCls"!] are not allowed.
                            Note: The common freeze frame shall not be changed via calibration, when
                            events with 'DemEventKind' set to 'DEM_EVENT_KIND_SEV' are configured.
                            Note: The common freeze frame data must not include data elements with
                            parameter DemDataElementCaptureTrigger configured to
                            DEM_TRIGGER_ON_DEQUALIFICATION.-->
                          </L-2>
                        </DESC>
                        <CATEGORY>VALUE</CATEGORY>
                        <RESULTING-PROPERTIES>
                          <SW-DATA-DEF-PROPS-VARIANTS>
                            <SW-DATA-DEF-PROPS-CONDITIONAL>
                              <BASE-TYPE-REF DEST="SW-BASE-TYPE">/AUTOSAR_Platform/BaseTypes/uint16</BASE-TYPE-REF>
                              <SW-CALIBRATION-ACCESS>READ-WRITE</SW-CALIBRATION-ACCESS>
                              <DATA-CONSTR-REF DEST="DATA-CONSTR">/AUTOSAR_Dem/DataConstrs/CONSTR_DemDevFFClassIdx</DATA-CONSTR-REF>
                            </SW-DATA-DEF-PROPS-CONDITIONAL>
                          </SW-DATA-DEF-PROPS-VARIANTS>
                        </RESULTING-PROPERTIES>
                        <SYMBOL>[2]</SYMBOL>
                      </MC-DATA-INSTANCE>
                    </SUB-ELEMENTS>
                    <SYMBOL>Dem_CommonPartFFClassIdx</SYMBOL>
                  </MC-DATA-INSTANCE>
    [!ENDIF!]
