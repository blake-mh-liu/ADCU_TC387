[part 2 of 2]

    [!VAR "EnableConditionGroupNumber" = "num:integer(count(DemGeneral/DemEnableConditionGroup/eb-list::*))"!]
    [!CALL "GET_VCC_OCC5_USED"!][!//
    [!CALL "CREATE_EVENT_CLASS_LIST"!]
                  <MC-DATA-INSTANCE>
                    <SHORT-NAME>Dem_EventClassDesc</SHORT-NAME>
                    <CATEGORY>ARRAY</CATEGORY>
                    <ARRAY-SIZE>[!"num:i($MaxNumberEventClasses)"!]</ARRAY-SIZE>
                    <SUB-ELEMENTS>
    [!VAR "EventClassIdx" = "0"!]
    [!FOR "EmptyEventClassIdx" = "$EventClassIdx"  TO "$MaxNumberEventClasses - 1"!]
      [!VAR "EventClassString" = "."!]
                      <!-- !LINKSTO VCC_DEM_007_Req106v2,1 -->
                      <MC-DATA-INSTANCE>
                        <SHORT-NAME>EventClass_[!"num:i($EventClassIdx)"!]</SHORT-NAME>
                        <CATEGORY>STRUCTURE</CATEGORY>
                        <SUB-ELEMENTS>
                          <!-- !LINKSTO VCC_DEM_006_Req108v1,1 -->
                          <MC-DATA-INSTANCE>
                            <SHORT-NAME>IndicatorClassIdx</SHORT-NAME>
                            <DESC>
                              <L-2 L="EN">
                                Allows calibration of indicator groups represented by Dem_IndicatorClasses.IndicatorClasses_x_y. Calibrate 'x' where 'x' denotes main group index and 'y' denotes group indicators. Single indicators are denoted by 'x' alone. Value [!"num:i($NumberOfIndicatorClasses + 1)"!] is used to disable.
                                <!--Notes for events assigned to a MIL group:
                                - If the MIL indicator is removed through calibration, the event is no longer
                                considered as member of the MIL group.
                                - If the calibration of the MIL indicator's class causes 'DemIndicatorFailureCycleRef'
                                or 'DemIndicatorFailureCycleCounterThreshold' to be different from 'DemOperationCycleRef'
                                or, respectively, 'DemEventFailureCycleCounterThreshold', the failure counters are not
                                in sync anymore. This could lead to undefined behavior at run-time.
                                - Calibration of the MIL indicator to a class with 'DemIndicatorFailureCycleCounterThreshold'
                                equal to 1 is not allowed.
                                Note for events with 'DemEventKind' set to 'DEM_EVENT_KIND_SEV':
                                No indicator may be assigned via calibration.-->
                              </L-2>
                            </DESC>
                            <CATEGORY>VALUE</CATEGORY>
                            <RESULTING-PROPERTIES>
                              <SW-DATA-DEF-PROPS-VARIANTS>
                                <SW-DATA-DEF-PROPS-CONDITIONAL>
                                  <BASE-TYPE-REF DEST="SW-BASE-TYPE">/AUTOSAR_Platform/BaseTypes/[!"$DemIndicatorGrpIdxType"!]</BASE-TYPE-REF>
                                  <SW-CALIBRATION-ACCESS>READ-WRITE</SW-CALIBRATION-ACCESS>
                                  <DATA-CONSTR-REF DEST="DATA-CONSTR">/AUTOSAR_Dem/DataConstrs/CONSTR_IndicatorClassIdx</DATA-CONSTR-REF>
                                </SW-DATA-DEF-PROPS-CONDITIONAL>
                              </SW-DATA-DEF-PROPS-VARIANTS>
                            </RESULTING-PROPERTIES>
                            <SYMBOL>IndicatorClassIdx</SYMBOL>
                          </MC-DATA-INSTANCE>
      [!IF "node:exists(DemConfigSet/eb-list::*/DemEventParameter/eb-list::*[node:existsAndTrue(DemEventClass/DemAgingAllowed)])"!]
                          <MC-DATA-INSTANCE>
                            <SHORT-NAME>AgingCycleCounterThreshold</SHORT-NAME>
                            <DESC>
                              <L-2 L="EN">
                                Value of DemAgingCycleCounterThreshold. Calibration of this value is only allowed before Dem_PreInit() is called. After re-calibration of aging support the stored event related data is not valid. Value 0 disables aging.
                                <!--Note that for events with 'DemEventKind' set to 'DEM_EVENT_KIND_SEV'
                                aging must not be enabled via calibration.-->
                              </L-2>
                            </DESC>
                            <CATEGORY>VALUE</CATEGORY>
                            <RESULTING-PROPERTIES>
                              <SW-DATA-DEF-PROPS-VARIANTS>
                                <SW-DATA-DEF-PROPS-CONDITIONAL>
                                  <BASE-TYPE-REF DEST="SW-BASE-TYPE">/AUTOSAR_Platform/BaseTypes/uint8</BASE-TYPE-REF>
                                  <SW-CALIBRATION-ACCESS>READ-WRITE</SW-CALIBRATION-ACCESS>
                                  <DATA-CONSTR-REF DEST="DATA-CONSTR">/AUTOSAR_Platform/DataConstrs/uint8</DATA-CONSTR-REF>
                                </SW-DATA-DEF-PROPS-CONDITIONAL>
                              </SW-DATA-DEF-PROPS-VARIANTS>
                            </RESULTING-PROPERTIES>
                            <SYMBOL>AgingCycleCounterThreshold</SYMBOL>
                          </MC-DATA-INSTANCE>
      [!ENDIF!]
      [!IF "$VccOcc5Used = 1"!]
                          <MC-DATA-INSTANCE>
                            <SHORT-NAME>OBDAgingCycleCounterThreshold</SHORT-NAME>
                            <DESC>
                              <L-2 L="EN">
                                Value of DemOBDAgingCycleCounterThreshold. Calibration of this value is only allowed before Dem_PreInit() is called. If the threshold is re-calibrated the effect is considered at the next processing and not during initialization. Value 0 disables aging.
                              </L-2>
                            </DESC>
                            <CATEGORY>VALUE</CATEGORY>
                            <RESULTING-PROPERTIES>
                              <SW-DATA-DEF-PROPS-VARIANTS>
                                <SW-DATA-DEF-PROPS-CONDITIONAL>
                                  <BASE-TYPE-REF DEST="SW-BASE-TYPE">/AUTOSAR_Platform/BaseTypes/uint8</BASE-TYPE-REF>
                                  <SW-CALIBRATION-ACCESS>READ-WRITE</SW-CALIBRATION-ACCESS>
                                  <DATA-CONSTR-REF DEST="DATA-CONSTR">/AUTOSAR_Platform/DataConstrs/uint8</DATA-CONSTR-REF>
                                </SW-DATA-DEF-PROPS-CONDITIONAL>
                              </SW-DATA-DEF-PROPS-VARIANTS>
                            </RESULTING-PROPERTIES>
                            <SYMBOL>OBDAgingCycleCounterThreshold</SYMBOL>
                          </MC-DATA-INSTANCE>
      [!ENDIF!]
                          <!-- !LINKSTO Dem.Calibration.DemEventFailureCycleCounterThreshold.EventCombinationDisabled,1 -->
                          <MC-DATA-INSTANCE>
                            <SHORT-NAME>EventFailureCycleCounterThreshold</SHORT-NAME>
                            <DESC>
                              <L-2 L="EN">
                                Value of DemEventFailureCycleCounterThreshold. Value 0 is only limited to events assigned to a driving cycle i.e. Zero-trip events. For MIL group events, the calibration of this parameter to value 1 is not allowed.
                                <!--Allowed calibration values are in the range 0..254.
                                If the 'DemEventFailureCycleCounterThreshold' of a MIL group event is changed
                                to be different from 'DemIndicatorFailureCycleCounterThreshold' configured
                                for its MIL indicator, the MIL counter and the confirmation counter would not
                                be in sync anymore. This could lead to undefined behavior during runtime.
                                Note:
                                - The calibrated threshold will be applied to all the events which belong to
                                  EventClass_[!"num:i($EventClassIdx)"!].-->
                              </L-2>
                            </DESC>
                            <CATEGORY>VALUE</CATEGORY>
                            <RESULTING-PROPERTIES>
                              <SW-DATA-DEF-PROPS-VARIANTS>
                                <SW-DATA-DEF-PROPS-CONDITIONAL>
                                  <BASE-TYPE-REF DEST="SW-BASE-TYPE">/AUTOSAR_Platform/BaseTypes/uint8</BASE-TYPE-REF>
                                  <SW-CALIBRATION-ACCESS>READ-WRITE</SW-CALIBRATION-ACCESS>
                                  <DATA-CONSTR-REF DEST="DATA-CONSTR">/AUTOSAR_Dem/DataConstrs/CONSTR_EventFailureCycleCounterThreshold</DATA-CONSTR-REF>
                                </SW-DATA-DEF-PROPS-CONDITIONAL>
                              </SW-DATA-DEF-PROPS-VARIANTS>
                            </RESULTING-PROPERTIES>
                            <SYMBOL>EventFailureCycleCounterThreshold</SYMBOL>
                          </MC-DATA-INSTANCE>
                          <MC-DATA-INSTANCE>
                            <SHORT-NAME>EventPriority</SHORT-NAME>
                            <DESC>
                              <L-2 L="EN">
                                Internal value of configured event priority. Value 0 represents the highest priority and each value sequentially larger represents a lower priority in the ranking of all configured priorities.
                                <!--Dem does not store the configured DemEventPriority value directly, but creates an ordered
                                list of all configured unique DemEventPriority values in ascending priority value order to build
                                a ranking of configured priorities.
                                You calibrate the index into the list of configured event priorities. That means, it is not
                                possible to add new event priority values via calibration.-->
                              </L-2>
                            </DESC>
                            <CATEGORY>VALUE</CATEGORY>
                            <RESULTING-PROPERTIES>
                              <SW-DATA-DEF-PROPS-VARIANTS>
                                <SW-DATA-DEF-PROPS-CONDITIONAL>
                                  <BASE-TYPE-REF DEST="SW-BASE-TYPE">/AUTOSAR_Platform/BaseTypes/uint8</BASE-TYPE-REF>
                                  <SW-CALIBRATION-ACCESS>READ-WRITE</SW-CALIBRATION-ACCESS>
      [!IF "(node:existsAndTrue(as:modconf('Dem')[1]/DemGeneral/DemEventDisplacementSupport))"!]
                                  <DATA-CONSTR-REF DEST="DATA-CONSTR">/AUTOSAR_Dem/DataConstrs/CONSTR_EventPriorityIdx</DATA-CONSTR-REF>
      [!ELSE!]
                                  <DATA-CONSTR-REF DEST="DATA-CONSTR">/AUTOSAR_Platform/DataConstrs/uint8</DATA-CONSTR-REF>
      [!ENDIF!]
                                </SW-DATA-DEF-PROPS-CONDITIONAL>
                              </SW-DATA-DEF-PROPS-VARIANTS>
                            </RESULTING-PROPERTIES>
                            <SYMBOL>EventPriority</SYMBOL>
                          </MC-DATA-INSTANCE>
      [!IF "$CommonOperationCycleEnabled = 'true'"!]
                          <MC-DATA-INSTANCE>
                            <SHORT-NAME>CommonOperationCycle</SHORT-NAME>
                            <DESC>
                              <L-2 L="EN">
                                Common operation cycle is used as aging cycle, event failure cycle, indicator failure cycle and indicator healing cycle. It has to reference a configured operation cycle.
                                <!--Calibrating the common operation cycle of events assigned to the same MIL
                                group with different operation cycles could lead to
                                undefined behavior during runtime.-->
                              </L-2>
                            </DESC>
                            <CATEGORY>VALUE</CATEGORY>
                            <RESULTING-PROPERTIES>
                              <SW-DATA-DEF-PROPS-VARIANTS>
                                <SW-DATA-DEF-PROPS-CONDITIONAL>
                                  <BASE-TYPE-REF DEST="SW-BASE-TYPE">/AUTOSAR_Platform/BaseTypes/uint8</BASE-TYPE-REF>
                                  <SW-CALIBRATION-ACCESS>READ-WRITE</SW-CALIBRATION-ACCESS>
                                  <COMPU-METHOD-REF DEST="COMPU-METHOD">/AUTOSAR_Dem/CompuMethods/CM_OperationCycle</COMPU-METHOD-REF>
                                  <DATA-CONSTR-REF DEST="DATA-CONSTR">/AUTOSAR_Platform/DataConstrs/uint8</DATA-CONSTR-REF>
                                </SW-DATA-DEF-PROPS-CONDITIONAL>
                              </SW-DATA-DEF-PROPS-VARIANTS>
                            </RESULTING-PROPERTIES>
                            <SYMBOL>CommonOperationCycle</SYMBOL>
                          </MC-DATA-INSTANCE>
      [!ENDIF!]
      [!IF "$AgingAllowedSeperateFlag = 'true'"!]
                          <MC-DATA-INSTANCE>
                            <SHORT-NAME>AgingAllowed</SHORT-NAME>
                            <DESC>
                              <L-2 L="EN">
                                Parameter to enable/disable aging. Calibration of this value is only allowed before Dem_PreInit() is called. After re-calibration of aging allowed the stored event related data is not valid.
                                <!--Note that for events with 'DemEventKind' set to 'DEM_EVENT_KIND_SEV'
                                aging must not be enabled via calibration.-->
                              </L-2>
                            </DESC>
                            <CATEGORY>VALUE</CATEGORY>
                            <RESULTING-PROPERTIES>
                              <SW-DATA-DEF-PROPS-VARIANTS>
                                <SW-DATA-DEF-PROPS-CONDITIONAL>
                                  <BASE-TYPE-REF DEST="SW-BASE-TYPE">/AUTOSAR_Platform/BaseTypes/boolean</BASE-TYPE-REF>
                                  <SW-CALIBRATION-ACCESS>READ-WRITE</SW-CALIBRATION-ACCESS>
                                  <COMPU-METHOD-REF DEST="COMPU-METHOD">/AUTOSAR_Dem/CompuMethods/CM_DemAgingAllowed</COMPU-METHOD-REF>
                                  <DATA-CONSTR-REF DEST="DATA-CONSTR">/AUTOSAR_Platform/DataConstrs/boolean</DATA-CONSTR-REF>
                                </SW-DATA-DEF-PROPS-CONDITIONAL>
                              </SW-DATA-DEF-PROPS-VARIANTS>
                            </RESULTING-PROPERTIES>
                            <SYMBOL>AgingAllowed</SYMBOL>
                          </MC-DATA-INSTANCE>
      [!ENDIF!]
      [!IF "($OBDSupport = 'true') or ($FreezeFrameRecordCapture = 'DEM_TRIGGER_ON_FDC_THRESHOLD')"!][!//
                          <MC-DATA-INSTANCE>
                            <SHORT-NAME>Bitfield</SHORT-NAME>
                            <DESC>
                              <L-2 L="EN">Collection of Boolean parameters per Event Class</L-2>
                            </DESC>
                            <CATEGORY>STRUCTURE</CATEGORY>
                            <SUB-ELEMENTS>
                              <MC-DATA-INSTANCE>
                                <SHORT-NAME>MinRatioEvent</SHORT-NAME>
                                <DESC>
                                  <L-2 L="EN">
                                    Value 1 means DemMinRatioEvent == 'true' and value 0 implies that DemMinRatioEvent == 'false'.
                                  </L-2>
                                </DESC>
                                <CATEGORY>VALUE</CATEGORY>
                                <RESULTING-PROPERTIES>
                                  <SW-DATA-DEF-PROPS-VARIANTS>
                                    <SW-DATA-DEF-PROPS-CONDITIONAL>
                                      <BASE-TYPE-REF DEST="SW-BASE-TYPE">/AUTOSAR_Platform/BaseTypes/uint8</BASE-TYPE-REF>
                                      <SW-BIT-REPRESENTATION>
                                        <BIT-POSITION>0</BIT-POSITION>
                                        <NUMBER-OF-BITS>1</NUMBER-OF-BITS>
                                      </SW-BIT-REPRESENTATION>
                                      <SW-CALIBRATION-ACCESS>READ-WRITE</SW-CALIBRATION-ACCESS>
                                      <COMPU-METHOD-REF DEST="COMPU-METHOD">/AUTOSAR_Dem/CompuMethods/CM_MinRatioEvent</COMPU-METHOD-REF>
                                      <DATA-CONSTR-REF DEST="DATA-CONSTR">/AUTOSAR_Platform/DataConstrs/uint8</DATA-CONSTR-REF>
                                    </SW-DATA-DEF-PROPS-CONDITIONAL>
                                  </SW-DATA-DEF-PROPS-VARIANTS>
                                </RESULTING-PROPERTIES>
                                <SYMBOL>Bitfield</SYMBOL>
                              </MC-DATA-INSTANCE>
                              <MC-DATA-INSTANCE>
                                <SHORT-NAME>FreezeFrameUpdate</SHORT-NAME>
                                <DESC>
                                  <L-2 L="EN">
                                    Value 1 means DemFreezeFrameUpdate == 'true' and value 0 implies that DemFreezeFrameUpdate == 'false'.
                                  </L-2>
                                </DESC>
                                <CATEGORY>VALUE</CATEGORY>
                                <RESULTING-PROPERTIES>
                                  <SW-DATA-DEF-PROPS-VARIANTS>
                                    <SW-DATA-DEF-PROPS-CONDITIONAL>
                                      <BASE-TYPE-REF DEST="SW-BASE-TYPE">/AUTOSAR_Platform/BaseTypes/uint8</BASE-TYPE-REF>
                                      <SW-BIT-REPRESENTATION>
                                        <BIT-POSITION>1</BIT-POSITION>
                                        <NUMBER-OF-BITS>1</NUMBER-OF-BITS>
                                      </SW-BIT-REPRESENTATION>
                                      <SW-CALIBRATION-ACCESS>READ-WRITE</SW-CALIBRATION-ACCESS>
                                      <COMPU-METHOD-REF DEST="COMPU-METHOD">/AUTOSAR_Dem/CompuMethods/CM_FreezeFrameUpdate</COMPU-METHOD-REF>
                                      <DATA-CONSTR-REF DEST="DATA-CONSTR">/AUTOSAR_Platform/DataConstrs/uint8</DATA-CONSTR-REF>
                                    </SW-DATA-DEF-PROPS-CONDITIONAL>
                                  </SW-DATA-DEF-PROPS-VARIANTS>
                                </RESULTING-PROPERTIES>
                                <SYMBOL>Bitfield</SYMBOL>
                              </MC-DATA-INSTANCE>
                            </SUB-ELEMENTS>
                          </MC-DATA-INSTANCE>
      [!ENDIF!]
      [!IF "$EnableConditionGroupNumber > 0"!]
                          <MC-DATA-INSTANCE>
                            <SHORT-NAME>EnableConditionGroupRef</SHORT-NAME>
                            <DESC>
                              <L-2 L="EN">
                                Reference to a configured enable condition group. Value [!"num:i($DemNumEnCondGroups)"!] is used to disable. Range is 0..[!"num:i($DemNumEnCondGroups)"!].
                              </L-2>
                            </DESC>
                            <CATEGORY>VALUE</CATEGORY>
                            <RESULTING-PROPERTIES>
                              <SW-DATA-DEF-PROPS-VARIANTS>
                                <SW-DATA-DEF-PROPS-CONDITIONAL>
                                  <BASE-TYPE-REF DEST="SW-BASE-TYPE">/AUTOSAR_Platform/BaseTypes/uint8</BASE-TYPE-REF>
                                  <SW-CALIBRATION-ACCESS>READ-WRITE</SW-CALIBRATION-ACCESS>
                                  <DATA-CONSTR-REF DEST="DATA-CONSTR">/AUTOSAR_Platform/DataConstrs/uint8</DATA-CONSTR-REF>
                                </SW-DATA-DEF-PROPS-CONDITIONAL>
                              </SW-DATA-DEF-PROPS-VARIANTS>
                            </RESULTING-PROPERTIES>
                            <SYMBOL>EnableConditionGroupRef</SYMBOL>
                          </MC-DATA-INSTANCE>
      [!ENDIF!]
                        </SUB-ELEMENTS>
                        <SYMBOL>[[!"num:i($EventClassIdx)"!]]</SYMBOL>
      [!VAR "EventClassIdx" = "$EventClassIdx + 1"!]
                      </MC-DATA-INSTANCE>
    [!ENDFOR!]
                    </SUB-ELEMENTS>
                      <SYMBOL>Dem_EventClassDesc</SYMBOL>
                  </MC-DATA-INSTANCE>

                  <MC-DATA-INSTANCE>
                    <SHORT-NAME>Dem_EventDesc</SHORT-NAME>
                    <CATEGORY>ARRAY</CATEGORY>
                    <ARRAY-SIZE>[!"num:integer(count(DemConfigSet/eb-list::*/DemEventParameter/eb-list::*))"!]</ARRAY-SIZE>
                    <SUB-ELEMENTS>
    [!VAR "Index" = "1"!]
    [!LOOP "util:distinct(node:order(DemConfigSet/eb-list::*/DemEventParameter/eb-list::*, 'DemEventId'))"!]
                      <MC-DATA-INSTANCE>
                        <SHORT-NAME>[!"as:name(.)"!]</SHORT-NAME>
                        <CATEGORY>STRUCTURE</CATEGORY>
                        <SUB-ELEMENTS>
                          <!-- !LINKSTO dsn.Dem.Calibration.EvConf1.EventCombinationDisabled,1 -->
                          <!-- EvConf1 -->
                          <MC-DATA-INSTANCE>
                            <SHORT-NAME>EvConf1</SHORT-NAME>
                            <CATEGORY>STRUCTURE</CATEGORY>
                            <SUB-ELEMENTS>
                              <!-- !LINKSTO VCC_DEM_006_Req103v1,1 -->
                              <MC-DATA-INSTANCE>
                                <SHORT-NAME>DemUdsDTC</SHORT-NAME>
                                <DESC>
                                  <L-2 L="EN">
                                    UDS DTC value of the event (special case DTC 0: means DTC off; it is not allowed to have the same DTC value for more than one event).
                                    <!--Valid range of DTC calibration is within the configured DTC group including value 0
                                    to disable the DTC For service 0x19, if the DTC is identified by the algorithm the
                                    value of the DTC will be returned. If re-calibration is performed during Dcm
                                    service request processing, the Dem may return still with the DTC, although the DTC is
                                    switched off already until a request for a different DTC. In case calibration occurs with
                                    DTC off and the service is called again, the DTC being identified by the algorithm, the
                                    DTC returned by the service is DEM_NO_DTC. Range is 0..16777214, displayable on 24 bits.-->
                                  </L-2>
                                </DESC>
                                <CATEGORY>VALUE</CATEGORY>
                                <RESULTING-PROPERTIES>
                                  <SW-DATA-DEF-PROPS-VARIANTS>
                                    <SW-DATA-DEF-PROPS-CONDITIONAL>
                                      <BASE-TYPE-REF DEST="SW-BASE-TYPE">/AUTOSAR_Platform/BaseTypes/uint32</BASE-TYPE-REF>
                                      <SW-BIT-REPRESENTATION>
                                        <BIT-POSITION>0</BIT-POSITION>
                                        <NUMBER-OF-BITS>24</NUMBER-OF-BITS>
                                      </SW-BIT-REPRESENTATION>
                                      <SW-CALIBRATION-ACCESS>READ-WRITE</SW-CALIBRATION-ACCESS>
                                      <DATA-CONSTR-REF DEST="DATA-CONSTR">/AUTOSAR_Dem/DataConstrs/CONSTR_DemUdsDTC</DATA-CONSTR-REF>
                                    </SW-DATA-DEF-PROPS-CONDITIONAL>
                                  </SW-DATA-DEF-PROPS-VARIANTS>
                                </RESULTING-PROPERTIES>
                                <SYMBOL>EvConf1</SYMBOL>
                              </MC-DATA-INSTANCE>
                              <!-- !LINKSTO VCC_DEM_006_Req103v1,1 -->
                              <MC-DATA-INSTANCE>
                                <SHORT-NAME>DemDTCSeverity</SHORT-NAME>
                                <DESC>
                                  <L-2 L="EN">
                                    Internal representation: '0' == 'DEM_DTC_SEV_NO_SEVERITY', '1' == 'DEM_DTC_SEV_MAINTENANCE_ONLY', '2' == 'DEM_DTC_SEV_CHECK_AT_NEXT_HALT', '3' == 'DEM_DTC_SEV_IMMEDIATELY'.
                                  </L-2>
                                </DESC>
                                <CATEGORY>VALUE</CATEGORY>
                                <RESULTING-PROPERTIES>
                                  <SW-DATA-DEF-PROPS-VARIANTS>
                                    <SW-DATA-DEF-PROPS-CONDITIONAL>
                                      <BASE-TYPE-REF DEST="SW-BASE-TYPE">/AUTOSAR_Platform/BaseTypes/uint32</BASE-TYPE-REF>
                                      <SW-BIT-REPRESENTATION>
                                        <BIT-POSITION>26</BIT-POSITION>
                                        <NUMBER-OF-BITS>2</NUMBER-OF-BITS>
                                      </SW-BIT-REPRESENTATION>
                                      <SW-CALIBRATION-ACCESS>READ-WRITE</SW-CALIBRATION-ACCESS>
                                      <COMPU-METHOD-REF DEST="COMPU-METHOD">/AUTOSAR_Dem/CompuMethods/CM_DemDTCSeverity</COMPU-METHOD-REF>
                                      <DATA-CONSTR-REF DEST="DATA-CONSTR">/AUTOSAR_Platform/DataConstrs/uint32</DATA-CONSTR-REF>
                                    </SW-DATA-DEF-PROPS-CONDITIONAL>
                                  </SW-DATA-DEF-PROPS-VARIANTS>
                                </RESULTING-PROPERTIES>
                                <SYMBOL>EvConf1</SYMBOL>
                              </MC-DATA-INSTANCE>
                            </SUB-ELEMENTS>
                          </MC-DATA-INSTANCE>
                          <!-- !LINKSTO dsn.Dem.Calibration.EvConf2.EventCombinationDisabled,1 -->
                          <!-- EvConf2 -->
                          <MC-DATA-INSTANCE>
                            <SHORT-NAME>EvConf2</SHORT-NAME>
                            <CATEGORY>STRUCTURE</CATEGORY>
                            <SUB-ELEMENTS>
                              <!-- !LINKSTO VCC_DEM_006_Req101v1_DemFreezeFrameClass,1 -->
                              <MC-DATA-INSTANCE>
                                <SHORT-NAME>FFClassIdx</SHORT-NAME>
                                <DESC>
                                  <L-2 L="EN">
                                    Index of used Freeze Frame class. Range is 0..16383 displayable on 14 bits (maximum assignable bits). Note: Freeze frames of events with 'DemEventKind' set to 'DEM_EVENT_KIND_SEV' must not be changed via calibration.
                                  </L-2>
                                </DESC>
                                <CATEGORY>VALUE</CATEGORY>
                                <RESULTING-PROPERTIES>
                                  <SW-DATA-DEF-PROPS-VARIANTS>
                                    <SW-DATA-DEF-PROPS-CONDITIONAL>
                                      <BASE-TYPE-REF DEST="SW-BASE-TYPE">/AUTOSAR_Platform/BaseTypes/uint32</BASE-TYPE-REF>
                                      <SW-BIT-REPRESENTATION>
                                        <BIT-POSITION>[!"num:i($CalFFClassIdxOffset)"!]</BIT-POSITION>
                                        <NUMBER-OF-BITS>[!"num:i($CalFFClassIdxWidth)"!]</NUMBER-OF-BITS>
                                      </SW-BIT-REPRESENTATION>
                                      <SW-CALIBRATION-ACCESS>READ-WRITE</SW-CALIBRATION-ACCESS>
                                      <DATA-CONSTR-REF DEST="DATA-CONSTR">/AUTOSAR_Dem/DataConstrs/CONSTR_DemFFClassIdx</DATA-CONSTR-REF>
                                    </SW-DATA-DEF-PROPS-CONDITIONAL>
                                  </SW-DATA-DEF-PROPS-VARIANTS>
                                </RESULTING-PROPERTIES>
                                <SYMBOL>EvConf2</SYMBOL>
                              </MC-DATA-INSTANCE>
                              <!-- !LINKSTO VCC_DEM_006_Req101v1_DemEventClass,1 -->
                              <MC-DATA-INSTANCE>
                                <SHORT-NAME>EventClassIndex</SHORT-NAME>
                                <DESC>
                                  <L-2 L="EN">
                                    Index of Event Class.
                                    <!--Ranges from 0 to whichever value is greater between
                                    DemMaxNumberEventClasses and the number of different EventClasses.
                                    DemMaxNumberEventClasses can be configured to a maximum value of 2048.
                                    Notes for events belonging to a MIL group:
                                    - If the MIL indicator is removed through calibration, the event
                                    is no longer considered as member of the MIL group.
                                    - If the change of the event class no longer ensures the consistency
                                    of 'DemOperationCycleRef', 'DemEventFailureCycleRef',
                                    'DemEventFailureCycleCounterThreshold' or MIL indicator's
                                    'DemIndicatorFailureCycleRef' and 'DemIndicatorFailureCycleCounterThreshold',
                                    between the MIL group events, the MIL counters and the confirmation counters
                                    will be out of sync. This could lead to undefined behavior during run-time.
                                    - Calibration of the MIL group event to a class with
                                    'DemEventFailureCycleCounterThreshold' equal to 1 is not allowed.
                                    Note that it is not recommended to calibrate the EventClassIndex for events
                                    with 'DemEventKind' set to 'DEM_EVENT_KIND_SEV', since this could cause violations
                                    of configuration constraints with respect to indicators, aging and MultiEventTriggering.-->
                                  </L-2>
                                </DESC>
                                <CATEGORY>VALUE</CATEGORY>
                                <RESULTING-PROPERTIES>
                                  <SW-DATA-DEF-PROPS-VARIANTS>
                                    <SW-DATA-DEF-PROPS-CONDITIONAL>
                                      <BASE-TYPE-REF DEST="SW-BASE-TYPE">/AUTOSAR_Platform/BaseTypes/uint32</BASE-TYPE-REF>
                                      <SW-BIT-REPRESENTATION>
                                        <BIT-POSITION>[!"num:i($CalEventClassOffset)"!]</BIT-POSITION>
                                        <NUMBER-OF-BITS>[!"num:i($CalEventClassWidth)"!]</NUMBER-OF-BITS>
                                      </SW-BIT-REPRESENTATION>
                                      <SW-CALIBRATION-ACCESS>READ-WRITE</SW-CALIBRATION-ACCESS>
                                      <DATA-CONSTR-REF DEST="DATA-CONSTR">/AUTOSAR_Dem/DataConstrs/CONSTR_DemEventClassIndex</DATA-CONSTR-REF>
                                    </SW-DATA-DEF-PROPS-CONDITIONAL>
                                  </SW-DATA-DEF-PROPS-VARIANTS>
                                </RESULTING-PROPERTIES>
                                <SYMBOL>EvConf2</SYMBOL>
                              </MC-DATA-INSTANCE>
                            </SUB-ELEMENTS>
                          </MC-DATA-INSTANCE>
                          <!-- !LINKSTO dsn.Dem.Calibration.EvConf3.EventCombinationDisabled,1 -->
                          <!-- EvConf3 -->
                          <MC-DATA-INSTANCE>
                            <SHORT-NAME>EvConf3</SHORT-NAME>
                            <CATEGORY>STRUCTURE</CATEGORY>
                            <SUB-ELEMENTS>
                              <!-- !LINKSTO VCC_DEM_006_Req103v1,1 -->
                              <MC-DATA-INSTANCE>
                                <SHORT-NAME>DemDTCFunctionalUnit</SHORT-NAME>
                                <DESC>
                                  <L-2 L="EN">
                                    DTCFunctionalUnit identifies the corresponding basic vehicle or system function which reports the DTC. Width of this bit-field can vary depending on configuration. Ranges between 0 to maximum value which fits number of bits allocated for this information.
                                  </L-2>
                                </DESC>
                                <CATEGORY>VALUE</CATEGORY>
                                <RESULTING-PROPERTIES>
                                  <SW-DATA-DEF-PROPS-VARIANTS>
                                    <SW-DATA-DEF-PROPS-CONDITIONAL>
                                      <BASE-TYPE-REF DEST="SW-BASE-TYPE">/AUTOSAR_Platform/BaseTypes/uint32</BASE-TYPE-REF>
                                      <SW-BIT-REPRESENTATION>
                                        <BIT-POSITION>[!"num:i($CalFunctionalUnitOffset)"!]</BIT-POSITION>
                                        <NUMBER-OF-BITS>[!"num:i($CalFunctionalUnitWidth)"!]</NUMBER-OF-BITS>
                                      </SW-BIT-REPRESENTATION>
                                      <SW-CALIBRATION-ACCESS>READ-WRITE</SW-CALIBRATION-ACCESS>
                                      <DATA-CONSTR-REF DEST="DATA-CONSTR">/AUTOSAR_Dem/DataConstrs/CONSTR_DemDTCFunctionalUnit</DATA-CONSTR-REF>
                                    </SW-DATA-DEF-PROPS-CONDITIONAL>
                                  </SW-DATA-DEF-PROPS-VARIANTS>
                                </RESULTING-PROPERTIES>
                                <SYMBOL>EvConf3</SYMBOL>
                              </MC-DATA-INSTANCE>
                            </SUB-ELEMENTS>
                          </MC-DATA-INSTANCE>
                        </SUB-ELEMENTS>
                        <SYMBOL>[[!"num:i($Index)"!]]</SYMBOL>
                      </MC-DATA-INSTANCE>
      [!VAR "Index" = "$Index + 1"!]
    [!ENDLOOP!]

                    </SUB-ELEMENTS>
                    <SYMBOL>Dem_EventDesc</SYMBOL>
                  </MC-DATA-INSTANCE>

    [!LOOP "DemGeneral/DemFreezeFrameClass/eb-list::*"!]
      [!VAR "Index" = "0"!]
                  <MC-DATA-INSTANCE>
                    <SHORT-NAME>[!"as:name(.)"!]</SHORT-NAME>
                    <CATEGORY>ARRAY</CATEGORY>
                    <ARRAY-SIZE>[!"num:integer(count(DemDidClassRef/eb-list::*))"!]</ARRAY-SIZE>
                    <SUB-ELEMENTS>
      [!LOOP "DemDidClassRef/eb-list::*"!]
                      <!-- !LINKSTO VCC_DEM_006_Req109v1,1, dsn.Dem.Calibration.DID.Unused,1 -->
                      <MC-DATA-INSTANCE>
                        <SHORT-NAME>[!"as:name(as:ref(.))"!]</SHORT-NAME>
                        <DESC>
                          <L-2 L="EN">
                            Index range of DID. Index range of DID is 0..65534 and the value 65535 is used for internal processing to identify the unused DIDs, i.e. DIDs that are marked as unused via calibration.
                            <!-- Note: The DIDs contained in freeze frames of events with 'DemEventKind'
                            set to 'DEM_EVENT_KIND_SEV' must not be changed via calibration.-->
                          </L-2>
                        </DESC>
                        <CATEGORY>VALUE</CATEGORY>
                        <RESULTING-PROPERTIES>
                          <SW-DATA-DEF-PROPS-VARIANTS>
                            <SW-DATA-DEF-PROPS-CONDITIONAL>
                              <BASE-TYPE-REF DEST="SW-BASE-TYPE">/AUTOSAR_Platform/BaseTypes/uint16</BASE-TYPE-REF>
                              <SW-CALIBRATION-ACCESS>READ-WRITE</SW-CALIBRATION-ACCESS>
                              <DATA-CONSTR-REF DEST="DATA-CONSTR">/AUTOSAR_Platform/DataConstrs/uint16</DATA-CONSTR-REF>
                            </SW-DATA-DEF-PROPS-CONDITIONAL>
                          </SW-DATA-DEF-PROPS-VARIANTS>
                        </RESULTING-PROPERTIES>
                        <SYMBOL>[[!"num:i($Index)"!]]</SYMBOL>
                      </MC-DATA-INSTANCE>
        [!VAR "Index" = "$Index + 1"!]
      [!ENDLOOP!]
                    </SUB-ELEMENTS>
                    <SYMBOL>Dem_FFSegIdx[!"as:name(.)"!]</SYMBOL>
                  </MC-DATA-INSTANCE>
    [!ENDLOOP!]

    [!IF "node:existsAndTrue(DemGeneral/DemOBDSupport)"!]
      [!IF "node:exists(DemConfigSet/eb-list::*/DemPidClass/eb-list::*)"!]
                  <MC-DATA-INSTANCE>
                    <SHORT-NAME>Dem_PidClass</SHORT-NAME>
                    <CATEGORY>ARRAY</CATEGORY>
                    <ARRAY-SIZE>[!"num:integer(count(as:modconf('Dem')[1]/DemConfigSet/eb-list::*/DemPidClass/eb-list::*))"!]</ARRAY-SIZE>
                    <SUB-ELEMENTS>
        [!VAR "Index" = "0"!]
      [!LOOP "DemConfigSet/eb-list::*/DemPidClass/eb-list::*"!]
                      <MC-DATA-INSTANCE>
                        <SHORT-NAME>[!"as:name(.)"!]</SHORT-NAME>
                        <CATEGORY>STRUCTURE</CATEGORY>
                        <SUB-ELEMENTS>
                          <!-- !LINKSTO VCC_DEM_006_Req111v1,1, dsn.Dem.OBD.DemPidIdentifier.Unused,1 -->
                          <MC-DATA-INSTANCE>
                            <SHORT-NAME>DemPidIdentifier</SHORT-NAME>
                            <DESC>
                              <L-2 L="EN">
                                PID Identifier. The PID identifier must be unique. Range is 0..254. Value 255 is used to disable PIDs in calibration context.
                              </L-2>
                            </DESC>
                            <CATEGORY>VALUE</CATEGORY>
                            <RESULTING-PROPERTIES>
                              <SW-DATA-DEF-PROPS-VARIANTS>
                                <SW-DATA-DEF-PROPS-CONDITIONAL>
                                  <BASE-TYPE-REF DEST="SW-BASE-TYPE">/AUTOSAR_Platform/BaseTypes/uint8</BASE-TYPE-REF>
                                  <SW-CALIBRATION-ACCESS>READ-WRITE</SW-CALIBRATION-ACCESS>
                                  <DATA-CONSTR-REF DEST="DATA-CONSTR">/AUTOSAR_Platform/DataConstrs/uint8</DATA-CONSTR-REF>
                                </SW-DATA-DEF-PROPS-CONDITIONAL>
                              </SW-DATA-DEF-PROPS-VARIANTS>
                            </RESULTING-PROPERTIES>
                            <SYMBOL>ParameterId</SYMBOL>
                          </MC-DATA-INSTANCE>
                        </SUB-ELEMENTS>
                        <SYMBOL>[[!"num:i($Index)"!]]</SYMBOL>
                      </MC-DATA-INSTANCE>
          [!VAR "Index" = "$Index + 1"!]
        [!ENDLOOP!]
                    </SUB-ELEMENTS>
                    <SYMBOL>Dem_PidClass</SYMBOL>
                  </MC-DATA-INSTANCE>
      [!ENDIF!]
    [!ENDIF!]

    [!IF "$CalibrationWithoutEvCombSupport = 'true'"!]
      [!IF "node:existsAndTrue(DemGeneral/DemOBDSupport)"!]
                  <MC-DATA-INSTANCE>
                    <SHORT-NAME>Dem_OBDConfig</SHORT-NAME>
                    <CATEGORY>STRUCTURE</CATEGORY>
                    <SUB-ELEMENTS>
        [!VAR "Index" = "1"!]
        [!LOOP "util:distinct(node:order(DemConfigSet/eb-list::*/DemEventParameter/eb-list::*, 'DemEventId'))"!]
                      <MC-DATA-INSTANCE>
                        <SHORT-NAME>[!"as:name(.)"!]</SHORT-NAME>
                        <CATEGORY>STRUCTURE</CATEGORY>
                        <SUB-ELEMENTS>
          [!IF "$ObdUdsDtcSeparationSupport = 'true'"!][!//
                          <!-- !LINKSTO Dem.3ByteObdDTC.Calibration,1 -->
                          <MC-DATA-INSTANCE>
                            <SHORT-NAME>DemDtcValue3Byte</SHORT-NAME>
                            <DESC>
                              <L-2 L="EN">
                                3-byte OBD DTC value of the event when DemSupportedObdUdsDtcSeparation is enabled and either OBD variant is configured to DEM_OBD_VARIANT_OBDONUDS or OBD variant is selectable via DemCalloutObdVariantFnc. Value 0 means 'no 3-byte OBD DTC assigned'.
                                <!-- If re-calibration is performed for a stored event (OBD to non-OBD),
                                the related OBD freeze frame (if stored),
                                the related permanent event memory entry (if stored),
                                etc. will not be cleared. The event memory entry will remain
                                occupied and these data will then remain in an orphan state and will
                                be inaccessible, belonging to an event that is no longer an OBD
                                event. Such an OBD freeze frame can only be cleared by a subsequent
                                call of Dem_ClearDTC() on the UDS DTC of this event, or with a clear
                                on all UDS DTCs, - however, it is recommended to clear the event before
                                re-calibration and avoid this situation.
                                Take care to calibrate a non-OBD event to OBD only if
                                DemEventDestination of the event is set to DEM_DTC_ORIGIN_PRIMARY_MEMORY.
                                If 3-byte OBD DTC value re-calibration is performed for an event,
                                DemEventOBDReadinessGroup needs to be re-calibrated consistently.
                                Range is 0..16776959.
                                The ranges 1..255 and 16776960..16777215 are reserved by ISO 14229-1.
                                For events with 'DemEventKind' set to 'DEM_EVENT_KIND_SEV' only value 0 is allowed.-->
                              </L-2>
                            </DESC>
                            <CATEGORY>VALUE</CATEGORY>
                            <RESULTING-PROPERTIES>
                              <SW-DATA-DEF-PROPS-VARIANTS>
                                <SW-DATA-DEF-PROPS-CONDITIONAL>
                                  <BASE-TYPE-REF DEST="SW-BASE-TYPE">/AUTOSAR_Platform/BaseTypes/uint32</BASE-TYPE-REF>
                                  <SW-BIT-REPRESENTATION>
                                    <BIT-POSITION>0</BIT-POSITION>
                                    <NUMBER-OF-BITS>24</NUMBER-OF-BITS>
                                  </SW-BIT-REPRESENTATION>
                                  <SW-CALIBRATION-ACCESS>READ-WRITE</SW-CALIBRATION-ACCESS>
                                  <DATA-CONSTR-REF DEST="DATA-CONSTR">/AUTOSAR_Dem/DataConstrs/CONSTR_DemDtcValue3Byte</DATA-CONSTR-REF>
                                </SW-DATA-DEF-PROPS-CONDITIONAL>
                              </SW-DATA-DEF-PROPS-VARIANTS>
                            </RESULTING-PROPERTIES>
                            <SYMBOL>Dem_OBDConfig[[!"num:i($Index)"!]]</SYMBOL>
                          </MC-DATA-INSTANCE>
            [!IF "$DTCClassAvailable = 'true'"!][!//
                          <MC-DATA-INSTANCE>
                            <SHORT-NAME>DemWWHOBDDTCClass</SHORT-NAME>
                            <DESC>
                              <L-2 L="EN">
                                WWHOBD DTC Class of the current event.
                              </L-2>
                            </DESC>
                            <CATEGORY>VALUE</CATEGORY>
                            <RESULTING-PROPERTIES>
                              <SW-DATA-DEF-PROPS-VARIANTS>
                                <SW-DATA-DEF-PROPS-CONDITIONAL>
                                  <BASE-TYPE-REF DEST="SW-BASE-TYPE">/AUTOSAR_Platform/BaseTypes/uint32</BASE-TYPE-REF>
                                  <SW-BIT-REPRESENTATION>
                                    <BIT-POSITION>24</BIT-POSITION>
                                    <NUMBER-OF-BITS>3</NUMBER-OF-BITS>
                                  </SW-BIT-REPRESENTATION>
                                  <SW-CALIBRATION-ACCESS>READ-WRITE</SW-CALIBRATION-ACCESS>
                                  <COMPU-METHOD-REF DEST="COMPU-METHOD">/AUTOSAR_Dem/CompuMethods/CM_DemWWHOBDDTCClass</COMPU-METHOD-REF>
                                  <DATA-CONSTR-REF DEST="DATA-CONSTR">/AUTOSAR_Platform/DataConstrs/uint32</DATA-CONSTR-REF>
                                </SW-DATA-DEF-PROPS-CONDITIONAL>
                              </SW-DATA-DEF-PROPS-VARIANTS>
                            </RESULTING-PROPERTIES>
                            <SYMBOL>Dem_OBDConfig[[!"num:i($Index)"!]]</SYMBOL>
                          </MC-DATA-INSTANCE>
            [!ENDIF!]
          [!ELSE!]
            [!IF "$DTCClassAvailable = 'true'"!][!//
                          <MC-DATA-INSTANCE>
                            <SHORT-NAME>DemWWHOBDDTCClass</SHORT-NAME>
                            <DESC>
                              <L-2 L="EN">
                                WWHOBD DTC Class of the current event.
                              </L-2>
                            </DESC>
                            <CATEGORY>VALUE</CATEGORY>
                            <RESULTING-PROPERTIES>
                              <SW-DATA-DEF-PROPS-VARIANTS>
                                <SW-DATA-DEF-PROPS-CONDITIONAL>
                                  <BASE-TYPE-REF DEST="SW-BASE-TYPE">/AUTOSAR_Platform/BaseTypes/uint8</BASE-TYPE-REF>
                                  <SW-BIT-REPRESENTATION>
                                    <BIT-POSITION>0</BIT-POSITION>
                                    <NUMBER-OF-BITS>3</NUMBER-OF-BITS>
                                  </SW-BIT-REPRESENTATION>
                                  <SW-CALIBRATION-ACCESS>READ-WRITE</SW-CALIBRATION-ACCESS>
                                  <COMPU-METHOD-REF DEST="COMPU-METHOD">/AUTOSAR_Dem/CompuMethods/CM_DemWWHOBDDTCClass</COMPU-METHOD-REF>
                                  <DATA-CONSTR-REF DEST="DATA-CONSTR">/AUTOSAR_Platform/DataConstrs/uint8</DATA-CONSTR-REF>
                                </SW-DATA-DEF-PROPS-CONDITIONAL>
                              </SW-DATA-DEF-PROPS-VARIANTS>
                            </RESULTING-PROPERTIES>
                            <SYMBOL>Dem_OBDConfig[[!"num:i($Index)"!]]</SYMBOL>
                          </MC-DATA-INSTANCE>
            [!ENDIF!]
          [!ENDIF!]
          [!IF "$DemObdDTCSupport = 'true'"!][!//
                          <!-- !LINKSTO VCC_DEM_006_Req103v1,1 -->
                          <MC-DATA-INSTANCE>
                            <SHORT-NAME>DemObdDTC</SHORT-NAME>
                            <DESC>
                              <L-2 L="EN">
                                2-byte OBD DTC value of the current event. Value 0 means 'no 2-byte OBD DTC assigned'.
                                <!--If re-calibration is performed for a stored event (OBD to non-OBD),
                                the related OBD freeze frame (if stored), the related permanent event
                                memory entry (if stored), etc. will not be cleared.
                                The event memory entry will remain occupied and these data will
                                then remain in an orphan state and will be inaccessible, belonging
                                to an event that is no longer an OBD event. Such an OBD freeze frame
                                can only be cleared by a subsequent call of Dem_ClearDTC() on the UDS
                                DTC of this event, or with a clear on all UDS DTCs, - however, it is
                                recommended to clear the event before re-calibration and avoid this
                                situation. Take care to calibrate a non-OBD event to OBD only if
                                DemEventDestination of the event is set to DEM_DTC_ORIGIN_PRIMARY_MEMORY.
                                If OBD DTC value re-calibration is performed for an event,
                                DemEventOBDReadinessGroup needs to be re-calibrated consistently.
                                Range is 0..65535.
                                For events with 'DemEventKind' set to 'DEM_EVENT_KIND_SEV' only value 0 is allowed.
                                It is possible to configure multiple DTCs with identical OBD DTC
                                value. When more than one DemDTCClass has identical OBD DTC, it is
                                recommended to have same DemEventPriority, DemEventOBDReadinessGroup,
                                DemDTCSeverity and DemDTCFunctionalUnit for events referring these
                                DTCs to avoid inconsistencies in the Dem behavior.-->
                              </L-2>
                            </DESC>
                            <CATEGORY>VALUE</CATEGORY>
                            <RESULTING-PROPERTIES>
                              <SW-DATA-DEF-PROPS-VARIANTS>
                                <SW-DATA-DEF-PROPS-CONDITIONAL>
                                  <BASE-TYPE-REF DEST="SW-BASE-TYPE">/AUTOSAR_Platform/BaseTypes/uint16</BASE-TYPE-REF>
                                  <SW-CALIBRATION-ACCESS>READ-WRITE</SW-CALIBRATION-ACCESS>
                                  <DATA-CONSTR-REF DEST="DATA-CONSTR">/AUTOSAR_Platform/DataConstrs/uint16</DATA-CONSTR-REF>
                                </SW-DATA-DEF-PROPS-CONDITIONAL>
                              </SW-DATA-DEF-PROPS-VARIANTS>
                            </RESULTING-PROPERTIES>
                            <SYMBOL>Dem_OBDDTC[[!"num:i($Index)"!]]</SYMBOL>
                          </MC-DATA-INSTANCE>
          [!ENDIF!]
                        </SUB-ELEMENTS>
                      </MC-DATA-INSTANCE>
          [!VAR "Index" = "$Index + 1"!]
        [!ENDLOOP!]
                    </SUB-ELEMENTS>
                  </MC-DATA-INSTANCE>
      [!ENDIF!]
    [!ENDIF!]
    [!IF "node:existsAndTrue(DemGeneral/DemOBDSupport)"!]
                  <MC-DATA-INSTANCE>
                    <SHORT-NAME>Dem_ObdReadinessForceCompleteMask</SHORT-NAME>
                    <CATEGORY>STRUCTURE</CATEGORY>
                    <SUB-ELEMENTS>
                      <!-- !LINKSTO VCC_DEM_006_Req112v1,1 -->
                      <!-- !LINKSTO Dem.DemOBDForceRGReady.Calibration,1 -->
      [!IF "((node:exists(DemGeneral/DemObdVariant)) and (DemGeneral/DemObdVariant = 'DEM_OBD_VARIANT_OBD_CLASSIC')) and
            (not(node:exists(DemGeneral/DemCalloutObdVariantFnc))) and
            (DemGeneral/DemReadinessGroupCalibrationConfigKind = 'DEM_NUMBER_OF_SLOTS_COMMON_CONFIG')"!]
                      <MC-DATA-INSTANCE>
                        <SHORT-NAME>DemOBDEngineType</SHORT-NAME>
                        <DESC>
                          <L-2 L="EN">
                            Value 0 means OBDEngineType is set to DEM_IGNITION_SPARK and value 1 means OBDEngineType is set to DEM_IGNITION_COMPRESSION. Range is 0..1.
                            <!-- OBDEngineType should be calibrated only
                            when the events are assigned to generic OBD Readiness Groups,
                            which are common for spark ignition and compression
                            ignition, e.g. CMPRCMPT, MISF, FLSYS.-->
                          </L-2>
                        </DESC>
                        <CATEGORY>VALUE</CATEGORY>
                        <RESULTING-PROPERTIES>
                          <SW-DATA-DEF-PROPS-VARIANTS>
                            <SW-DATA-DEF-PROPS-CONDITIONAL>
                              <BASE-TYPE-REF DEST="SW-BASE-TYPE">/AUTOSAR_Platform/BaseTypes/uint8</BASE-TYPE-REF>
                              <SW-BIT-REPRESENTATION>
                                <BIT-POSITION>3</BIT-POSITION>
                                <NUMBER-OF-BITS>1</NUMBER-OF-BITS>
                              </SW-BIT-REPRESENTATION>
                              <SW-CALIBRATION-ACCESS>READ-WRITE</SW-CALIBRATION-ACCESS>
                              <COMPU-METHOD-REF DEST="COMPU-METHOD">/AUTOSAR_Dem/CompuMethods/CM_DemOBDEngineType</COMPU-METHOD-REF>
                              <DATA-CONSTR-REF DEST="DATA-CONSTR">/AUTOSAR_Platform/DataConstrs/uint8</DATA-CONSTR-REF>
                            </SW-DATA-DEF-PROPS-CONDITIONAL>
                          </SW-DATA-DEF-PROPS-VARIANTS>
                        </RESULTING-PROPERTIES>
                        <SYMBOL>Dem_ObdReadinessForceCompleteMask</SYMBOL>
                      </MC-DATA-INSTANCE>
      [!ENDIF!]
                      <MC-DATA-INSTANCE>
                        <SHORT-NAME>DemOBDForceMisfireMonitoringReady</SHORT-NAME>
                        <DESC>
                          <L-2 L="EN">
                            Range is 0..1. Value 0 means DemOBDForceMisfireMonitoringReady is set to TRUE and value 1 means it is set to FALSE.
                          </L-2>
                        </DESC>
                        <CATEGORY>VALUE</CATEGORY>
                        <RESULTING-PROPERTIES>
                          <SW-DATA-DEF-PROPS-VARIANTS>
                            <SW-DATA-DEF-PROPS-CONDITIONAL>
                              <BASE-TYPE-REF DEST="SW-BASE-TYPE">/AUTOSAR_Platform/BaseTypes/uint8</BASE-TYPE-REF>
                              <SW-BIT-REPRESENTATION>
                                <BIT-POSITION>4</BIT-POSITION>
                                <NUMBER-OF-BITS>1</NUMBER-OF-BITS>
                              </SW-BIT-REPRESENTATION>
                              <SW-CALIBRATION-ACCESS>READ-WRITE</SW-CALIBRATION-ACCESS>
                              <COMPU-METHOD-REF DEST="COMPU-METHOD">/AUTOSAR_Dem/CompuMethods/CM_DemOBDForceMisfireMonitoringReady</COMPU-METHOD-REF>
                              <DATA-CONSTR-REF DEST="DATA-CONSTR">/AUTOSAR_Platform/DataConstrs/uint8</DATA-CONSTR-REF>
                            </SW-DATA-DEF-PROPS-CONDITIONAL>
                          </SW-DATA-DEF-PROPS-VARIANTS>
                        </RESULTING-PROPERTIES>
                        <SYMBOL>Dem_ObdReadinessForceCompleteMask</SYMBOL>
                      </MC-DATA-INSTANCE>
                      <!-- !LINKSTO VCC_DEM_006_Req112v1,1 -->
                      <MC-DATA-INSTANCE>
                        <SHORT-NAME>DemOBDForceFuelSysMonitoringReady</SHORT-NAME>
                        <DESC>
                          <L-2 L="EN">
                            Range is 0..1. Value 0 means DemOBDForceFuelSysMonitoringReady is set to TRUE and value 1 means it is set to FALSE.
                          </L-2>
                        </DESC>
                        <CATEGORY>VALUE</CATEGORY>
                        <RESULTING-PROPERTIES>
                          <SW-DATA-DEF-PROPS-VARIANTS>
                            <SW-DATA-DEF-PROPS-CONDITIONAL>
                              <BASE-TYPE-REF DEST="SW-BASE-TYPE">/AUTOSAR_Platform/BaseTypes/uint8</BASE-TYPE-REF>
                              <SW-BIT-REPRESENTATION>
                                <BIT-POSITION>5</BIT-POSITION>
                                <NUMBER-OF-BITS>1</NUMBER-OF-BITS>
                              </SW-BIT-REPRESENTATION>
                              <SW-CALIBRATION-ACCESS>READ-WRITE</SW-CALIBRATION-ACCESS>
                              <COMPU-METHOD-REF DEST="COMPU-METHOD">/AUTOSAR_Dem/CompuMethods/CM_DemOBDForceFuelSysMonitoringReady</COMPU-METHOD-REF>
                              <DATA-CONSTR-REF DEST="DATA-CONSTR">/AUTOSAR_Platform/DataConstrs/uint8</DATA-CONSTR-REF>
                            </SW-DATA-DEF-PROPS-CONDITIONAL>
                          </SW-DATA-DEF-PROPS-VARIANTS>
                        </RESULTING-PROPERTIES>
                        <SYMBOL>Dem_ObdReadinessForceCompleteMask</SYMBOL>
                      </MC-DATA-INSTANCE>
                      <!-- !LINKSTO VCC_DEM_006_Req112v1,1 -->
                      <MC-DATA-INSTANCE>
                        <SHORT-NAME>DemOBDForceCCMonitoringReady</SHORT-NAME>
                        <DESC>
                          <L-2 L="EN">
                            Range is 0..1. Value 0 means DemOBDForceCCMonitoringReady is set to TRUE and value 1 means it is set to FALSE.
                          </L-2>
                        </DESC>
                        <CATEGORY>VALUE</CATEGORY>
                        <RESULTING-PROPERTIES>
                          <SW-DATA-DEF-PROPS-VARIANTS>
                            <SW-DATA-DEF-PROPS-CONDITIONAL>
                              <BASE-TYPE-REF DEST="SW-BASE-TYPE">/AUTOSAR_Platform/BaseTypes/uint8</BASE-TYPE-REF>
                              <SW-BIT-REPRESENTATION>
                              <BIT-POSITION>6</BIT-POSITION>
                              <NUMBER-OF-BITS>1</NUMBER-OF-BITS>
                              </SW-BIT-REPRESENTATION>
                              <SW-CALIBRATION-ACCESS>READ-WRITE</SW-CALIBRATION-ACCESS>
                              <COMPU-METHOD-REF DEST="COMPU-METHOD">/AUTOSAR_Dem/CompuMethods/CM_DemOBDForceCCMonitoringReady</COMPU-METHOD-REF>
                              <DATA-CONSTR-REF DEST="DATA-CONSTR">/AUTOSAR_Platform/DataConstrs/uint8</DATA-CONSTR-REF>
                            </SW-DATA-DEF-PROPS-CONDITIONAL>
                          </SW-DATA-DEF-PROPS-VARIANTS>
                        </RESULTING-PROPERTIES>
                        <SYMBOL>Dem_ObdReadinessForceCompleteMask</SYMBOL>
                      </MC-DATA-INSTANCE>
                    </SUB-ELEMENTS>
                  </MC-DATA-INSTANCE>

                  <!-- !LINKSTO Dem.CalibrationPID41BitCCM_ENA,1 -->
                  <MC-DATA-INSTANCE>
                    <SHORT-NAME>Dem_ObdReadinessPID41ByteB</SHORT-NAME>
                    <CATEGORY>STRUCTURE</CATEGORY>
                    <SUB-ELEMENTS>
                      <MC-DATA-INSTANCE>
                        <SHORT-NAME>DemOBDSetCCMenabled</SHORT-NAME>
                        <DESC>
                          <L-2 L="EN">
                            Comprehensive component monitoring enabled (CCM_ENA 1 == enabled, 0 == disabled).
                          </L-2>
                        </DESC>
                        <CATEGORY>VALUE</CATEGORY>
                        <RESULTING-PROPERTIES>
                          <SW-DATA-DEF-PROPS-VARIANTS>
                            <SW-DATA-DEF-PROPS-CONDITIONAL>
                              <BASE-TYPE-REF DEST="SW-BASE-TYPE">/AUTOSAR_Platform/BaseTypes/uint8</BASE-TYPE-REF>
                              <SW-BIT-REPRESENTATION>
                                <BIT-POSITION>2</BIT-POSITION>
                                <NUMBER-OF-BITS>1</NUMBER-OF-BITS>
                              </SW-BIT-REPRESENTATION>
                              <SW-CALIBRATION-ACCESS>READ-WRITE</SW-CALIBRATION-ACCESS>
                              <COMPU-METHOD-REF DEST="COMPU-METHOD">/AUTOSAR_Dem/CompuMethods/CM_DemOBDSetCCMenabled</COMPU-METHOD-REF>
                              <DATA-CONSTR-REF DEST="DATA-CONSTR">/AUTOSAR_Platform/DataConstrs/uint8</DATA-CONSTR-REF>
                            </SW-DATA-DEF-PROPS-CONDITIONAL>
                          </SW-DATA-DEF-PROPS-VARIANTS>
                        </RESULTING-PROPERTIES>
                        <SYMBOL>Dem_ObdReadinessPID41ByteB</SYMBOL>
                      </MC-DATA-INSTANCE>
                    </SUB-ELEMENTS>
                  </MC-DATA-INSTANCE>
    [!ENDIF!]

    [!IF "node:exists(DemGeneral/DemGeneralOBD/DemOBDCompliancy)"!]
                  <!-- !LINKSTO VCC_DEM_007_Req177v1,1 -->
                  <MC-DATA-INSTANCE>
                    <SHORT-NAME>Dem_ObdCompliancyPID1CByte</SHORT-NAME>
                    <DESC>
                      <L-2 L="EN">
                        Configuration value to define the appropriate value to PID$1C.
                      </L-2>
                    </DESC>
                    <CATEGORY>VALUE</CATEGORY>
                    <RESULTING-PROPERTIES>
                      <SW-DATA-DEF-PROPS-VARIANTS>
                        <SW-DATA-DEF-PROPS-CONDITIONAL>
                          <BASE-TYPE-REF DEST="SW-BASE-TYPE">/AUTOSAR_Platform/BaseTypes/uint8</BASE-TYPE-REF>
                          <SW-CALIBRATION-ACCESS>READ-WRITE</SW-CALIBRATION-ACCESS>
                          <DATA-CONSTR-REF DEST="DATA-CONSTR">/AUTOSAR_Platform/DataConstrs/uint8</DATA-CONSTR-REF>
                        </SW-DATA-DEF-PROPS-CONDITIONAL>
                      </SW-DATA-DEF-PROPS-VARIANTS>
                    </RESULTING-PROPERTIES>
                    <SYMBOL>Dem_ObdCompliancyPID1CByte</SYMBOL>
                  </MC-DATA-INSTANCE>
    [!ENDIF!]

    [!IF "(as:modconf('Dem')[1]/DemGeneral/DemExtendedDataCapture = 'DEM_TRIGGER_ON_FDC_THRESHOLD') and
          (as:modconf('Dem')[1]/DemGeneral/DemEventDisplacementStrategy = 'DEM_DISPLACEMENT_FULL') and
        (node:existsAndTrue(as:modconf('Dem')[1]/DemGeneral/DemEventDisplacementSupport))"!]
      [!IF "node:exists(DemConfigSet/eb-list::*/DemAdvDisplacementPassiveTableLine/eb-list::*)"!]
        [!VAR "NumberOfLines" = "num:integer(count(DemConfigSet/eb-list::*/DemAdvDisplacementPassiveTableLine/eb-list::*))"!]
        [!VAR "NumOfLines" = "0"!]
                  <!-- !LINKSTO VCC_DEM_006_Req116v1,1 -->
                  <MC-DATA-INSTANCE>
                    <SHORT-NAME>Dem_AdvDisplPassiveTableLineReportedEventIds</SHORT-NAME>
                    <CATEGORY>ARRAY</CATEGORY>
                    <ARRAY-SIZE>[!"$NumberOfLines"!]</ARRAY-SIZE>
                    <SUB-ELEMENTS>
        [!LOOP "DemConfigSet/eb-list::*/DemAdvDisplacementPassiveTableLine/eb-list::*"!]
                      <MC-DATA-INSTANCE>
                        <SHORT-NAME>[!"as:name(.)"!]</SHORT-NAME>
                        <DESC>
                          <L-2 L="EN">
                            Reference to EventIds that are considered in the advanced displacement algorithm as reported events.
                          </L-2>
                        </DESC>
                        <CATEGORY>VALUE</CATEGORY>
                        <RESULTING-PROPERTIES>
                          <SW-DATA-DEF-PROPS-VARIANTS>
                            <SW-DATA-DEF-PROPS-CONDITIONAL>
                              <BASE-TYPE-REF DEST="SW-BASE-TYPE">/AUTOSAR_Platform/BaseTypes/uint16</BASE-TYPE-REF>
                              <SW-CALIBRATION-ACCESS>READ-WRITE</SW-CALIBRATION-ACCESS>
                              <DATA-CONSTR-REF DEST="DATA-CONSTR">/AUTOSAR_Dem/DataConstrs/CONSTR_DemValidEventIdRange</DATA-CONSTR-REF>
                            </SW-DATA-DEF-PROPS-CONDITIONAL>
                          </SW-DATA-DEF-PROPS-VARIANTS>
                        </RESULTING-PROPERTIES>
                        <SYMBOL>[[!"num:i($NumOfLines)"!]]</SYMBOL>
                      </MC-DATA-INSTANCE>
          [!VAR "NumOfLines" = "$NumOfLines + 1"!]
        [!ENDLOOP!]
                    </SUB-ELEMENTS>
                    <SYMBOL>Dem_AdvDisplPassiveTableLineReportedEventIds</SYMBOL>
                  </MC-DATA-INSTANCE>
        [!VAR "NumOfLines" = "0"!]
        [!LOOP "DemConfigSet/eb-list::*/DemAdvDisplacementPassiveTableLine/eb-list::*"!]
                  <MC-DATA-INSTANCE>
                    <SHORT-NAME>DemAdvDisplacementPassiveTableLine[!"num:integer($NumOfLines)"!]</SHORT-NAME>
                    <CATEGORY>ARRAY</CATEGORY>
                    <ARRAY-SIZE>[!"num:integer(count(./DemPassiveEventRefs/eb-list::*/DemPassiveEventRef))"!]</ARRAY-SIZE>
                    <SUB-ELEMENTS>
          [!VAR "Index" = "0"!]
          [!LOOP "./DemPassiveEventRefs/eb-list::*/DemPassiveEventRef"!]
                      <MC-DATA-INSTANCE>
                        <SHORT-NAME>DemPassiveEventRef_[!"as:name(as:ref(.))"!]</SHORT-NAME>
                        <DESC>
                          <L-2 L="EN">
                            Reference to EventIds that are considered in the advanced displacement algorithm as passive events.
                          </L-2>
                        </DESC>
                        <CATEGORY>VALUE</CATEGORY>
                        <RESULTING-PROPERTIES>
                          <SW-DATA-DEF-PROPS-VARIANTS>
                            <SW-DATA-DEF-PROPS-CONDITIONAL>
                              <BASE-TYPE-REF DEST="SW-BASE-TYPE">/AUTOSAR_Platform/BaseTypes/uint16</BASE-TYPE-REF>
                              <SW-CALIBRATION-ACCESS>READ-WRITE</SW-CALIBRATION-ACCESS>
                              <DATA-CONSTR-REF DEST="DATA-CONSTR">/AUTOSAR_Dem/DataConstrs/CONSTR_DemValidEventIdRange</DATA-CONSTR-REF>
                            </SW-DATA-DEF-PROPS-CONDITIONAL>
                          </SW-DATA-DEF-PROPS-VARIANTS>
                        </RESULTING-PROPERTIES>
                        <SYMBOL>[[!"num:i($Index)"!]]</SYMBOL>
                      </MC-DATA-INSTANCE>
            [!VAR "Index" = "$Index + 1"!]
          [!ENDLOOP!]
                    </SUB-ELEMENTS>
                    <SYMBOL>Dem_AdvDisplPassiveEventIdsLine[!"num:integer($NumOfLines)"!]</SYMBOL>
                  </MC-DATA-INSTANCE>
          [!VAR "NumOfLines" = "$NumOfLines + 1"!]
        [!ENDLOOP!]
      [!ENDIF!]
    [!ENDIF!]

  [!/*  - Generate calibration data for DEM_EVCOMB_TYPE1 - */!][!//
  [!ELSEIF "$CalibrationWithEvCombSupport = 'true'"!]
                  <MC-DATA-INSTANCE>
                    <SHORT-NAME>Dem_EventIndicatorClassIdx</SHORT-NAME>
                    <DESC>
                      <L-2 L="EN">Array for mapping an indicator group per event</L-2>
                    </DESC>
                    <CATEGORY>ARRAY</CATEGORY>
                    <ARRAY-SIZE>[!"num:integer(count(DemConfigSet/eb-list::*/DemEventParameter/eb-list::*))"!]</ARRAY-SIZE>
                    <SUB-ELEMENTS>
      [!LOOP "util:distinct(node:order(DemConfigSet/eb-list::*/DemEventParameter/eb-list::*, 'DemEventId'))"!]
                      <MC-DATA-INSTANCE>
                        <SHORT-NAME>[!"as:name(.)"!]</SHORT-NAME>
                        <DESC>
                          <L-2 L="EN">
                            Allows calibration of indicator groups represented by Dem_IndicatorClasses.IndicatorClasses_x_y. Calibrate 'x' where 'x' denotes main group index and 'y' denotes group indicators. Single indicators are denoted by 'x' alone. Value [!"num:i($NumberOfIndicatorClasses + 1)"!] is used to disable.
                            <!--Index of Indicator group referenced by [!"as:name(.)"!] (DemEventId=[!"num:i(DemEventId)"!]).
        [!IF "node:exists(DemDTCClassRef) and node:refvalid(DemDTCClassRef)"!]
                            This Event references DTCClass [!"as:name(as:ref(DemDTCClassRef))"!].
        [!ELSE!]
                            This Event references no DTCClass.
        [!ENDIF!]
                            Notes for events assigned to a MIL group:
                            - If the MIL indicator is removed through calibration, the event is no longer
                            considered as member of the MIL group.
                            - If the calibration of the MIL indicator's class causes 'DemIndicatorFailureCycleRef'
                            or 'DemIndicatorFailureCycleCounterThreshold' to be different from 'DemOperationCycleRef'
                            or, respectively, 'DemEventFailureCycleCounterThreshold', the failure counters are not
                            in sync anymore. This could lead to undefined behavior at run-time.
                            Note for events with 'DemEventKind' set to 'DEM_EVENT_KIND_SEV':
                            Such security events must not be linked to an indicator.-->
                          </L-2>
                        </DESC>
                        <CATEGORY>VALUE</CATEGORY>
                          <RESULTING-PROPERTIES>
                            <SW-DATA-DEF-PROPS-VARIANTS>
                              <SW-DATA-DEF-PROPS-CONDITIONAL>
                                <BASE-TYPE-REF DEST="SW-BASE-TYPE">/AUTOSAR_Platform/BaseTypes/[!"$DemIndicatorGrpIdxType"!]</BASE-TYPE-REF>
                                <SW-CALIBRATION-ACCESS>READ-WRITE</SW-CALIBRATION-ACCESS>
                                <DATA-CONSTR-REF DEST="DATA-CONSTR">/AUTOSAR_Dem/DataConstrs/CONSTR_IndicatorClassIdx</DATA-CONSTR-REF>
                              </SW-DATA-DEF-PROPS-CONDITIONAL>
                            </SW-DATA-DEF-PROPS-VARIANTS>
                          </RESULTING-PROPERTIES>
                        <SYMBOL>[[!"num:i(DemEventId)"!]]</SYMBOL>
                      </MC-DATA-INSTANCE>
      [!ENDLOOP!]
                    </SUB-ELEMENTS>
                    <SYMBOL>Dem_EventIndicatorClassIdx</SYMBOL>
                  </MC-DATA-INSTANCE>

    [!IF "node:existsAndTrue(DemGeneral/DemOBDSupport)"!]
                  <MC-DATA-INSTANCE>
                    <SHORT-NAME>Dem_OBDConfig</SHORT-NAME>
                    <CATEGORY>STRUCTURE</CATEGORY>
                    <SUB-ELEMENTS>
      [!VAR "DTCClassIdx" = "0"!]
      [!LOOP "text:split($DemDTCClassList, '#')"!]
                      <MC-DATA-INSTANCE>
                        <SHORT-NAME>[!"."!]</SHORT-NAME>
                        <CATEGORY>STRUCTURE</CATEGORY>
                        <SUB-ELEMENTS>
        [!IF "$ObdUdsDtcSeparationSupport = 'true'"!][!//
                          <MC-DATA-INSTANCE>
                            <SHORT-NAME>ObdDTC3Byte</SHORT-NAME>
                            <DESC>
                              <L-2 L="EN">
                                3-byte OBD DTC value of the event when DemSupportedObdUdsDtcSeparation is enabled and either OBD variant is configured to DEM_OBD_VARIANT_OBDONUDS or OBD variant is selected via DemCalloutObdVariantFnc. Value 0 means 'no 3-byte OBD DTC assigned'
                                <!--If re-calibration is performed for a stored event (OBD to non-OBD),
                                the related OBD freeze frame (if stored),
                                the related permanent event memory entry (if stored),
                                etc. will not be cleared. The event memory entry will remain
                                occupied and these data will then remain in an orphan state and will
                                be inaccessible, belonging to an event that is no longer an OBD
                                event. Such an OBD freeze frame can only be cleared by a subsequent
                                call of Dem_ClearDTC() on the UDS DTC of this event, or with a clear
                                on all UDS DTCs, - however, it is recommended to clear the event before
                                re-calibration and avoid this situation.
                                Take care to calibrate a non-OBD event to OBD only if
                                DemEventDestination of the event is set to DEM_DTC_ORIGIN_PRIMARY_MEMORY.
                                If 3-byte OBD DTC value re-calibration is performed for an event,
                                DemEventOBDReadinessGroup needs to be re-calibrated consistently.
                                Range is 0..16776959.
                                The ranges 1..255 and 16776960..16777215 are reserved by ISO 14229-1.
                                For events with 'DemEventKind' set to 'DEM_EVENT_KIND_SEV' only value 0 is allowed.-->
                              </L-2>
                            </DESC>
                            <CATEGORY>VALUE</CATEGORY>
                            <RESULTING-PROPERTIES>
                              <SW-DATA-DEF-PROPS-VARIANTS>
                                <SW-DATA-DEF-PROPS-CONDITIONAL>
                                  <BASE-TYPE-REF DEST="SW-BASE-TYPE">/AUTOSAR_Platform/BaseTypes/uint32</BASE-TYPE-REF>
                                  <SW-BIT-REPRESENTATION>
                                    <BIT-POSITION>0</BIT-POSITION>
                                    <NUMBER-OF-BITS>24</NUMBER-OF-BITS>
                                  </SW-BIT-REPRESENTATION>
                                  <SW-CALIBRATION-ACCESS>READ-WRITE</SW-CALIBRATION-ACCESS>
                                  <DATA-CONSTR-REF DEST="DATA-CONSTR">/AUTOSAR_Dem/DataConstrs/CONSTR_DemDtcValue3Byte</DATA-CONSTR-REF>
                                </SW-DATA-DEF-PROPS-CONDITIONAL>
                              </SW-DATA-DEF-PROPS-VARIANTS>
                            </RESULTING-PROPERTIES>
                            <SYMBOL>Dem_OBDConfig[[!"num:i($DTCClassIdx)"!]]</SYMBOL>
                          </MC-DATA-INSTANCE>
          [!IF "$DTCClassAvailable = 'true'"!][!//
                          <MC-DATA-INSTANCE>
                            <SHORT-NAME>DemWWHOBDDTCClass</SHORT-NAME>
                            <DESC>
                              <L-2 L="EN">
                                WWHOBD DTC Class of the current event.
                              </L-2>
                            </DESC>
                            <CATEGORY>VALUE</CATEGORY>
                            <RESULTING-PROPERTIES>
                              <SW-DATA-DEF-PROPS-VARIANTS>
                                <SW-DATA-DEF-PROPS-CONDITIONAL>
                                  <BASE-TYPE-REF DEST="SW-BASE-TYPE">/AUTOSAR_Platform/BaseTypes/uint32</BASE-TYPE-REF>
                                  <SW-BIT-REPRESENTATION>
                                    <BIT-POSITION>24</BIT-POSITION>
                                    <NUMBER-OF-BITS>3</NUMBER-OF-BITS>
                                  </SW-BIT-REPRESENTATION>
                                  <SW-CALIBRATION-ACCESS>READ-WRITE</SW-CALIBRATION-ACCESS>
                                  <COMPU-METHOD-REF DEST="COMPU-METHOD">/AUTOSAR_Dem/CompuMethods/CM_DemWWHOBDDTCClass</COMPU-METHOD-REF>
                                  <DATA-CONSTR-REF DEST="DATA-CONSTR">/AUTOSAR_Platform/DataConstrs/uint32</DATA-CONSTR-REF>
                                </SW-DATA-DEF-PROPS-CONDITIONAL>
                              </SW-DATA-DEF-PROPS-VARIANTS>
                            </RESULTING-PROPERTIES>
                            <SYMBOL>Dem_OBDConfig[[!"num:i($DTCClassIdx)"!]]</SYMBOL>
                          </MC-DATA-INSTANCE>
          [!ENDIF!]
        [!ELSE!]
          [!IF "$DTCClassAvailable = 'true'"!][!//
                          <MC-DATA-INSTANCE>
                            <SHORT-NAME>DemWWHOBDDTCClass</SHORT-NAME>
                            <DESC>
                              <L-2 L="EN">
                                WWHOBD DTC Class of the current event.
                              </L-2>
                            </DESC>
                            <CATEGORY>VALUE</CATEGORY>
                            <RESULTING-PROPERTIES>
                              <SW-DATA-DEF-PROPS-VARIANTS>
                                <SW-DATA-DEF-PROPS-CONDITIONAL>
                                  <BASE-TYPE-REF DEST="SW-BASE-TYPE">/AUTOSAR_Platform/BaseTypes/uint8</BASE-TYPE-REF>
                                  <SW-BIT-REPRESENTATION>
                                    <BIT-POSITION>0</BIT-POSITION>
                                    <NUMBER-OF-BITS>3</NUMBER-OF-BITS>
                                  </SW-BIT-REPRESENTATION>
                                  <SW-CALIBRATION-ACCESS>READ-WRITE</SW-CALIBRATION-ACCESS>
                                  <COMPU-METHOD-REF DEST="COMPU-METHOD">/AUTOSAR_Dem/CompuMethods/CM_DemWWHOBDDTCClass</COMPU-METHOD-REF>
                                  <DATA-CONSTR-REF DEST="DATA-CONSTR">/AUTOSAR_Platform/DataConstrs/uint8</DATA-CONSTR-REF>
                                </SW-DATA-DEF-PROPS-CONDITIONAL>
                              </SW-DATA-DEF-PROPS-VARIANTS>
                            </RESULTING-PROPERTIES>
                            <SYMBOL>Dem_OBDConfig[[!"num:i($DTCClassIdx)"!]]</SYMBOL>
                          </MC-DATA-INSTANCE>
          [!ENDIF!]
        [!ENDIF!]
        [!IF "$DemObdDTCSupport = 'true'"!]
                          <MC-DATA-INSTANCE>
                            <SHORT-NAME>ObdDTC</SHORT-NAME>
                            <DESC>
                              <L-2 L="EN">
                              2-byte OBD DTC value of the current event. Value 0 means 'no 2-byte OBD DTC assigned'.
                              <!-- If re-calibration is performed for a stored event (OBD to non-OBD),
                              the related OBD freeze frame (if stored), the related permanent event
                              memory entry (if stored), etc. will not be cleared. The event memory
                              entry will remain occupied and these data will then remain in an orphan
                              state and will be inaccessible, belonging to an event that is no longer
                              an OBD event. Such an OBD freeze frame can only be cleared by a subsequent
                              call of Dem_ClearDTC() on the UDS DTC of this event, or with a clear
                              on all UDS DTCs, - however, it is recommended to clear the event before
                              re-calibration and avoid this situation.
                              Take care to calibrate a non-OBD event to OBD only if
                              DemEventDestination of the event is set to DEM_DTC_ORIGIN_PRIMARY_MEMORY.
                              If OBD DTC value re-calibration is performed for an event,
                              DemEventOBDReadinessGroup needs to be re-calibrated consistently.
                              Range is 0..65535. Value 0 means 'no OBD DTC assigned'.
                              For events with 'DemEventKind' set to 'DEM_EVENT_KIND_SEV' only value 0 is allowed.
                              It is possible to configure multiple DTCs with identical OBD DTC
                              value. When more than one DemDTCClass has identical OBD DTC, it is
                              recommended to have same DemEventPriority, DemEventOBDReadinessGroup,
                              DemDTCSeverity and DemDTCFunctionalUnit for events referring these
                              DTCs to avoid inconsistencies in the Dem behavior.-->
                            </L-2>
                          </DESC>
                          <CATEGORY>VALUE</CATEGORY>
                          <RESULTING-PROPERTIES>
                            <SW-DATA-DEF-PROPS-VARIANTS>
                              <SW-DATA-DEF-PROPS-CONDITIONAL>
                                <BASE-TYPE-REF DEST="SW-BASE-TYPE">/AUTOSAR_Platform/BaseTypes/uint16</BASE-TYPE-REF>
                                <SW-CALIBRATION-ACCESS>READ-WRITE</SW-CALIBRATION-ACCESS>
                                <DATA-CONSTR-REF DEST="DATA-CONSTR">/AUTOSAR_Platform/DataConstrs/uint16</DATA-CONSTR-REF>
                              </SW-DATA-DEF-PROPS-CONDITIONAL>
                            </SW-DATA-DEF-PROPS-VARIANTS>
                          </RESULTING-PROPERTIES>
                            <SYMBOL>Dem_OBDDTC[[!"num:i($DTCClassIdx)"!]]</SYMBOL>
                          </MC-DATA-INSTANCE>
        [!ENDIF!]
                        </SUB-ELEMENTS>
                      </MC-DATA-INSTANCE>
        [!VAR "DTCClassIdx" = "$DTCClassIdx + 1"!]
      [!ENDLOOP!][!//
                    </SUB-ELEMENTS>
                  </MC-DATA-INSTANCE>
    [!ENDIF!]

    [!IF "(num:integer($EventFailureClassIdx) > 0)"!]
                  <MC-DATA-INSTANCE>
                    <SHORT-NAME>Dem_EventFailureCycleCfg</SHORT-NAME>
                    <CATEGORY>ARRAY</CATEGORY>
                    <ARRAY-SIZE>[!"num:i($EventFailureClassIdx)"!]</ARRAY-SIZE>
                    <SUB-ELEMENTS>
      [!FOR "EachFailureClass" = "0"  TO "$EventFailureClassIdx - 1"!]
                      <MC-DATA-INSTANCE>
                        <SHORT-NAME>EventFailureClass_[!"$EachFailureClass"!]</SHORT-NAME>
                        <CATEGORY>STRUCTURE</CATEGORY>
                        <SUB-ELEMENTS>
                          <!-- !LINKSTO Dem.Calibration.DemEventFailureCycleCounterThreshold.EventCombinationEnabled,1 -->
                          <MC-DATA-INSTANCE>
                            <SHORT-NAME>EventFailureCycleCounterThreshold</SHORT-NAME>
                            <DESC>
                              <L-2 L="EN">
                                Value of DemEventFailureCycleCounterThreshold. Value 0 is only limited to events assigned to a driving cycle i.e. Zero-trip events. Note: The calibrated threshold will be applied to all events which belong to EventFailureClass_[!"$EachFailureClass"!].
                                <!--
                                For MIL group events, the calibration of this parameter to value 1 is not allowed.
                                If the 'DemEventFailureCycleCounterThreshold' of a MIL group event is changed
                                to be different from 'DemIndicatorFailureCycleCounterThreshold' configured
                                for its MIL indicator, the MIL counter and the confirmation counter would not
                                be in sync anymore. This could lead to undefined behavior during runtime. -->
                              </L-2>
                            </DESC>
                            <CATEGORY>VALUE</CATEGORY>
                            <RESULTING-PROPERTIES>
                              <SW-DATA-DEF-PROPS-VARIANTS>
                                <SW-DATA-DEF-PROPS-CONDITIONAL>
                                  <BASE-TYPE-REF DEST="SW-BASE-TYPE">/AUTOSAR_Platform/BaseTypes/uint8</BASE-TYPE-REF>
                                  <SW-CALIBRATION-ACCESS>READ-WRITE</SW-CALIBRATION-ACCESS>
                                  <DATA-CONSTR-REF DEST="DATA-CONSTR">/AUTOSAR_Dem/DataConstrs/CONSTR_EventFailureCycleCounterThreshold</DATA-CONSTR-REF>
                                </SW-DATA-DEF-PROPS-CONDITIONAL>
                              </SW-DATA-DEF-PROPS-VARIANTS>
                            </RESULTING-PROPERTIES>
                            <SYMBOL>EventFailureCycleCounterThreshold</SYMBOL>
                          </MC-DATA-INSTANCE>
                        </SUB-ELEMENTS>
                        <SYMBOL>[[!"$EachFailureClass"!]]</SYMBOL>
                      </MC-DATA-INSTANCE>
      [!ENDFOR!]
                    </SUB-ELEMENTS>
                    <SYMBOL>Dem_EventFailureCycleCfg</SYMBOL>
                  </MC-DATA-INSTANCE>
    [!ENDIF!]

    [!VAR "EnableConditionGroupNumber" = "num:integer(count(DemGeneral/DemEnableConditionGroup/eb-list::*))"!]
                  <MC-DATA-INSTANCE>
                    <SHORT-NAME>Dem_EventDesc</SHORT-NAME>
                    <CATEGORY>ARRAY</CATEGORY>
                    <ARRAY-SIZE>[!"num:integer(count(DemConfigSet/eb-list::*/DemEventParameter/eb-list::*))"!]</ARRAY-SIZE>
                    <SUB-ELEMENTS>
    [!VAR "Index" = "1"!]
    [!LOOP "util:distinct(node:order(DemConfigSet/eb-list::*/DemEventParameter/eb-list::*, 'DemEventId'))"!]
                      <MC-DATA-INSTANCE>
                        <SHORT-NAME>[!"as:name(.)"!]</SHORT-NAME>
                        <CATEGORY>STRUCTURE</CATEGORY>
                        <SUB-ELEMENTS>
                          <!-- !LINKSTO dsn.Dem.Calibration.EvConf1.EventCombinationEnabled,1 -->
                          <!-- EvConf1 -->
                          <MC-DATA-INSTANCE>
                            <SHORT-NAME>EvConf1</SHORT-NAME>
                            <CATEGORY>STRUCTURE</CATEGORY>
                            <SUB-ELEMENTS>
                              <!-- !LINKSTO Dem.Calibration.DemEventFailureClassIdx.EventCombinationEnabled,1 -->
      [!IF "(num:integer($EventFailureClassIdx) > 0)"!]
                              <MC-DATA-INSTANCE>
                                <SHORT-NAME>DemEventFailureClassIdx</SHORT-NAME>
                                <DESC>
                                  <L-2 L="EN">
                                    Index of Event failure class. Fault confirmation can be removed by calibrating to [!"num:i($EventFailureClassIdx)"!].
                                    <!--Note:
                                    - If the event belongs to a MIL group, it shall be ensured that an appropriate
                                      index of event failure class with event failure cycle counter threshold greater
                                      than 1 shall be calibrated.
                                    - If a combined event is calibrated with a new index of event failure class, it
                                      shall be ensured that all the associated events within the combined set shall also
                                      be calibrated with the same index of event failure class.-->
                                  </L-2>
                                </DESC>
                                <CATEGORY>VALUE</CATEGORY>
                                <RESULTING-PROPERTIES>
                                  <SW-DATA-DEF-PROPS-VARIANTS>
                                    <SW-DATA-DEF-PROPS-CONDITIONAL>
                                      <BASE-TYPE-REF DEST="SW-BASE-TYPE">/AUTOSAR_Platform/BaseTypes/uint32</BASE-TYPE-REF>
                                      <SW-BIT-REPRESENTATION>
                                        <BIT-POSITION>[!"num:i($CalEventFailureClassIdxOffset)"!]</BIT-POSITION>
                                        <NUMBER-OF-BITS>[!"num:i($CalEventFailureClassIdxWidth)"!]</NUMBER-OF-BITS>
                                      </SW-BIT-REPRESENTATION>
                                      <SW-CALIBRATION-ACCESS>READ-WRITE</SW-CALIBRATION-ACCESS>
                                      <DATA-CONSTR-REF DEST="DATA-CONSTR">/AUTOSAR_Dem/DataConstrs/CONSTR_EventFailureClassIdx</DATA-CONSTR-REF>
                                    </SW-DATA-DEF-PROPS-CONDITIONAL>
                                  </SW-DATA-DEF-PROPS-VARIANTS>
                                </RESULTING-PROPERTIES>
                                <SYMBOL>EvConf1</SYMBOL>
                              </MC-DATA-INSTANCE>
      [!ENDIF!]
      [!IF "$EnableConditionGroupNumber > 0"!]
                              <MC-DATA-INSTANCE>
                                <SHORT-NAME>EnableConditionGroupRef</SHORT-NAME>
                                <DESC>
                                  <L-2 L="EN">
                                    Reference to a configured enable condition group. Value [!"num:i($DemNumEnCondGroups)"!] is used to disable.
                                  </L-2>
                                </DESC>
                                <CATEGORY>VALUE</CATEGORY>
                                <RESULTING-PROPERTIES>
                                  <SW-DATA-DEF-PROPS-VARIANTS>
                                    <SW-DATA-DEF-PROPS-CONDITIONAL>
                                      <BASE-TYPE-REF DEST="SW-BASE-TYPE">/AUTOSAR_Platform/BaseTypes/uint32</BASE-TYPE-REF>
                                      <SW-BIT-REPRESENTATION>
                                        <BIT-POSITION>[!"num:i($CalEnableConditionGroupIdxOffset)"!]</BIT-POSITION>
                                        <NUMBER-OF-BITS>[!"num:i($CalEnableConditionGroupIdxWidth)"!]</NUMBER-OF-BITS>
                                      </SW-BIT-REPRESENTATION>
                                      <SW-CALIBRATION-ACCESS>READ-WRITE</SW-CALIBRATION-ACCESS>
                                      <DATA-CONSTR-REF DEST="DATA-CONSTR">/AUTOSAR_Dem/DataConstrs/CONSTR_EnableConditionGroup</DATA-CONSTR-REF>
                                    </SW-DATA-DEF-PROPS-CONDITIONAL>
                                  </SW-DATA-DEF-PROPS-VARIANTS>
                                </RESULTING-PROPERTIES>
                                <SYMBOL>EvConf1</SYMBOL>
                              </MC-DATA-INSTANCE>
      [!ENDIF!]
                            </SUB-ELEMENTS>
                          </MC-DATA-INSTANCE>
                        </SUB-ELEMENTS>
                        <SYMBOL>[[!"num:i($Index)"!]]</SYMBOL>
                      </MC-DATA-INSTANCE>
      [!VAR "Index" = "$Index + 1"!]
    [!ENDLOOP!]
                    </SUB-ELEMENTS>
                    <SYMBOL>Dem_EventDesc</SYMBOL>
                  </MC-DATA-INSTANCE>

                  <MC-DATA-INSTANCE>
                    <SHORT-NAME>Dem_DTCDesc</SHORT-NAME>
                    <CATEGORY>ARRAY</CATEGORY>
                    <ARRAY-SIZE>[!"num:i($DemNbOfDTCClasses)"!]</ARRAY-SIZE>
                    <SUB-ELEMENTS>
    [!FOR "DTCCtr" = "0" TO "num:integer($DemNbOfDTCClasses) - 1"!][!//
      [!VAR "DTCClassName" = "text:split($DemDTCClassList, '#')[position() = $DTCCtr+1]"!][!//
      [!LOOP "as:modconf('Dem')[1]/DemConfigSet/eb-list::*/DemEventParameter/eb-list::*"!][!//
        [!IF "node:exists(DemDTCClassRef)"!][!//
          [!VAR "EventDTCClassName" = "text:split(DemDTCClassRef, '/')[last()]"!][!//
        [!ELSE!][!/* No DTC class or no UDS-DTC configured */!][!//
          [!VAR "EventDTCClassName" = "node:name(.)"!][!//
        [!ENDIF!][!//
        [!IF "$DTCClassName = $EventDTCClassName"!][!//
          [!IF "not(node:exists(DemDTCClassRef)) or not(node:exists(DemEvtCmbCommonParamMaster)) or (node:existsAndTrue(DemEvtCmbCommonParamMaster))"!][!//
                      <MC-DATA-INSTANCE>
                        <SHORT-NAME>[!"as:name(.)"!]</SHORT-NAME>
                        <CATEGORY>STRUCTURE</CATEGORY>
                        <SUB-ELEMENTS>
                          <!-- !LINKSTO dsn.Dem.Calibration.DTCConf1.EventCombinationEnabled,1 -->
                          <!-- DTCConf1 -->
                          <MC-DATA-INSTANCE>
                            <SHORT-NAME>DTCConf1</SHORT-NAME>
                            <CATEGORY>STRUCTURE</CATEGORY>
                            <SUB-ELEMENTS>
                              <!-- !LINKSTO VCC_DEM_006_Req103v1,1 -->
                              <MC-DATA-INSTANCE>
                                <SHORT-NAME>DemUdsDTC</SHORT-NAME>
                                <DESC>
                                  <L-2 L="EN">
                                    UDS DTC value of the event (special case DTC 0: means DTC off; it is not allowed to have the same DTC value for more than one event).
                                    <!--Valid range of DTC calibration is within the configured DTC group including value 0
                                    to disable the DTC For service 0x19, if the DTC is identified by the algorithm the
                                    value of the DTC will be returned. If re-calibration is performed during Dcm
                                    service request processing, the Dem may return still with the DTC, although the DTC is
                                    switched off already until a request for a different DTC. In case calibration occurs with
                                    DTC off and the service is called again, the DTC being identified by the algorithm, the
                                    DTC returned by the service is DEM_NO_DTC. Range is 0..16777214, displayable on 24 bits.-->
                                  </L-2>
                                </DESC>
                                <CATEGORY>VALUE</CATEGORY>
                                <RESULTING-PROPERTIES>
                                  <SW-DATA-DEF-PROPS-VARIANTS>
                                    <SW-DATA-DEF-PROPS-CONDITIONAL>
                                      <BASE-TYPE-REF DEST="SW-BASE-TYPE">/AUTOSAR_Platform/BaseTypes/uint32</BASE-TYPE-REF>
                                      <SW-BIT-REPRESENTATION>
                                        <BIT-POSITION>0</BIT-POSITION>
                                        <NUMBER-OF-BITS>24</NUMBER-OF-BITS>
                                      </SW-BIT-REPRESENTATION>
                                      <SW-CALIBRATION-ACCESS>READ-WRITE</SW-CALIBRATION-ACCESS>
                                      <DATA-CONSTR-REF DEST="DATA-CONSTR">/AUTOSAR_Dem/DataConstrs/CONSTR_DemUdsDTC</DATA-CONSTR-REF>
                                    </SW-DATA-DEF-PROPS-CONDITIONAL>
                                  </SW-DATA-DEF-PROPS-VARIANTS>
                                </RESULTING-PROPERTIES>
                                <SYMBOL>DTCConf1</SYMBOL>
                              </MC-DATA-INSTANCE>
                            </SUB-ELEMENTS>
                          </MC-DATA-INSTANCE>
            [!IF "(node:existsAndTrue(as:modconf('Dem')[1]/DemGeneral/DemEventDisplacementSupport)) or
                ($DemAgingAllowedSupport = 'true')"!]
                          <!-- !LINKSTO dsn.Dem.Calibration.DTCConf2.EventCombinationEnabled,1 -->
                          <!-- DTCConf2 -->
                          <MC-DATA-INSTANCE>
                            <SHORT-NAME>DTCConf2</SHORT-NAME>
                            <CATEGORY>STRUCTURE</CATEGORY>
                            <SUB-ELEMENTS>
              [!IF "(node:existsAndTrue(as:modconf('Dem')[1]/DemGeneral/DemEventDisplacementSupport))"!]
                              <MC-DATA-INSTANCE>
                                <SHORT-NAME>EventPriority</SHORT-NAME>
                                <DESC>
                                  <L-2 L="EN">
                                    Internal value of configured event priority. Value 0 represents the highest priority and each value sequentially larger represents a lower priority in the ranking of all configured priorities.
                                    <!--Dem does not store the configured DemEventPriority value directly, but creates an ordered
                                    list of all configured unique DemEventPriority values in ascending priority value order to build
                                    a ranking of configured priorities.
                                    You calibrate the index into the list of configured event priorities. That means, it is not
                                    possible to add new event priority values via calibration.-->
                                  </L-2>
                                </DESC>
                                <CATEGORY>VALUE</CATEGORY>
                                <RESULTING-PROPERTIES>
                                  <SW-DATA-DEF-PROPS-VARIANTS>
                                    <SW-DATA-DEF-PROPS-CONDITIONAL>
                                      <BASE-TYPE-REF DEST="SW-BASE-TYPE">/AUTOSAR_Platform/BaseTypes/uint32</BASE-TYPE-REF>
                                      <SW-BIT-REPRESENTATION>
                                        <BIT-POSITION>[!"num:i($CalEventPriorityOffset)"!]</BIT-POSITION>
                                        <NUMBER-OF-BITS>[!"num:i($CalEventPriorityWidth)"!]</NUMBER-OF-BITS>
                                      </SW-BIT-REPRESENTATION>
                                      <SW-CALIBRATION-ACCESS>READ-WRITE</SW-CALIBRATION-ACCESS>
                                      <DATA-CONSTR-REF DEST="DATA-CONSTR">/AUTOSAR_Dem/DataConstrs/CONSTR_EventPriorityIdx</DATA-CONSTR-REF>
                                    </SW-DATA-DEF-PROPS-CONDITIONAL>
                                  </SW-DATA-DEF-PROPS-VARIANTS>
                                </RESULTING-PROPERTIES>
                                <SYMBOL>DTCConf2</SYMBOL>
                              </MC-DATA-INSTANCE>
              [!ENDIF!]
              [!IF "$DemAgingAllowedSupport = 'true'"!]
                              <MC-DATA-INSTANCE>
                                <SHORT-NAME>AgingCycleCounterThreshold</SHORT-NAME>
                                <DESC>
                                  <L-2 L="EN">
                                    Value of DemAgingCycleCounterThreshold. Calibration of this value is only allowed before Dem_PreInit() is called. After re-calibration of aging support the stored event related data is not valid. Value 0 disables aging.
                                    <!--Range is configuration dependent.
                                    Note that for events with 'DemEventKind' set to 'DEM_EVENT_KIND_SEV'
                                    aging must not be enabled via calibration.-->
                                  </L-2>
                                </DESC>
                                <CATEGORY>VALUE</CATEGORY>
                                <RESULTING-PROPERTIES>
                                  <SW-DATA-DEF-PROPS-VARIANTS>
                                    <SW-DATA-DEF-PROPS-CONDITIONAL>
                                      <BASE-TYPE-REF DEST="SW-BASE-TYPE">/AUTOSAR_Platform/BaseTypes/uint32</BASE-TYPE-REF>
                                      <SW-BIT-REPRESENTATION>
                                        <BIT-POSITION>[!"num:i($CalAgingCycleIdOffset)"!]</BIT-POSITION>
                                        <NUMBER-OF-BITS>[!"num:i($CalAgingCycleIdWidth)"!]</NUMBER-OF-BITS>
                                      </SW-BIT-REPRESENTATION>
                                      <SW-CALIBRATION-ACCESS>READ-WRITE</SW-CALIBRATION-ACCESS>
                                      <DATA-CONSTR-REF DEST="DATA-CONSTR">/AUTOSAR_Dem/DataConstrs/CONSTR_AgingCycleThreshold</DATA-CONSTR-REF>
                                    </SW-DATA-DEF-PROPS-CONDITIONAL>
                                  </SW-DATA-DEF-PROPS-VARIANTS>
                                </RESULTING-PROPERTIES>
                                <SYMBOL>DTCConf2</SYMBOL>
                              </MC-DATA-INSTANCE>
              [!ENDIF!]
                            </SUB-ELEMENTS>
                          </MC-DATA-INSTANCE>
            [!ENDIF!]
                        </SUB-ELEMENTS>
                        <SYMBOL>[[!"num:i($DTCCtr)"!]]</SYMBOL>
                      </MC-DATA-INSTANCE>
            [!BREAK!][!//
          [!ENDIF!]
        [!ENDIF!]
      [!ENDLOOP!]
    [!ENDFOR!]
                    </SUB-ELEMENTS>
                    <SYMBOL>Dem_DTCDesc</SYMBOL>
                  </MC-DATA-INSTANCE>

  [!ENDIF!]
[!ENDIF!]
                </MC-PARAMETER-INSTANCES>
              </MC-SUPPORT>
[!INCLUDE "../Dem_Bswmd_ResourceConsumption.arxml.m"!]
            </BSW-IMPLEMENTATION>
          </ELEMENTS>
        </AR-PACKAGE>
      </AR-PACKAGES>
    </AR-PACKAGE>
  </AR-PACKAGES>
</AUTOSAR>
