AUTOSAR XML (schema 4-3-0)
package /TS_TxDxM6I17R0
  module config NvMPreConfiguration: definition=NvM
    NvMBlock_ConfigID (NvMBlockDescriptor):
      NvMNvramBlockIdentifier = 1
      NvMNvBlockNum = 2
      NvMRomBlockNum = 1
      NvMBlockUseCrc = 1
      NvMCalcRamBlockCrc = 1
      NvMBlockManagementType = NVM_BLOCK_REDUNDANT
      NvMNvBlockBaseNumber = 1
      NvMRamBlockDataAddress = &NvM_ConfigurationId
      NvMRomBlockDataAddress = &NvM_CompiledConfigurationId
      NvMSelectBlockForReadAll = 1
      NvMSelectBlockForWriteAll = 1
