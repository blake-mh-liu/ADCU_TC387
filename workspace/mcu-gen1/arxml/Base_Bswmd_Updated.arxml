AUTOSAR XML (schema 4-3-0)
standard types defined: boolean, float32, float64, sint16, sint32, sint64, sint8, uint16, uint32, uint64, uint8, void, sint16_least, sint32_least, sint8_least, uint16_least, uint32_least, uint8_least, Std_ReturnType
package /AUTOSAR_MemMap/SwAddrMethods
  88 x sw addr method:
    CAL: memory-allocation-keyword-policy=ADDR-METHOD-SHORT-NAME-AND-ALIGNMENT, section-initialization-policy=INIT, section-type=CALPRM
    CALIB: memory-allocation-keyword-policy=ADDR-METHOD-SHORT-NAME-AND-ALIGNMENT, section-initialization-policy=INIT, section-type=CALPRM
    CALIB_ASIL_A: memory-allocation-keyword-policy=ADDR-METHOD-SHORT-NAME-AND-ALIGNMENT, options=safetyAsilA, section-initialization-policy=INIT, section-type=CALPRM
    CALIB_ASIL_B: memory-allocation-keyword-policy=ADDR-METHOD-SHORT-NAME-AND-ALIGNMENT, options=safetyAsilB, section-initialization-policy=INIT, section-type=CALPRM
    CALIB_ASIL_C: memory-allocation-keyword-policy=ADDR-METHOD-SHORT-NAME-AND-ALIGNMENT, options=safetyAsilC, section-initialization-policy=INIT, section-type=CALPRM
    CALIB_ASIL_D: memory-allocation-keyword-policy=ADDR-METHOD-SHORT-NAME-AND-ALIGNMENT, options=safetyAsilD, section-initialization-policy=INIT, section-type=CALPRM
    CALLOUT_CODE: memory-allocation-keyword-policy=ADDR-METHOD-SHORT-NAME, section-type=CODE
    CALLOUT_CODE_ASIL_A: memory-allocation-keyword-policy=ADDR-METHOD-SHORT-NAME, options=safetyAsilA, section-type=CODE
    CALLOUT_CODE_ASIL_A_LOCAL: memory-allocation-keyword-policy=ADDR-METHOD-SHORT-NAME, options=[safetyAsilA, coreLocal], section-type=CODE
    CALLOUT_CODE_ASIL_B: memory-allocation-keyword-policy=ADDR-METHOD-SHORT-NAME, options=safetyAsilB, section-type=CODE
    CALLOUT_CODE_ASIL_B_LOCAL: memory-allocation-keyword-policy=ADDR-METHOD-SHORT-NAME, options=[safetyAsilB, coreLocal], section-type=CODE
    CALLOUT_CODE_ASIL_C: memory-allocation-keyword-policy=ADDR-METHOD-SHORT-NAME, options=safetyAsilC, section-type=CODE
    CALLOUT_CODE_ASIL_C_LOCAL: memory-allocation-keyword-policy=ADDR-METHOD-SHORT-NAME, options=[safetyAsilC, coreLocal], section-type=CODE
    CALLOUT_CODE_ASIL_D: memory-allocation-keyword-policy=ADDR-METHOD-SHORT-NAME, options=safetyAsilD, section-type=CODE
    CALLOUT_CODE_ASIL_D_LOCAL: memory-allocation-keyword-policy=ADDR-METHOD-SHORT-NAME, options=[safetyAsilD, coreLocal], section-type=CODE
    CALLOUT_CODE_LOCAL: memory-allocation-keyword-policy=ADDR-METHOD-SHORT-NAME, options=coreLocal, section-type=CODE
    CODE: memory-allocation-keyword-policy=ADDR-METHOD-SHORT-NAME, section-type=CODE
    CODE_ASIL_A: memory-allocation-keyword-policy=ADDR-METHOD-SHORT-NAME, options=safetyAsilA, section-type=CODE
    CODE_ASIL_A_LOCAL: memory-allocation-keyword-policy=ADDR-METHOD-SHORT-NAME, options=[safetyAsilA, coreLocal], section-type=CODE
    CODE_ASIL_B: memory-allocation-keyword-policy=ADDR-METHOD-SHORT-NAME, options=safetyAsilB, section-type=CODE
    CODE_ASIL_B_LOCAL: memory-allocation-keyword-policy=ADDR-METHOD-SHORT-NAME, options=[safetyAsilB, coreLocal], section-type=CODE
    CODE_ASIL_C: memory-allocation-keyword-policy=ADDR-METHOD-SHORT-NAME, options=safetyAsilC, section-type=CODE
    CODE_ASIL_C_LOCAL: memory-allocation-keyword-policy=ADDR-METHOD-SHORT-NAME, options=[safetyAsilC, coreLocal], section-type=CODE
    CODE_ASIL_D: memory-allocation-keyword-policy=ADDR-METHOD-SHORT-NAME, options=safetyAsilD, section-type=CODE
    CODE_ASIL_D_LOCAL: memory-allocation-keyword-policy=ADDR-METHOD-SHORT-NAME, options=[safetyAsilD, coreLocal], section-type=CODE
    CODE_LOCAL: memory-allocation-keyword-policy=ADDR-METHOD-SHORT-NAME, options=coreLocal, section-type=CODE
    CONFIG_DATA: memory-allocation-keyword-policy=ADDR-METHOD-SHORT-NAME-AND-ALIGNMENT, section-type=CONFIG-DATA
    CONFIG_DATA_ASIL_A: memory-allocation-keyword-policy=ADDR-METHOD-SHORT-NAME-AND-ALIGNMENT, options=safetyAsilA, section-type=CONFIG-DATA
    CONFIG_DATA_ASIL_B: memory-allocation-keyword-policy=ADDR-METHOD-SHORT-NAME-AND-ALIGNMENT, options=safetyAsilB, section-type=CONFIG-DATA
    CONFIG_DATA_ASIL_C: memory-allocation-keyword-policy=ADDR-METHOD-SHORT-NAME-AND-ALIGNMENT, options=safetyAsilC, section-type=CONFIG-DATA
    CONFIG_DATA_ASIL_D: memory-allocation-keyword-policy=ADDR-METHOD-SHORT-NAME-AND-ALIGNMENT, options=safetyAsilD, section-type=CONFIG-DATA
    CONST: memory-allocation-keyword-policy=ADDR-METHOD-SHORT-NAME-AND-ALIGNMENT, section-type=CONST
    CONST_ASIL_A: memory-allocation-keyword-policy=ADDR-METHOD-SHORT-NAME-AND-ALIGNMENT, options=safetyAsilA, section-type=CONST
    CONST_ASIL_B: memory-allocation-keyword-policy=ADDR-METHOD-SHORT-NAME-AND-ALIGNMENT, options=safetyAsilB, section-type=CONST
    CONST_ASIL_C: memory-allocation-keyword-policy=ADDR-METHOD-SHORT-NAME-AND-ALIGNMENT, options=safetyAsilC, section-type=CONST
    CONST_ASIL_D: memory-allocation-keyword-policy=ADDR-METHOD-SHORT-NAME-AND-ALIGNMENT, options=safetyAsilD, section-type=CONST
    VAR: memory-allocation-keyword-policy=ADDR-METHOD-SHORT-NAME-AND-ALIGNMENT, section-initialization-policy=INIT, section-type=VAR
    VAR_CLEARED: memory-allocation-keyword-policy=ADDR-METHOD-SHORT-NAME-AND-ALIGNMENT, section-initialization-policy=CLEARED, section-type=VAR
    VAR_CLEARED_ASIL_A: memory-allocation-keyword-policy=ADDR-METHOD-SHORT-NAME-AND-ALIGNMENT, options=safetyAsilA, section-initialization-policy=CLEARED, section-type=VAR
    VAR_CLEARED_ASIL_A_LOCAL: memory-allocation-keyword-policy=ADDR-METHOD-SHORT-NAME-AND-ALIGNMENT, options=[safetyAsilA, coreLocal], section-initialization-policy=CLEARED, section-type=VAR
    VAR_CLEARED_ASIL_B: memory-allocation-keyword-policy=ADDR-METHOD-SHORT-NAME-AND-ALIGNMENT, options=safetyAsilB, section-initialization-policy=CLEARED, section-type=VAR
    VAR_CLEARED_ASIL_B_LOCAL: memory-allocation-keyword-policy=ADDR-METHOD-SHORT-NAME-AND-ALIGNMENT, options=[safetyAsilB, coreLocal], section-initialization-policy=CLEARED, section-type=VAR
    VAR_CLEARED_ASIL_C: memory-allocation-keyword-policy=ADDR-METHOD-SHORT-NAME-AND-ALIGNMENT, options=safetyAsilC, section-initialization-policy=CLEARED, section-type=VAR
    VAR_CLEARED_ASIL_C_LOCAL: memory-allocation-keyword-policy=ADDR-METHOD-SHORT-NAME-AND-ALIGNMENT, options=[safetyAsilC, coreLocal], section-initialization-policy=CLEARED, section-type=VAR
    VAR_CLEARED_ASIL_D: memory-allocation-keyword-policy=ADDR-METHOD-SHORT-NAME-AND-ALIGNMENT, options=safetyAsilD, section-initialization-policy=CLEARED, section-type=VAR
    VAR_CLEARED_ASIL_D_LOCAL: memory-allocation-keyword-policy=ADDR-METHOD-SHORT-NAME-AND-ALIGNMENT, options=[safetyAsilD, coreLocal], section-initialization-policy=CLEARED, section-type=VAR
    VAR_CLEARED_LOCAL: memory-allocation-keyword-policy=ADDR-METHOD-SHORT-NAME-AND-ALIGNMENT, options=coreLocal, section-initialization-policy=CLEARED, section-type=VAR
    VAR_FAST: memory-allocation-keyword-policy=ADDR-METHOD-SHORT-NAME-AND-ALIGNMENT, section-initialization-policy=INIT, section-type=VAR-FAST
    VAR_FAST_ASIL_A: memory-allocation-keyword-policy=ADDR-METHOD-SHORT-NAME-AND-ALIGNMENT, options=safetyAsilA, section-initialization-policy=INIT, section-type=VAR-FAST
    VAR_FAST_ASIL_A_LOCAL: memory-allocation-keyword-policy=ADDR-METHOD-SHORT-NAME-AND-ALIGNMENT, options=[safetyAsilA, coreLocal], section-initialization-policy=INIT, section-type=VAR-FAST
    VAR_FAST_ASIL_B: memory-allocation-keyword-policy=ADDR-METHOD-SHORT-NAME-AND-ALIGNMENT, options=safetyAsilB, section-initialization-policy=INIT, section-type=VAR-FAST
    VAR_FAST_ASIL_B_LOCAL: memory-allocation-keyword-policy=ADDR-METHOD-SHORT-NAME-AND-ALIGNMENT, options=[safetyAsilB, coreLocal], section-initialization-policy=INIT, section-type=VAR-FAST
    VAR_FAST_ASIL_C: memory-allocation-keyword-policy=ADDR-METHOD-SHORT-NAME-AND-ALIGNMENT, options=safetyAsilC, section-initialization-policy=INIT, section-type=VAR-FAST
    VAR_FAST_ASIL_C_LOCAL: memory-allocation-keyword-policy=ADDR-METHOD-SHORT-NAME-AND-ALIGNMENT, options=[safetyAsilC, coreLocal], section-initialization-policy=INIT, section-type=VAR-FAST
    VAR_FAST_ASIL_D: memory-allocation-keyword-policy=ADDR-METHOD-SHORT-NAME-AND-ALIGNMENT, options=safetyAsilD, section-initialization-policy=INIT, section-type=VAR-FAST
    VAR_FAST_ASIL_D_LOCAL: memory-allocation-keyword-policy=ADDR-METHOD-SHORT-NAME-AND-ALIGNMENT, options=[safetyAsilD, coreLocal], section-initialization-policy=INIT, section-type=VAR-FAST
    VAR_FAST_LOCAL: memory-allocation-keyword-policy=ADDR-METHOD-SHORT-NAME-AND-ALIGNMENT, options=coreLocal, section-initialization-policy=INIT, section-type=VAR-FAST
    VAR_INIT: memory-allocation-keyword-policy=ADDR-METHOD-SHORT-NAME-AND-ALIGNMENT, section-initialization-policy=INIT, section-type=VAR
    VAR_INIT_ASIL_A: memory-allocation-keyword-policy=ADDR-METHOD-SHORT-NAME-AND-ALIGNMENT, options=safetyAsilA, section-initialization-policy=INIT, section-type=VAR
    VAR_INIT_ASIL_A_LOCAL: memory-allocation-keyword-policy=ADDR-METHOD-SHORT-NAME-AND-ALIGNMENT, options=[safetyAsilA, coreLocal], section-initialization-policy=INIT, section-type=VAR
    VAR_INIT_ASIL_B: memory-allocation-keyword-policy=ADDR-METHOD-SHORT-NAME-AND-ALIGNMENT, options=safetyAsilB, section-initialization-policy=INIT, section-type=VAR
    VAR_INIT_ASIL_B_LOCAL: memory-allocation-keyword-policy=ADDR-METHOD-SHORT-NAME-AND-ALIGNMENT, options=[safetyAsilB, coreLocal], section-initialization-policy=INIT, section-type=VAR
    VAR_INIT_ASIL_C: memory-allocation-keyword-policy=ADDR-METHOD-SHORT-NAME-AND-ALIGNMENT, options=safetyAsilC, section-initialization-policy=INIT, section-type=VAR
    VAR_INIT_ASIL_C_LOCAL: memory-allocation-keyword-policy=ADDR-METHOD-SHORT-NAME-AND-ALIGNMENT, options=[safetyAsilC, coreLocal], section-initialization-policy=INIT, section-type=VAR
    VAR_INIT_ASIL_D: memory-allocation-keyword-policy=ADDR-METHOD-SHORT-NAME-AND-ALIGNMENT, options=safetyAsilD, section-initialization-policy=INIT, section-type=VAR
    VAR_INIT_ASIL_D_LOCAL: memory-allocation-keyword-policy=ADDR-METHOD-SHORT-NAME-AND-ALIGNMENT, options=[safetyAsilD, coreLocal], section-initialization-policy=INIT, section-type=VAR
    VAR_INIT_LOCAL: memory-allocation-keyword-policy=ADDR-METHOD-SHORT-NAME-AND-ALIGNMENT, options=coreLocal, section-initialization-policy=INIT, section-type=VAR
    VAR_NOINIT: memory-allocation-keyword-policy=ADDR-METHOD-SHORT-NAME-AND-ALIGNMENT, section-initialization-policy=NO-INIT, section-type=VAR
    VAR_NO_INIT: memory-allocation-keyword-policy=ADDR-METHOD-SHORT-NAME-AND-ALIGNMENT, section-initialization-policy=NO-INIT, section-type=VAR
    VAR_NO_INIT_ASIL_A: memory-allocation-keyword-policy=ADDR-METHOD-SHORT-NAME-AND-ALIGNMENT, options=safetyAsilA, section-initialization-policy=NO-INIT, section-type=VAR
    VAR_NO_INIT_ASIL_B: memory-allocation-keyword-policy=ADDR-METHOD-SHORT-NAME-AND-ALIGNMENT, options=safetyAsilB, section-initialization-policy=NO-INIT, section-type=VAR
    VAR_NO_INIT_ASIL_C: memory-allocation-keyword-policy=ADDR-METHOD-SHORT-NAME-AND-ALIGNMENT, options=safetyAsilC, section-initialization-policy=NO-INIT, section-type=VAR
    VAR_NO_INIT_ASIL_D: memory-allocation-keyword-policy=ADDR-METHOD-SHORT-NAME-AND-ALIGNMENT, options=safetyAsilD, section-initialization-policy=NO-INIT, section-type=VAR
    VAR_POWER_ON_CLEARED: memory-allocation-keyword-policy=ADDR-METHOD-SHORT-NAME-AND-ALIGNMENT, section-initialization-policy=POWER-ON-CLEARED, section-type=VAR
    VAR_POWER_ON_CLEARED_ASIL_A: memory-allocation-keyword-policy=ADDR-METHOD-SHORT-NAME-AND-ALIGNMENT, options=safetyAsilA, section-initialization-policy=POWER-ON-CLEARED, section-type=VAR
    VAR_POWER_ON_CLEARED_ASIL_B: memory-allocation-keyword-policy=ADDR-METHOD-SHORT-NAME-AND-ALIGNMENT, options=safetyAsilB, section-initialization-policy=POWER-ON-CLEARED, section-type=VAR
    VAR_POWER_ON_CLEARED_ASIL_C: memory-allocation-keyword-policy=ADDR-METHOD-SHORT-NAME-AND-ALIGNMENT, options=safetyAsilC, section-initialization-policy=POWER-ON-CLEARED, section-type=VAR
    VAR_POWER_ON_CLEARED_ASIL_D: memory-allocation-keyword-policy=ADDR-METHOD-SHORT-NAME-AND-ALIGNMENT, options=safetyAsilD, section-initialization-policy=POWER-ON-CLEARED, section-type=VAR
    VAR_POWER_ON_INIT: memory-allocation-keyword-policy=ADDR-METHOD-SHORT-NAME-AND-ALIGNMENT, section-initialization-policy=POWER-ON-INIT, section-type=VAR
    VAR_POWER_ON_INIT_ASIL_A: memory-allocation-keyword-policy=ADDR-METHOD-SHORT-NAME-AND-ALIGNMENT, options=safetyAsilA, section-initialization-policy=POWER-ON-INIT, section-type=VAR
    VAR_POWER_ON_INIT_ASIL_B: memory-allocation-keyword-policy=ADDR-METHOD-SHORT-NAME-AND-ALIGNMENT, options=safetyAsilB, section-initialization-policy=POWER-ON-INIT, section-type=VAR
    VAR_POWER_ON_INIT_ASIL_C: memory-allocation-keyword-policy=ADDR-METHOD-SHORT-NAME-AND-ALIGNMENT, options=safetyAsilC, section-initialization-policy=POWER-ON-INIT, section-type=VAR
    VAR_POWER_ON_INIT_ASIL_D: memory-allocation-keyword-policy=ADDR-METHOD-SHORT-NAME-AND-ALIGNMENT, options=safetyAsilD, section-initialization-policy=POWER-ON-INIT, section-type=VAR
    VAR_SAVED_ZONE: memory-allocation-keyword-policy=ADDR-METHOD-SHORT-NAME-AND-ALIGNMENT, section-initialization-policy=NO-INIT, section-type=VAR
    VAR_SAVED_ZONE_ASIL_A: memory-allocation-keyword-policy=ADDR-METHOD-SHORT-NAME-AND-ALIGNMENT, options=safetyAsilA, section-initialization-policy=NO-INIT, section-type=VAR
    VAR_SAVED_ZONE_ASIL_B: memory-allocation-keyword-policy=ADDR-METHOD-SHORT-NAME-AND-ALIGNMENT, options=safetyAsilB, section-initialization-policy=NO-INIT, section-type=VAR
    VAR_SAVED_ZONE_ASIL_C: memory-allocation-keyword-policy=ADDR-METHOD-SHORT-NAME-AND-ALIGNMENT, options=safetyAsilC, section-initialization-policy=NO-INIT, section-type=VAR
    VAR_SAVED_ZONE_ASIL_D: memory-allocation-keyword-policy=ADDR-METHOD-SHORT-NAME-AND-ALIGNMENT, options=safetyAsilD, section-initialization-policy=NO-INIT, section-type=VAR
package /AUTOSAR_Platform/ImplementationDataTypes
  impl type ConstVoidPtr: category=DATA_REFERENCE, sw-pointer-target-props={target-category=VALUE, base-type=void, sw-impl-policy=CONST}, type-emitter=BSW
  impl type VoidPtr: category=DATA_REFERENCE, sw-pointer-target-props={target-category=VALUE, base-type=void}, type-emitter=BSW
package /AUTOSAR_Std/ImplementationDataTypes
  impl type Std_MessageResultType: implementation-data-type=uint8, type-emitter=Std_Types.h
  impl type Std_MessageTypeType: implementation-data-type=uint8, type-emitter=Std_Types.h
  impl type Std_VersionInfoType: category=STRUCTURE, type-emitter=Std_Types.h
    5 x element, all with category=TYPE_REFERENCE:
      vendorID: implementation-data-type=uint16
      moduleID: implementation-data-type=uint16
      sw_major_version: implementation-data-type=uint8
      sw_minor_version: implementation-data-type=uint8
      sw_patch_version: implementation-data-type=uint8
