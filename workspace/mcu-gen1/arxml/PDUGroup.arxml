AUTOSAR XML (schema 4-3-0)
package /PduGroups
  4 x i signal i pdu group:
    MCU_B_R_CAN3_Tx: communication-direction=OUT, communication-mode=CAN_Transmit_All, i-signal-i-pdus=[CAN3_MCU_B_R1, CAN3_MCU_B_R2, CAN3_MCU_B_R_Debug1, CAN3_MCU_FVT_R1]
    MCU_B_R_CAN3_Rx: communication-direction=IN, communication-mode=CAN_Receive_All, i-signal-i-pdus=[CAN3_BMS1, CAN3_BMS6, CAN3_FD3_C100_0, CAN3_FD3_VCU1, CAN3_FD3_VCU2, CAN3_FD3_VCU5, CAN3_GW3_CE100_0]
    MCU_B_R_CAN_MCU_R1_Tx: communication-direction=OUT, communication-mode=CAN_Transmit_All, i-signal-i-pdus=CAN_MCU_R1_MCU_FVT_R_Local1
    MCU_B_R_CAN_MCU_R1_Rx: communication-direction=IN, communication-mode=CAN_Receive_All, i-signal-i-pdus=CAN_MCU_R1_EOP_FVT_R_Local1
