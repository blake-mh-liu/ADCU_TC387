AUTOSAR XML (schema 4-3-0)
package /SysEnv_ARPkg
  system System_MCU: category=SYSTEM_DESCRIPTION, system-version=1.0.0
    13 x system mapping:
      System_MCU
        sw-impl-mappings:
          swc to impl mapping SWC_APP_ImplMapping: component-implementation=Impl_SWC_APP_type, component=root_MCU.SWC_APP
          swc to impl mapping SWC_ETE_ImplMapping: component-implementation=Impl_SWC_ETE_type, component=root_MCU.SWC_ETE
        sw-mappings:
          swc to ecu mapping MCUMapping: component=[root_MCU.SWC_APP, root_MCU.SWC_ETE], ecu-instance=MCU
      MAP_P_CAN3_MCU_B_R1: sender-receiver-to-signal-group-mapping{communication-direction=OUT, data-element=SWC_APP.root_MCU.P_CAN3_MCU_B_R1.CAN3_SG_MCU_B_R1, signal-group=CAN3_SG_MCU_B_R1, type-mapping=sender-rec-record-type-mapping=record-element-mappings=[{implementation-record-element=CAN3_MCUWarn_R, system-signal=CAN3_MCUWarn_R}, {implementation-record-element=CAN3_Rr_TMiq, system-signal=CAN3_Rr_TMiq}, {implementation-record-element=CAN3_Rr_TMid, system-signal=CAN3_Rr_TMid}, {implementation-record-element=CAN3_Rr_TMTemp, system-signal=CAN3_Rr_TMTemp}, {implementation-record-element=CAN3_Rr_TMSpd, system-signal=CAN3_Rr_TMSpd}, {implementation-record-element=CAN3_Rr_Reserved_bits, system-signal=CAN3_Rr_Reserved_bits}, {implementation-record-element=CAN3_Rr_RegenAvailTq, system-signal=CAN3_Rr_RegenAvailTq}, {implementation-record-element=CAN3_Rr_MotorAvailTq, system-signal=CAN3_Rr_MotorAvailTq}, {implementation-record-element=CAN3_Rr_MCUTemp, system-signal=CAN3_Rr_MCUTemp}, {implementation-record-element=CAN3_Rr_MCUSysSta, system-signal=CAN3_Rr_MCUSysSta}, {implementation-record-element=CAN3_Rr_MCUReady4Pre, system-signal=CAN3_Rr_MCUReady4Pre}, {implementation-record-element=CAN3_Rr_MCUReady, system-signal=CAN3_Rr_MCUReady}, {implementation-record-element=CAN3_Rr_MCUIGN_sta, system-signal=CAN3_Rr_MCUIGN_sta}, {implementation-record-element=CAN3_Rr_MCUErr, system-signal=CAN3_Rr_MCUErr}, {implementation-record-element=CAN3_Rr_MCUEnaSta, system-signal=CAN3_Rr_MCUEnaSta}, {implementation-record-element=CAN3_Rr_MCUDischrgSta, system-signal=CAN3_Rr_MCUDischrgSta}, {implementation-record-element=CAN3_Rr_MCUDCBusVolt, system-signal=CAN3_Rr_MCUDCBusVolt}, {implementation-record-element=CAN3_Rr_MCUDCBusCurr, system-signal=CAN3_Rr_MCUDCBusCurr}, {implementation-record-element=CAN3_Rr_MCUBAT, system-signal=CAN3_Rr_MCUBAT}, {implementation-record-element=CAN3_Rr_MCU1RolCnt, system-signal=CAN3_Rr_MCU1RolCnt}, {implementation-record-element=CAN3_Rr_MCU1Chksum, system-signal=CAN3_Rr_MCU1Chksum}, {implementation-record-element=CAN3_Rr_EDUTqReqFbk, system-signal=CAN3_Rr_EDUTqReqFbk}, {implementation-record-element=CAN3_Rr_EDURotateDirction, system-signal=CAN3_Rr_EDURotateDirction}, {implementation-record-element=CAN3_Rr_EDURealTMTq, system-signal=CAN3_Rr_EDURealTMTq}, {implementation-record-element=CAN3_Rr_EDUOpratingSta, system-signal=CAN3_Rr_EDUOpratingSta}, {implementation-record-element=CAN3_Rr_EDUDrtSta, system-signal=CAN3_Rr_EDUDrtSta}, {implementation-record-element=CAN3_Rr_ActvDmpDisabSta, system-signal=CAN3_Rr_ActvDmpDisabSta}, {implementation-record-element=CAN3_MCU_B_R_RealPwrKw_Sta, system-signal=CAN3_MCU_B_R_RealPwrKw_Sta}, {implementation-record-element=CAN3_MCU_B_R_IGBTDdeTemp_Sta, system-signal=CAN3_MCU_B_R_IGBTDdeTemp_Sta}]}
      MAP_P_CAN3_MCU_B_R2: sender-receiver-to-signal-group-mapping{communication-direction=OUT, data-element=SWC_APP.root_MCU.P_CAN3_MCU_B_R2.CAN3_SG_MCU_B_R2, signal-group=CAN3_SG_MCU_B_R2, type-mapping=sender-rec-record-type-mapping=record-element-mappings=[{implementation-record-element=CAN3_MCU_B_R_FailLv_Sta, system-signal=CAN3_MCU_B_R_FailLv_Sta}, {implementation-record-element=CAN3_Rr_TMTempWarn, system-signal=CAN3_Rr_TMTempWarn}, {implementation-record-element=CAN3_Rr_MCUTempWarn, system-signal=CAN3_Rr_MCUTempWarn}, {implementation-record-element=CAN3_Rr_MCU3_SW_Ver, system-signal=CAN3_Rr_MCU3_SW_Ver}, {implementation-record-element=CAN3_Rr_MCU3_HW_Ver, system-signal=CAN3_Rr_MCU3_HW_Ver}, {implementation-record-element=CAN3_Rr_MCU2RolCnt, system-signal=CAN3_Rr_MCU2RolCnt}, {implementation-record-element=CAN3_Rr_MCU2Chksum, system-signal=CAN3_Rr_MCU2Chksum}, {implementation-record-element=CAN3_Rr_LLCflowReq, system-signal=CAN3_Rr_LLCflowReq}, {implementation-record-element=CAN3_Rr_LLCTemp, system-signal=CAN3_Rr_LLCTemp}, {implementation-record-element=CAN3_Rr_Failcodehistory2, system-signal=CAN3_Rr_Failcodehistory2}, {implementation-record-element=CAN3_Rr_Failcodehistory1, system-signal=CAN3_Rr_Failcodehistory1}, {implementation-record-element=CAN3_Rr_Failcode2, system-signal=CAN3_Rr_Failcode2}, {implementation-record-element=CAN3_Rr_Failcode1, system-signal=CAN3_Rr_Failcode1}, {implementation-record-element=CAN3_Rr_CoolanttempReq, system-signal=CAN3_Rr_CoolanttempReq}, {implementation-record-element=CAN3_MCU_B_R_LLCTempWarn_Sta, system-signal=CAN3_MCU_B_R_LLCTempWarn_Sta}, {implementation-record-element=CAN3_MCU_B_R_KL302TqCnt_Sta, system-signal=CAN3_MCU_B_R_KL302TqCnt_Sta}]}
      MAP_P_CAN3_MCU_FVT_R1: sender-receiver-to-signal-group-mapping{communication-direction=OUT, data-element=SWC_APP.root_MCU.P_CAN3_MCU_FVT_R1.CAN3_SG_MCU_FVT_R1, signal-group=CAN3_SG_MCU_FVT_R1, type-mapping=sender-rec-record-type-mapping=record-element-mappings=[{implementation-record-element=CAN3_MCU_FVT_R_BoostOP_Sta, system-signal=CAN3_MCU_FVT_R_BoostOP_Sta}, {implementation-record-element=CAN3_MCU_FVT_R_TMSpd_Sta, system-signal=CAN3_MCU_FVT_R_TMSpd_Sta}, {implementation-record-element=CAN3_MCU_FVT_R_OilTemp_Sta, system-signal=CAN3_MCU_FVT_R_OilTemp_Sta}, {implementation-record-element=CAN3_MCU_FVT_R_MCUSys_Sta, system-signal=CAN3_MCU_FVT_R_MCUSys_Sta}, {implementation-record-element=CAN3_MCU_FVT_R_MCUErr_Sta, system-signal=CAN3_MCU_FVT_R_MCUErr_Sta}, {implementation-record-element=CAN3_MCU_FVT_R_MCUBAT_Sta, system-signal=CAN3_MCU_FVT_R_MCUBAT_Sta}, {implementation-record-element=CAN3_MCU_FVT_R_HeatingOP_Sta, system-signal=CAN3_MCU_FVT_R_HeatingOP_Sta}, {implementation-record-element=CAN3_MCU_FVT_R_Failcode3_Sta, system-signal=CAN3_MCU_FVT_R_Failcode3_Sta}, {implementation-record-element=CAN3_MCU_FVT_R_EDUTqReq_Fbk, system-signal=CAN3_MCU_FVT_R_EDUTqReq_Fbk}]}
      MAP_P_CAN_MCU_R1_MCU_FVT_R_Local1: sender-receiver-to-signal-group-mapping{communication-direction=OUT, data-element=SWC_APP.root_MCU.P_CAN_MCU_R1_MCU_FVT_R_Local1.CAN_MCU_R1_SG_MCU_FVT_R_Local1, signal-group=CAN_MCU_R1_SG_MCU_FVT_R_Local1, type-mapping=sender-rec-record-type-mapping=record-element-mappings=[{implementation-record-element=CAN_MCU_R1_MCU_FVT_R_Local1_CS_Sta, system-signal=CAN_MCU_R1_MCU_FVT_R_Local1_CS_Sta}, {implementation-record-element=CAN_MCU_R1_MCU_FVT_R_OilPmpTarSpd_Req, system-signal=CAN_MCU_R1_MCU_FVT_R_OilPmpTarSpd_Req}, {implementation-record-element=CAN_MCU_R1_MCU_FVT_R_OPCStartOn_Req, system-signal=CAN_MCU_R1_MCU_FVT_R_OPCStartOn_Req}, {implementation-record-element=CAN_MCU_R1_MCU_FVT_R_Local1_RC_Sta, system-signal=CAN_MCU_R1_MCU_FVT_R_Local1_RC_Sta}]}
      MAP_R_CAN3_BMS1: sender-receiver-to-signal-group-mapping{communication-direction=IN, data-element=SWC_APP.root_MCU.R_CAN3_BMS1.CAN3_SG_BMS1, signal-group=CAN3_SG_BMS1, type-mapping=sender-rec-record-type-mapping=sender-rec-record-element-mapping{implementation-record-element=CAN3_HVBattVolt, system-signal=CAN3_HVBattVolt}}
      MAP_R_CAN3_BMS6: sender-receiver-to-signal-group-mapping{communication-direction=IN, data-element=SWC_APP.root_MCU.R_CAN3_BMS6.CAN3_SG_BMS6, signal-group=CAN3_SG_BMS6, type-mapping=sender-rec-record-type-mapping=sender-rec-record-element-mapping{implementation-record-element=CAN3_HVBContactorSta, system-signal=CAN3_HVBContactorSta}}
      MAP_R_CAN3_FD3_C100_0: sender-receiver-to-signal-group-mapping{communication-direction=IN, data-element=SWC_APP.root_MCU.R_CAN3_FD3_C100_0.CAN3_SG_FD3_C100_0, signal-group=CAN3_SG_FD3_C100_0, type-mapping=sender-rec-record-type-mapping=record-element-mappings=[{implementation-record-element=CAN3_BatteryMode, system-signal=CAN3_BatteryMode}, {implementation-record-element=CAN3_Rr_Coolanttemp, system-signal=CAN3_Rr_Coolanttemp}, {implementation-record-element=CAN3_Rr_Coolantflow, system-signal=CAN3_Rr_Coolantflow}]}
      MAP_R_CAN3_FD3_VCU1: sender-receiver-to-signal-group-mapping{communication-direction=IN, data-element=SWC_APP.root_MCU.R_CAN3_FD3_VCU1.CAN3_SG_FD3_VCU1, signal-group=CAN3_SG_FD3_VCU1, type-mapping=sender-rec-record-type-mapping=record-element-mappings=[{implementation-record-element=CAN3_ActiveDischReq, system-signal=CAN3_ActiveDischReq}, {implementation-record-element=CAN3_ShiftGearPosn, system-signal=CAN3_ShiftGearPosn}, {implementation-record-element=CAN3_RC_VCU1, system-signal=CAN3_RC_VCU1}, {implementation-record-element=CAN3_PwrSta, system-signal=CAN3_PwrSta}, {implementation-record-element=CAN3_CS_VCU1, system-signal=CAN3_CS_VCU1}]}
      MAP_R_CAN3_FD3_VCU2: sender-receiver-to-signal-group-mapping{communication-direction=IN, data-element=SWC_APP.root_MCU.R_CAN3_FD3_VCU2.CAN3_SG_FD3_VCU2, signal-group=CAN3_SG_FD3_VCU2, type-mapping=sender-rec-record-type-mapping=record-element-mappings=[{implementation-record-element=CAN3_CS_VCU2_CAN1, system-signal=CAN3_CS_VCU2_CAN1}, {implementation-record-element=CAN3_Rr_UdcMin, system-signal=CAN3_Rr_UdcMin}, {implementation-record-element=CAN3_Rr_UdcMax, system-signal=CAN3_Rr_UdcMax}, {implementation-record-element=CAN3_Rr_TorqMin, system-signal=CAN3_Rr_TorqMin}, {implementation-record-element=CAN3_Rr_TorqMax, system-signal=CAN3_Rr_TorqMax}, {implementation-record-element=CAN3_Rr_TMTqReq, system-signal=CAN3_Rr_TMTqReq}, {implementation-record-element=CAN3_Rr_MCUEnaReq, system-signal=CAN3_Rr_MCUEnaReq}, {implementation-record-element=CAN3_Rr_IdcMin, system-signal=CAN3_Rr_IdcMin}, {implementation-record-element=CAN3_Rr_IdcMax, system-signal=CAN3_Rr_IdcMax}, {implementation-record-element=CAN3_Rr_ActvDmpDisabReq, system-signal=CAN3_Rr_ActvDmpDisabReq}, {implementation-record-element=CAN3_RC_VCU2_CAN1, system-signal=CAN3_RC_VCU2_CAN1}]}
      MAP_R_CAN3_FD3_VCU5: sender-receiver-to-signal-group-mapping{communication-direction=IN, data-element=SWC_APP.root_MCU.R_CAN3_FD3_VCU5.CAN3_SG_FD3_VCU5, signal-group=CAN3_SG_FD3_VCU5, type-mapping=sender-rec-record-type-mapping=record-element-mappings=[{implementation-record-element=CAN3_FDC_VCU_RrSpdMax_Req, system-signal=CAN3_FDC_VCU_RrSpdMax_Req}, {implementation-record-element=CAN3_FDC_VCU_RrTqMin_Req, system-signal=CAN3_FDC_VCU_RrTqMin_Req}, {implementation-record-element=CAN3_FDC_VCU_RrTqMax_Req, system-signal=CAN3_FDC_VCU_RrTqMax_Req}, {implementation-record-element=CAN3_FDC_VCU_RrTMTq_Req, system-signal=CAN3_FDC_VCU_RrTMTq_Req}, {implementation-record-element=CAN3_FDC_VCU_RrTMSpd_Req, system-signal=CAN3_FDC_VCU_RrTMSpd_Req}, {implementation-record-element=CAN3_FDC_VCU_RrTMCtrlMode_Req, system-signal=CAN3_FDC_VCU_RrTMCtrlMode_Req}, {implementation-record-element=CAN3_FDC_VCU_RrSpdMin_Req, system-signal=CAN3_FDC_VCU_RrSpdMin_Req}]}
      MAP_R_CAN3_GW3_CE100_0: sender-receiver-to-signal-group-mapping{communication-direction=IN, data-element=SWC_APP.root_MCU.R_CAN3_GW3_CE100_0.CAN3_SG_GW3_CE100_0, signal-group=CAN3_SG_GW3_CE100_0, type-mapping=sender-rec-record-type-mapping=record-element-mappings=[{implementation-record-element=CAN3_IVI_Time_Day, system-signal=CAN3_IVI_Time_Day}, {implementation-record-element=CAN3_VehSpeed, system-signal=CAN3_VehSpeed}, {implementation-record-element=CAN3_IVI_Time_Second, system-signal=CAN3_IVI_Time_Second}, {implementation-record-element=CAN3_IVI_Time_Month, system-signal=CAN3_IVI_Time_Month}, {implementation-record-element=CAN3_IVI_Time_Minute, system-signal=CAN3_IVI_Time_Minute}, {implementation-record-element=CAN3_IVI_Time_Hour, system-signal=CAN3_IVI_Time_Hour}]}
      MAP_R_CAN_MCU_R1_EOP_FVT_R_Local1: sender-receiver-to-signal-group-mapping{communication-direction=IN, data-element=SWC_APP.root_MCU.R_CAN_MCU_R1_EOP_FVT_R_Local1.CAN_MCU_R1_SG_EOP_FVT_R_Local1, signal-group=CAN_MCU_R1_SG_EOP_FVT_R_Local1, type-mapping=sender-rec-record-type-mapping=record-element-mappings=[{implementation-record-element=CAN_MCU_R1_EOP_FVT_R_ActualSpd_Sta, system-signal=CAN_MCU_R1_EOP_FVT_R_ActualSpd_Sta}, {implementation-record-element=CAN_MCU_R1_EOP_FVT_R_UnderVol_Sta, system-signal=CAN_MCU_R1_EOP_FVT_R_UnderVol_Sta}, {implementation-record-element=CAN_MCU_R1_EOP_FVT_R_StartFailure_Sta, system-signal=CAN_MCU_R1_EOP_FVT_R_StartFailure_Sta}, {implementation-record-element=CAN_MCU_R1_EOP_FVT_R_RunStatus_Sta, system-signal=CAN_MCU_R1_EOP_FVT_R_RunStatus_Sta}, {implementation-record-element=CAN_MCU_R1_EOP_FVT_R_RCInvalid_Sta, system-signal=CAN_MCU_R1_EOP_FVT_R_RCInvalid_Sta}, {implementation-record-element=CAN_MCU_R1_EOP_FVT_R_PumpReady_Sta, system-signal=CAN_MCU_R1_EOP_FVT_R_PumpReady_Sta}, {implementation-record-element=CAN_MCU_R1_EOP_FVT_R_OverVol_Sta, system-signal=CAN_MCU_R1_EOP_FVT_R_OverVol_Sta}, {implementation-record-element=CAN_MCU_R1_EOP_FVT_R_OverTemp_Sta, system-signal=CAN_MCU_R1_EOP_FVT_R_OverTemp_Sta}, {implementation-record-element=CAN_MCU_R1_EOP_FVT_R_OverTempBCK_Sta, system-signal=CAN_MCU_R1_EOP_FVT_R_OverTempBCK_Sta}, {implementation-record-element=CAN_MCU_R1_EOP_FVT_R_Local1_RC_Sta, system-signal=CAN_MCU_R1_EOP_FVT_R_Local1_RC_Sta}, {implementation-record-element=CAN_MCU_R1_EOP_FVT_R_Local1_CS_Sta, system-signal=CAN_MCU_R1_EOP_FVT_R_Local1_CS_Sta}, {implementation-record-element=CAN_MCU_R1_EOP_FVT_R_HallSigErr_Sta, system-signal=CAN_MCU_R1_EOP_FVT_R_HallSigErr_Sta}, {implementation-record-element=CAN_MCU_R1_EOP_FVT_R_EnableOff_Sta, system-signal=CAN_MCU_R1_EOP_FVT_R_EnableOff_Sta}, {implementation-record-element=CAN_MCU_R1_EOP_FVT_R_CanLoss_Sta, system-signal=CAN_MCU_R1_EOP_FVT_R_CanLoss_Sta}, {implementation-record-element=CAN_MCU_R1_EOP_FVT_R_CSInvalid_Sta, system-signal=CAN_MCU_R1_EOP_FVT_R_CSInvalid_Sta}]}
    root-software-compositions:
      root sw composition prototype root_MCU: flat-map=root_MCU_FlatMap, software-composition=Comp_MCU_main
  flat map root_MCU_FlatMap
    flat instance descriptor FlatIns_MCU: upstream-reference=root_MCU.SWC_APP, ecu-extract-reference=root_MCU.SWC_APP
